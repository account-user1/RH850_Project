AUTOSAR XML (schema 4-0-3)
standard types defined: float32_DataConstr, float64_DataConstr, sint16_DataConstr, sint32_DataConstr, sint8_DataConstr, uint16_DataConstr, uint32_DataConstr, uint8_DataConstr, boolean, float32, float64, sint16, sint32, sint8, uint16, uint32, uint8
package /Nexteer/DataTypes
  20 x impl type, all with type-emitter=RTE:
    Ary1D_s11p4_14: category=ARRAY, sw-calibration-access=READ-ONLY
      element Element: array-size=14, array-size-semantics=FIXED-SIZE, implementation-data-type=s11p4
    Ary1D_u12p4_16: category=ARRAY, sw-calibration-access=READ-ONLY
      element Element: array-size=16, array-size-semantics=FIXED-SIZE, implementation-data-type=u12p4
    Ary1D_u5p11_16: category=ARRAY, sw-calibration-access=READ-ONLY
      element Element: array-size=16, array-size-semantics=FIXED-SIZE, implementation-data-type=u5p11
    Ary1D_u7p9_4: category=ARRAY, sw-calibration-access=READ-ONLY
      element Element: array-size=4, array-size-semantics=FIXED-SIZE, implementation-data-type=u7p9
    Ary1D_u8p8_14: category=ARRAY, sw-calibration-access=READ-ONLY
      element Element: array-size=14, array-size-semantics=FIXED-SIZE, implementation-data-type=u8p8
    Ary1D_u8p8_4: category=ARRAY, sw-calibration-access=READ-ONLY
      element Element: array-size=4, array-size-semantics=FIXED-SIZE, implementation-data-type=u8p8
    Ary1D_u8p8_8: category=ARRAY, sw-calibration-access=READ-ONLY
      element Element: array-size=8, array-size-semantics=FIXED-SIZE, implementation-data-type=u8p8
    Ary1D_u9p7_4: category=ARRAY, sw-calibration-access=READ-ONLY
      element Element: array-size=4, array-size-semantics=FIXED-SIZE, implementation-data-type=u9p7
    Ary1D_u9p7_9: category=ARRAY, sw-calibration-access=READ-ONLY
      element Element: array-size=9, array-size-semantics=FIXED-SIZE, implementation-data-type=u9p7
    Ary2D_u12p4_9_16: category=ARRAY, sw-calibration-access=READ-ONLY
      element Element: array-size=9, array-size-semantics=FIXED-SIZE, implementation-data-type=Ary1D_u12p4_16
    Ary2D_u5p11_9_16: category=ARRAY, sw-calibration-access=READ-ONLY
      element Element: array-size=9, array-size-semantics=FIXED-SIZE, implementation-data-type=Ary1D_u5p11_16
    Ary2D_u7p9_9_4: category=ARRAY, sw-calibration-access=READ-ONLY
      element Element: array-size=9, array-size-semantics=FIXED-SIZE, implementation-data-type=Ary1D_u7p9_4
    Ary2D_u8p8_9_4: category=ARRAY, sw-calibration-access=READ-ONLY
      element Element: array-size=9, array-size-semantics=FIXED-SIZE, implementation-data-type=Ary1D_u8p8_4
    Ary2D_u8p8_9_8: category=ARRAY, sw-calibration-access=READ-ONLY
      element Element: array-size=9, array-size-semantics=FIXED-SIZE, implementation-data-type=Ary1D_u8p8_8
    s11p4: implementation-data-type=sint16
    u12p4: implementation-data-type=uint16
    u5p11: implementation-data-type=uint16
    u7p9: implementation-data-type=uint16
    u8p8: implementation-data-type=uint16
    u9p7: implementation-data-type=uint16
