AUTOSAR XML (schema 4-0-3)
standard types defined: boolean, float32, sint16, sint8, uint16, uint32, uint8, boolean_CompuMethod, boolean_DataConstr, float32_DataConstr, sint16_DataConstr, sint8_DataConstr, uint16_DataConstr, uint32_DataConstr, uint8_DataConstr, Boolean, dtRef_const_VOID, dtRef_VOID
package /Nexteer/DataTypes
  7 x impl type, all with type-emitter=RTE:
    Ary1D_s16_22: category=ARRAY, sw-calibration-access=READ-ONLY
      element Element: array-size=22, array-size-semantics=FIXED-SIZE, implementation-data-type=sint16
    Ary1D_u08_22: category=ARRAY, sw-calibration-access=READ-ONLY
      element Element: array-size=22, array-size-semantics=FIXED-SIZE, implementation-data-type=uint8
    HwAgOffsRec1: category=STRUCTURE, sw-calibration-access=READ-ONLY
      element OffsTrim: implementation-data-type=float32
      element OffsTrimPrfmdSts: implementation-data-type=boolean
    HwAgSnsrTyp1: compu {0=HWAGSNSRTYP_NOSNSR, 1=HWAGSNSRTYP_A1335}, implementation-data-type=uint8
    NtcNr1: compu {1..511=NTCNR_0X001..NTCNR_0X1FF}, implementation-data-type=uint16
    NtcSts1: compu {0=NTCSTS_PASSD, 1=NTCSTS_FAILD, 2=NTCSTS_PREPASSD, 3=NTCSTS_PREFAILD}, implementation-data-type=uint8
    SigQlfr1: compu {0=SIGQLFR_NORES, 1=SIGQLFR_PASSD, 2=SIGQLFR_FAILD}, implementation-data-type=uint8
package /Nexteer/NvMProxy_swc/DataTypes
  impl type NvM_RequestResultType: category=VALUE, base-type=NvM_RequestResultType, compu {0=NVM_REQ_OK, 1=NVM_REQ_NOT_OK, 2=NVM_REQ_PENDING, 3=NVM_REQ_INTEGRITY_FAILED, 4=NVM_REQ_BLOCK_SKIPPED, 5=NVM_REQ_NV_INVALIDATED, 6=NVM_REQ_CANCELED, 7=NVM_REQ_REDUNDANCY_FAILED, 8=NVM_REQ_RESTORED_FROM_ROM}
package /Nexteer/NvMProxy_swc/DataTypes/BaseTypes
  base type NvM_RequestResultType: category=FIXED_LENGTH, base-type-size=8, base-type-encoding=NONE, native-declaration=uint8
