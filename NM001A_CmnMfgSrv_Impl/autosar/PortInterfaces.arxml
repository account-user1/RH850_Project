AUTOSAR XML (schema 4-0-3)
package /Nexteer/Calibrations
  parameter interface uint16_CalPortIf1
    parameter data prototype Val: sw-calibration-access=READ-WRITE, type=uint16
  parameter interface uint8_CalPortIf1
    parameter data prototype Val: sw-calibration-access=READ-WRITE, type=uint8
package /Nexteer/NvMProxy_swc/Interfaces
  client server interface NvMService_AC3_SRBS: is-service=true
    6 x operation, all with possible-error=NvMService_AC3_SRBS/E_NOT_OK:
      EraseBlock
      GetErrorStatus
        arg ErrorStatus: type=NvM_RequestResultType, direction=OUT, server-argument-impl-policy=USE-ARGUMENT-TYPE
      InvalidateNvBlock
      ReadBlock
        arg DstPtr: type=dtRef_VOID, direction=IN, server-argument-impl-policy=USE-ARGUMENT-TYPE
      SetRamBlockStatus
        arg RamBlockStatus: type=Boolean, direction=IN, server-argument-impl-policy=USE-ARGUMENT-TYPE
      WriteBlock
        arg SrcPtr: type=dtRef_const_VOID, direction=IN, server-argument-impl-policy=USE-ARGUMENT-TYPE
    error E_NOT_OK: error-code=1
  client server interface NvMService_AC3_SRBS_Defs: is-service=true
    7 x operation, all with possible-error=NvMService_AC3_SRBS_Defs/E_NOT_OK:
      EraseBlock
      GetErrorStatus
        arg ErrorStatus: type=NvM_RequestResultType, direction=OUT, server-argument-impl-policy=USE-ARGUMENT-TYPE
      InvalidateNvBlock
      ReadBlock
        arg DstPtr: type=dtRef_VOID, direction=IN, server-argument-impl-policy=USE-ARGUMENT-TYPE
      RestoreBlockDefaults
        arg DstPtr: type=dtRef_VOID, direction=IN, server-argument-impl-policy=USE-ARGUMENT-TYPE
      SetRamBlockStatus
        arg RamBlockStatus: type=Boolean, direction=IN, server-argument-impl-policy=USE-ARGUMENT-TYPE
      WriteBlock
        arg SrcPtr: type=dtRef_const_VOID, direction=IN, server-argument-impl-policy=USE-ARGUMENT-TYPE
    error E_NOT_OK: error-code=1
package /Nexteer/PortInterfaces
  133 x client server interface:
    ClrAllDiagc_PortIf1
      operation Oper
    ClrFricLrngOperMod_PortIf1
      operation Oper
    ClrHwAgTrimVal_PortIf1
      operation Oper
    ClrLtchCntrData_PortIf1
      operation Oper
    ClrSnpshtData_PortIf1
      operation Oper
    CurrMeasEolGainReq_PortIf1
      operation Oper
    CurrMeasEolGainStReq_PortIf1
      operation Oper
        arg CurrMeasEolGainSt_Arg: type=uint8, direction=OUT, server-argument-impl-policy=USE-ARGUMENT-TYPE
    CurrMeasEolOffsReq_PortIf1
      operation Oper
    CurrMeasEolOffsStReq_PortIf1
      operation Oper
        arg CurrMeasEolOffsSt_Arg: type=uint8, direction=OUT, server-argument-impl-policy=USE-ARGUMENT-TYPE
    CurrMeasGainReadReq_PortIf1
      operation Oper
        6 x arg, all with type=float32, direction=OUT, server-argument-impl-policy=USE-ARGUMENT-TYPE:
          CurrMeasMotCurrGainA_Arg
          CurrMeasMotCurrGainB_Arg
          CurrMeasMotCurrGainC_Arg
          CurrMeasMotCurrGainD_Arg
          CurrMeasMotCurrGainE_Arg
          CurrMeasMotCurrGainF_Arg
    CurrMeasGainReadReqSngIvtr_PortIf1
      operation Oper
        arg CurrMeasMotCurrGainA_Arg: type=float32, direction=OUT, server-argument-impl-policy=USE-ARGUMENT-TYPE
        arg CurrMeasMotCurrGainB_Arg: type=float32, direction=OUT, server-argument-impl-policy=USE-ARGUMENT-TYPE
        arg CurrMeasMotCurrGainC_Arg: type=float32, direction=OUT, server-argument-impl-policy=USE-ARGUMENT-TYPE
    CurrMeasGainWrReq_PortIf2
      operation Oper
        7 x arg, all with server-argument-impl-policy=USE-ARGUMENT-TYPE:
          CurrMeasMotCurrGainA_Arg: type=float32, direction=IN
          CurrMeasMotCurrGainB_Arg: type=float32, direction=IN
          CurrMeasMotCurrGainC_Arg: type=float32, direction=IN
          CurrMeasMotCurrGainD_Arg: type=float32, direction=IN
          CurrMeasMotCurrGainE_Arg: type=float32, direction=IN
          CurrMeasMotCurrGainF_Arg: type=float32, direction=IN
          CurrMeasGainWrReqSts_Arg: type=uint8, direction=OUT
    CurrMeasGainWrReqSngIvtr_PortIf1
      operation Oper
        4 x arg, all with server-argument-impl-policy=USE-ARGUMENT-TYPE:
          CurrMeasMotCurrGainA_Arg: type=float32, direction=IN
          CurrMeasMotCurrGainB_Arg: type=float32, direction=IN
          CurrMeasMotCurrGainC_Arg: type=float32, direction=IN
          CurrMeasGainWrReqSts_Arg: type=uint8, direction=OUT
    CurrMeasOffsReadReq_PortIf2
      operation Oper
        13 x arg, all with type=float32, direction=OUT, server-argument-impl-policy=USE-ARGUMENT-TYPE:
          CurrMeasEolOffsHiBrdgVltg_Arg
          CurrMeasMotCurrOffsDifA_Arg
          CurrMeasMotCurrOffsDifB_Arg
          CurrMeasMotCurrOffsDifC_Arg
          CurrMeasMotCurrOffsDifD_Arg
          CurrMeasMotCurrOffsDifE_Arg
          CurrMeasMotCurrOffsDifF_Arg
          CurrMeasMotCurrOffsLoAvrgA_Arg
          CurrMeasMotCurrOffsLoAvrgB_Arg
          CurrMeasMotCurrOffsLoAvrgC_Arg
          CurrMeasMotCurrOffsLoAvrgD_Arg
          CurrMeasMotCurrOffsLoAvrgE_Arg
          CurrMeasMotCurrOffsLoAvrgF_Arg
    CurrMeasOffsReadReqSngIvtr_PortIf1
      operation Oper
        7 x arg, all with type=float32, direction=OUT, server-argument-impl-policy=USE-ARGUMENT-TYPE:
          CurrMeasEolOffsHiBrdgVltg_Arg
          CurrMeasMotCurrOffsDifA_Arg
          CurrMeasMotCurrOffsDifB_Arg
          CurrMeasMotCurrOffsDifC_Arg
          CurrMeasMotCurrOffsLoAvrgA_Arg
          CurrMeasMotCurrOffsLoAvrgB_Arg
          CurrMeasMotCurrOffsLoAvrgC_Arg
    CurrMeasOffsWrReq_PortIf3
      operation Oper
        14 x arg, all with server-argument-impl-policy=USE-ARGUMENT-TYPE:
          CurrMeasEolOffsHiBrdgVltg_Arg: type=float32, direction=IN
          CurrMeasMotCurrOffsDifA_Arg: type=float32, direction=IN
          CurrMeasMotCurrOffsDifB_Arg: type=float32, direction=IN
          CurrMeasMotCurrOffsDifC_Arg: type=float32, direction=IN
          CurrMeasMotCurrOffsDifD_Arg: type=float32, direction=IN
          CurrMeasMotCurrOffsDifE_Arg: type=float32, direction=IN
          CurrMeasMotCurrOffsDifF_Arg: type=float32, direction=IN
          CurrMeasMotCurrOffsLoAvrgA_Arg: type=float32, direction=IN
          CurrMeasMotCurrOffsLoAvrgB_Arg: type=float32, direction=IN
          CurrMeasMotCurrOffsLoAvrgC_Arg: type=float32, direction=IN
          CurrMeasMotCurrOffsLoAvrgD_Arg: type=float32, direction=IN
          CurrMeasMotCurrOffsLoAvrgE_Arg: type=float32, direction=IN
          CurrMeasMotCurrOffsLoAvrgF_Arg: type=float32, direction=IN
          CurrMeasOffsWrReqSts_Arg: type=uint8, direction=OUT
    CurrMeasOffsWrReqSngIvtr_PortIf1
      operation Oper
        8 x arg, all with server-argument-impl-policy=USE-ARGUMENT-TYPE:
          CurrMeasEolOffsHiBrdgVltg_Arg: type=float32, direction=IN
          CurrMeasMotCurrOffsDifA_Arg: type=float32, direction=IN
          CurrMeasMotCurrOffsDifB_Arg: type=float32, direction=IN
          CurrMeasMotCurrOffsDifC_Arg: type=float32, direction=IN
          CurrMeasMotCurrOffsLoAvrgA_Arg: type=float32, direction=IN
          CurrMeasMotCurrOffsLoAvrgB_Arg: type=float32, direction=IN
          CurrMeasMotCurrOffsLoAvrgC_Arg: type=float32, direction=IN
          CurrMeasOffsWrReqSts_Arg: type=uint8, direction=OUT
    FSnsrlsHwCentr_PortIf1
      operation Oper
    GetCtrlPrm_PortIf1
      operation Oper
        7 x arg, all with type=float32, direction=OUT, server-argument-impl-policy=USE-ARGUMENT-TYPE:
          MotVelCtrlPropGain_Arg
          MotVelCtrlIntgtrGain_Arg
          MotVelCtrlDerivtvGain_Arg
          MotVelCtrlAntiWdupLim_Arg
          MotVelCtrlAntiWdupGain_Arg
          MotVelCtrlDerivtvLpFilTiCon_Arg
          MotVelCtrlTqCmdLim_Arg
    GetFricData_PortIf3
      operation Oper
        5 x arg, all with direction=OUT, server-argument-impl-policy=USE-ARGUMENT-TYPE:
          FricOffs_Arg: type=float32
          BasLineFric_Arg: type=Ary1D_f32_4
          VehLrndFric_Arg: type=Ary1D_f32_4
          Hys_Arg: type=Ary2D_f32_8_4
          RngCntr_Arg: type=Ary2D_u16_8_3
    GetFricLrngData_PortIf1
      operation Oper
        4 x arg, all with direction=OUT, server-argument-impl-policy=USE-ARGUMENT-TYPE:
          FricLrngEna_Arg: type=boolean
          FricLrngOffsOutpEna_Arg: type=boolean
          FricLrngOperMod_Arg: type=SysFricLrngOperMod1
          EolFric_Arg: type=float32
    GetFricOffsOutpDi_PortIf1
      operation Oper
        arg FricOffsOutpDi_Arg: type=boolean, direction=OUT, server-argument-impl-policy=USE-ARGUMENT-TYPE
    GetGearIdn_PortIf1
      operation Oper
        arg GearIdn_Arg: type=uint8, direction=OUT, server-argument-impl-policy=USE-ARGUMENT-TYPE
    GetHwAgOffs_PortIf1
      operation Oper
        arg HwAgOffs_Arg: type=float32, direction=OUT, server-argument-impl-policy=USE-ARGUMENT-TYPE
        arg HwAgLrngStRst_Arg: type=boolean, direction=OUT, server-argument-impl-policy=USE-ARGUMENT-TYPE
    GetHwAgOverTrvlCnt_PortIf2
      operation Oper
        arg HwAgOverTrvlCnt_Arg: type=uint8, direction=OUT, server-argument-impl-policy=USE-ARGUMENT-TYPE
    GetHwAgTrimVal_PortIf2
      operation Oper
        arg HwAgTrimVal_Arg: type=float32, direction=OUT, server-argument-impl-policy=USE-ARGUMENT-TYPE
        arg HwAgTrimPrfmd_Arg: type=boolean, direction=OUT, server-argument-impl-policy=USE-ARGUMENT-TYPE
    GetHwTqOffs_PortIf1
      operation Oper
        arg HwTqOffs_Arg: type=float32, direction=OUT, server-argument-impl-policy=USE-ARGUMENT-TYPE
        arg HwTqLrngStRst_Arg: type=boolean, direction=OUT, server-argument-impl-policy=USE-ARGUMENT-TYPE
    GetMotCoggCmdPrm_PortIf1
      operation Oper
        arg MotCoggCmdY_Arg: type=Ary1D_s1p14_128, direction=OUT, server-argument-impl-policy=USE-ARGUMENT-TYPE
        arg Idx_Arg: type=uint8, direction=IN, server-argument-impl-policy=USE-ARGUMENT-TYPE
    GetMotPrmNomEol1  # OBSELETE
      operation Oper: possible-error=GetMotPrmNomEol1/E_NOT_OK
        arg MotKeNom: type=MotCon1, direction=OUT, server-argument-impl-policy=USE-ARGUMENT-TYPE
        arg MotRNom: type=R6, direction=OUT, server-argument-impl-policy=USE-ARGUMENT-TYPE
      error E_NOT_OK: error-code=1
    GetMotRplCoggPrm_PortIf1
      operation Oper
        9 x arg, all with direction=OUT, server-argument-impl-policy=USE-ARGUMENT-TYPE:
          CoggOrder1_Arg: type=uint16
          CoggOrder1X_Arg: type=s1p14
          CoggOrder1Y_Arg: type=s1p14
          CoggOrder2_Arg: type=uint16
          CoggOrder2X_Arg: type=s1p14
          CoggOrder2Y_Arg: type=s1p14
          CoggOrder3_Arg: type=uint16
          CoggOrder3X_Arg: type=s1p14
          CoggOrder3Y_Arg: type=s1p14
    GetMotTqCmdSca_PortIf1
      operation Oper
        arg MotTqCmdSca_Arg: type=float32, direction=OUT, server-argument-impl-policy=USE-ARGUMENT-TYPE
    GetNtcSts_PortIf1
      operation Oper: possible-error=GetNtcSts_PortIf1/E_NOT_OK
        arg NtcNr_Arg: type=NtcNr1, direction=IN, server-argument-impl-policy=USE-ARGUMENT-TYPE
        arg NtcInfoSts_Arg: type=uint8, direction=OUT, server-argument-impl-policy=USE-ARGUMENT-TYPE
      error E_NOT_OK: error-code=1
    GetPullCmpPrm_PortIf1
      operation Oper
        4 x arg, all with direction=OUT, server-argument-impl-policy=USE-ARGUMENT-TYPE:
          PullCmpCmdTot_Arg: type=float32
          PullCmpShoTerm_Arg: type=float32
          PullCmpLongTerm_Arg: type=float32
          LrngEnad_Arg: type=boolean
    GetRefTmr100MicroSec32bit1
      operation Oper
        arg RefTmr: type=uint32, direction=OUT, server-argument-impl-policy=USE-ARGUMENT-TYPE
    GetTiSpan100MicroSec32bit1
      operation Oper
        arg RefTmr: type=uint32, direction=IN, server-argument-impl-policy=USE-ARGUMENT-TYPE
        arg TiSpan: type=uint32, direction=OUT, server-argument-impl-policy=USE-ARGUMENT-TYPE
    GetYawRateOffs_PortIf1
      operation Oper
        arg VehYawRateOffs_Arg: type=float32, direction=OUT, server-argument-impl-policy=USE-ARGUMENT-TYPE
        arg VehYawRateLrngStRst_Arg: type=boolean, direction=OUT, server-argument-impl-policy=USE-ARGUMENT-TYPE
    HwAg0ClrLtch_PortIf1
      operation Oper
    HwAg0MeasHwAg0AutoTrim1  # OBSOLETE
      operation Oper
    HwAg0MeasHwAg0ClrTrim1  # OBSOLETE
      operation Oper
    HwAg0MeasHwAg0ReadTrim2  # OBSOLETE
      operation Oper
        arg HwAg0MeasHwAg0WrOffsTrimData: type=Ag19, direction=OUT, server-argument-impl-policy=USE-ARGUMENT-TYPE
    HwAg0MeasHwAg0TrimPrfmdSts2  # OBSOLETE
      operation Oper
        arg HwAg0MeasHwAg0OffsTrimPrfmdStsData: type=Logl1, direction=OUT, server-argument-impl-policy=USE-ARGUMENT-TYPE
    HwAg0MeasHwAg0WrTrim2  # OBSOLETE
      operation Oper
        arg HwAg0MeasHwAg0WrTrimData: type=Ag19, direction=IN, server-argument-impl-policy=USE-ARGUMENT-TYPE
    HwAg1ClrLtch_PortIf1
      operation Oper
    HwAg1MeasHwAg1AutoTrim1  # OBSOLETE
      operation Oper
    HwAg1MeasHwAg1ClrTrim1  # OBSOLETE
      operation Oper
    HwAg1MeasHwAg1ReadTrim2  # OBSOLETE
      operation Oper
        arg HwAg1MeasHwAg1WrOffsTrimData: type=Ag19, direction=OUT, server-argument-impl-policy=USE-ARGUMENT-TYPE
    HwAg1MeasHwAg1TrimPrfmdSts2  # OBSOLETE
      operation Oper
        arg HwAg1MeasHwAg1OffsTrimPrfmdStsData: type=Logl1, direction=OUT, server-argument-impl-policy=USE-ARGUMENT-TYPE
    HwAg1MeasHwAg1WrTrim2  # OBSOLETE
      operation Oper
        arg HwAg1MeasHwAg1WrTrimData: type=Ag19, direction=IN, server-argument-impl-policy=USE-ARGUMENT-TYPE
    HwTq0MeasHwTq0AutTrim_PortIf1  # OBSOLETE
      operation Oper
    HwTq0MeasHwTq0ClrTrim_PortIf1  # OBSOLETE
      operation Oper
    HwTq0MeasHwTq0ReadTrim_PortIf1  # OBSOLETE
      operation Oper
        arg HwTq0MeasHwTq0ReadTrimData_Arg: type=float32, direction=OUT, server-argument-impl-policy=USE-ARGUMENT-TYPE
    HwTq0MeasHwTq0TrimPrfmdSts_PortIf1  # OBSOLETE
      operation Oper
        arg HwTq0MeasHwTq0OffsTrimPrfmdStsData_Arg: type=boolean, direction=OUT, server-argument-impl-policy=USE-ARGUMENT-TYPE
    HwTq0MeasHwTq0WrTrim_PortIf1  # OBSOLETE
      operation Oper
        arg HwTq0MeasHwTq0WrOffsTrimData_Arg: type=float32, direction=IN, server-argument-impl-policy=USE-ARGUMENT-TYPE
    HwTq1MeasHwTq1AutTrim_PortIf1  # OBSOLETE
      operation Oper
    HwTq1MeasHwTq1ClrTrim_PortIf1  # OBSOLETE
      operation Oper
    HwTq1MeasHwTq1ReadTrim_PortIf1  # OBSOLETE
      operation Oper
        arg HwTq1MeasHwTq1ReadTrimData_Arg: type=float32, direction=OUT, server-argument-impl-policy=USE-ARGUMENT-TYPE
    HwTq1MeasHwTq1TrimPrfmdSts_PortIf1  # OBSOLETE
      operation Oper
        arg HwTq1MeasHwTq1OffsTrimPrfmdStsData_Arg: type=boolean, direction=OUT, server-argument-impl-policy=USE-ARGUMENT-TYPE
    HwTq1MeasHwTq1WrTrim_PortIf1  # OBSOLETE
      operation Oper
        arg HwTq1MeasHwTq1WrOffsTrimData_Arg: type=float32, direction=IN, server-argument-impl-policy=USE-ARGUMENT-TYPE
    HwTq2MeasHwTq2AutTrim_PortIf1  # OBSOLETE
      operation Oper
    HwTq2MeasHwTq2ClrTrim_PortIf1  # OBSOLETE
      operation Oper
    HwTq2MeasHwTq2ReadTrim_PortIf1  # OBSOLETE
      operation Oper
        arg HwTq2MeasHwTq2ReadTrimData_Arg: type=float32, direction=OUT, server-argument-impl-policy=USE-ARGUMENT-TYPE
    HwTq2MeasHwTq2TrimPrfmdSts_PortIf1  # OBSOLETE
      operation Oper
        arg HwTq2MeasHwTq2OffsTrimPrfmdStsData_Arg: type=boolean, direction=OUT, server-argument-impl-policy=USE-ARGUMENT-TYPE
    HwTq2MeasHwTq2WrTrim_PortIf1  # OBSOLETE
      operation Oper
        arg HwTq2MeasHwTq2WrOffsTrimData_Arg: type=float32, direction=IN, server-argument-impl-policy=USE-ARGUMENT-TYPE
    HwTq3MeasHwTq3AutTrim_PortIf1  # OBSOLETE
      operation Oper
    HwTq3MeasHwTq3ClrTrim_PortIf1  # OBSOLETE
      operation Oper
    HwTq3MeasHwTq3ReadTrim_PortIf1  # OBSOLETE
      operation Oper
        arg HwTq3MeasHwTq3ReadTrimData_Arg: type=float32, direction=OUT, server-argument-impl-policy=USE-ARGUMENT-TYPE
    HwTq3MeasHwTq3TrimPrfmdSts_PortIf1  # OBSOLETE
      operation Oper
        arg HwTq3MeasHwTq3OffsTrimPrfmdStsData_Arg: type=boolean, direction=OUT, server-argument-impl-policy=USE-ARGUMENT-TYPE
    HwTq3MeasHwTq3WrTrim_PortIf1  # OBSOLETE
      operation Oper
        arg HwTq3MeasHwTq3WrOffsTrimData_Arg: type=float32, direction=IN, server-argument-impl-policy=USE-ARGUMENT-TYPE
    HwTqClrSnsrSca_PortIf1
      operation Oper
    HwTqMeasHwTqAutTrim_PortIf1
      operation Oper
    HwTqMeasHwTqClrTrim_PortIf1
      operation Oper
    HwTqMeasHwTqReadTrim_PortIf1
      operation Oper
        arg HwTqReadTrimData_Arg: type=float32, direction=OUT, server-argument-impl-policy=USE-ARGUMENT-TYPE
    HwTqMeasHwTqTrimPrfmdSts_PortIf1
      operation Oper
        arg HwTqOffsTrimPrfmdStsData_Arg: type=boolean, direction=OUT, server-argument-impl-policy=USE-ARGUMENT-TYPE
    HwTqMeasHwTqWrTrim_PortIf1
      operation Oper
        arg HwTqWrOffsTrimData_Arg: type=float32, direction=IN, server-argument-impl-policy=USE-ARGUMENT-TYPE
    HwTqReadSnsrSca_PortIf2
      operation Oper
        arg HwTqReadScaData_Arg: type=float32, direction=OUT, server-argument-impl-policy=USE-ARGUMENT-TYPE
    HwTqSnsrScaPrfmdSts_PortIf1
      operation Oper
        arg HwTqScaPrfmdStsData_Arg: type=boolean, direction=OUT, server-argument-impl-policy=USE-ARGUMENT-TYPE
    HwTqWrSnsrSca_PortIf1
      operation Oper
        arg HwTqScaVal_Arg: type=float32, direction=IN, server-argument-impl-policy=USE-ARGUMENT-TYPE
    InitFricLrngTbl_PortIf1
      operation Oper
    MotAgCmpBackEmfRead1  # OBSELETE
      operation Oper: possible-error=MotAgCmpBackEmfRead1/E_NOT_OK
        arg MotAgBackEmfRead: type=Ag9, direction=OUT, server-argument-impl-policy=USE-ARGUMENT-TYPE
      error E_NOT_OK: error-code=1
    MotAgCmpBackEmfWr1
      operation Oper: possible-error=MotAgCmpBackEmfWr1/E_NOT_OK
        arg MotAgCmpBackEmfWrData: type=Ag9, direction=IN, server-argument-impl-policy=USE-ARGUMENT-TYPE
      error E_NOT_OK: error-code=1
    MotAgEolPrmRead_PortIf1
      operation Oper
        arg MotAgEolPrmData_Arg: type=MotAgEolPrmRec1, direction=OUT, server-argument-impl-policy=USE-ARGUMENT-TYPE
    MotAgEolPrmWr_PortIf1
      operation Oper
        arg MotAgEolPrmData_Arg: type=MotAgEolPrmRec1, direction=IN, server-argument-impl-policy=USE-ARGUMENT-TYPE
    MotAgMeasEolPrmRead_PortIf2
      operation Oper
        arg MotAgEolPrmRead_Arg: type=MotAgMeasEolPrmRec1, direction=OUT, server-argument-impl-policy=USE-ARGUMENT-TYPE
    MotAgMeasEolPrmWr_PortIf2
      operation Oper
        arg MotAgSinCosEolCalData_Arg: type=MotAgMeasEolPrmRec1, direction=IN, server-argument-impl-policy=USE-ARGUMENT-TYPE
    MotAgMeasMotAgCoeffTblRead_PortIf1
      operation Oper
        arg MotAgCoeffTbl_Arg: type=Ary1D_f32_26, direction=OUT, server-argument-impl-policy=USE-ARGUMENT-TYPE
    MotAgMeasMotAgCoeffTblWr_PortIf1
      operation Oper
        arg MotAgCoeffTbl_Arg: type=Ary1D_f32_26, direction=IN, server-argument-impl-policy=USE-ARGUMENT-TYPE
    NxtrCalIdsCalDevlpRd_PortIf1
      operation Oper: possible-error=NxtrCalIdsCalDevlpRd_PortIf1/E_NOT_OK
        5 x arg, all with server-argument-impl-policy=USE-ARGUMENT-TYPE:
          CalRegn: type=uint8, direction=IN
          CalAuthor: type=Ary1D_u8_6, direction=OUT
          CalVers: type=uint8, direction=OUT
          CalTiStamp: type=uint32, direction=OUT
          CalDescr: type=Ary1D_u8_48, direction=OUT
      error E_NOT_OK: error-code=1
    NxtrCalIdsCalRelRd_PortIf1
      operation Oper
        arg CalRegn: type=uint8, direction=IN, server-argument-impl-policy=USE-ARGUMENT-TYPE
        arg RelNr: type=uint32, direction=OUT, server-argument-impl-policy=USE-ARGUMENT-TYPE
        arg RelSt: type=uint8, direction=OUT, server-argument-impl-policy=USE-ARGUMENT-TYPE
    NxtrSwIdsPsrInfoRd_PortIf1
      operation Oper: possible-error=NxtrSwIdsPsrInfoRd_PortIf1/E_NOT_OK
        arg PsrId: type=uint32, direction=OUT, server-argument-impl-policy=USE-ARGUMENT-TYPE
        arg PsrRev: type=uint8, direction=OUT, server-argument-impl-policy=USE-ARGUMENT-TYPE
      error E_NOT_OK: error-code=1
    NxtrSwIdsSwBuildDateTiRd_PortIf1
      operation Oper
        arg SwBuildDateTi: type=Ary1D_u8_20, direction=OUT, server-argument-impl-policy=USE-ARGUMENT-TYPE
    NxtrSwIdsSwRelInfoRd_PortIf1
      operation Oper
        arg SwOrigin: type=uint8, direction=OUT, server-argument-impl-policy=USE-ARGUMENT-TYPE
        arg SwAuthor: type=Ary1D_u8_6, direction=OUT, server-argument-impl-policy=USE-ARGUMENT-TYPE
    NxtrSwIdsSwRelNrRd_PortIf1
      operation Oper
        arg SwRelNr: type=Ary1D_u8_16, direction=OUT, server-argument-impl-policy=USE-ARGUMENT-TYPE
    NxtrSwIdsSwRelVerRd_PortIf1
      operation Oper
        arg SwRelVer: type=Ary1D_u8_16, direction=OUT, server-argument-impl-policy=USE-ARGUMENT-TYPE
    PolarityCfgRead1
      operation Oper: possible-error=PolarityCfgRead1/E_NOT_OK
        arg PolarityCfgSaved: type=Cnt15, direction=OUT, server-argument-impl-policy=USE-ARGUMENT-TYPE
      error E_NOT_OK: error-code=1
    PolarityCfgWr1
      operation Oper: possible-error=PolarityCfgWr1/E_NOT_OK
        arg PolarityCfgSaved: type=Cnt15, direction=IN, server-argument-impl-policy=USE-ARGUMENT-TYPE
      error E_NOT_OK: error-code=1
    ReadLtchCntrData_PortIf1
      operation Oper
        arg ReadLtchCntrAry_Arg: type=Ary1D_u08_20, direction=OUT, server-argument-impl-policy=USE-ARGUMENT-TYPE
    ReadNtcFltAry_PortIf1
      operation Oper
        arg DiagcMgrReadFltInfo_Arg: type=Ary1D_ReadFltInfoRec1_20, direction=OUT, server-argument-impl-policy=USE-ARGUMENT-TYPE
    ReadNtcInfoAndDebCntr_PortIf1
      operation Oper
        arg NtcNr_Arg: type=NtcNr1, direction=IN, server-argument-impl-policy=USE-ARGUMENT-TYPE
        arg NtcInfo_Arg: type=NtcInfoRec4, direction=OUT, server-argument-impl-policy=USE-ARGUMENT-TYPE
        arg DebCntr_Arg: type=sint16, direction=OUT, server-argument-impl-policy=USE-ARGUMENT-TYPE
    ReadSnpshtData_PortIf1  # OBSOLETE
      operation Oper  # OBSOLETE
        arg ReadSnpshtDataAry_Arg: type=Ary1D_SnpshtDataRec1_8, direction=OUT, server-argument-impl-policy=USE-ARGUMENT-TYPE
    ReadSnpshtData_PortIf2
      operation Oper
        arg ReadSnpshtDataAry_Arg: type=Ary1D_SnpshtDataRec2_8, direction=OUT, server-argument-impl-policy=USE-ARGUMENT-TYPE
    RstHwAgOverTrvlCnt_PortIf1
      operation Oper
    RstHwTq_PortIf1
      operation Oper
    RstMaxHwAgCwAndCcw_PortIf1
      operation Oper
    RstPullCmp_PortIf1
      operation Oper
    RstSnsrlsHwCentr_PortIf1
      operation Oper
    RstYawAndAg_PortIf1
      operation Oper
    RtnMaxHwAgCwAndCcw_PortIf1
      operation Oper
        arg HwAgCcwMax_Arg: type=float32, direction=OUT, server-argument-impl-policy=USE-ARGUMENT-TYPE
        arg HwAgCwMax_Arg: type=float32, direction=OUT, server-argument-impl-policy=USE-ARGUMENT-TYPE
    SerlComRstEot_PortIf1
      operation Oper
    SetCtrlPrm_PortIf1
      operation Oper
        7 x arg, all with type=float32, direction=IN, server-argument-impl-policy=USE-ARGUMENT-TYPE:
          MotVelCtrlPropGain_Arg
          MotVelCtrlIntgtrGain_Arg
          MotVelCtrlDerivtvGain_Arg
          MotVelCtrlAntiWdupLim_Arg
          MotVelCtrlAntiWdupGain_Arg
          MotVelCtrlDerivtvLpFilTiCon_Arg
          MotVelCtrlTqCmdLim_Arg
    SetFricData_PortIf3
      operation Oper
        5 x arg, all with direction=IN, server-argument-impl-policy=USE-ARGUMENT-TYPE:
          FricOffs_Arg: type=float32
          BasLineFric_Arg: type=Ary1D_f32_4
          VehLrndFric_Arg: type=Ary1D_f32_4
          Hys_Arg: type=Ary2D_f32_8_4
          RngCntr_Arg: type=Ary2D_u16_8_3
    SetFricLrngData_PortIf1
      operation Oper
        4 x arg, all with direction=IN, server-argument-impl-policy=USE-ARGUMENT-TYPE:
          FricLrngEna_Arg: type=boolean
          FricLrngOffsOutpEna_Arg: type=boolean
          FricLrngOperMod_Arg: type=SysFricLrngOperMod1
          EolFric_Arg: type=float32
    SetFricOffsOutpDi_PortIf1
      operation Oper
        arg FricOffsOutpDi_Arg: type=boolean, direction=IN, server-argument-impl-policy=USE-ARGUMENT-TYPE
    SetHwAgOffs_PortIf1
      operation Oper
        arg HwAgOffs_Arg: type=float32, direction=IN, server-argument-impl-policy=USE-ARGUMENT-TYPE
        arg HwAgLrngStRst_Arg: type=boolean, direction=IN, server-argument-impl-policy=USE-ARGUMENT-TYPE
    SetHwAgOverTrvlCnt_PortIf2
      operation Oper
        arg HwAgOverTrvlCnt_Arg: type=uint8, direction=IN, server-argument-impl-policy=USE-ARGUMENT-TYPE
    SetHwAgTrimVal_PortIf2
      operation Oper
        arg HwAgTrimVal_Arg: type=float32, direction=IN, server-argument-impl-policy=USE-ARGUMENT-TYPE
        arg HwAgTrimPrfmd_Arg: type=boolean, direction=IN, server-argument-impl-policy=USE-ARGUMENT-TYPE
    SetHwTqOffs_PortIf1
      operation Oper
        arg HwTqOffs_Arg: type=float32, direction=IN, server-argument-impl-policy=USE-ARGUMENT-TYPE
        arg HwTqLrngStRst_Arg: type=boolean, direction=IN, server-argument-impl-policy=USE-ARGUMENT-TYPE
    SetManTqCmd1
      operation Oper: possible-error=SetManTqCmd1/E_NOT_OK
        arg ManTqCmd: type=Tq1, direction=IN, server-argument-impl-policy=USE-ARGUMENT-TYPE
        arg ManTqCmdEna: type=boolean, direction=IN, server-argument-impl-policy=USE-ARGUMENT-TYPE
      error E_NOT_OK: error-code=1
    SetMotCoggCmdPrm_PortIf1
      operation Oper
        arg MotCoggCmdY_Arg: type=Ary1D_s1p14_128, direction=IN, server-argument-impl-policy=USE-ARGUMENT-TYPE
        arg Idx_Arg: type=uint8, direction=IN, server-argument-impl-policy=USE-ARGUMENT-TYPE
    SetMotPrmNomEol1  # OBSELETE
      operation Oper: possible-error=SetMotPrmNomEol1/E_NOT_OK
        arg MotKeNom: type=MotCon1, direction=IN, server-argument-impl-policy=USE-ARGUMENT-TYPE
        arg MotRNom: type=R6, direction=IN, server-argument-impl-policy=USE-ARGUMENT-TYPE
      error E_NOT_OK: error-code=1
    SetMotRplCoggPrm_PortIf1
      operation Oper
        9 x arg, all with direction=IN, server-argument-impl-policy=USE-ARGUMENT-TYPE:
          CoggOrder1_Arg: type=uint16
          CoggOrder1X_Arg: type=s1p14
          CoggOrder1Y_Arg: type=s1p14
          CoggOrder2_Arg: type=uint16
          CoggOrder2X_Arg: type=s1p14
          CoggOrder2Y_Arg: type=s1p14
          CoggOrder3_Arg: type=uint16
          CoggOrder3X_Arg: type=s1p14
          CoggOrder3Y_Arg: type=s1p14
    SetMotTqCmdSca_PortIf1
      operation Oper
        arg MotTqCmdSca_Arg: type=float32, direction=IN, server-argument-impl-policy=USE-ARGUMENT-TYPE
    SetPullCmpLongTerm_PortIf1
      operation Oper
        arg PullCmpLongTerm_Arg: type=float32, direction=IN, server-argument-impl-policy=USE-ARGUMENT-TYPE
    SetPullCmpShoTerm_PortIf1
      operation Oper
        arg PullCmpShoTerm_Arg: type=float32, direction=IN, server-argument-impl-policy=USE-ARGUMENT-TYPE
    SetYawRateOffs_PortIf1
      operation Oper
        arg VehYawRateOffs_Arg: type=float32, direction=IN, server-argument-impl-policy=USE-ARGUMENT-TYPE
        arg VehYawRateLrngStRst_Arg: type=boolean, direction=IN, server-argument-impl-policy=USE-ARGUMENT-TYPE
    StopCtrl_PortIf1
      operation Oper
        arg MotVelCtrlVelSlewRate_Arg: type=float32, direction=IN, server-argument-impl-policy=USE-ARGUMENT-TYPE
    StrtCtrl_PortIf1
      operation Oper
        arg MotVelCtrlMotVelTar_Arg: type=float32, direction=IN, server-argument-impl-policy=USE-ARGUMENT-TYPE
        arg MotVelCtrlVelSlewRate_Arg: type=float32, direction=IN, server-argument-impl-policy=USE-ARGUMENT-TYPE
    SwCalGetPrm_PortIf1
      operation Oper
        11 x arg, all with direction=OUT, server-argument-impl-policy=USE-ARGUMENT-TYPE:
          BoostModlnIdx_Arg: type=float32
          HldModlnIdx_Arg: type=float32
          CoolDwnModlnIdx_Arg: type=float32
          Ramp{1..3}Ti_Arg: type=uint8
          BoostTi_Arg: type=uint8
          HldTi_Arg: type=uint16
          CoolDwnTi_Arg: type=uint16
          PosnStepSize_Arg: type=u0p16
          ElecRevCnt_Arg: type=uint8
    SwCalSetPrm_PortIf1
      operation Oper: possible-error=SwCalSetPrm_PortIf1/E_NOT_OK
        11 x arg, all with direction=IN, server-argument-impl-policy=USE-ARGUMENT-TYPE:
          BoostModlnIdx_Arg: type=float32
          HldModlnIdx_Arg: type=float32
          CoolDwnModlnIdx_Arg: type=float32
          Ramp{1..3}Ti_Arg: type=uint8
          BoostTi_Arg: type=uint8
          HldTi_Arg: type=uint16
          CoolDwnTi_Arg: type=uint16
          PosnStepSize_Arg: type=u0p16
          ElecRevCnt_Arg: type=uint8
      error E_NOT_OK: error-code=1
    SwCalStop_PortIf1
      operation Oper
    SwCalStrt_PortIf1
      operation Oper
    SwCalStsCallBack_PortIf1
      operation Oper
        arg ElecRev_Arg: type=uint8, direction=IN, server-argument-impl-policy=USE-ARGUMENT-TYPE
        arg PosIdx_Arg: type=uint16, direction=IN, server-argument-impl-policy=USE-ARGUMENT-TYPE
        arg SnsrData_Arg: type=Ary1D_u16_12, direction=IN, server-argument-impl-policy=USE-ARGUMENT-TYPE
    UpdErrInjReg_PortIf1
      operation Oper
        arg NtcNr_Arg: type=uint16, direction=IN, server-argument-impl-policy=USE-ARGUMENT-TYPE
        arg NtcStInfo_Arg: type=uint8, direction=IN, server-argument-impl-policy=USE-ARGUMENT-TYPE
        arg ErrInjNr_Arg: type=uint8, direction=IN, server-argument-impl-policy=USE-ARGUMENT-TYPE
    UpdHwAgTrimVal_PortIf1
      operation Oper
        arg UpdHwAgTrimValSrvResp_Arg: type=uint8, direction=OUT, server-argument-impl-policy=USE-ARGUMENT-TYPE
  7 x sender receiver interface:
    boolean_PortIf1: invalidation-policy{data-element=Logl, handle-invalid=DONT-INVALIDATE}
      data Logl: sw-calibration-access=READ-ONLY, type=boolean
    float32_PortIf1: invalidation-policy{data-element=float32_PortIf1/Val, handle-invalid=DONT-INVALIDATE}
      data Val: sw-calibration-access=READ-ONLY, type=float32
    MfgEnaSt1_PortIf1: invalidation-policy{data-element=MfgEnaSt1_PortIf1/Val, handle-invalid=DONT-INVALIDATE}
      data Val: type=MfgEnaSt1
    sint32_PortIf1: invalidation-policy{data-element=sint32_PortIf1/Val, handle-invalid=DONT-INVALIDATE}
      data Val: sw-calibration-access=READ-ONLY, type=sint32
    SysSt1: invalidation-policy{data-element=SysSt1/Val, handle-invalid=DONT-INVALIDATE}
      data Val: sw-calibration-access=READ-ONLY, type=SysSt1
    uint16_PortIf1: invalidation-policy{data-element=uint16_PortIf1/Val, handle-invalid=DONT-INVALIDATE}
      data Val: sw-calibration-access=READ-ONLY, type=uint16
    uint32_PortIf1: invalidation-policy{data-element=uint32_PortIf1/Val, handle-invalid=DONT-INVALIDATE}
      data Val: sw-calibration-access=READ-ONLY, type=uint32
package /PortInterfaces
  client server interface CmnMfgSrvCmnMfgSrvMaiFct
    operation Oper
      7 x arg, all with server-argument-impl-policy=USE-ARGUMENT-TYPE:
        CmnMfgSrvCmnMfgSrvSrvId: type=uint8, direction=IN
        CmnMfgSrvCmnMfgSrvSubFct: type=uint8, direction=IN
        CmnMfgSrvCmnMfgSrvPrmId: type=uint16, direction=IN
        CmnMfgSrvCmnMfgSrvDataBufferPtr: type=uint8, direction=INOUT
        CmnMfgSrvCmnMfgSrvReqLen: type=uint16, direction=IN
        CmnMfgSrvCmnMfgSrvRespLen: type=uint16, direction=OUT
        CmnMfgSrvCmnMfgSrvRespCod: type=uint8, direction=OUT
  client server interface CmnMfgSrvIfCmnMfgSrvIfImdtTx
    operation Oper
      arg CmnMfgSrvCmnMfgSrvDataBufferPtr: type=Ary1D_u8_CmnMfgSrvIf, direction=IN, server-argument-impl-policy=USE-ARGUMENT-TYPE
      arg CmnMfgSrvCmnMfgSrvDataLen: type=uint16, direction=IN, server-argument-impl-policy=USE-ARGUMENT-TYPE
