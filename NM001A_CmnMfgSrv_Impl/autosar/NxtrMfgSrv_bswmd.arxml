AUTOSAR XML (schema 4-0-3)
package /Nexteer
  module definition NxtrMfgSrv [0..1]: variants pre-compile  # Configuration of Nexteer Common Manufacturing Services.
    container CommonService [0..65535]  # This contains all of the available common services
      enumeration ServiceType: {Reset - 0x11, Session - 0x10, Periodic - 0x2A, Security - 0x27, TesterPresent - 0x3E, Routine - 0x31, Read - 0x22, Write - 0x2E, Control - 0x2F}, origin=NEXTEER  # ISO 14229 standard type for this diagnostic service.
      integer ServiceId [0..1]: 61440..65231, origin=NEXTEER  # ID value for this service.
      integer SubFunction [0..1]: 0..255, origin=NEXTEER  # Sub-function for this service. Sub-function is dependent upon the type of service and not all services support a sub-function.
      integer RequestLength: 0..65535, origin=NEXTEER  # Number of bytes of data input to the service when it is invoked.
      integer ResponseLength: 0..65535, origin=NEXTEER  # Number of bytes of data output from the service when it is finished.
      boolean Enabled: origin=NEXTEER  # Set to true if support for this service shall be included in the project
      symbolic name reference Application: destination=OsApplication  # Map to OS application using non-trusted function call before service invocation.
      container AccessControls  # Configure access restrictions for this service.
        boolean NexteerSession: origin=NEXTEER, default-value=true  # Require the user be in Nexteer session to execute this service.
        boolean SecurityAccess: origin=NEXTEER, default-value=true  # Require the user complete the Nexteer Seed/Key routine before executing this service.
    container ProgramSpecificService [0..65535]  # This contains all of the program specific services
      enumeration ServiceType: {Routine - 0x31, Read - 0x22, Write - 0x2E, Control - 0x2F, Session - 0x10, Reset - 0x11, Tester Present - 0x3E, Security - 0x27}, origin=NEXTEER  # ISO 14229 standard type for this diagnostic service.
      integer ServiceId [0..1]: 65232..65279, origin=NEXTEER  # ID value for this service.
      integer SubFunction [0..1]: 0..255, origin=NEXTEER  # Sub-function for this service. Sub-function is dependent upon the type of service and not all services support a sub-function.
      integer RequestLength: 0..65535, origin=NEXTEER  # Number of bytes of data input to the service when it is invoked.
      integer ResponseLength: 0..65535, origin=NEXTEER  # Number of bytes of data output from the service when it is finished.
      boolean Enabled: origin=NEXTEER  # Set to true if support for this service shall be included in the project
      symbolic name reference Application: destination=OsApplication  # Map to OS application using non-trusted function call before service invocation.
      container AccessControls  # Configure access restrictions for this service.
        boolean NexteerSession: origin=NEXTEER, default-value=true  # Require the user be in Nexteer session to execute this service.
        boolean SecurityAccess: origin=NEXTEER, default-value=true  # Require the user complete the Nexteer Seed/Key routine before executing this service.
    container NxtrMfgSrvGeneral  # General configuration options for all Nexteer Manufacturing Services
      symbolic name reference MfgSrvApplRef: destination=OsApplication  # OS application in which Common Manufacturing Services component is mapped.
