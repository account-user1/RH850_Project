AUTOSAR XML (schema 4-0-3)
package /Nexteer/Calibrations
  parameter interface float32_CalPortIf1
    parameter data prototype Val: sw-calibration-access=READ-WRITE, type=float32
  parameter interface u16p0_CalPortIf1
    parameter data prototype Val: sw-calibration-access=READ-WRITE, type=u16p0
package /Nexteer/PortInterfaces
  client server interface GetNtcQlfrSts_PortIf1
    operation Oper: possible-error=E_NOT_OK
      arg NtcNr_Arg: type=NtcNr1, direction=IN
      arg NtcQlfr_Arg: type=SigQlfr1, direction=OUT
    error E_NOT_OK: error-code=1
  6 x sender receiver interface:
    BattVltgSt1_PortIf1: invalidation-policy{data-element=BattVltgSt1_PortIf1/Val, handle-invalid=DONT-INVALIDATE}
      data Val: sw-calibration-access=READ-ONLY, type=BattVltgSt1
    boolean_PortIf1: invalidation-policy{data-element=Logl, handle-invalid=DONT-INVALIDATE}
      data Logl: sw-calibration-access=READ-ONLY, type=boolean
    float32_PortIf1: invalidation-policy{data-element=float32_PortIf1/Val, handle-invalid=DONT-INVALIDATE}
      data Val: sw-calibration-access=READ-ONLY, type=float32
    LoaSt1_PortIf1: invalidation-policy{data-element=LoaSt1_PortIf1/Val, handle-invalid=DONT-INVALIDATE}
      data Val: sw-calibration-access=READ-ONLY, type=LoaSt1
    SysSt1_PortIf1: invalidation-policy{data-element=SysSt1_PortIf1/Val, handle-invalid=DONT-INVALIDATE}
      data Val: sw-calibration-access=READ-ONLY, type=SysSt1
    uint16_PortIf1: invalidation-policy{data-element=uint16_PortIf1/Val, handle-invalid=DONT-INVALIDATE}
      data Val: sw-calibration-access=READ-ONLY, type=uint16
