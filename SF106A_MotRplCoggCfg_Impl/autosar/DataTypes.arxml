AUTOSAR XML (schema 4-0-3)
standard types defined: float32_DataConstr, float64_DataConstr, sint16_DataConstr, sint32_DataConstr, sint8_DataConstr, uint16_DataConstr, uint32_DataConstr, uint8_DataConstr, boolean, float32, float64, sint16, sint32, sint8, uint16, uint32, uint8, Boolean, dtRef_const_VOID, dtRef_VOID
package /Nexteer/DataTypes
  17 x impl type, all with type-emitter=RTE:
    Ary1D_s1p14_12: category=ARRAY, sw-calibration-access=READ-ONLY
      element Element: array-size=12, array-size-semantics=FIXED-SIZE, implementation-data-type=s1p14
    Ary1D_u0p16_8: category=ARRAY, sw-calibration-access=READ-ONLY
      element Element: array-size=8, array-size-semantics=FIXED-SIZE, implementation-data-type=u0p16
    Ary1D_u16p0_20: category=ARRAY, sw-calibration-access=READ-ONLY
      element Element: array-size=20, array-size-semantics=FIXED-SIZE, implementation-data-type=u16p0
    Ary1D_u3p13_8: category=ARRAY, sw-calibration-access=READ-ONLY
      element Element: array-size=8, array-size-semantics=FIXED-SIZE, implementation-data-type=u3p13
    Ary1D_u5p11_8: category=ARRAY, sw-calibration-access=READ-ONLY
      element Element: array-size=8, array-size-semantics=FIXED-SIZE, implementation-data-type=u5p11
    Ary1D_u9p7_10: category=ARRAY, sw-calibration-access=READ-ONLY
      element Element: array-size=10, array-size-semantics=FIXED-SIZE, implementation-data-type=u9p7
    Ary1D_u9p7_12: category=ARRAY, sw-calibration-access=READ-ONLY
      element Element: array-size=12, array-size-semantics=FIXED-SIZE, implementation-data-type=u9p7
    Ary2D_s1p14_10_12: category=ARRAY, sw-calibration-access=READ-ONLY
      element Element: array-size=10, array-size-semantics=FIXED-SIZE, implementation-data-type=Ary1D_s1p14_12
    Ary2D_u0p16_20_8: category=ARRAY, sw-calibration-access=READ-ONLY
      element Element: array-size=20, array-size-semantics=FIXED-SIZE, implementation-data-type=Ary1D_u0p16_8
    Ary2D_u3p13_20_8: category=ARRAY, sw-calibration-access=READ-ONLY
      element Element: array-size=20, array-size-semantics=FIXED-SIZE, implementation-data-type=Ary1D_u3p13_8
    MotRplCoggPrmRec2: category=STRUCTURE, sw-calibration-access=READ-ONLY
      9 x element, all with category=TYPE_REFERENCE:
        CoggOrder1: implementation-data-type=uint16
        CoggOrder1X: implementation-data-type=s1p14
        CoggOrder1Y: implementation-data-type=s1p14
        CoggOrder2: implementation-data-type=uint16
        CoggOrder2X: implementation-data-type=s1p14
        CoggOrder2Y: implementation-data-type=s1p14
        CoggOrder3: implementation-data-type=uint16
        CoggOrder3X: implementation-data-type=s1p14
        CoggOrder3Y: implementation-data-type=s1p14
    s1p14: implementation-data-type=sint16
    u0p16: implementation-data-type=uint16
    u16p0: implementation-data-type=uint16
    u3p13: implementation-data-type=uint16
    u5p11: implementation-data-type=uint16
    u9p7: implementation-data-type=uint16
package /Nexteer/NvMProxy_swc/DataTypes
  impl type NvM_RequestResultType: category=VALUE, base-type=NvM_RequestResultType, compu {0=NVM_REQ_OK, 1=NVM_REQ_NOT_OK, 2=NVM_REQ_PENDING, 3=NVM_REQ_INTEGRITY_FAILED, 4=NVM_REQ_BLOCK_SKIPPED, 5=NVM_REQ_NV_INVALIDATED, 6=NVM_REQ_CANCELED, 7=NVM_REQ_REDUNDANCY_FAILED, 8=NVM_REQ_RESTORED_FROM_ROM}
package /Nexteer/NvMProxy_swc/DataTypes/BaseTypes
  base type NvM_RequestResultType: category=FIXED_LENGTH, base-type-size=8, base-type-encoding=NONE, native-declaration=uint8
