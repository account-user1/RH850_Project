AUTOSAR XML (schema 4-0-3)
# COPYRIGHT
# Copyright (c) 2016 by Vector Informatik GmbH. All rights reserved.
# This software is copyright protected and proprietary to Vector Informatik GmbH.
# Vector Informatik GmbH grants to you only those rights as set out in the license conditions.
package /MICROSAR  # Nm Preconfiguration
  module config Nm_Pre: definition=Nm
  module config Nm_Rec: definition=Nm, implementation-config-variant=VARIANT-PRE-COMPILE
    NmGlobalConfig
      NmGlobalFeatures:
        NmBusSynchronizationEnabled = 0
        NmCarWakeUpRxEnabled = 0
        NmComControlEnabled = 0
        NmComUserDataSupport = 1
        NmCoordinatorSupportEnabled = 0
        NmGlobalCoordinatorTime = 0
        NmNodeDetectionEnabled = 0
        NmNodeIdEnabled = 1
        NmRemoteSleepIndEnabled = 0
        NmRepeatMsgIndEnabled = 0
        NmStateChangeIndEnabled = 0
        NmUserDataEnabled = 0
      NmGlobalProperties: NmDevErrorDetect=0, NmVersionInfoApi=1
  module config Nm_Rec_Class1: definition=Nm
    NmChannelConfig: NmChannelSleepMaster=1, NmCoordClusterIndex=0, NmShutdownDelayTimer=0, NmStateReportEnabled=0, NmSynchronizingNetwork=0
