AUTOSAR XML (schema 4-0-3)
package /Nexteer/Calibrations
  parameter interface float32_CalPortIf1
    parameter data prototype Val: sw-calibration-access=READ-WRITE, type=float32
package /Nexteer/PortInterfaces
  5 x client server interface:
    SwCalGetPrm_PortIf1
      operation Oper
        11 x arg, all with direction=OUT, server-argument-impl-policy=USE-ARGUMENT-TYPE:
          BoostModlnIdx_Arg: type=float32
          HldModlnIdx_Arg: type=float32
          CoolDwnModlnIdx_Arg: type=float32
          Ramp{1..3}Ti_Arg: type=uint8
          BoostTi_Arg: type=uint8
          HldTi_Arg: type=uint16
          CoolDwnTi_Arg: type=uint16
          PosnStepSize_Arg: type=u0p16
          ElecRevCnt_Arg: type=uint8
    SwCalSetPrm_PortIf1
      operation Oper: possible-error=E_NOT_OK
        11 x arg, all with direction=IN, server-argument-impl-policy=USE-ARGUMENT-TYPE:
          BoostModlnIdx_Arg: type=float32
          HldModlnIdx_Arg: type=float32
          CoolDwnModlnIdx_Arg: type=float32
          Ramp{1..3}Ti_Arg: type=uint8
          BoostTi_Arg: type=uint8
          HldTi_Arg: type=uint16
          CoolDwnTi_Arg: type=uint16
          PosnStepSize_Arg: type=u0p16
          ElecRevCnt_Arg: type=uint8
      error E_NOT_OK: error-code=1
    SwCalStop_PortIf1
      operation Oper
    SwCalStrt_PortIf1
      operation Oper
    SwCalStsCallBack_PortIf1
      operation Oper
        arg ElecRev_Arg: type=uint8, direction=IN, server-argument-impl-policy=USE-ARGUMENT-TYPE
        arg PosIdx_Arg: type=uint16, direction=IN, server-argument-impl-policy=USE-ARGUMENT-TYPE
        arg SnsrData_Arg: type=Ary1D_u16_12, direction=IN, server-argument-impl-policy=USE-ARGUMENT-TYPE
