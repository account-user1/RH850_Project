AUTOSAR XML (schema 4-0-3)
standard types defined: float32_DataConstr, float64_DataConstr, sint16_DataConstr, sint32_DataConstr, sint8_DataConstr, uint16_DataConstr, uint32_DataConstr, uint8_DataConstr, boolean, float32, float64, sint16, sint32, sint8, uint16, uint32, uint8, Boolean, dtRef_const_VOID, dtRef_VOID, UInt8
package /Nexteer/DataTypes
  19 x impl type:
    Ary1D_boolean_4: category=ARRAY, sw-calibration-access=READ-ONLY, type-emitter=RTE
      element Element: array-size=4, array-size-semantics=FIXED-SIZE, implementation-data-type=boolean
    Ary1D_f32_12: category=ARRAY, sw-calibration-access=READ-ONLY, type-emitter=RTE
      element Element: array-size=12, array-size-semantics=FIXED-SIZE, implementation-data-type=float32
    Ary1D_f32_2: category=ARRAY, sw-calibration-access=READ-ONLY, type-emitter=RTE
      element Element: array-size=2, array-size-semantics=FIXED-SIZE, implementation-data-type=float32
    Ary1D_f32_4: category=ARRAY, sw-calibration-access=READ-ONLY, type-emitter=RTE
      element Element: array-size=4, array-size-semantics=FIXED-SIZE, implementation-data-type=float32
    Ary1D_u11p5_10: category=ARRAY, sw-calibration-access=READ-ONLY, type-emitter=RTE
      element Element: array-size=10, array-size-semantics=FIXED-SIZE, implementation-data-type=u11p5
    Ary1D_u16_3: category=ARRAY, sw-calibration-access=READ-ONLY, type-emitter=RTE
      element Element: array-size=3, array-size-semantics=FIXED-SIZE, implementation-data-type=uint16
    Ary1D_u6p10_10: category=ARRAY, sw-calibration-access=READ-ONLY, type-emitter=RTE
      element Element: array-size=10, array-size-semantics=FIXED-SIZE, implementation-data-type=u6p10
    Ary2D_f32_4_2: category=ARRAY, sw-calibration-access=READ-ONLY, type-emitter=RTE
      element Element: array-size=4, array-size-semantics=FIXED-SIZE, implementation-data-type=Ary1D_f32_2
    Ary2D_f32_8_4: category=ARRAY, sw-calibration-access=READ-ONLY, type-emitter=RTE
      element Element: array-size=8, array-size-semantics=FIXED-SIZE, implementation-data-type=Ary1D_f32_4
    Ary2D_u16_8_3: category=ARRAY, sw-calibration-access=READ-ONLY, type-emitter=RTE
      element Element: array-size=8, array-size-semantics=FIXED-SIZE, implementation-data-type=Ary1D_u16_3
    FilLpRec1: category=STRUCTURE, sw-calibration-access=READ-ONLY, type-emitter=NxtrFil
      element FilSt: implementation-data-type=float32
      element FilGain: implementation-data-type=float32
      symbol props FilLpRec1
    NtcNr1: compu {1..511=NTCNR_0X001..NTCNR_0X1FF}, implementation-data-type=uint16, type-emitter=RTE
    NtcSts1: compu {0=NTCSTS_PASSD, 1=NTCSTS_FAILD, 2=NTCSTS_PREPASSD, 3=NTCSTS_PREFAILD}, implementation-data-type=uint8, type-emitter=RTE
    SigQlfr1: compu {0=SIGQLFR_NORES, 1=SIGQLFR_PASSD, 2=SIGQLFR_FAILD}, implementation-data-type=uint8, type-emitter=RTE
    SysFricDataRec1: category=STRUCTURE, sw-calibration-access=READ-ONLY, type-emitter=RTE
      6 x element, all with category=TYPE_REFERENCE:
        FricOffs: implementation-data-type=float32
        BasLineFric: implementation-data-type=Ary1D_f32_4
        VehLrndFric: implementation-data-type=Ary1D_f32_4
        Hys: implementation-data-type=Ary2D_f32_8_4
        RngCntr: implementation-data-type=Ary2D_u16_8_3
        SysFricLrngOperMod: implementation-data-type=SysFricLrngOperMod1
    SysFricLrngOperMod1: compu {0=SYSFRICLRNGOPERMOD_CALIBRATION, 1=SYSFRICLRNGOPERMOD_NORMAL, 2=SYSFRICLRNGOPERMOD_CLEAR, 3=SYSFRICLRNGOPERMOD_IDLE, 4=SYSFRICLRNGOPERMOD_BASELINE}, implementation-data-type=uint8, type-emitter=RTE
    SysFricNonLrngDataRec1: category=STRUCTURE, sw-calibration-access=READ-ONLY, type-emitter=RTE
      element EolFric: implementation-data-type=float32
      element EnaFricLrng: implementation-data-type=boolean
      element EnaFricOffsOutp: implementation-data-type=boolean
    u11p5: implementation-data-type=uint16, type-emitter=RTE
    u6p10: implementation-data-type=uint16, type-emitter=RTE
package /Nexteer/NvMProxy_swc/DataTypes
  impl type NvM_BlockIdType: category=VALUE, base-type=NvM_BlockIdType, range raw 1..32767
  impl type NvM_RequestResultType: category=VALUE, base-type=NvM_RequestResultType, compu {0=NVM_REQ_OK, 1=NVM_REQ_NOT_OK, 2=NVM_REQ_PENDING, 3=NVM_REQ_INTEGRITY_FAILED, 4=NVM_REQ_BLOCK_SKIPPED, 5=NVM_REQ_NV_INVALIDATED, 6=NVM_REQ_CANCELED, 7=NVM_REQ_REDUNDANCY_FAILED, 8=NVM_REQ_RESTORED_FROM_ROM}
package /Nexteer/NvMProxy_swc/DataTypes/BaseTypes
  base type NvM_BlockIdType: category=FIXED_LENGTH, base-type-size=16, base-type-encoding=NONE, native-declaration=uint16
  base type NvM_RequestResultType: category=FIXED_LENGTH, base-type-size=8, base-type-encoding=NONE, native-declaration=uint8
package /Nexteer/NvMProxy_swc/DataTypes/DataConstrs
  range UInt8_Constr: raw 0..255
