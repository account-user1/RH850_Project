AUTOSAR XML (schema 4-0-3)
package /ActiveEcuC
  module config Os: implementation-config-variant=VARIANT-PRE-COMPILE, module-description=Os_Impl
    OsOS:
      OsStackMonitoring = (unset)
      OsOSStackUsageMeasurement = AUTO
      OsStatus = EXTENDED
      OsUseGetServiceId = (unset)
      OsUseParameterAccess = (unset)
      OsUseResScheduler = false
      OsOSCallISRHooks = false
      OsOSSystemTimerNestable = false
      OsOSMemoryProtection = false
      OsOSEnumeratedUnhandledISRs = false
      OsOSORTIDebugSupport = false
      OsOSTypeHeaderInclude = true
      OsOSCpuFrequency = (unset)
      OsOSTimerClockDivider = 1
      OsOSUserConfigurationVersion = 1
      OsOSSystemStackSize = 200
      OsOSSystemTimerPriority = 15
      OsOSSystemTimerStackSize = 200
      OsOSTickTime = 1000
      OsOSSystemTimer = OSTM0
      OsOSOSInternalChecks = Additional
      OsOSCompiler = GHS
      OsOSORTIDebugLevel = ORTI_22_Additional
      OsOSSCHEDULE
        AUTO
      OsOSCC
        AUTO
      OsOSProtectionHookReaction
        Selected: OsOSSHUTDOWN=true
      OsOSTimingMeasurement
        TRUE: OsOSGlobalConfig=AsSelected
      OsHooks: OsErrorHook=(unset), OsPostTaskHook=(unset), OsPreTaskHook=(unset), OsShutdownHook=(unset), OsStartupHook=(unset)
    VectorCommonData: BswmdVersion=6.05.00
    OsImplementationInformation: OsVectorOilVersion=4.0, OsVectorImplementationName=RenesasRH850_P1M.i40, OsBswmdStyleVersion=2
    OSDEFAULTAPPMODE (OsAppMode)
    SystemTimer (OsCounter): OsCounterMaxAllowedValue=2147483647, OsCounterTicksPerBase=1, OsCounterMinCycle=1, OsSecondsPerTick=1234567890, OsCounterType=SOFTWARE
