AUTOSAR XML (schema 4-0-3)
package /Nexteer/Calibrations
  parameter interface uint32_CalPortIf1
    parameter data prototype Val: sw-calibration-access=READ-WRITE, type=uint32
  parameter interface uint8_CalPortIf1
    parameter data prototype Val: sw-calibration-access=READ-WRITE, type=uint8
package /Nexteer/PortInterfaces
  22 x client server interface:
    GetRefTmr100MicroSec32bit_PortIf1
      operation Oper
        arg RefTmr_Arg: type=uint32, direction=OUT
    GetSigImcData_f32_PortIf1
      operation Oper: possible-error=GetSigImcData_f32_PortIf1/E_NOT_OK
        arg SigId_Arg: type=uint16, direction=IN
        arg Data_Arg: type=float32, direction=OUT
        arg Sts_Arg: type=ImcArbnRxSts1, direction=OUT
      error E_NOT_OK: error-code=1
    GetSigImcData_logl_PortIf1
      operation Oper: possible-error=GetSigImcData_logl_PortIf1/E_NOT_OK
        arg SigId_Arg: type=uint16, direction=IN
        arg Data_Arg: type=boolean, direction=OUT
        arg Sts_Arg: type=ImcArbnRxSts1, direction=OUT
      error E_NOT_OK: error-code=1
    GetSigImcData_s08_PortIf1
      operation Oper: possible-error=GetSigImcData_s08_PortIf1/E_NOT_OK
        arg SigId_Arg: type=uint16, direction=IN
        arg Data_Arg: type=sint8, direction=OUT
        arg Sts_Arg: type=ImcArbnRxSts1, direction=OUT
      error E_NOT_OK: error-code=1
    GetSigImcData_s16_PortIf1
      operation Oper: possible-error=GetSigImcData_s16_PortIf1/E_NOT_OK
        arg SigId_Arg: type=uint16, direction=IN
        arg Data_Arg: type=sint16, direction=OUT
        arg Sts_Arg: type=ImcArbnRxSts1, direction=OUT
      error E_NOT_OK: error-code=1
    GetSigImcData_s32_PortIf1
      operation Oper: possible-error=GetSigImcData_s32_PortIf1/E_NOT_OK
        arg SigId_Arg: type=uint16, direction=IN
        arg Data_Arg: type=sint32, direction=OUT
        arg Sts_Arg: type=ImcArbnRxSts1, direction=OUT
      error E_NOT_OK: error-code=1
    GetSigImcData_u08_PortIf1
      operation Oper: possible-error=GetSigImcData_u08_PortIf1/E_NOT_OK
        arg SigId_Arg: type=uint16, direction=IN
        arg Data_Arg: type=uint8, direction=OUT
        arg Sts_Arg: type=ImcArbnRxSts1, direction=OUT
      error E_NOT_OK: error-code=1
    GetSigImcData_u16_PortIf1
      operation Oper: possible-error=GetSigImcData_u16_PortIf1/E_NOT_OK
        arg SigId_Arg: type=uint16, direction=IN
        arg Data_Arg: type=uint16, direction=OUT
        arg Sts_Arg: type=ImcArbnRxSts1, direction=OUT
      error E_NOT_OK: error-code=1
    GetSigImcData_u32_PortIf1
      operation Oper: possible-error=GetSigImcData_u32_PortIf1/E_NOT_OK
        arg SigId_Arg: type=uint16, direction=IN
        arg Data_Arg: type=uint32, direction=OUT
        arg Sts_Arg: type=ImcArbnRxSts1, direction=OUT
      error E_NOT_OK: error-code=1
    GetSigImcDataExtdSts_f32_PortIf1
      operation Oper: possible-error=GetSigImcDataExtdSts_f32_PortIf1/E_NOT_OK
        4 x arg:
          SigId_Arg: type=uint16, direction=IN
          Data_Arg: type=float32, direction=OUT
          Sts_Arg: type=ImcArbnRxExtdSts1, direction=OUT
          DataSrc_Arg: type=ImcArbnRxDataSrc1, direction=OUT
      error E_NOT_OK: error-code=1
    GetSigImcDataExtdSts_logl_PortIf1
      operation Oper: possible-error=GetSigImcDataExtdSts_logl_PortIf1/E_NOT_OK
        4 x arg:
          SigId_Arg: type=uint16, direction=IN
          Data_Arg: type=boolean, direction=OUT
          Sts_Arg: type=ImcArbnRxExtdSts1, direction=OUT
          DataSrc_Arg: type=ImcArbnRxDataSrc1, direction=OUT
      error E_NOT_OK: error-code=1
    GetSigImcDataExtdSts_s08_PortIf1
      operation Oper: possible-error=GetSigImcDataExtdSts_s08_PortIf1/E_NOT_OK
        4 x arg:
          SigId_Arg: type=uint16, direction=IN
          Data_Arg: type=sint8, direction=OUT
          Sts_Arg: type=ImcArbnRxExtdSts1, direction=OUT
          DataSrc_Arg: type=ImcArbnRxDataSrc1, direction=OUT
      error E_NOT_OK: error-code=1
    GetSigImcDataExtdSts_s16_PortIf1
      operation Oper: possible-error=GetSigImcDataExtdSts_s16_PortIf1/E_NOT_OK
        4 x arg:
          SigId_Arg: type=uint16, direction=IN
          Data_Arg: type=sint16, direction=OUT
          Sts_Arg: type=ImcArbnRxExtdSts1, direction=OUT
          DataSrc_Arg: type=ImcArbnRxDataSrc1, direction=OUT
      error E_NOT_OK: error-code=1
    GetSigImcDataExtdSts_s32_PortIf1
      operation Oper: possible-error=GetSigImcDataExtdSts_s32_PortIf1/E_NOT_OK
        4 x arg:
          SigId_Arg: type=uint16, direction=IN
          Data_Arg: type=sint32, direction=OUT
          Sts_Arg: type=ImcArbnRxExtdSts1, direction=OUT
          DataSrc_Arg: type=ImcArbnRxDataSrc1, direction=OUT
      error E_NOT_OK: error-code=1
    GetSigImcDataExtdSts_u08_PortIf1
      operation Oper: possible-error=GetSigImcDataExtdSts_u08_PortIf1/E_NOT_OK
        4 x arg:
          SigId_Arg: type=uint16, direction=IN
          Data_Arg: type=uint8, direction=OUT
          Sts_Arg: type=ImcArbnRxExtdSts1, direction=OUT
          DataSrc_Arg: type=ImcArbnRxDataSrc1, direction=OUT
      error E_NOT_OK: error-code=1
    GetSigImcDataExtdSts_u16_PortIf1
      operation Oper: possible-error=GetSigImcDataExtdSts_u16_PortIf1/E_NOT_OK
        4 x arg:
          SigId_Arg: type=uint16, direction=IN
          Data_Arg: type=uint16, direction=OUT
          Sts_Arg: type=ImcArbnRxExtdSts1, direction=OUT
          DataSrc_Arg: type=ImcArbnRxDataSrc1, direction=OUT
      error E_NOT_OK: error-code=1
    GetSigImcDataExtdSts_u32_PortIf1
      operation Oper: possible-error=GetSigImcDataExtdSts_u32_PortIf1/E_NOT_OK
        4 x arg:
          SigId_Arg: type=uint16, direction=IN
          Data_Arg: type=uint32, direction=OUT
          Sts_Arg: type=ImcArbnRxExtdSts1, direction=OUT
          DataSrc_Arg: type=ImcArbnRxDataSrc1, direction=OUT
      error E_NOT_OK: error-code=1
    GetTiSpan100MicroSec32bit_PortIf1
      operation Oper
        arg RefTmr_Arg: type=uint32, direction=IN
        arg TiSpan_Arg: type=uint32, direction=OUT
    GetTxRateGroup_PortIf1
      operation Oper: possible-error=GetTxRateGroup_PortIf1/E_NOT_OK
        arg RateGroup_Arg: type=uint8, direction=IN
        arg Buf_Arg: type=uint8, direction=OUT
      error E_NOT_OK: error-code=1
    GetTxSigGroup_PortIf1
      operation Oper: possible-error=GetTxSigGroup_PortIf1/E_NOT_OK
        arg SigGroupId_Arg: type=uint8, direction=IN
        arg Buf_Arg: type=uint8, direction=OUT
      error E_NOT_OK: error-code=1
    SetNtcSts_PortIf1
      operation Oper: possible-error=SetNtcSts_PortIf1/E_NOT_OK
        4 x arg, all with direction=IN:
          NtcNr_Arg: type=NtcNr1
          NtcStInfo_Arg: type=uint8
          NtcSts_Arg: type=NtcSts1
          DebStep_Arg: type=uint16
      error E_NOT_OK: error-code=1
    SetRxSigGroup_PortIf1
      operation Oper: possible-error=SetRxSigGroup_PortIf1/E_NOT_OK
        arg SigGroup_Arg: type=uint8, direction=IN
        arg DataSrc_Arg: type=ImcArbnRxDataSrc1, direction=IN
        arg Buf_Arg: type=Ary1D_u8_8, direction=IN
      error E_NOT_OK: error-code=1
