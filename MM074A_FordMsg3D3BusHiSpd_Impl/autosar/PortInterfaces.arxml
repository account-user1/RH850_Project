AUTOSAR XML (schema 4-0-3)
package /Ford/PortInterfaces
  168 x sender receiver interface:
    Ford_AbsActv_B_Actl: invalidation-policy{data-element=Ford_AbsActv_B_Actl, handle-invalid=DONT-INVALIDATE}
      data Ford_AbsActv_B_Actl: sw-calibration-access=READ-ONLY, type=Ford_AbsActv_B_Actl
    Ford_ApaSys_D_Stat: invalidation-policy{data-element=Ford_ApaSys_D_Stat, handle-invalid=DONT-INVALIDATE}
      data Ford_ApaSys_D_Stat: sw-calibration-access=READ-ONLY, type=Ford_ApaSys_D_Stat
    Ford_ApedPos_Pc_ActlArb: invalidation-policy{data-element=Ford_ApedPos_Pc_ActlArb, handle-invalid=DONT-INVALIDATE}
      data Ford_ApedPos_Pc_ActlArb: sw-calibration-access=READ-ONLY, type=Ford_ApedPos_Pc_ActlArb
    Ford_ApedPosPcActl_D_Qf: invalidation-policy{data-element=Ford_ApedPosPcActl_D_Qf, handle-invalid=DONT-INVALIDATE}
      data Ford_ApedPosPcActl_D_Qf: sw-calibration-access=READ-ONLY, type=Ford_ApedPosPcActl_D_Qf
    Ford_BattULo_U_Actl: invalidation-policy{data-element=Ford_BattULo_U_Actl, handle-invalid=DONT-INVALIDATE}
      data Ford_BattULo_U_Actl: sw-calibration-access=READ-ONLY, type=Ford_BattULo_U_Actl
    Ford_BpedDrvAppl_D_Actl: invalidation-policy{data-element=Ford_BpedDrvAppl_D_Actl, handle-invalid=DONT-INVALIDATE}
      data Ford_BpedDrvAppl_D_Actl: sw-calibration-access=READ-ONLY, type=Ford_BpedDrvAppl_D_Actl
    Ford_BPedDrvAppl_D_QF: invalidation-policy{data-element=Ford_BPedDrvAppl_D_QF, handle-invalid=DONT-INVALIDATE}
      data Ford_BPedDrvAppl_D_QF: sw-calibration-access=READ-ONLY, type=Ford_BPedDrvAppl_D_QF
    Ford_BrkTot_Tq_Actl: invalidation-policy{data-element=Ford_BrkTot_Tq_Actl, handle-invalid=DONT-INVALIDATE}
      data Ford_BrkTot_Tq_Actl: sw-calibration-access=READ-ONLY, type=Ford_BrkTot_Tq_Actl
    Ford_CmbbBrkDis_B_Actl: invalidation-policy{data-element=Ford_CmbbBrkDis_B_Actl, handle-invalid=DONT-INVALIDATE}
      data Ford_CmbbBrkDis_B_Actl: sw-calibration-access=READ-ONLY, type=Ford_CmbbBrkDis_B_Actl
    Ford_CmbbDeny_B_ActlBrk: invalidation-policy{data-element=Ford_CmbbDeny_B_ActlBrk, handle-invalid=DONT-INVALIDATE}
      data Ford_CmbbDeny_B_ActlBrk: sw-calibration-access=READ-ONLY, type=Ford_CmbbDeny_B_ActlBrk
    Ford_CmbbObjClass_D_Stat: invalidation-policy{data-element=Ford_CmbbObjClass_D_Stat, handle-invalid=DONT-INVALIDATE}
      data Ford_CmbbObjClass_D_Stat: sw-calibration-access=READ-ONLY, type=Ford_CmbbObjClass_D_Stat
    Ford_CmbbObjColl_T_Actl: invalidation-policy{data-element=Ford_CmbbObjColl_T_Actl, handle-invalid=DONT-INVALIDATE}
      data Ford_CmbbObjColl_T_Actl: sw-calibration-access=READ-ONLY, type=Ford_CmbbObjColl_T_Actl
    Ford_CmbbObjConfdnc_D_Stat: invalidation-policy{data-element=Ford_CmbbObjConfdnc_D_Stat, handle-invalid=DONT-INVALIDATE}
      data Ford_CmbbObjConfdnc_D_Stat: sw-calibration-access=READ-ONLY, type=Ford_CmbbObjConfdnc_D_Stat
    Ford_CmbbObjDistLat_L_Actl: invalidation-policy{data-element=Ford_CmbbObjDistLat_L_Actl, handle-invalid=DONT-INVALIDATE}
      data Ford_CmbbObjDistLat_L_Actl: sw-calibration-access=READ-ONLY, type=Ford_CmbbObjDistLat_L_Actl
    Ford_CmbbObjDistLong_L_Actl: invalidation-policy{data-element=Ford_CmbbObjDistLong_L_Actl, handle-invalid=DONT-INVALIDATE}
      data Ford_CmbbObjDistLong_L_Actl: sw-calibration-access=READ-ONLY, type=Ford_CmbbObjDistLong_L_Actl
    Ford_CmbbObjRelLat_V_Actl: invalidation-policy{data-element=Ford_CmbbObjRelLat_V_Actl, handle-invalid=DONT-INVALIDATE}
      data Ford_CmbbObjRelLat_V_Actl: sw-calibration-access=READ-ONLY, type=Ford_CmbbObjRelLat_V_Actl
    Ford_CmbbObjRelLong_V_Actl: invalidation-policy{data-element=Ford_CmbbObjRelLong_V_Actl, handle-invalid=DONT-INVALIDATE}
      data Ford_CmbbObjRelLong_V_Actl: sw-calibration-access=READ-ONLY, type=Ford_CmbbObjRelLong_V_Actl
    Ford_DeliveryIdle: invalidation-policy{data-element=Ford_DeliveryIdle, handle-invalid=DONT-INVALIDATE}
      data Ford_DeliveryIdle: sw-calibration-access=READ-ONLY, type=Ford_DeliveryIdle
    Ford_DeliveryNumber: invalidation-policy{data-element=Ford_DeliveryNumber, handle-invalid=DONT-INVALIDATE}
      data Ford_DeliveryNumber: sw-calibration-access=READ-ONLY, type=Ford_DeliveryNumber
    Ford_DeliverySipNumber: invalidation-policy{data-element=Ford_DeliverySipNumber, handle-invalid=DONT-INVALIDATE}
      data Ford_DeliverySipNumber: sw-calibration-access=READ-ONLY, type=Ford_DeliverySipNumber
    Ford_DeliverySubProjectNumber: invalidation-policy{data-element=Ford_DeliverySubProjectNumber, handle-invalid=DONT-INVALIDATE}
      data Ford_DeliverySubProjectNumber: sw-calibration-access=READ-ONLY, type=Ford_DeliverySubProjectNumber
    Ford_DrvSte_D_Stat: invalidation-policy{data-element=Ford_DrvSte_D_Stat, handle-invalid=DONT-INVALIDATE}
      data Ford_DrvSte_D_Stat: sw-calibration-access=READ-ONLY, type=Ford_DrvSte_D_Stat
    Ford_DrvSte_Tq_Actl: invalidation-policy{data-element=Ford_DrvSte_Tq_Actl, handle-invalid=DONT-INVALIDATE}
      data Ford_DrvSte_Tq_Actl: sw-calibration-access=READ-ONLY, type=Ford_DrvSte_Tq_Actl
    Ford_DrvSte_Tq_Rq: invalidation-policy{data-element=Ford_DrvSte_Tq_Rq, handle-invalid=DONT-INVALIDATE}
      data Ford_DrvSte_Tq_Rq: sw-calibration-access=READ-ONLY, type=Ford_DrvSte_Tq_Rq
    Ford_DrvSteActv_B_Stat: invalidation-policy{data-element=Ford_DrvSteActv_B_Stat, handle-invalid=DONT-INVALIDATE}
      data Ford_DrvSteActv_B_Stat: sw-calibration-access=READ-ONLY, type=Ford_DrvSteActv_B_Stat
    Ford_ElPw_D_Stat: invalidation-policy{data-element=Ford_ElPw_D_Stat, handle-invalid=DONT-INVALIDATE}
      data Ford_ElPw_D_Stat: sw-calibration-access=READ-ONLY, type=Ford_ElPw_D_Stat
    Ford_ElPw_D_StatStrtStop: invalidation-policy{data-element=Ford_ElPw_D_StatStrtStop, handle-invalid=DONT-INVALIDATE}
      data Ford_ElPw_D_StatStrtStop: sw-calibration-access=READ-ONLY, type=Ford_ElPw_D_StatStrtStop
    Ford_EngAout_N_Actl: invalidation-policy{data-element=Ford_EngAout_N_Actl, handle-invalid=DONT-INVALIDATE}
      data Ford_EngAout_N_Actl: sw-calibration-access=READ-ONLY, type=Ford_EngAout_N_Actl
    Ford_EPAS_Failure: invalidation-policy{data-element=Ford_EPAS_Failure, handle-invalid=DONT-INVALIDATE}
      data Ford_EPAS_Failure: sw-calibration-access=READ-ONLY, type=Ford_EPAS_Failure
    Ford_EPASExtAngleStatReq: invalidation-policy{data-element=Ford_EPASExtAngleStatReq, handle-invalid=DONT-INVALIDATE}
      data Ford_EPASExtAngleStatReq: sw-calibration-access=READ-ONLY, type=Ford_EPASExtAngleStatReq
    Ford_EsaEnbl_D2_Rq: invalidation-policy{data-element=Ford_EsaEnbl_D2_Rq, handle-invalid=DONT-INVALIDATE}
      data Ford_EsaEnbl_D2_Rq: sw-calibration-access=READ-ONLY, type=Ford_EsaEnbl_D2_Rq
    Ford_EsaOn_B_Rq: invalidation-policy{data-element=Ford_EsaOn_B_Rq, handle-invalid=DONT-INVALIDATE}
      data Ford_EsaOn_B_Rq: sw-calibration-access=READ-ONLY, type=Ford_EsaOn_B_Rq
    Ford_EsaOn_B_Stat: invalidation-policy{data-element=Ford_EsaOn_B_Stat, handle-invalid=DONT-INVALIDATE}
      data Ford_EsaOn_B_Stat: sw-calibration-access=READ-ONLY, type=Ford_EsaOn_B_Stat
    Ford_ExtSteeringAngleReq2: invalidation-policy{data-element=Ford_ExtSteeringAngleReq2, handle-invalid=DONT-INVALIDATE}
      data Ford_ExtSteeringAngleReq2: sw-calibration-access=READ-ONLY, type=Ford_ExtSteeringAngleReq2
    Ford_FileVersionDay: invalidation-policy{data-element=Ford_FileVersionDay, handle-invalid=DONT-INVALIDATE}
      data Ford_FileVersionDay: sw-calibration-access=READ-ONLY, type=Ford_FileVersionDay
    Ford_FileVersionMonth: invalidation-policy{data-element=Ford_FileVersionMonth, handle-invalid=DONT-INVALIDATE}
      data Ford_FileVersionMonth: sw-calibration-access=READ-ONLY, type=Ford_FileVersionMonth
    Ford_FileVersionNumber: invalidation-policy{data-element=Ford_FileVersionNumber, handle-invalid=DONT-INVALIDATE}
      data Ford_FileVersionNumber: sw-calibration-access=READ-ONLY, type=Ford_FileVersionNumber
    Ford_FileVersionYear: invalidation-policy{data-element=Ford_FileVersionYear, handle-invalid=DONT-INVALIDATE}
      data Ford_FileVersionYear: sw-calibration-access=READ-ONLY, type=Ford_FileVersionYear
    Ford_GearLvrPos_D_Actl: invalidation-policy{data-element=Ford_GearLvrPos_D_Actl, handle-invalid=DONT-INVALIDATE}
      data Ford_GearLvrPos_D_Actl: sw-calibration-access=READ-ONLY, type=Ford_GearLvrPos_D_Actl
    Ford_GearPos_D_Actl: invalidation-policy{data-element=Ford_GearPos_D_Actl, handle-invalid=DONT-INVALIDATE}
      data Ford_GearPos_D_Actl: sw-calibration-access=READ-ONLY, type=Ford_GearPos_D_Actl
    Ford_GearRvrse_D_Actl: invalidation-policy{data-element=Ford_GearRvrse_D_Actl, handle-invalid=DONT-INVALIDATE}
      data Ford_GearRvrse_D_Actl: sw-calibration-access=READ-ONLY, type=Ford_GearRvrse_D_Actl
    Ford_HandsOffCnfm_B_Rq: invalidation-policy{data-element=Ford_HandsOffCnfm_B_Rq, handle-invalid=DONT-INVALIDATE}
      data Ford_HandsOffCnfm_B_Rq: sw-calibration-access=READ-ONLY, type=Ford_HandsOffCnfm_B_Rq
    Ford_HitchToTrlrAxle_L_Calc: invalidation-policy{data-element=Ford_HitchToTrlrAxle_L_Calc, handle-invalid=DONT-INVALIDATE}
      data Ford_HitchToTrlrAxle_L_Calc: sw-calibration-access=READ-ONLY, type=Ford_HitchToTrlrAxle_L_Calc
    Ford_HitchToVehAxle_L_Calc: invalidation-policy{data-element=Ford_HitchToVehAxle_L_Calc, handle-invalid=DONT-INVALIDATE}
      data Ford_HitchToVehAxle_L_Calc: sw-calibration-access=READ-ONLY, type=Ford_HitchToVehAxle_L_Calc
    Ford_Ignition_Status: invalidation-policy{data-element=Ford_Ignition_Status, handle-invalid=DONT-INVALIDATE}
      data Ford_Ignition_Status: sw-calibration-access=READ-ONLY, type=Ford_Ignition_Status
    Ford_LaActAvail_D_Actl: invalidation-policy{data-element=Ford_LaActAvail_D_Actl, handle-invalid=DONT-INVALIDATE}
      data Ford_LaActAvail_D_Actl: sw-calibration-access=READ-ONLY, type=Ford_LaActAvail_D_Actl
    Ford_LaActDeny_B_Actl: invalidation-policy{data-element=Ford_LaActDeny_B_Actl, handle-invalid=DONT-INVALIDATE}
      data Ford_LaActDeny_B_Actl: sw-calibration-access=READ-ONLY, type=Ford_LaActDeny_B_Actl
    Ford_LaCurvature_No_Calc: invalidation-policy{data-element=Ford_LaCurvature_No_Calc, handle-invalid=DONT-INVALIDATE}
      data Ford_LaCurvature_No_Calc: sw-calibration-access=READ-ONLY, type=Ford_LaCurvature_No_Calc
    Ford_LaHandsOff_B_Actl: invalidation-policy{data-element=Ford_LaHandsOff_B_Actl, handle-invalid=DONT-INVALIDATE}
      data Ford_LaHandsOff_B_Actl: sw-calibration-access=READ-ONLY, type=Ford_LaHandsOff_B_Actl
    Ford_LaRampType_B_Req: invalidation-policy{data-element=Ford_LaRampType_B_Req, handle-invalid=DONT-INVALIDATE}
      data Ford_LaRampType_B_Req: sw-calibration-access=READ-ONLY, type=Ford_LaRampType_B_Req
    Ford_LaRefAng_No_Req: invalidation-policy{data-element=Ford_LaRefAng_No_Req, handle-invalid=DONT-INVALIDATE}
      data Ford_LaRefAng_No_Req: sw-calibration-access=READ-ONLY, type=Ford_LaRefAng_No_Req
    Ford_LatCtl_D_Rq: invalidation-policy{data-element=Ford_LatCtl_D_Rq, handle-invalid=DONT-INVALIDATE}
      data Ford_LatCtl_D_Rq: sw-calibration-access=READ-ONLY, type=Ford_LatCtl_D_Rq
    Ford_LatCtlCurv_No_Actl: invalidation-policy{data-element=Ford_LatCtlCurv_No_Actl, handle-invalid=DONT-INVALIDATE}
      data Ford_LatCtlCurv_No_Actl: sw-calibration-access=READ-ONLY, type=Ford_LatCtlCurv_No_Actl
    Ford_LatCtlCurv_NoRate_Actl: invalidation-policy{data-element=Ford_LatCtlCurv_NoRate_Actl, handle-invalid=DONT-INVALIDATE}
      data Ford_LatCtlCurv_NoRate_Actl: sw-calibration-access=READ-ONLY, type=Ford_LatCtlCurv_NoRate_Actl
    Ford_LatCtlLim_D_Stat: invalidation-policy{data-element=Ford_LatCtlLim_D_Stat, handle-invalid=DONT-INVALIDATE}
      data Ford_LatCtlLim_D_Stat: sw-calibration-access=READ-ONLY, type=Ford_LatCtlLim_D_Stat
    Ford_LatCtlPath_An_Actl: invalidation-policy{data-element=Ford_LatCtlPath_An_Actl, handle-invalid=DONT-INVALIDATE}
      data Ford_LatCtlPath_An_Actl: sw-calibration-access=READ-ONLY, type=Ford_LatCtlPath_An_Actl
    Ford_LatCtlPathOffst_L_Actl: invalidation-policy{data-element=Ford_LatCtlPathOffst_L_Actl, handle-invalid=DONT-INVALIDATE}
      data Ford_LatCtlPathOffst_L_Actl: sw-calibration-access=READ-ONLY, type=Ford_LatCtlPathOffst_L_Actl
    Ford_LatCtlPrecision_D_Rq: invalidation-policy{data-element=Ford_LatCtlPrecision_D_Rq, handle-invalid=DONT-INVALIDATE}
      data Ford_LatCtlPrecision_D_Rq: sw-calibration-access=READ-ONLY, type=Ford_LatCtlPrecision_D_Rq
    Ford_LatCtlRampType_D_Rq: invalidation-policy{data-element=Ford_LatCtlRampType_D_Rq, handle-invalid=DONT-INVALIDATE}
      data Ford_LatCtlRampType_D_Rq: sw-calibration-access=READ-ONLY, type=Ford_LatCtlRampType_D_Rq
    Ford_LatCtlRng_L_Max: invalidation-policy{data-element=Ford_LatCtlRng_L_Max, handle-invalid=DONT-INVALIDATE}
      data Ford_LatCtlRng_L_Max: sw-calibration-access=READ-ONLY, type=Ford_LatCtlRng_L_Max
    Ford_LatCtlSte_D_Stat: invalidation-policy{data-element=Ford_LatCtlSte_D_Stat, handle-invalid=DONT-INVALIDATE}
      data Ford_LatCtlSte_D_Stat: sw-calibration-access=READ-ONLY, type=Ford_LatCtlSte_D_Stat
    Ford_LdwActvIntns_D_Req: invalidation-policy{data-element=Ford_LdwActvIntns_D_Req, handle-invalid=DONT-INVALIDATE}
      data Ford_LdwActvIntns_D_Req: sw-calibration-access=READ-ONLY, type=Ford_LdwActvIntns_D_Req
    Ford_LdwActvStats_D_Req: invalidation-policy{data-element=Ford_LdwActvStats_D_Req, handle-invalid=DONT-INVALIDATE}
      data Ford_LdwActvStats_D_Req: sw-calibration-access=READ-ONLY, type=Ford_LdwActvStats_D_Req
    Ford_LifeCycMde_D_Actl: invalidation-policy{data-element=Ford_LifeCycMde_D_Actl, handle-invalid=DONT-INVALIDATE}
      data Ford_LifeCycMde_D_Actl: sw-calibration-access=READ-ONLY, type=Ford_LifeCycMde_D_Actl
    Ford_LkaActvStats_D2_Req: invalidation-policy{data-element=Ford_LkaActvStats_D2_Req, handle-invalid=DONT-INVALIDATE}
      data Ford_LkaActvStats_D2_Req: sw-calibration-access=READ-ONLY, type=Ford_LkaActvStats_D2_Req
    Ford_LkaDrvOvrrd_D_Rq: invalidation-policy{data-element=Ford_LkaDrvOvrrd_D_Rq, handle-invalid=DONT-INVALIDATE}
      data Ford_LkaDrvOvrrd_D_Rq: sw-calibration-access=READ-ONLY, type=Ford_LkaDrvOvrrd_D_Rq
    Ford_LsmcBrk_Tq_Rq: invalidation-policy{data-element=Ford_LsmcBrk_Tq_Rq, handle-invalid=DONT-INVALIDATE}
      data Ford_LsmcBrk_Tq_Rq: sw-calibration-access=READ-ONLY, type=Ford_LsmcBrk_Tq_Rq
    Ford_LsmcBrkDecel_D_Stat: invalidation-policy{data-element=Ford_LsmcBrkDecel_D_Stat, handle-invalid=DONT-INVALIDATE}
      data Ford_LsmcBrkDecel_D_Stat: sw-calibration-access=READ-ONLY, type=Ford_LsmcBrkDecel_D_Stat
    Ford_LsmcBrkDecelEnbl_D_Rq: invalidation-policy{data-element=Ford_LsmcBrkDecelEnbl_D_Rq, handle-invalid=DONT-INVALIDATE}
      data Ford_LsmcBrkDecelEnbl_D_Rq: sw-calibration-access=READ-ONLY, type=Ford_LsmcBrkDecelEnbl_D_Rq
    Ford_OdometerMasterValue: invalidation-policy{data-element=Ford_OdometerMasterValue, handle-invalid=DONT-INVALIDATE}
      data Ford_OdometerMasterValue: sw-calibration-access=READ-ONLY, type=Ford_OdometerMasterValue
    Ford_Outside_Air_Temp_Stat: invalidation-policy{data-element=Ford_Outside_Air_Temp_Stat, handle-invalid=DONT-INVALIDATE}
      data Ford_Outside_Air_Temp_Stat: sw-calibration-access=READ-ONLY, type=Ford_Outside_Air_Temp_Stat
    Ford_PrplWhlTot2_Tq_Actl: invalidation-policy{data-element=Ford_PrplWhlTot2_Tq_Actl, handle-invalid=DONT-INVALIDATE}
      data Ford_PrplWhlTot2_Tq_Actl: sw-calibration-access=READ-ONLY, type=Ford_PrplWhlTot2_Tq_Actl
    Ford_PwPckTq_D_Stat: invalidation-policy{data-element=Ford_PwPckTq_D_Stat, handle-invalid=DONT-INVALIDATE}
      data Ford_PwPckTq_D_Stat: sw-calibration-access=READ-ONLY, type=Ford_PwPckTq_D_Stat
    Ford_SAPPAngleControlStat1: invalidation-policy{data-element=Ford_SAPPAngleControlStat1, handle-invalid=DONT-INVALIDATE}
      data Ford_SAPPAngleControlStat1: sw-calibration-access=READ-ONLY, type=Ford_SAPPAngleControlStat1
    Ford_SAPPAngleControlStat2: invalidation-policy{data-element=Ford_SAPPAngleControlStat2, handle-invalid=DONT-INVALIDATE}
      data Ford_SAPPAngleControlStat2: sw-calibration-access=READ-ONLY, type=Ford_SAPPAngleControlStat2
    Ford_SAPPAngleControlStat3: invalidation-policy{data-element=Ford_SAPPAngleControlStat3, handle-invalid=DONT-INVALIDATE}
      data Ford_SAPPAngleControlStat3: sw-calibration-access=READ-ONLY, type=Ford_SAPPAngleControlStat3
    Ford_SAPPAngleControlStat4: invalidation-policy{data-element=Ford_SAPPAngleControlStat4, handle-invalid=DONT-INVALIDATE}
      data Ford_SAPPAngleControlStat4: sw-calibration-access=READ-ONLY, type=Ford_SAPPAngleControlStat4
    Ford_SAPPAngleControlStat5: invalidation-policy{data-element=Ford_SAPPAngleControlStat5, handle-invalid=DONT-INVALIDATE}
      data Ford_SAPPAngleControlStat5: sw-calibration-access=READ-ONLY, type=Ford_SAPPAngleControlStat5
    Ford_SAPPAngleControlStat6: invalidation-policy{data-element=Ford_SAPPAngleControlStat6, handle-invalid=DONT-INVALIDATE}
      data Ford_SAPPAngleControlStat6: sw-calibration-access=READ-ONLY, type=Ford_SAPPAngleControlStat6
    Ford_SelDrvMdeChassis2_D_Rq: invalidation-policy{data-element=Ford_SelDrvMdeChassis2_D_Rq, handle-invalid=DONT-INVALIDATE}
      data Ford_SelDrvMdeChassis2_D_Rq: sw-calibration-access=READ-ONLY, type=Ford_SelDrvMdeChassis2_D_Rq
    Ford_SelDrvMdeSte_D_Stat: invalidation-policy{data-element=Ford_SelDrvMdeSte_D_Stat, handle-invalid=DONT-INVALIDATE}
      data Ford_SelDrvMdeSte_D_Stat: sw-calibration-access=READ-ONLY, type=Ford_SelDrvMdeSte_D_Stat
    Ford_StabCtlBrkActv_B_Actl: invalidation-policy{data-element=Ford_StabCtlBrkActv_B_Actl, handle-invalid=DONT-INVALIDATE}
      data Ford_StabCtlBrkActv_B_Actl: sw-calibration-access=READ-ONLY, type=Ford_StabCtlBrkActv_B_Actl
    Ford_SteeringColumnTorque: invalidation-policy{data-element=Ford_SteeringColumnTorque, handle-invalid=DONT-INVALIDATE}
      data Ford_SteeringColumnTorque: sw-calibration-access=READ-ONLY, type=Ford_SteeringColumnTorque
    Ford_SteMdule_D_Stat: invalidation-policy{data-element=Ford_SteMdule_D_Stat, handle-invalid=DONT-INVALIDATE}
      data Ford_SteMdule_D_Stat: sw-calibration-access=READ-ONLY, type=Ford_SteMdule_D_Stat
    Ford_SteMdule_I_Est: invalidation-policy{data-element=Ford_SteMdule_I_Est, handle-invalid=DONT-INVALIDATE}
      data Ford_SteMdule_I_Est: sw-calibration-access=READ-ONLY, type=Ford_SteMdule_I_Est
    Ford_SteMdule_U_Meas: invalidation-policy{data-element=Ford_SteMdule_U_Meas, handle-invalid=DONT-INVALIDATE}
      data Ford_SteMdule_U_Meas: sw-calibration-access=READ-ONLY, type=Ford_SteMdule_U_Meas
    Ford_StePinAn_No_Cnt: invalidation-policy{data-element=Ford_StePinAn_No_Cnt, handle-invalid=DONT-INVALIDATE}
      data Ford_StePinAn_No_Cnt: sw-calibration-access=READ-ONLY, type=Ford_StePinAn_No_Cnt
    Ford_StePinAn_No_Cs: invalidation-policy{data-element=Ford_StePinAn_No_Cs, handle-invalid=DONT-INVALIDATE}
      data Ford_StePinAn_No_Cs: sw-calibration-access=READ-ONLY, type=Ford_StePinAn_No_Cs
    Ford_StePinComp_An_Est: invalidation-policy{data-element=Ford_StePinComp_An_Est, handle-invalid=DONT-INVALIDATE}
      data Ford_StePinComp_An_Est: sw-calibration-access=READ-ONLY, type=Ford_StePinComp_An_Est
    Ford_StePinCompAnEst_D_Qf: invalidation-policy{data-element=Ford_StePinCompAnEst_D_Qf, handle-invalid=DONT-INVALIDATE}
      data Ford_StePinCompAnEst_D_Qf: sw-calibration-access=READ-ONLY, type=Ford_StePinCompAnEst_D_Qf
    Ford_StePinOffst_An_Est: invalidation-policy{data-element=Ford_StePinOffst_An_Est, handle-invalid=DONT-INVALIDATE}
      data Ford_StePinOffst_An_Est: sw-calibration-access=READ-ONLY, type=Ford_StePinOffst_An_Est
    Ford_StePinOffst_D_Stat: invalidation-policy{data-element=Ford_StePinOffst_D_Stat, handle-invalid=DONT-INVALIDATE}
      data Ford_StePinOffst_D_Stat: sw-calibration-access=READ-ONLY, type=Ford_StePinOffst_D_Stat
    Ford_StePinOffst_No_Cnt: invalidation-policy{data-element=Ford_StePinOffst_No_Cnt, handle-invalid=DONT-INVALIDATE}
      data Ford_StePinOffst_No_Cnt: sw-calibration-access=READ-ONLY, type=Ford_StePinOffst_No_Cnt
    Ford_StePinOffst_No_Cs: invalidation-policy{data-element=Ford_StePinOffst_No_Cs, handle-invalid=DONT-INVALIDATE}
      data Ford_StePinOffst_No_Cs: sw-calibration-access=READ-ONLY, type=Ford_StePinOffst_No_Cs
    Ford_StePinRelInit_An_Sns: invalidation-policy{data-element=Ford_StePinRelInit_An_Sns, handle-invalid=DONT-INVALIDATE}
      data Ford_StePinRelInit_An_Sns: sw-calibration-access=READ-ONLY, type=Ford_StePinRelInit_An_Sns
    Ford_StePw_B_Rq: invalidation-policy{data-element=Ford_StePw_B_Rq, handle-invalid=DONT-INVALIDATE}
      data Ford_StePw_B_Rq: sw-calibration-access=READ-ONLY, type=Ford_StePw_B_Rq
    Ford_SteWhlRelCalib_An_Sns: invalidation-policy{data-element=Ford_SteWhlRelCalib_An_Sns, handle-invalid=DONT-INVALIDATE}
      data Ford_SteWhlRelCalib_An_Sns: sw-calibration-access=READ-ONLY, type=Ford_SteWhlRelCalib_An_Sns
    Ford_TjaHandsOnCnfdnc_B_Est: invalidation-policy{data-element=Ford_TjaHandsOnCnfdnc_B_Est, handle-invalid=DONT-INVALIDATE}
      data Ford_TjaHandsOnCnfdnc_B_Est: sw-calibration-access=READ-ONLY, type=Ford_TjaHandsOnCnfdnc_B_Est
    Ford_TrlrAid_An3_Actl: invalidation-policy{data-element=Ford_TrlrAid_An3_Actl, handle-invalid=DONT-INVALIDATE}
      data Ford_TrlrAid_An3_Actl: sw-calibration-access=READ-ONLY, type=Ford_TrlrAid_An3_Actl
    Ford_TrlrAid_AnRate2_Actl: invalidation-policy{data-element=Ford_TrlrAid_AnRate2_Actl, handle-invalid=DONT-INVALIDATE}
      data Ford_TrlrAid_AnRate2_Actl: sw-calibration-access=READ-ONLY, type=Ford_TrlrAid_AnRate2_Actl
    Ford_TrlrAid_D2_Stat: invalidation-policy{data-element=Ford_TrlrAid_D2_Stat, handle-invalid=DONT-INVALIDATE}
      data Ford_TrlrAid_D2_Stat: sw-calibration-access=READ-ONLY, type=Ford_TrlrAid_D2_Stat
    Ford_TrlrAidCancl_B_Rq: invalidation-policy{data-element=Ford_TrlrAidCancl_B_Rq, handle-invalid=DONT-INVALIDATE}
      data Ford_TrlrAidCancl_B_Rq: sw-calibration-access=READ-ONLY, type=Ford_TrlrAidCancl_B_Rq
    Ford_TrlrAidCtl_U_RqDrv: invalidation-policy{data-element=Ford_TrlrAidCtl_U_RqDrv, handle-invalid=DONT-INVALIDATE}
      data Ford_TrlrAidCtl_U_RqDrv: sw-calibration-access=READ-ONLY, type=Ford_TrlrAidCtl_U_RqDrv
    Ford_TrlrAidEnbl_D2_Rq: invalidation-policy{data-element=Ford_TrlrAidEnbl_D2_Rq, handle-invalid=DONT-INVALIDATE}
      data Ford_TrlrAidEnbl_D2_Rq: sw-calibration-access=READ-ONLY, type=Ford_TrlrAidEnbl_D2_Rq
    Ford_TrlrAidEnbl_D2_Stat: invalidation-policy{data-element=Ford_TrlrAidEnbl_D2_Stat, handle-invalid=DONT-INVALIDATE}
      data Ford_TrlrAidEnbl_D2_Stat: sw-calibration-access=READ-ONLY, type=Ford_TrlrAidEnbl_D2_Stat
    Ford_TrlrAidMde_D_Rq: invalidation-policy{data-element=Ford_TrlrAidMde_D_Rq, handle-invalid=DONT-INVALIDATE}
      data Ford_TrlrAidMde_D_Rq: sw-calibration-access=READ-ONLY, type=Ford_TrlrAidMde_D_Rq
    Ford_TrlrAidMsgTxt_D2_Rq: invalidation-policy{data-element=Ford_TrlrAidMsgTxt_D2_Rq, handle-invalid=DONT-INVALIDATE}
      data Ford_TrlrAidMsgTxt_D2_Rq: sw-calibration-access=READ-ONLY, type=Ford_TrlrAidMsgTxt_D2_Rq
    Ford_TrlrAidSetup_D2_Rq: invalidation-policy{data-element=Ford_TrlrAidSetup_D2_Rq, handle-invalid=DONT-INVALIDATE}
      data Ford_TrlrAidSetup_D2_Rq: sw-calibration-access=READ-ONLY, type=Ford_TrlrAidSetup_D2_Rq
    Ford_TrlrAidSetup_D2_Stat: invalidation-policy{data-element=Ford_TrlrAidSetup_D2_Stat, handle-invalid=DONT-INVALIDATE}
      data Ford_TrlrAidSetup_D2_Stat: sw-calibration-access=READ-ONLY, type=Ford_TrlrAidSetup_D2_Stat
    Ford_TrlrAidSwtch_D_RqDrv: invalidation-policy{data-element=Ford_TrlrAidSwtch_D_RqDrv, handle-invalid=DONT-INVALIDATE}
      data Ford_TrlrAidSwtch_D_RqDrv: sw-calibration-access=READ-ONLY, type=Ford_TrlrAidSwtch_D_RqDrv
    Ford_TrlrAidTrgtId_No_Actl: invalidation-policy{data-element=Ford_TrlrAidTrgtId_No_Actl, handle-invalid=DONT-INVALIDATE}
      data Ford_TrlrAidTrgtId_No_Actl: sw-calibration-access=READ-ONLY, type=Ford_TrlrAidTrgtId_No_Actl
    Ford_TrlrAidTrgtId_No_Rq: invalidation-policy{data-element=Ford_TrlrAidTrgtId_No_Rq, handle-invalid=DONT-INVALIDATE}
      data Ford_TrlrAidTrgtId_No_Rq: sw-calibration-access=READ-ONLY, type=Ford_TrlrAidTrgtId_No_Rq
    Ford_TrlrAidTrlrId_No_Rq: invalidation-policy{data-element=Ford_TrlrAidTrlrId_No_Rq, handle-invalid=DONT-INVALIDATE}
      data Ford_TrlrAidTrlrId_No_Rq: sw-calibration-access=READ-ONLY, type=Ford_TrlrAidTrlrId_No_Rq
    Ford_TrlrAn_An_MxCalc: invalidation-policy{data-element=Ford_TrlrAn_An_MxCalc, handle-invalid=DONT-INVALIDATE}
      data Ford_TrlrAn_An_MxCalc: sw-calibration-access=READ-ONLY, type=Ford_TrlrAn_An_MxCalc
    Ford_TrlrAn_An_TrgtCalc: invalidation-policy{data-element=Ford_TrlrAn_An_TrgtCalc, handle-invalid=DONT-INVALIDATE}
      data Ford_TrlrAn_An_TrgtCalc: sw-calibration-access=READ-ONLY, type=Ford_TrlrAn_An_TrgtCalc
    Ford_TrlrAn_An_WarnCalc: invalidation-policy{data-element=Ford_TrlrAn_An_WarnCalc, handle-invalid=DONT-INVALIDATE}
      data Ford_TrlrAn_An_WarnCalc: sw-calibration-access=READ-ONLY, type=Ford_TrlrAn_An_WarnCalc
    Ford_TrlrAnOffst_An2_Calc: invalidation-policy{data-element=Ford_TrlrAnOffst_An2_Calc, handle-invalid=DONT-INVALIDATE}
      data Ford_TrlrAnOffst_An2_Calc: sw-calibration-access=READ-ONLY, type=Ford_TrlrAnOffst_An2_Calc
    Ford_TrlrAnOffstDir_D_Mem: invalidation-policy{data-element=Ford_TrlrAnOffstDir_D_Mem, handle-invalid=DONT-INVALIDATE}
      data Ford_TrlrAnOffstDir_D_Mem: sw-calibration-access=READ-ONLY, type=Ford_TrlrAnOffstDir_D_Mem
    Ford_TrlrAxleToBmpr_L_Actl: invalidation-policy{data-element=Ford_TrlrAxleToBmpr_L_Actl, handle-invalid=DONT-INVALIDATE}
      data Ford_TrlrAxleToBmpr_L_Actl: sw-calibration-access=READ-ONLY, type=Ford_TrlrAxleToBmpr_L_Actl
    Ford_TrlrBrkActCnnct_B_Actl: invalidation-policy{data-element=Ford_TrlrBrkActCnnct_B_Actl, handle-invalid=DONT-INVALIDATE}
      data Ford_TrlrBrkActCnnct_B_Actl: sw-calibration-access=READ-ONLY, type=Ford_TrlrBrkActCnnct_B_Actl
    Ford_TrlrHitchLamp_D_Rqst: invalidation-policy{data-element=Ford_TrlrHitchLamp_D_Rqst, handle-invalid=DONT-INVALIDATE}
      data Ford_TrlrHitchLamp_D_Rqst: sw-calibration-access=READ-ONLY, type=Ford_TrlrHitchLamp_D_Rqst
    Ford_TrlrHitchYaw_An_Actl: invalidation-policy{data-element=Ford_TrlrHitchYaw_An_Actl, handle-invalid=DONT-INVALIDATE}
      data Ford_TrlrHitchYaw_An_Actl: sw-calibration-access=READ-ONLY, type=Ford_TrlrHitchYaw_An_Actl
    Ford_TrlrHitchYaw_D_Stat: invalidation-policy{data-element=Ford_TrlrHitchYaw_D_Stat, handle-invalid=DONT-INVALIDATE}
      data Ford_TrlrHitchYaw_D_Stat: sw-calibration-access=READ-ONLY, type=Ford_TrlrHitchYaw_D_Stat
    Ford_TrlrHitYaw_AnRate_Actl: invalidation-policy{data-element=Ford_TrlrHitYaw_AnRate_Actl, handle-invalid=DONT-INVALIDATE}
      data Ford_TrlrHitYaw_AnRate_Actl: sw-calibration-access=READ-ONLY, type=Ford_TrlrHitYaw_AnRate_Actl
    Ford_TrlrId_No_Actl: invalidation-policy{data-element=Ford_TrlrId_No_Actl, handle-invalid=DONT-INVALIDATE}
      data Ford_TrlrId_No_Actl: sw-calibration-access=READ-ONLY, type=Ford_TrlrId_No_Actl
    Ford_TrlrIdType_D_Stat: invalidation-policy{data-element=Ford_TrlrIdType_D_Stat, handle-invalid=DONT-INVALIDATE}
      data Ford_TrlrIdType_D_Stat: sw-calibration-access=READ-ONLY, type=Ford_TrlrIdType_D_Stat
    Ford_TrlrLampCnnct_B_Actl: invalidation-policy{data-element=Ford_TrlrLampCnnct_B_Actl, handle-invalid=DONT-INVALIDATE}
      data Ford_TrlrLampCnnct_B_Actl: sw-calibration-access=READ-ONLY, type=Ford_TrlrLampCnnct_B_Actl
    Ford_TrlrRvrse_D_Stat: invalidation-policy{data-element=Ford_TrlrRvrse_D_Stat, handle-invalid=DONT-INVALIDATE}
      data Ford_TrlrRvrse_D_Stat: sw-calibration-access=READ-ONLY, type=Ford_TrlrRvrse_D_Stat
    Ford_TrlrRvrseCancl_B_Rq: invalidation-policy{data-element=Ford_TrlrRvrseCancl_B_Rq, handle-invalid=DONT-INVALIDATE}
      data Ford_TrlrRvrseCancl_B_Rq: sw-calibration-access=READ-ONLY, type=Ford_TrlrRvrseCancl_B_Rq
    Ford_TrlrRvrseEnbl_D2_Stat: invalidation-policy{data-element=Ford_TrlrRvrseEnbl_D2_Stat, handle-invalid=DONT-INVALIDATE}
      data Ford_TrlrRvrseEnbl_D2_Stat: sw-calibration-access=READ-ONLY, type=Ford_TrlrRvrseEnbl_D2_Stat
    Ford_TrlrRvrseMsgTxt_D2_Rq: invalidation-policy{data-element=Ford_TrlrRvrseMsgTxt_D2_Rq, handle-invalid=DONT-INVALIDATE}
      data Ford_TrlrRvrseMsgTxt_D2_Rq: sw-calibration-access=READ-ONLY, type=Ford_TrlrRvrseMsgTxt_D2_Rq
    Ford_TrlrSnsId_No_Actl: invalidation-policy{data-element=Ford_TrlrSnsId_No_Actl, handle-invalid=DONT-INVALIDATE}
      data Ford_TrlrSnsId_No_Actl: sw-calibration-access=READ-ONLY, type=Ford_TrlrSnsId_No_Actl
    Ford_TrlrTrgtAcquire_D_Stat: invalidation-policy{data-element=Ford_TrlrTrgtAcquire_D_Stat, handle-invalid=DONT-INVALIDATE}
      data Ford_TrlrTrgtAcquire_D_Stat: sw-calibration-access=READ-ONLY, type=Ford_TrlrTrgtAcquire_D_Stat
    Ford_TrlrYaw_W_Actl: invalidation-policy{data-element=Ford_TrlrYaw_W_Actl, handle-invalid=DONT-INVALIDATE}
      data Ford_TrlrYaw_W_Actl: sw-calibration-access=READ-ONLY, type=Ford_TrlrYaw_W_Actl
    Ford_TrlrYawWActl_D_Qf: invalidation-policy{data-element=Ford_TrlrYawWActl_D_Qf, handle-invalid=DONT-INVALIDATE}
      data Ford_TrlrYawWActl_D_Qf: sw-calibration-access=READ-ONLY, type=Ford_TrlrYawWActl_D_Qf
    Ford_TrnRng_D_Rq: invalidation-policy{data-element=Ford_TrnRng_D_Rq, handle-invalid=DONT-INVALIDATE}
      data Ford_TrnRng_D_Rq: sw-calibration-access=READ-ONLY, type=Ford_TrnRng_D_Rq
    Ford_TurnLghtSwtch_D_Stat: invalidation-policy{data-element=Ford_TurnLghtSwtch_D_Stat, handle-invalid=DONT-INVALIDATE}
      data Ford_TurnLghtSwtch_D_Stat: sw-calibration-access=READ-ONLY, type=Ford_TurnLghtSwtch_D_Stat
    Ford_Veh_V_ActlBrk: invalidation-policy{data-element=Ford_Veh_V_ActlBrk, handle-invalid=DONT-INVALIDATE}
      data Ford_Veh_V_ActlBrk: sw-calibration-access=READ-ONLY, type=Ford_Veh_V_ActlBrk
    Ford_Veh_V_ActlEng: invalidation-policy{data-element=Ford_Veh_V_ActlEng, handle-invalid=DONT-INVALIDATE}
      data Ford_Veh_V_ActlEng: sw-calibration-access=READ-ONLY, type=Ford_Veh_V_ActlEng
    Ford_Veh_V_RqMxTrlrAid: invalidation-policy{data-element=Ford_Veh_V_RqMxTrlrAid, handle-invalid=DONT-INVALIDATE}
      data Ford_Veh_V_RqMxTrlrAid: sw-calibration-access=READ-ONLY, type=Ford_Veh_V_RqMxTrlrAid
    Ford_VehicleGGCCData: invalidation-policy{data-element=Ford_VehicleGGCCData, handle-invalid=DONT-INVALIDATE}
      data Ford_VehicleGGCCData: sw-calibration-access=READ-ONLY, type=Ford_VehicleGGCCData
    Ford_VehLatComp_A_Actl: invalidation-policy{data-element=Ford_VehLatComp_A_Actl, handle-invalid=DONT-INVALIDATE}
      data Ford_VehLatComp_A_Actl: sw-calibration-access=READ-ONLY, type=Ford_VehLatComp_A_Actl
    Ford_VehLongComp_A_Actl: invalidation-policy{data-element=Ford_VehLongComp_A_Actl, handle-invalid=DONT-INVALIDATE}
      data Ford_VehLongComp_A_Actl: sw-calibration-access=READ-ONLY, type=Ford_VehLongComp_A_Actl
    Ford_VehOverGnd_V_Est: invalidation-policy{data-element=Ford_VehOverGnd_V_Est, handle-invalid=DONT-INVALIDATE}
      data Ford_VehOverGnd_V_Est: sw-calibration-access=READ-ONLY, type=Ford_VehOverGnd_V_Est
    Ford_VehVActlBrk_D_Qf: invalidation-policy{data-element=Ford_VehVActlBrk_D_Qf, handle-invalid=DONT-INVALIDATE}
      data Ford_VehVActlBrk_D_Qf: sw-calibration-access=READ-ONLY, type=Ford_VehVActlBrk_D_Qf
    Ford_VehVActlBrk_No_Cnt: invalidation-policy{data-element=Ford_VehVActlBrk_No_Cnt, handle-invalid=DONT-INVALIDATE}
      data Ford_VehVActlBrk_No_Cnt: sw-calibration-access=READ-ONLY, type=Ford_VehVActlBrk_No_Cnt
    Ford_VehVActlBrk_No_Cs: invalidation-policy{data-element=Ford_VehVActlBrk_No_Cs, handle-invalid=DONT-INVALIDATE}
      data Ford_VehVActlBrk_No_Cs: sw-calibration-access=READ-ONLY, type=Ford_VehVActlBrk_No_Cs
    Ford_VehVActlEng_D_Qf: invalidation-policy{data-element=Ford_VehVActlEng_D_Qf, handle-invalid=DONT-INVALIDATE}
      data Ford_VehVActlEng_D_Qf: sw-calibration-access=READ-ONLY, type=Ford_VehVActlEng_D_Qf
    Ford_VehVActlEng_No_Cnt: invalidation-policy{data-element=Ford_VehVActlEng_No_Cnt, handle-invalid=DONT-INVALIDATE}
      data Ford_VehVActlEng_No_Cnt: sw-calibration-access=READ-ONLY, type=Ford_VehVActlEng_No_Cnt
    Ford_VehVActlEng_No_Cs: invalidation-policy{data-element=Ford_VehVActlEng_No_Cs, handle-invalid=DONT-INVALIDATE}
      data Ford_VehVActlEng_No_Cs: sw-calibration-access=READ-ONLY, type=Ford_VehVActlEng_No_Cs
    Ford_VehVertComp_A_Actl: invalidation-policy{data-element=Ford_VehVertComp_A_Actl, handle-invalid=DONT-INVALIDATE}
      data Ford_VehVertComp_A_Actl: sw-calibration-access=READ-ONLY, type=Ford_VehVertComp_A_Actl
    Ford_VehVTrlrAid_B_Avail: invalidation-policy{data-element=Ford_VehVTrlrAid_B_Avail, handle-invalid=DONT-INVALIDATE}
      data Ford_VehVTrlrAid_B_Avail: sw-calibration-access=READ-ONLY, type=Ford_VehVTrlrAid_B_Avail
    Ford_VehVTrlrAid_B_Rq: invalidation-policy{data-element=Ford_VehVTrlrAid_B_Rq, handle-invalid=DONT-INVALIDATE}
      data Ford_VehVTrlrAid_B_Rq: sw-calibration-access=READ-ONLY, type=Ford_VehVTrlrAid_B_Rq
    Ford_VehYaw_W_Actl: invalidation-policy{data-element=Ford_VehYaw_W_Actl, handle-invalid=DONT-INVALIDATE}
      data Ford_VehYaw_W_Actl: sw-calibration-access=READ-ONLY, type=Ford_VehYaw_W_Actl
    Ford_VehYawComp_W_Actl: invalidation-policy{data-element=Ford_VehYawComp_W_Actl, handle-invalid=DONT-INVALIDATE}
      data Ford_VehYawComp_W_Actl: sw-calibration-access=READ-ONLY, type=Ford_VehYawComp_W_Actl
    Ford_WhlDirFl_D_Actl: invalidation-policy{data-element=Ford_WhlDirFl_D_Actl, handle-invalid=DONT-INVALIDATE}
      data Ford_WhlDirFl_D_Actl: sw-calibration-access=READ-ONLY, type=Ford_WhlDirFl_D_Actl
    Ford_WhlDirFr_D_Actl: invalidation-policy{data-element=Ford_WhlDirFr_D_Actl, handle-invalid=DONT-INVALIDATE}
      data Ford_WhlDirFr_D_Actl: sw-calibration-access=READ-ONLY, type=Ford_WhlDirFr_D_Actl
    Ford_WhlDirRl_D_Actl: invalidation-policy{data-element=Ford_WhlDirRl_D_Actl, handle-invalid=DONT-INVALIDATE}
      data Ford_WhlDirRl_D_Actl: sw-calibration-access=READ-ONLY, type=Ford_WhlDirRl_D_Actl
    Ford_WhlDirRr_D_Actl: invalidation-policy{data-element=Ford_WhlDirRr_D_Actl, handle-invalid=DONT-INVALIDATE}
      data Ford_WhlDirRr_D_Actl: sw-calibration-access=READ-ONLY, type=Ford_WhlDirRr_D_Actl
    Ford_WhlFl_W_Meas: invalidation-policy{data-element=Ford_WhlFl_W_Meas, handle-invalid=DONT-INVALIDATE}
      data Ford_WhlFl_W_Meas: sw-calibration-access=READ-ONLY, type=Ford_WhlFl_W_Meas
    Ford_WhlFr_W_Meas: invalidation-policy{data-element=Ford_WhlFr_W_Meas, handle-invalid=DONT-INVALIDATE}
      data Ford_WhlFr_W_Meas: sw-calibration-access=READ-ONLY, type=Ford_WhlFr_W_Meas
    Ford_WhlRl_W_Meas: invalidation-policy{data-element=Ford_WhlRl_W_Meas, handle-invalid=DONT-INVALIDATE}
      data Ford_WhlRl_W_Meas: sw-calibration-access=READ-ONLY, type=Ford_WhlRl_W_Meas
    Ford_WhlRotatFl_No_Cnt: invalidation-policy{data-element=Ford_WhlRotatFl_No_Cnt, handle-invalid=DONT-INVALIDATE}
      data Ford_WhlRotatFl_No_Cnt: sw-calibration-access=READ-ONLY, type=Ford_WhlRotatFl_No_Cnt
    Ford_WhlRotatFr_No_Cnt: invalidation-policy{data-element=Ford_WhlRotatFr_No_Cnt, handle-invalid=DONT-INVALIDATE}
      data Ford_WhlRotatFr_No_Cnt: sw-calibration-access=READ-ONLY, type=Ford_WhlRotatFr_No_Cnt
    Ford_WhlRotatRl_No_Cnt: invalidation-policy{data-element=Ford_WhlRotatRl_No_Cnt, handle-invalid=DONT-INVALIDATE}
      data Ford_WhlRotatRl_No_Cnt: sw-calibration-access=READ-ONLY, type=Ford_WhlRotatRl_No_Cnt
    Ford_WhlRotatRr_No_Cnt: invalidation-policy{data-element=Ford_WhlRotatRr_No_Cnt, handle-invalid=DONT-INVALIDATE}
      data Ford_WhlRotatRr_No_Cnt: sw-calibration-access=READ-ONLY, type=Ford_WhlRotatRr_No_Cnt
    Ford_WhlRr_W_Meas: invalidation-policy{data-element=Ford_WhlRr_W_Meas, handle-invalid=DONT-INVALIDATE}
      data Ford_WhlRr_W_Meas: sw-calibration-access=READ-ONLY, type=Ford_WhlRr_W_Meas
    Ford_YawStabilityIndex: invalidation-policy{data-element=Ford_YawStabilityIndex, handle-invalid=DONT-INVALIDATE}
      data Ford_YawStabilityIndex: sw-calibration-access=READ-ONLY, type=Ford_YawStabilityIndex
package /Nexteer/Calibrations
  parameter interface uint16_CalPortIf1
    parameter data prototype Val: sw-calibration-access=READ-WRITE, type=uint16
package /Nexteer/PortInterfaces
  client server interface GetRefTmr100MicroSec32bit_PortIf1
    operation Oper
      arg RefTmr_Arg: type=uint32, direction=OUT, server-argument-impl-policy=USE-ARGUMENT-TYPE
  client server interface GetTiSpan100MicroSec32bit_PortIf1
    operation Oper
      arg RefTmr_Arg: type=uint32, direction=IN, server-argument-impl-policy=USE-ARGUMENT-TYPE
      arg TiSpan_Arg: type=uint32, direction=OUT, server-argument-impl-policy=USE-ARGUMENT-TYPE
  client server interface SetNtcSts_PortIf1
    operation Oper: possible-error=E_NOT_OK
      4 x arg, all with direction=IN, server-argument-impl-policy=USE-ARGUMENT-TYPE:
        NtcNr_Arg: type=NtcNr1
        NtcStInfo_Arg: type=uint8
        NtcSts_Arg: type=NtcSts1
        DebStep_Arg: type=uint16
    error E_NOT_OK: error-code=1
  4 x sender receiver interface:
    boolean_PortIf1: invalidation-policy{data-element=Logl, handle-invalid=DONT-INVALIDATE}
      data Logl: sw-calibration-access=READ-ONLY, type=boolean
    float32_PortIf1: invalidation-policy{data-element=float32_PortIf1/Val, handle-invalid=DONT-INVALIDATE}
      data Val: sw-calibration-access=READ-ONLY, type=float32
    uint16_PortIf1: invalidation-policy{data-element=uint16_PortIf1/Val, handle-invalid=DONT-INVALIDATE}
      data Val: sw-calibration-access=READ-ONLY, type=uint16
    uint8_PortIf1: invalidation-policy{data-element=uint8_PortIf1/Val, handle-invalid=DONT-INVALIDATE}
      data Val: sw-calibration-access=READ-ONLY, type=uint8
