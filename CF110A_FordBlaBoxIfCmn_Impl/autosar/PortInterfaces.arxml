AUTOSAR XML (schema 4-0-3)
package /Ford/PortInterfaces
  sender receiver interface Ford_StePinCompAnEst_D_Qf_PortIf1: invalidation-policy{data-element=Ford_StePinCompAnEst_D_Qf_PortIf1/Val, handle-invalid=DONT-INVALIDATE}
    data Val: sw-calibration-access=READ-ONLY, type=Ford_StePinCompAnEst_D_Qf
  sender receiver interface Ford_VehYaw_W_Actl: invalidation-policy{data-element=Ford_VehYaw_W_Actl/Val, handle-invalid=DONT-INVALIDATE}
    data Val: sw-calibration-access=READ-ONLY, type=Ford_VehYaw_W_Actl
package /Nexteer/Calibrations
  parameter interface u8p8_CalPortIf1
    parameter data prototype Val: sw-calibration-access=READ-WRITE, type=u8p8
  parameter interface uint16_CalPortIf1
    parameter data prototype Val: sw-calibration-access=READ-WRITE, type=uint16
package /Nexteer/PortInterfaces
  5 x sender receiver interface:
    boolean_PortIf1: invalidation-policy{data-element=Logl, handle-invalid=DONT-INVALIDATE}
      data Logl: sw-calibration-access=READ-ONLY, type=boolean
    float32_PortIf1: invalidation-policy{data-element=float32_PortIf1/Val, handle-invalid=DONT-INVALIDATE}
      data Val: sw-calibration-access=READ-ONLY, type=float32
    uint16_PortIf1: invalidation-policy{data-element=uint16_PortIf1/Val, handle-invalid=DONT-INVALIDATE}
      data Val: sw-calibration-access=READ-ONLY, type=uint16
    uint32_PortIf1: invalidation-policy{data-element=uint32_PortIf1/Val, handle-invalid=DONT-INVALIDATE}
      data Val: sw-calibration-access=READ-ONLY, type=uint32
    uint8_PortIf1: invalidation-policy{data-element=uint8_PortIf1/Val, handle-invalid=DONT-INVALIDATE}
      data Val: sw-calibration-access=READ-ONLY, type=uint8
package /PortInterfaces
  sender receiver interface s5p10_PortIf1: invalidation-policy{data-element=s5p10_PortIf1/Val, handle-invalid=DONT-INVALIDATE}
    data Val: sw-calibration-access=READ-ONLY, type=s5p10
  sender receiver interface s8p7_PortIf1: invalidation-policy{data-element=s8p7_PortIf1/Val, handle-invalid=DONT-INVALIDATE}
    data Val: sw-calibration-access=READ-ONLY, type=s8p7
  sender receiver interface u8p8_PortIf1: invalidation-policy{data-element=u8p8_PortIf1/Val, handle-invalid=DONT-INVALIDATE}
    data Val: sw-calibration-access=READ-ONLY, type=u8p8
