AUTOSAR XML (schema 4-0-3)
standard types defined: boolean, dtRef_const_VOID, dtRef_VOID, float32, float64, sint16, sint16_least, sint32, sint32_least, sint64, sint8, sint8_least, uint16, uint16_least, uint32, uint32_least, uint64, uint8, uint8_least, boolean_CompuMethod, boolean_DataConstr, float32_DataConstr, float64_DataConstr, sint16_DataConstr, sint16_least_DataConstr, sint32_DataConstr, sint32_least_DataConstr, sint64_DataConstr, sint8_DataConstr, sint8_least_DataConstr, uint16_DataConstr, uint16_least_DataConstr, uint32_DataConstr, uint32_least_DataConstr, uint64_DataConstr, uint8_DataConstr, uint8_least_DataConstr
package /DataType/Unit
  unit U_radYs: display-name=rad/s, factor-si-to-unit=1, offset-si-to-unit=0
  unit U_SED: display-name=SED, factor-si-to-unit=1, offset-si-to-unit=0
package /Ford/DataTypes
  impl type Ford_StePinCompAnEst_D_Qf: category=VALUE, base-type=DataType/uint8, sw-calibration-access=READ-ONLY, compu {phys=raw for raw 0..3, 0=Cx0_Faulty, 1=Cx1_No_Data_Exists, 2=Cx2_Degraded, 3=Cx3_OK; unit SED}, range raw 0..3
  impl type Ford_VehYaw_W_Actl: category=VALUE, base-type=DataType/uint16, sw-calibration-access=READ-ONLY, compu {65534=CxFFFE_NoDataExists, 65535=CxFFFF_Faulty, phys=raw for raw 0..65535; unit rad/s} "Source signal range: [0,65533]"
package /Nexteer/DataTypes
  impl type s5p10: implementation-data-type=sint16, type-emitter=RTE
  impl type s8p7: implementation-data-type=sint16, type-emitter=RTE
  impl type u8p8: implementation-data-type=uint16, type-emitter=RTE
