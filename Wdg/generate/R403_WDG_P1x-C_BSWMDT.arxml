AUTOSAR XML (schema 4-0-3)
# COPYRIGHT
# Copyright(c) 2015-2017  Renesas Electronics Corporation
package /Renesas/EcucDefs_Wdg0
  bsw implementation Wdg_Impl: programming-language=C, sw-version=1.0.2, vendor-id=59, ar-release-version=4.0.3, behavior=Wdg/BswInternalBehavior_0, vendor-api-infix=DriverA
  bsw module description Wdg: module-id=102
    bsw internal behavior BswInternalBehavior_0
      exclusive area WDG_59_DRIVERA_TRIGG_PROTECTION
      exclusive area WDG_59_DRIVERA_MODE_SWITCH_PROTECTION
      bsw interrupt entity BswInterruptEntity_0: can-enter-exclusive-area=WDG_59_DRIVERA_TRIGG_PROTECTION, implemented-entry=WDG_59_DRIVERA_TRIGGERFUNCTION_ISR, interrupt-category=CAT-1, interrupt-source=INTWDTA0
      bsw interrupt entity BswInterruptEntity_1: can-enter-exclusive-area=WDG_59_DRIVERA_TRIGG_PROTECTION, implemented-entry=WDG_59_DRIVERA_TRIGGERFUNCTION_CAT2_ISR, interrupt-category=CAT-2, interrupt-source=INTWDTA0
      4 x bsw called entity:
        BswCalledEntity_0: can-enter-exclusive-area=[WDG_59_DRIVERA_MODE_SWITCH_PROTECTION, WDG_59_DRIVERA_TRIGG_PROTECTION], implemented-entry=Wdg_59_DriverA_Init
        BswCalledEntity_1: can-enter-exclusive-area=[WDG_59_DRIVERA_TRIGG_PROTECTION, WDG_59_DRIVERA_MODE_SWITCH_PROTECTION], implemented-entry=Wdg_59_DriverA_SetMode
        BswCalledEntity_2: can-enter-exclusive-area=WDG_59_DRIVERA_TRIGG_PROTECTION, implemented-entry=Wdg_59_DriverA_SetTriggerCondition
        BswCalledEntity_3: implemented-entry=Wdg_59_DriverA_GetVersionInfo
  6 x bsw module entry, all with is-synchronous=true, sw-service-impl-policy=STANDARD:
    WDG_59_DRIVERA_TRIGGERFUNCTION_ISR: call-type=INTERRUPT, execution-context=INTERRUPT-CAT-1, is-reentrant=true
    WDG_59_DRIVERA_TRIGGERFUNCTION_CAT2_ISR: call-type=INTERRUPT, execution-context=INTERRUPT-CAT-2, is-reentrant=true
    Wdg_59_DriverA_Init: call-type=REGULAR, execution-context=TASK, is-reentrant=false, service-id=0
    Wdg_59_DriverA_SetMode: call-type=REGULAR, execution-context=TASK, is-reentrant=false, service-id=1
    Wdg_59_DriverA_SetTriggerCondition: call-type=REGULAR, execution-context=TASK, is-reentrant=false, service-id=3
    Wdg_59_DriverA_GetVersionInfo: call-type=REGULAR, execution-context=TASK, is-reentrant=true, service-id=4
package /Renesas/EcucDefs_Wdg1
  bsw implementation Wdg_Impl: programming-language=C, sw-version=1.0.2, vendor-id=59, ar-release-version=4.0.3, behavior=Wdg/BswInternalBehavior_0, vendor-api-infix=DriverB
  bsw module description Wdg: module-id=102
    bsw internal behavior BswInternalBehavior_0
      exclusive area WDG_59_DRIVERB_TRIGG_PROTECTION
      exclusive area WDG_59_DRIVERB_MODE_SWITCH_PROTECTION
      bsw interrupt entity BswInterruptEntity_0: can-enter-exclusive-area=WDG_59_DRIVERB_TRIGG_PROTECTION, implemented-entry=WDG_59_DRIVERB_TRIGGERFUNCTION_ISR, interrupt-category=CAT-1, interrupt-source=INTWDTA1
      bsw interrupt entity BswInterruptEntity_1: can-enter-exclusive-area=WDG_59_DRIVERB_TRIGG_PROTECTION, implemented-entry=WDG_59_DRIVERB_TRIGGERFUNCTION_CAT2_ISR, interrupt-category=CAT-2, interrupt-source=INTWDTA1
      4 x bsw called entity:
        BswCalledEntity_0: can-enter-exclusive-area=[WDG_59_DRIVERB_MODE_SWITCH_PROTECTION, WDG_59_DRIVERB_TRIGG_PROTECTION], implemented-entry=Wdg_59_DriverB_Init
        BswCalledEntity_1: can-enter-exclusive-area=[WDG_59_DRIVERB_TRIGG_PROTECTION, WDG_59_DRIVERB_MODE_SWITCH_PROTECTION], implemented-entry=Wdg_59_DriverB_SetMode
        BswCalledEntity_2: can-enter-exclusive-area=WDG_59_DRIVERB_TRIGG_PROTECTION, implemented-entry=Wdg_59_DriverB_SetTriggerCondition
        BswCalledEntity_3: implemented-entry=Wdg_59_DriverB_GetVersionInfo
  6 x bsw module entry, all with is-synchronous=true, sw-service-impl-policy=STANDARD:
    WDG_59_DRIVERB_TRIGGERFUNCTION_ISR: call-type=INTERRUPT, execution-context=INTERRUPT-CAT-1, is-reentrant=true
    WDG_59_DRIVERB_TRIGGERFUNCTION_CAT2_ISR: call-type=INTERRUPT, execution-context=INTERRUPT-CAT-2, is-reentrant=true
    Wdg_59_DriverB_Init: call-type=REGULAR, execution-context=TASK, is-reentrant=false, service-id=0
    Wdg_59_DriverB_SetMode: call-type=REGULAR, execution-context=TASK, is-reentrant=false, service-id=1
    Wdg_59_DriverB_SetTriggerCondition: call-type=REGULAR, execution-context=TASK, is-reentrant=false, service-id=3
    Wdg_59_DriverB_GetVersionInfo: call-type=REGULAR, execution-context=TASK, is-reentrant=true, service-id=4
