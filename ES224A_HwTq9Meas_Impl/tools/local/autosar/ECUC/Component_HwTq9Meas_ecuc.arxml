AUTOSAR XML (schema 4-0-3)
package /ActiveEcuC
  module config HwTq9Meas: implementation-config-variant=VARIANT-PRE-COMPILE
    HwTq9MeasGeneral: NTC_HwTq9MfgFlt=NTCNR_0X1E0, NTC_HwTq9PrtclFlt=NTCNR_0X073
