AUTOSAR XML (schema 4-2-1)
package /MICROSAR
  module config Os_Pre: definition=Os
    OsPublishedInformation
      RH850E1x (OsDerivativeInformation):
        OsMpuAlignment = 4
        OsStackAlignment = 4
        OsExceptionVectorTableAlignment = 512
        OsInterruptVectorTableAlignment = 512
        OsHardwareManuals = RH850/E1x-FCC1 Users Manual: Hardware Rev.0.50 Jul 2014 RH850/E1L Users Manual: Hardware Rev.1.10 Apr 2016 RH850/E1M-S Users Manual: Hardware Rev.1.10 Apr 2016 RH850G3M Users Manual: Software Rev.1.30 Jun 2016 RH850G3K Users Manual: Software Rev.1.20 Apr 2016
        CORE0 (OsPhysicalCore):
          OsPhysicalCoreId = 0
          OsPhysicalCoreType = G3M
          OsPhysicalCoreExceptionSources = 16
          OsPhysicalCoreIsAutostart = 1
          OsPhysicalCoreMasterStartAllowed = 0
          OsPhysicalCorePrivelegedHwAccess = 1
          MPU_CORE0 (OsPhysicalCoreMpu): OsPhysicalCoreMpuId=0, OsPhysicalCoreMpuMaxRegions=12, OsPhysicalCoreMpuType=CoreMpu
        OSTM0 (OsHardwareTimer):
          OsHardwareTimerBaseAddress = 4293656576
          OsHardwareTimerHighResPossible = 1
          OsHardwareTimerUnit = OSTM
          OsHardwareTimerSize = 32
          OsHardwareTimerId = 0
          OsHardwareTimerType = OSTM
          OSTM0 (OsHardwareTimerChannel): OsHardwareTimerChannelIntSource=25, OsHardwareTimerChannelOffset=0, OsHardwareTimerChannelId=0
        OSTM1 (OsHardwareTimer):
          OsHardwareTimerBaseAddress = 4293660672
          OsHardwareTimerHighResPossible = 1
          OsHardwareTimerUnit = OSTM
          OsHardwareTimerSize = 32
          OsHardwareTimerId = 1
          OsHardwareTimerType = OSTM
          OSTM1 (OsHardwareTimerChannel): OsHardwareTimerChannelIntSource=26, OsHardwareTimerChannelOffset=0, OsHardwareTimerChannelId=0
        INTC (OsSystemIntCtrl): OsSystemIntCtrlBaseAddress=4294896128, OsSystemIntCtrlMaxPrios=16, OsSystemIntCtrlMaxSources=512, OsSystemIntCtrlPrioOrder=DESC
          5 x OsSystemIntCtrlAddress:
            INTC1: OsSystemIntCtrlAddressValue=4294896128
            INTC2: OsSystemIntCtrlAddressValue=4294946816
            EIBD1: OsSystemIntCtrlAddressValue=0
            EIBD2: OsSystemIntCtrlAddressValue=0
            IPIR: OsSystemIntCtrlAddressValue=0
        MPAT (OsMemoryRegionSpecifics)
          6 x OsMemoryRegionAccess:
            SR: OsMemoryRegionAccessRights=R, OsMemoryRegionAccessType=SUPERVISOR
            SW: OsMemoryRegionAccessRights=W, OsMemoryRegionAccessType=SUPERVISOR
            SX: OsMemoryRegionAccessRights=X, OsMemoryRegionAccessType=SUPERVISOR
            UR: OsMemoryRegionAccessRights=R, OsMemoryRegionAccessType=USER
            UW: OsMemoryRegionAccessRights=W, OsMemoryRegionAccessType=USER
            UX: OsMemoryRegionAccessRights=X, OsMemoryRegionAccessType=USER
        OSTM2 (OsHardwareTimer):
          OsHardwareTimerBaseAddress = 4293664768
          OsHardwareTimerHighResPossible = 1
          OsHardwareTimerUnit = OSTM
          OsHardwareTimerSize = 32
          OsHardwareTimerId = 2
          OsHardwareTimerType = OSTM
          OSTM2 (OsHardwareTimerChannel): OsHardwareTimerChannelIntSource=126, OsHardwareTimerChannelOffset=0, OsHardwareTimerChannelId=0
