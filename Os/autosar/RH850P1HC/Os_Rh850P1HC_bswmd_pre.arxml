AUTOSAR XML (schema 4-2-1)
package /MICROSAR
  module config Os_Pre: definition=Os
    OsPublishedInformation
      RH850P1HC (OsDerivativeInformation):
        OsMpuAlignment = 4
        OsStackAlignment = 4
        OsExceptionVectorTableAlignment = 512
        OsInterruptVectorTableAlignment = 512
        OsHardwareManuals = RH850/P1x-C Group Users Manual: Hardware Rev.1.10 Jul 2016 RH850G3M Users Manual: Software Rev.1.30 Jun 2016
        CORE0 (OsPhysicalCore):
          OsPhysicalCoreId = 0
          OsPhysicalCoreType = G3M
          OsPhysicalCoreExceptionSources = 16
          OsPhysicalCoreIsAutostart = 1
          OsPhysicalCoreMasterStartAllowed = 0
          OsPhysicalCorePrivelegedHwAccess = 1
          MPU_CORE0 (OsPhysicalCoreMpu): OsPhysicalCoreMpuId=0, OsPhysicalCoreMpuMaxRegions=16, OsPhysicalCoreMpuType=CoreMpu
        STM0 (OsHardwareTimer):
          OsHardwareTimerBaseAddress = 4292706304
          OsHardwareTimerHighResPossible = 1
          OsHardwareTimerUnit = STM
          OsHardwareTimerSize = 32
          OsHardwareTimerId = 0
          OsHardwareTimerType = STM
          STM0 (OsHardwareTimerChannel): OsHardwareTimerChannelIntSource=41, OsHardwareTimerChannelOffset=0, OsHardwareTimerChannelId=0
        STM1 (OsHardwareTimer):
          OsHardwareTimerBaseAddress = 4292710400
          OsHardwareTimerHighResPossible = 1
          OsHardwareTimerUnit = STM
          OsHardwareTimerSize = 32
          OsHardwareTimerId = 1
          OsHardwareTimerType = STM
          STM1 (OsHardwareTimerChannel): OsHardwareTimerChannelIntSource=43, OsHardwareTimerChannelOffset=0, OsHardwareTimerChannelId=0
        INTC (OsSystemIntCtrl): OsSystemIntCtrlBaseAddress=4294896128, OsSystemIntCtrlMaxPrios=16, OsSystemIntCtrlMaxSources=512, OsSystemIntCtrlPrioOrder=DESC
          5 x OsSystemIntCtrlAddress:
            INTC1: OsSystemIntCtrlAddressValue=4294896128
            INTC2: OsSystemIntCtrlAddressValue=4294946816
            EIBD1: OsSystemIntCtrlAddressValue=4294896384
            EIBD2: OsSystemIntCtrlAddressValue=4294948864
            IPIR: OsSystemIntCtrlAddressValue=4294896772
        CORE1 (OsPhysicalCore):
          OsPhysicalCoreId = 1
          OsPhysicalCoreType = G3M
          OsPhysicalCoreExceptionSources = 16
          OsPhysicalCoreIsAutostart = 1
          OsPhysicalCoreMasterStartAllowed = 0
          OsPhysicalCorePrivelegedHwAccess = 1
          MPU_CORE1 (OsPhysicalCoreMpu): OsPhysicalCoreMpuId=1, OsPhysicalCoreMpuMaxRegions=16, OsPhysicalCoreMpuType=CoreMpu
        MPAT (OsMemoryRegionSpecifics)
          6 x OsMemoryRegionAccess:
            SR: OsMemoryRegionAccessRights=R, OsMemoryRegionAccessType=SUPERVISOR
            SW: OsMemoryRegionAccessRights=W, OsMemoryRegionAccessType=SUPERVISOR
            SX: OsMemoryRegionAccessRights=X, OsMemoryRegionAccessType=SUPERVISOR
            UR: OsMemoryRegionAccessRights=R, OsMemoryRegionAccessType=USER
            UW: OsMemoryRegionAccessRights=W, OsMemoryRegionAccessType=USER
            UX: OsMemoryRegionAccessRights=X, OsMemoryRegionAccessType=USER
