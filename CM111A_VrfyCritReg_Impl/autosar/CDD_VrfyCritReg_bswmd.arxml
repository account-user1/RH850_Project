AUTOSAR XML (schema 4-0-3)
package /Nexteer
  module definition VrfyCritReg [0..1]: variants pre-compile
    container VrfyCritReg8bitInitSignallist [0..65536]  # Critical registers with 8 bit Access that needs to checked only during initialisation
      integer Address: 0x00000000..0xFFFFFFFF, origin=NEXTEER  # Address of the critical Register.
      integer Value: 0x00000000..0xFF, origin=NEXTEER  # Expected Value for critical resisters
      integer Mask: 0x00000000..0xFF, origin=NEXTEER  # Mask for critical resister value
    container VrfyCritReg16bitInitSignallist [0..65536]  # Critical registers with 16 bit Access that needs to checked only during initialisation
      integer Address: 0x00000000..0xFFFFFFFF, origin=NEXTEER  # Address of the Register.
      integer Value: 0x00000000..0xFFFF, origin=NEXTEER  # Expected Value for critical resisters
      integer Mask: 0x00000000..0xFFFF, origin=NEXTEER  # Mask for critical resister value
    container VrfyCritReg32bitInitSignallist [0..65536]  # Critical registers with 32 bit Access that needs to checked only during initialisation
      integer Address: 0x00000000..0xFFFFFFFF, origin=NEXTEER  # Address of the Register.
      integer Value: 0x00000000..0xFFFFFFFF, origin=NEXTEER  # Expected Value for critical resisters
      integer Mask: 0x00000000..0xFFFFFFFF, origin=NEXTEER  # Mask for critical resister value
    container VrfyCritReg8bitPerSignallist [0..65536]  # Critical registers with 8 bit Access that needs to checked periodically
      integer Address: 0x00000000..0xFFFFFFFF, origin=NEXTEER  # Address of the Register.
      integer Value: 0x00000000..0xFF, origin=NEXTEER  # Expected Value for critical resisters
      integer Mask: 0x00000000..0xFF, origin=NEXTEER  # Mask for critical resister value
    container VrfyCritReg16bitPerSignallist [0..65536]  # Critical registers with 16 bit Access that needs to checked periodically
      integer Address: 0x0..0xFFFFFFFF, origin=NEXTEER  # Address of the Register.
      integer Value: 0x0..0xFFFF, origin=NEXTEER  # Expected Value for critical resisters
      integer Mask: 0x0..0xFFFF, origin=NEXTEER  # Mask for critical resister value
    container VrfyCritReg32bitPerSignallist [0..65536]  # Critical registers with 32 bit Access that needs to checked periodically
      integer Address: 0x00000000..0xFFFFFFFF, origin=NEXTEER  # Address of the Register.
      integer Value: 0x00000000..0xFFFFFFFF, origin=NEXTEER  # Expected Value for critical resister
      integer Mask: 0x00000000..0xFFFFFFFF, origin=NEXTEER  # Mask for critical resister value
    container VrfySysCritRegInitSignallist [0..65536]  # System Critical registers that needs to checked only during initialisation
      integer RegisterID: 0x00000000..0xFFFFFFFF, origin=NEXTEER  # Register ID of System Critical register
      integer SelectionID: 0x00000000..0xFFFFFFFF, origin=NEXTEER  # Selection ID of the System Critical register.
      integer Value: 0x00000000..0xFFFFFFFF, origin=NEXTEER  # Expected Value for System Critical register
      integer Mask: 0x00000000..0xFFFFFFFF, origin=NEXTEER  # Mask for System Critical register
    container VrfySysCritRegPerSignallist [0..65536]  # System Critical registers that needs to checked periodically
      integer RegisterID: 0x00000000..0xFFFFFFFF, origin=NEXTEER  # Register ID for System Critical register
      integer SelectionID: 0x00000000..0xFFFFFFFF, origin=NEXTEER  # Selection ID for System Critical register
      integer Value: 0x00000000..0xFFFFFFFF, origin=NEXTEER  # Expected Value for System Critical register
      integer Mask: 0x00000000..0xFFFFFFFF, origin=NEXTEER  # Mask for System Critical register
