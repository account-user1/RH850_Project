AUTOSAR XML (schema 4-0-3)
package /Nexteer/Calibrations
  4 x parameter interface:
    Ary1D_u9p7_12_CalPortIf1
      parameter data prototype Ary1D: sw-calibration-access=READ-WRITE, type=Ary1D_u9p7_12
    Ary2D_s4p11_12_20_CalPortIf1
      parameter data prototype Ary2D: sw-calibration-access=READ-WRITE, type=Ary2D_s4p11_12_20
    Ary2D_u8p8_12_20_CalPortIf1
      parameter data prototype Ary2D: sw-calibration-access=READ-WRITE, type=Ary2D_u8p8_12_20
    float32_CalPortIf1
      parameter data prototype Val: sw-calibration-access=READ-WRITE, type=float32
package /Nexteer/NvMProxy_swc/Interfaces
  client server interface NvMService_AC3_SRBS_Defs: is-service=true
    7 x operation, all with possible-error=NvMService_AC3_SRBS_Defs/E_NOT_OK:
      EraseBlock
      GetErrorStatus
        arg ErrorStatus: type=NvM_RequestResultType, direction=OUT, server-argument-impl-policy=USE-ARGUMENT-TYPE
      InvalidateNvBlock
      ReadBlock
        arg DstPtr: type=dtRef_VOID, direction=IN, server-argument-impl-policy=USE-ARGUMENT-TYPE
      RestoreBlockDefaults
        arg DstPtr: type=dtRef_VOID, direction=IN, server-argument-impl-policy=USE-ARGUMENT-TYPE
      SetRamBlockStatus
        arg RamBlockStatus: type=Boolean, direction=IN, server-argument-impl-policy=USE-ARGUMENT-TYPE
      WriteBlock
        arg SrcPtr: type=dtRef_const_VOID, direction=IN, server-argument-impl-policy=USE-ARGUMENT-TYPE
    error E_NOT_OK: error-code=1
package /Nexteer/PortInterfaces
  client server interface FordClrBlaBoxNvm_PortIf1
    operation Oper: possible-error=FordClrBlaBoxNvm_PortIf1/E_NOT_OK
    error E_NOT_OK: error-code=1
  9 x sender receiver interface:
    float32_PortIf1: invalidation-policy{data-element=float32_PortIf1/Val, handle-invalid=DONT-INVALIDATE}
      data Val: sw-calibration-access=READ-ONLY, type=float32
    Ford_LatCtlLim_D_Stat_PortIf1: invalidation-policy{data-element=Ford_LatCtlLim_D_Stat_PortIf1/Val, handle-invalid=DONT-INVALIDATE}
      data Val: type=Ford_LatCtlLim_D_Stat
    Ford_LatCtlSte_D_Stat_PortIf1: invalidation-policy{data-element=Ford_LatCtlSte_D_Stat_PortIf1/Val, handle-invalid=DONT-INVALIDATE}
      data Val: type=Ford_LatCtlSte_D_Stat
    FordArbnCmd1_PortIf1: invalidation-policy{data-element=FordArbnCmd1_PortIf1/Val, handle-invalid=DONT-INVALIDATE}
      data Val: type=FordArbnCmd1
    FordFeatSt1_PortIf1: invalidation-policy{data-element=FordFeatSt1_PortIf1/Val, handle-invalid=DONT-INVALIDATE}
      data Val: type=FordFeatSt1
    s8p7_PortIf1: invalidation-policy{data-element=s8p7_PortIf1/Val, handle-invalid=DONT-INVALIDATE}
      data Val: sw-calibration-access=READ-ONLY, type=s8p7
    uint16_PortIf1: invalidation-policy{data-element=uint16_PortIf1/Val, handle-invalid=DONT-INVALIDATE}
      data Val: sw-calibration-access=READ-ONLY, type=uint16
    uint32_PortIf1: invalidation-policy{data-element=uint32_PortIf1/Val, handle-invalid=DONT-INVALIDATE}
      data Val: sw-calibration-access=READ-ONLY, type=uint32
    uint8_PortIf1: invalidation-policy{data-element=uint8_PortIf1/Val, handle-invalid=DONT-INVALIDATE}
      data Val: sw-calibration-access=READ-ONLY, type=uint8
