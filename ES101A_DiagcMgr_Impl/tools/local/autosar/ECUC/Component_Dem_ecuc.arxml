AUTOSAR XML (schema 4-0-3)
package /ActiveEcuC
  module config Dem: implementation-config-variant=VARIANT-PRE-COMPILE, module-description=Dem_Impl
    DemConfigSet
      6 x DemDTCClass, all with DemDTCFunctionalUnit=255, DemImmediateNvStorage=false:
        TestDTC: DemUdsDTC=1193131
        TestDTC1: DemUdsDTC=1193046
        TestDTC2: DemUdsDTC=1193148
        TestDTC3: DemUdsDTC=1193165
        TestDTC4: DemUdsDTC=1193182
        TestDTC5: DemUdsDTC=1193199
      3 x DemEventParameter, all with DemEventKind=DEM_EVENT_KIND_SWC:
        TestEvent1: DemEventId=1, DemDTCClassRef=TestDTC
          DemEventClass:
            DemAgingAllowed = true
            DemConsiderPtoStatus = false
            DemEventDestination = DEM_DTC_ORIGIN_PRIMARY_MEMORY
            DemEventOBDReadinessGroup = DEM_OBD_RDY_NONE
            DemEventPriority = 2
            DemFFPrestorageSupported = false
            DemAgingCycleCounterThreshold = 50
            DemOperationCycleRef = DemOperationCycle
            DemAgingCycleRef = DemOperationCycle
            DemDebounceAlgorithmClass
              DemDebounceMonitorInternal
                DemCallbackGetFDC
        TestEvent2: DemEventId=2, DemDTCClassRef=TestDTC1
          DemEventClass:
            DemAgingAllowed = false
            DemConsiderPtoStatus = false
            DemEventDestination = DEM_DTC_ORIGIN_PRIMARY_MEMORY
            DemEventOBDReadinessGroup = DEM_OBD_RDY_NONE
            DemEventPriority = 2
            DemFFPrestorageSupported = false
            DemAgingCycleCounterThreshold = 60
            DemOperationCycleRef = DemOperationCycle
            DemAgingCycleRef = DemOperationCycle
            DemDebounceAlgorithmClass
              DemDebounceMonitorInternal
                DemCallbackGetFDC
        TestEvent3: DemEventId=3, DemDTCClassRef=TestDTC2
          DemEventClass:
            DemAgingAllowed = false
            DemConsiderPtoStatus = false
            DemEventDestination = DEM_DTC_ORIGIN_PRIMARY_MEMORY
            DemEventOBDReadinessGroup = DEM_OBD_RDY_NONE
            DemEventPriority = 2
            DemFFPrestorageSupported = false
            DemOperationCycleRef = DemOperationCycle
            DemDebounceAlgorithmClass
              DemDebounceMonitorInternal
                DemCallbackGetFDC
    DemGeneral:
      DemAgingCycleCounterProcessing = DEM_PROCESS_AGINGCTR_INTERN
      DemBswErrorBufferSize = 0
      DemClearDTCBehavior = DEM_CLRRESP_VOLATILE
      DemDTCSuppressionSupport = false
      DemDebounceCounterBasedSupport = true
      DemDebounceTimeBasedSupport = false
      DemDevErrorDetect = false
      DemDtcStatusAvailabilityMask = 255
      DemEnableConditionSupport = false
      DemEventCombinationSupport = DEM_EVCOMB_DISABLED
      DemEventDisplacementStrategy = DEM_DISPLACEMENT_LEGACY_403
      DemMaxNumberEventEntryMirror = 0
      DemMaxNumberEventEntryPermanent = 0
      DemMaxNumberEventEntryPrimary = 8
      DemMaxNumberEventEntrySecondary = 0
      DemMaxNumberPrestoredFF = 0
      DemOBDSupport = DEM_OBD_NO_OBD_SUPPORT
      DemOccurrenceCounterProcessing = DEM_PROCESS_OCCCTR_TF
      DemOperationCycleProcessing = DEM_PROCESS_OPCYC_STATE
      DemOperationCycleStatusStorage = false
      DemPTOSupport = false
      DemStatusBitHandlingTestFailedSinceLastClear = DEM_STATUS_BIT_NORMAL
      DemStatusBitStorageTestFailed = true
      DemStorageConditionSupport = false
      DemTaskTime = 0.01
      DemTriggerDcmReports = false
      DemTriggerDltReports = false
      DemTriggerFiMReports = false
      DemTriggerMonitorInitBeforeClearOk = true
      DemTypeOfDTCSupported = DEM_DTC_TRANSLATION_ISO14229_1
      DemTypeOfFreezeFrameRecordNumeration = DEM_FF_RECNUM_CALCULATED
      DemVersionInfoApi = false
      DemUseRte = true
      DemGeneralDiagnosticInfoSupport = true
      DemEventStorageTrigger = DEM_STORAGE_TRIGGER_FAILED
      DemPendingDtcProcessing = DEM_PROCESS_PDTC_STOREDONLY
      DemWarningIndicatorRequestedProcessing = DEM_PROCESS_WIR_STOREDONLY
      DemAgingBehavior = DEM_AGING_AT_PASSED
      DemSuppressionSupport = DEM_NO_SUPPRESSION
      DemMaxNumberEventEntryOBDFreezeFrame = 0
      DemAgingRetainEnvironmentalData = false
      DemEventDisplacementFallbackStrategy = DEM_FALLBACK_DISCARD_NEW_EVENT
      DemResetConfirmedBitOnOverflow = true
      DemOperationCycle: DemOperationCycleType=DEM_OPCYC_OTHER
      DemPostbuild: DemMaxSizeFreezeFrame=0
