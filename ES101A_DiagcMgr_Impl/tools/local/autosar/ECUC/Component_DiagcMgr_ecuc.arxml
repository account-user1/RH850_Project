AUTOSAR XML (schema 4-0-3)
package /ActiveEcuC
  module config DiagcMgr: implementation-config-variant=VARIANT-PRE-COMPILE, module-description=DiagcMgr_Impl
    117 x NTCNR:
      NTCNR_0X002: Debounce=false, LtchCntrThd=1, LtchgEna=true, MfgNtcInhibInNonOper=false, MfgNtcInhibInOper=false, NtcPwrCycLtch=false, NTCOsApplicationRef=Appl10
      NTCNR_0X003: Debounce=true, LtchCntrThd=0, LtchgEna=false, MfgNtcInhibInNonOper=false, MfgNtcInhibInOper=false, NtcPwrCycLtch=true, NTCOsApplicationRef=Appl10
      NTCNR_0X006: Debounce=false, LtchCntrThd=0, LtchgEna=false, MfgNtcInhibInNonOper=false, MfgNtcInhibInOper=true, NtcPwrCycLtch=false, NTCOsApplicationRef=Appl10
      NTCNR_0X007: Debounce=false, LtchCntrThd=0, LtchgEna=false, MfgNtcInhibInNonOper=true, MfgNtcInhibInOper=false, NtcPwrCycLtch=false, NTCOsApplicationRef=Appl10
      NTCNR_0X00A: Debounce=true, LtchCntrThd=0, LtchgEna=false, MfgNtcInhibInNonOper=false, MfgNtcInhibInOper=false, NtcPwrCycLtch=false, NTCOsApplicationRef=Appl0
      NTCNR_0X03C: Debounce=false, LtchCntrThd=0, LtchgEna=false, MfgNtcInhibInNonOper=true, MfgNtcInhibInOper=true, NtcPwrCycLtch=false, NTCOsApplicationRef=Appl10
      NTCNR_0X193: Debounce=false, LtchCntrThd=253, LtchgEna=true, MfgNtcInhibInNonOper=false, MfgNtcInhibInOper=false, NtcPwrCycLtch=false, NTCOsApplicationRef=Appl6
      NTCNR_0X198: Debounce=true, LtchCntrThd=0, LtchgEna=false, MfgNtcInhibInNonOper=false, MfgNtcInhibInOper=false, NtcPwrCycLtch=true, NTCOsApplicationRef=Appl6
      NTCNR_0X199: Debounce=false, LtchCntrThd=0, LtchgEna=false, MfgNtcInhibInNonOper=false, MfgNtcInhibInOper=true, NtcPwrCycLtch=false, NTCOsApplicationRef=Appl6
      NTCNR_0X1A0: Debounce=false, LtchCntrThd=0, LtchgEna=false, MfgNtcInhibInNonOper=true, MfgNtcInhibInOper=false, NtcPwrCycLtch=false, NTCOsApplicationRef=Appl6
      NTCNR_0X1A1: Debounce=false, LtchCntrThd=0, LtchgEna=false, MfgNtcInhibInNonOper=true, MfgNtcInhibInOper=true, NtcPwrCycLtch=false, NTCOsApplicationRef=Appl6
      NTCNR_0X1FF: Debounce=false, LtchCntrThd=0, LtchgEna=false, MfgNtcInhibInNonOper=true, MfgNtcInhibInOper=false, NtcPwrCycLtch=true, NTCOsApplicationRef=Appl6
      NTCNR_0X008: Debounce=false, LtchCntrThd=0, LtchgEna=false, MfgNtcInhibInNonOper=true, MfgNtcInhibInOper=false, NtcPwrCycLtch=true, NTCOsApplicationRef=Appl10
      NTCNR_0X010: Debounce=false, LtchCntrThd=0, LtchgEna=false, MfgNtcInhibInNonOper=false, MfgNtcInhibInOper=true, NtcPwrCycLtch=true, NTCOsApplicationRef=Appl10
      NTCNR_0X012: Debounce=false, LtchCntrThd=0, LtchgEna=false, MfgNtcInhibInNonOper=true, MfgNtcInhibInOper=true, NtcPwrCycLtch=true, NTCOsApplicationRef=Appl10
      NTCNR_0X013: Debounce=false, LtchCntrThd=0, LtchgEna=false, MfgNtcInhibInNonOper=false, MfgNtcInhibInOper=false, NtcPwrCycLtch=false, NTCOsApplicationRef=Appl10
      NTCNR_0X016: Debounce=true, LtchCntrThd=167, LtchgEna=true, MfgNtcInhibInNonOper=true, MfgNtcInhibInOper=true, NtcPwrCycLtch=true, NTCOsApplicationRef=Appl10
      NTCNR_0X017: Debounce=false, LtchCntrThd=1, LtchgEna=true, MfgNtcInhibInNonOper=false, MfgNtcInhibInOper=false, NtcPwrCycLtch=false, NTCOsApplicationRef=Appl5
      NTCNR_0X018: Debounce=true, LtchCntrThd=0, LtchgEna=false, MfgNtcInhibInNonOper=false, MfgNtcInhibInOper=false, NtcPwrCycLtch=true, NTCOsApplicationRef=Appl5
      NTCNR_0X019: Debounce=false, LtchCntrThd=0, LtchgEna=false, MfgNtcInhibInNonOper=false, MfgNtcInhibInOper=true, NtcPwrCycLtch=false, NTCOsApplicationRef=Appl5
      NTCNR_0X01A: Debounce=false, LtchCntrThd=0, LtchgEna=false, MfgNtcInhibInNonOper=true, MfgNtcInhibInOper=false, NtcPwrCycLtch=false, NTCOsApplicationRef=Appl5
      NTCNR_0X01B: Debounce=false, LtchCntrThd=0, LtchgEna=false, MfgNtcInhibInNonOper=true, MfgNtcInhibInOper=true, NtcPwrCycLtch=false, NTCOsApplicationRef=Appl5
      NTCNR_0X021: Debounce=false, LtchCntrThd=225, LtchgEna=true, MfgNtcInhibInNonOper=false, MfgNtcInhibInOper=false, NtcPwrCycLtch=false, NTCOsApplicationRef=Appl3
      NTCNR_0X022: Debounce=false, LtchCntrThd=19, LtchgEna=true, MfgNtcInhibInNonOper=false, MfgNtcInhibInOper=false, NtcPwrCycLtch=false, NTCOsApplicationRef=Appl4
      NTCNR_0X025: Debounce=false, LtchCntrThd=0, LtchgEna=false, MfgNtcInhibInNonOper=true, MfgNtcInhibInOper=false, NtcPwrCycLtch=true, NTCOsApplicationRef=Appl5
      NTCNR_0X026: Debounce=false, LtchCntrThd=0, LtchgEna=false, MfgNtcInhibInNonOper=false, MfgNtcInhibInOper=true, NtcPwrCycLtch=true, NTCOsApplicationRef=Appl5
      NTCNR_0X028: Debounce=false, LtchCntrThd=0, LtchgEna=false, MfgNtcInhibInNonOper=false, MfgNtcInhibInOper=false, NtcPwrCycLtch=false, NTCOsApplicationRef=Appl10
      NTCNR_0X029: Debounce=false, LtchCntrThd=0, LtchgEna=false, MfgNtcInhibInNonOper=false, MfgNtcInhibInOper=false, NtcPwrCycLtch=false, NTCOsApplicationRef=Appl10
      NTCNR_0X02A: Debounce=false, LtchCntrThd=0, LtchgEna=false, MfgNtcInhibInNonOper=false, MfgNtcInhibInOper=false, NtcPwrCycLtch=false, NTCOsApplicationRef=Appl10
      NTCNR_0X02C: Debounce=false, LtchCntrThd=0, LtchgEna=false, MfgNtcInhibInNonOper=false, MfgNtcInhibInOper=false, NtcPwrCycLtch=false, NTCOsApplicationRef=Appl10
      NTCNR_0X02D: Debounce=false, LtchCntrThd=0, LtchgEna=false, MfgNtcInhibInNonOper=false, MfgNtcInhibInOper=false, NtcPwrCycLtch=false, NTCOsApplicationRef=Appl10
      NTCNR_0X030: Debounce=false, LtchCntrThd=4, LtchgEna=true, MfgNtcInhibInNonOper=false, MfgNtcInhibInOper=false, NtcPwrCycLtch=false, NTCOsApplicationRef=Appl7
      NTCNR_0X031: Debounce=true, LtchCntrThd=0, LtchgEna=false, MfgNtcInhibInNonOper=false, MfgNtcInhibInOper=false, NtcPwrCycLtch=true, NTCOsApplicationRef=Appl4
      NTCNR_0X036: Debounce=true, LtchCntrThd=0, LtchgEna=false, MfgNtcInhibInNonOper=false, MfgNtcInhibInOper=false, NtcPwrCycLtch=true, NTCOsApplicationRef=Appl3
      NTCNR_0X039: Debounce=false, LtchCntrThd=0, LtchgEna=false, MfgNtcInhibInNonOper=false, MfgNtcInhibInOper=false, NtcPwrCycLtch=false, NTCOsApplicationRef=Appl10
      NTCNR_0X040: Debounce=true, LtchCntrThd=0, LtchgEna=false, MfgNtcInhibInNonOper=false, MfgNtcInhibInOper=false, NtcPwrCycLtch=true, NTCOsApplicationRef=Appl7
      NTCNR_0X041: Debounce=false, LtchCntrThd=0, LtchgEna=false, MfgNtcInhibInNonOper=false, MfgNtcInhibInOper=false, NtcPwrCycLtch=false, NTCOsApplicationRef=Appl10
      NTCNR_0X042: Debounce=false, LtchCntrThd=0, LtchgEna=false, MfgNtcInhibInNonOper=false, MfgNtcInhibInOper=false, NtcPwrCycLtch=false, NTCOsApplicationRef=Appl10
      NTCNR_0X044: Debounce=false, LtchCntrThd=0, LtchgEna=false, MfgNtcInhibInNonOper=true, MfgNtcInhibInOper=true, NtcPwrCycLtch=true, NTCOsApplicationRef=Appl5
      NTCNR_0X045: Debounce=false, LtchCntrThd=0, LtchgEna=false, MfgNtcInhibInNonOper=false, MfgNtcInhibInOper=true, NtcPwrCycLtch=false, NTCOsApplicationRef=Appl7
      NTCNR_0X048: Debounce=false, LtchCntrThd=0, LtchgEna=false, MfgNtcInhibInNonOper=false, MfgNtcInhibInOper=false, NtcPwrCycLtch=false, NTCOsApplicationRef=Appl9
      NTCNR_0X049: Debounce=true, LtchCntrThd=0, LtchgEna=false, MfgNtcInhibInNonOper=false, MfgNtcInhibInOper=false, NtcPwrCycLtch=true, NTCOsApplicationRef=Appl9
      NTCNR_0X04A: Debounce=false, LtchCntrThd=0, LtchgEna=false, MfgNtcInhibInNonOper=false, MfgNtcInhibInOper=true, NtcPwrCycLtch=false, NTCOsApplicationRef=Appl9
      NTCNR_0X04C: Debounce=false, LtchCntrThd=0, LtchgEna=false, MfgNtcInhibInNonOper=true, MfgNtcInhibInOper=false, NtcPwrCycLtch=false, NTCOsApplicationRef=Appl9
      NTCNR_0X04D: Debounce=false, LtchCntrThd=222, LtchgEna=true, MfgNtcInhibInNonOper=false, MfgNtcInhibInOper=false, NtcPwrCycLtch=false, NTCOsApplicationRef=Appl8
      NTCNR_0X04E: Debounce=false, LtchCntrThd=0, LtchgEna=false, MfgNtcInhibInNonOper=true, MfgNtcInhibInOper=true, NtcPwrCycLtch=false, NTCOsApplicationRef=Appl9
      NTCNR_0X050: Debounce=false, LtchCntrThd=0, LtchgEna=false, MfgNtcInhibInNonOper=true, MfgNtcInhibInOper=false, NtcPwrCycLtch=false, NTCOsApplicationRef=Appl7
      NTCNR_0X054: Debounce=false, LtchCntrThd=0, LtchgEna=false, MfgNtcInhibInNonOper=true, MfgNtcInhibInOper=false, NtcPwrCycLtch=true, NTCOsApplicationRef=Appl9
      NTCNR_0X05D: Debounce=false, LtchCntrThd=0, LtchgEna=false, MfgNtcInhibInNonOper=false, MfgNtcInhibInOper=true, NtcPwrCycLtch=true, NTCOsApplicationRef=Appl9
      NTCNR_0X060: Debounce=false, LtchCntrThd=0, LtchgEna=false, MfgNtcInhibInNonOper=false, MfgNtcInhibInOper=true, NtcPwrCycLtch=false, NTCOsApplicationRef=Appl4
      NTCNR_0X064: Debounce=false, LtchCntrThd=0, LtchgEna=false, MfgNtcInhibInNonOper=true, MfgNtcInhibInOper=true, NtcPwrCycLtch=true, NTCOsApplicationRef=Appl9
      NTCNR_0X06D: Debounce=false, LtchCntrThd=0, LtchgEna=false, MfgNtcInhibInNonOper=false, MfgNtcInhibInOper=false, NtcPwrCycLtch=false, NTCOsApplicationRef=Appl9
      NTCNR_0X070: Debounce=true, LtchCntrThd=0, LtchgEna=false, MfgNtcInhibInNonOper=false, MfgNtcInhibInOper=false, NtcPwrCycLtch=true, NTCOsApplicationRef=Appl8
      NTCNR_0X071: Debounce=false, LtchCntrThd=0, LtchgEna=false, MfgNtcInhibInNonOper=false, MfgNtcInhibInOper=true, NtcPwrCycLtch=false, NTCOsApplicationRef=Appl8
      NTCNR_0X07B: Debounce=false, LtchCntrThd=0, LtchgEna=false, MfgNtcInhibInNonOper=true, MfgNtcInhibInOper=false, NtcPwrCycLtch=false, NTCOsApplicationRef=Appl8
      NTCNR_0X07C: Debounce=false, LtchCntrThd=0, LtchgEna=false, MfgNtcInhibInNonOper=true, MfgNtcInhibInOper=true, NtcPwrCycLtch=false, NTCOsApplicationRef=Appl8
      NTCNR_0X07D: Debounce=false, LtchCntrThd=0, LtchgEna=false, MfgNtcInhibInNonOper=true, MfgNtcInhibInOper=false, NtcPwrCycLtch=true, NTCOsApplicationRef=Appl8
      NTCNR_0X080: Debounce=false, LtchCntrThd=0, LtchgEna=false, MfgNtcInhibInNonOper=false, MfgNtcInhibInOper=true, NtcPwrCycLtch=true, NTCOsApplicationRef=Appl8
      NTCNR_0X081: Debounce=false, LtchCntrThd=0, LtchgEna=false, MfgNtcInhibInNonOper=true, MfgNtcInhibInOper=false, NtcPwrCycLtch=false, NTCOsApplicationRef=Appl4
      NTCNR_0X082: Debounce=false, LtchCntrThd=0, LtchgEna=false, MfgNtcInhibInNonOper=true, MfgNtcInhibInOper=true, NtcPwrCycLtch=false, NTCOsApplicationRef=Appl4
      NTCNR_0X092: Debounce=false, LtchCntrThd=0, LtchgEna=false, MfgNtcInhibInNonOper=false, MfgNtcInhibInOper=true, NtcPwrCycLtch=false, NTCOsApplicationRef=Appl3
      NTCNR_0X0A3: Debounce=false, LtchCntrThd=0, LtchgEna=false, MfgNtcInhibInNonOper=false, MfgNtcInhibInOper=false, NtcPwrCycLtch=false, NTCOsApplicationRef=Appl1
      NTCNR_0X0A4: Debounce=false, LtchCntrThd=103, LtchgEna=true, MfgNtcInhibInNonOper=false, MfgNtcInhibInOper=false, NtcPwrCycLtch=false, NTCOsApplicationRef=Appl2
      NTCNR_0X0AA: Debounce=false, LtchCntrThd=0, LtchgEna=false, MfgNtcInhibInNonOper=true, MfgNtcInhibInOper=false, NtcPwrCycLtch=false, NTCOsApplicationRef=Appl3
      NTCNR_0X0AB: Debounce=false, LtchCntrThd=0, LtchgEna=false, MfgNtcInhibInNonOper=true, MfgNtcInhibInOper=false, NtcPwrCycLtch=true, NTCOsApplicationRef=Appl4
      NTCNR_0X0AC: Debounce=false, LtchCntrThd=0, LtchgEna=false, MfgNtcInhibInNonOper=false, MfgNtcInhibInOper=false, NtcPwrCycLtch=false, NTCOsApplicationRef=Appl5
      NTCNR_0X0AD: Debounce=false, LtchCntrThd=0, LtchgEna=false, MfgNtcInhibInNonOper=true, MfgNtcInhibInOper=true, NtcPwrCycLtch=false, NTCOsApplicationRef=Appl7
      NTCNR_0X0AE: Debounce=false, LtchCntrThd=0, LtchgEna=false, MfgNtcInhibInNonOper=true, MfgNtcInhibInOper=true, NtcPwrCycLtch=true, NTCOsApplicationRef=Appl8
      NTCNR_0X0AF: Debounce=false, LtchCntrThd=0, LtchgEna=false, MfgNtcInhibInNonOper=false, MfgNtcInhibInOper=false, NtcPwrCycLtch=true, NTCOsApplicationRef=Appl8
      NTCNR_0X0B{0..2}: Debounce=true, LtchCntrThd=0, LtchgEna=false, MfgNtcInhibInNonOper=false, MfgNtcInhibInOper=false, NtcPwrCycLtch=true, NTCOsApplicationRef=Appl{0..2}
      NTCNR_0X0B5: Debounce=false, LtchCntrThd=0, LtchgEna=false, MfgNtcInhibInNonOper=true, MfgNtcInhibInOper=true, NtcPwrCycLtch=false, NTCOsApplicationRef=Appl3
      NTCNR_0X0BF: Debounce=false, LtchCntrThd=0, LtchgEna=false, MfgNtcInhibInNonOper=false, MfgNtcInhibInOper=true, NtcPwrCycLtch=true, NTCOsApplicationRef=Appl4
      NTCNR_0X0C4: Debounce=true, LtchCntrThd=154, LtchgEna=true, MfgNtcInhibInNonOper=true, MfgNtcInhibInOper=true, NtcPwrCycLtch=true, NTCOsApplicationRef=Appl5
      NTCNR_0X0E0: Debounce=false, LtchCntrThd=0, LtchgEna=false, MfgNtcInhibInNonOper=true, MfgNtcInhibInOper=false, NtcPwrCycLtch=true, NTCOsApplicationRef=Appl7
      NTCNR_0X0E1: Debounce=true, LtchCntrThd=1, LtchgEna=true, MfgNtcInhibInNonOper=true, MfgNtcInhibInOper=true, NtcPwrCycLtch=true, NTCOsApplicationRef=Appl8
      NTCNR_0X100: Debounce=false, LtchCntrThd=0, LtchgEna=false, MfgNtcInhibInNonOper=true, MfgNtcInhibInOper=true, NtcPwrCycLtch=true, NTCOsApplicationRef=Appl6
      NTCNR_0X110: Debounce=false, LtchCntrThd=0, LtchgEna=false, MfgNtcInhibInNonOper=true, MfgNtcInhibInOper=true, NtcPwrCycLtch=true, NTCOsApplicationRef=Appl6
      NTCNR_0X128: Debounce=false, LtchCntrThd=0, LtchgEna=false, MfgNtcInhibInNonOper=false, MfgNtcInhibInOper=false, NtcPwrCycLtch=false, NTCOsApplicationRef=Appl6
      NTCNR_0X129: Debounce=true, LtchCntrThd=250, LtchgEna=true, MfgNtcInhibInNonOper=true, MfgNtcInhibInOper=true, NtcPwrCycLtch=true, NTCOsApplicationRef=Appl6
      NTCNR_0X131: Debounce=false, LtchCntrThd=0, LtchgEna=false, MfgNtcInhibInNonOper=false, MfgNtcInhibInOper=true, NtcPwrCycLtch=true, NTCOsApplicationRef=Appl7
      NTCNR_0X138: Debounce=false, LtchCntrThd=0, LtchgEna=false, MfgNtcInhibInNonOper=true, MfgNtcInhibInOper=true, NtcPwrCycLtch=true, NTCOsApplicationRef=Appl7
      NTCNR_0X139: Debounce=false, LtchCntrThd=0, LtchgEna=false, MfgNtcInhibInNonOper=false, MfgNtcInhibInOper=true, NtcPwrCycLtch=false, NTCOsApplicationRef=Appl0
      NTCNR_0X141: Debounce=false, LtchCntrThd=0, LtchgEna=false, MfgNtcInhibInNonOper=false, MfgNtcInhibInOper=false, NtcPwrCycLtch=false, NTCOsApplicationRef=Appl7
      NTCNR_0X148: Debounce=false, LtchCntrThd=0, LtchgEna=false, MfgNtcInhibInNonOper=true, MfgNtcInhibInOper=false, NtcPwrCycLtch=false, NTCOsApplicationRef=Appl0
      NTCNR_0X149: Debounce=false, LtchCntrThd=0, LtchgEna=false, MfgNtcInhibInNonOper=true, MfgNtcInhibInOper=true, NtcPwrCycLtch=false, NTCOsApplicationRef=Appl0
      NTCNR_0X160: Debounce=false, LtchCntrThd=0, LtchgEna=false, MfgNtcInhibInNonOper=true, MfgNtcInhibInOper=false, NtcPwrCycLtch=true, NTCOsApplicationRef=Appl0
      NTCNR_0X161: Debounce=false, LtchCntrThd=0, LtchgEna=false, MfgNtcInhibInNonOper=false, MfgNtcInhibInOper=true, NtcPwrCycLtch=true, NTCOsApplicationRef=Appl0
      NTCNR_0X168: Debounce=false, LtchCntrThd=0, LtchgEna=false, MfgNtcInhibInNonOper=true, MfgNtcInhibInOper=true, NtcPwrCycLtch=true, NTCOsApplicationRef=Appl0
      NTCNR_0X169: Debounce=false, LtchCntrThd=0, LtchgEna=false, MfgNtcInhibInNonOper=false, MfgNtcInhibInOper=true, NtcPwrCycLtch=false, NTCOsApplicationRef=Appl1
      NTCNR_0X170: Debounce=false, LtchCntrThd=0, LtchgEna=false, MfgNtcInhibInNonOper=false, MfgNtcInhibInOper=false, NtcPwrCycLtch=false, NTCOsApplicationRef=Appl0
      NTCNR_0X171: Debounce=false, LtchCntrThd=0, LtchgEna=false, MfgNtcInhibInNonOper=false, MfgNtcInhibInOper=true, NtcPwrCycLtch=false, NTCOsApplicationRef=Appl2
      NTCNR_0X178: Debounce=true, LtchCntrThd=254, LtchgEna=true, MfgNtcInhibInNonOper=true, MfgNtcInhibInOper=true, NtcPwrCycLtch=true, NTCOsApplicationRef=Appl0
      NTCNR_0X179: Debounce=false, LtchCntrThd=0, LtchgEna=false, MfgNtcInhibInNonOper=true, MfgNtcInhibInOper=false, NtcPwrCycLtch=false, NTCOsApplicationRef=Appl2
      NTCNR_0X17A: Debounce=false, LtchCntrThd=0, LtchgEna=false, MfgNtcInhibInNonOper=true, MfgNtcInhibInOper=false, NtcPwrCycLtch=true, NTCOsApplicationRef=Appl3
      NTCNR_0X17B: Debounce=false, LtchCntrThd=0, LtchgEna=false, MfgNtcInhibInNonOper=true, MfgNtcInhibInOper=false, NtcPwrCycLtch=false, NTCOsApplicationRef=Appl1
      NTCNR_0X188: Debounce=false, LtchCntrThd=0, LtchgEna=false, MfgNtcInhibInNonOper=true, MfgNtcInhibInOper=true, NtcPwrCycLtch=false, NTCOsApplicationRef=Appl1
      NTCNR_0X189: Debounce=false, LtchCntrThd=0, LtchgEna=false, MfgNtcInhibInNonOper=true, MfgNtcInhibInOper=false, NtcPwrCycLtch=true, NTCOsApplicationRef=Appl1
      NTCNR_0X191: Debounce=false, LtchCntrThd=0, LtchgEna=false, MfgNtcInhibInNonOper=true, MfgNtcInhibInOper=true, NtcPwrCycLtch=false, NTCOsApplicationRef=Appl2
      NTCNR_0X192: Debounce=false, LtchCntrThd=0, LtchgEna=false, MfgNtcInhibInNonOper=false, MfgNtcInhibInOper=true, NtcPwrCycLtch=true, NTCOsApplicationRef=Appl1
      NTCNR_0X1A9: Debounce=false, LtchCntrThd=0, LtchgEna=false, MfgNtcInhibInNonOper=true, MfgNtcInhibInOper=true, NtcPwrCycLtch=true, NTCOsApplicationRef=Appl1
      NTCNR_0X1B0: Debounce=false, LtchCntrThd=0, LtchgEna=false, MfgNtcInhibInNonOper=false, MfgNtcInhibInOper=false, NtcPwrCycLtch=false, NTCOsApplicationRef=Appl1
      NTCNR_0X1B1: Debounce=true, LtchCntrThd=64, LtchgEna=true, MfgNtcInhibInNonOper=true, MfgNtcInhibInOper=true, NtcPwrCycLtch=true, NTCOsApplicationRef=Appl1
      NTCNR_0X1B8: Debounce=true, LtchCntrThd=11, LtchgEna=true, MfgNtcInhibInNonOper=true, MfgNtcInhibInOper=true, NtcPwrCycLtch=true, NTCOsApplicationRef=Appl7
      NTCNR_0X1B9: Debounce=false, LtchCntrThd=0, LtchgEna=false, MfgNtcInhibInNonOper=true, MfgNtcInhibInOper=false, NtcPwrCycLtch=true, NTCOsApplicationRef=Appl2
      NTCNR_0X1C1: Debounce=false, LtchCntrThd=0, LtchgEna=false, MfgNtcInhibInNonOper=false, MfgNtcInhibInOper=true, NtcPwrCycLtch=true, NTCOsApplicationRef=Appl3
      NTCNR_0X1C2: Debounce=false, LtchCntrThd=0, LtchgEna=false, MfgNtcInhibInNonOper=false, MfgNtcInhibInOper=true, NtcPwrCycLtch=true, NTCOsApplicationRef=Appl2
      NTCNR_0X1C3: Debounce=false, LtchCntrThd=0, LtchgEna=false, MfgNtcInhibInNonOper=true, MfgNtcInhibInOper=true, NtcPwrCycLtch=true, NTCOsApplicationRef=Appl2
      NTCNR_0X1C8: Debounce=false, LtchCntrThd=0, LtchgEna=false, MfgNtcInhibInNonOper=false, MfgNtcInhibInOper=false, NtcPwrCycLtch=false, NTCOsApplicationRef=Appl2
      NTCNR_0X1C9: Debounce=true, LtchCntrThd=99, LtchgEna=true, MfgNtcInhibInNonOper=true, MfgNtcInhibInOper=true, NtcPwrCycLtch=true, NTCOsApplicationRef=Appl2
      NTCNR_0X1EC: Debounce=false, LtchCntrThd=0, LtchgEna=false, MfgNtcInhibInNonOper=true, MfgNtcInhibInOper=true, NtcPwrCycLtch=true, NTCOsApplicationRef=Appl3
      NTCNR_0X1ED: Debounce=false, LtchCntrThd=0, LtchgEna=false, MfgNtcInhibInNonOper=false, MfgNtcInhibInOper=false, NtcPwrCycLtch=false, NTCOsApplicationRef=Appl3
      NTCNR_0X1F2: Debounce=true, LtchCntrThd=200, LtchgEna=true, MfgNtcInhibInNonOper=true, MfgNtcInhibInOper=true, NtcPwrCycLtch=false, NTCOsApplicationRef=Appl3
      NTCNR_0X1F6: Debounce=false, LtchCntrThd=0, LtchgEna=false, MfgNtcInhibInNonOper=true, MfgNtcInhibInOper=true, NtcPwrCycLtch=true, NTCOsApplicationRef=Appl4
      NTCNR_0X1F7: Debounce=false, LtchCntrThd=0, LtchgEna=false, MfgNtcInhibInNonOper=false, MfgNtcInhibInOper=false, NtcPwrCycLtch=false, NTCOsApplicationRef=Appl4
      NTCNR_0X1F8: Debounce=true, LtchCntrThd=95, LtchgEna=true, MfgNtcInhibInNonOper=true, MfgNtcInhibInOper=true, NtcPwrCycLtch=true, NTCOsApplicationRef=Appl4
    DiagcMgrGeneral: DIAGCMGR_DEMCHK=STD_ON, DEMTOTNROFDTC=TblSize_m(Dem_C_DtcTable)
    DTC1 (DTCEnaCndn):
      Bit_15 = true
      Bit_14 = false
      Bit_13 = false
      Bit_12 = false
      Bit_11 = false
      Bit_10 = false
      Bit__9 = false
      Bit__8 = false
      Bit__7 = false
      Bit__6 = false
      Bit__5 = false
      Bit__4 = false
      Bit__3 = true
      Bit__2 = false
      Bit__1 = true
      Bit__0 = true
      DiagcMgrDTCIdx = 1
      DTC = TestDTC
    DTC2 (DTCEnaCndn):
      Bit_15 = false
      Bit_14 = false
      Bit_13 = false
      Bit_12 = false
      Bit_11 = false
      Bit_10 = false
      Bit__9 = false
      Bit__8 = false
      Bit__7 = false
      Bit__6 = false
      Bit__5 = false
      Bit__4 = true
      Bit__3 = false
      Bit__2 = false
      Bit__1 = false
      Bit__0 = false
      DiagcMgrDTCIdx = 2
      DTC = TestDTC1
    NTCNR_0X001 (NTCNR): Debounce=true, MfgNtcInhibInOper=true, MfgNtcInhibInNonOper=true, NtcPwrCycLtch=true, LtchgEna=true, LtchCntrThd=145, NTCOsApplicationRef=Appl9
    4 x DTCEnaCndn:
      DTC5: Bit_15=false, Bit_14=false, Bit_13=false, Bit_12=false, Bit_11=false, Bit_10=false, Bit__9=false, Bit__8=false, Bit__7=false, Bit__6=false, Bit__5=false, Bit__4=false, Bit__3=false, Bit__2=false, Bit__1=false, Bit__0=false, DiagcMgrDTCIdx=5, DTC=TestDTC4
      DTC4: Bit_15=false, Bit_14=true, Bit_13=false, Bit_12=true, Bit_11=false, Bit_10=true, Bit__9=false, Bit__8=true, Bit__7=false, Bit__6=true, Bit__5=false, Bit__4=true, Bit__3=false, Bit__2=true, Bit__1=false, Bit__0=true, DiagcMgrDTCIdx=4, DTC=TestDTC3
      DTC6: Bit_15=true, Bit_14=true, Bit_13=true, Bit_12=true, Bit_11=true, Bit_10=true, Bit__9=true, Bit__8=true, Bit__7=true, Bit__6=true, Bit__5=true, Bit__4=true, Bit__3=true, Bit__2=true, Bit__1=true, Bit__0=true, DiagcMgrDTCIdx=6, DTC=TestDTC5
      DTC3: Bit_15=true, Bit_14=false, Bit_13=true, Bit_12=false, Bit_11=true, Bit_10=false, Bit__9=true, Bit__8=false, Bit__7=true, Bit__6=false, Bit__5=true, Bit__4=false, Bit__3=true, Bit__2=false, Bit__1=true, Bit__0=false, DiagcMgrDTCIdx=3, DTC=TestDTC2
