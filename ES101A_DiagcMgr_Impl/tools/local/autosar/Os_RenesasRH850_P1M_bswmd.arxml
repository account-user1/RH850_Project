AUTOSAR XML (schema 4-0-3)
package /MICROSAR/RenesasRH850_P1M
  bsw implementation Os_Impl: programming-language=C, sw-version=6.05.00, used-code-generator=cMSR, vendor-id=30, ar-release-version=4.00.03, preconfigured-configuration=Os_Pre, recommended-configuration=Os_Rec, vendor-specific-module-def=Os
  module definition Os [0..1]: refined-module-def=Os, variants pre-compile  # Configuration of the Os (Operating System) module.
    container OsAlarm [0..32766]  # An OsAlarm may be used to asynchronously inform or activate a specific task. It is possible to start alarms automatically at system start-up depending on the application mode.
      reference OsAlarmAccessingApplication [0..*]: set at pre-compile, destination=OsApplication  # Reference to applications which have an access to this object.
      reference OsAlarmCounterRef: set at pre-compile, destination=OsCounter  # Reference to the assigned counter for that alarm
      choice container OsAlarmAction  # This container defines which type of notification is used when the alarm expires.
        container OsAlarmActivateTask [0..1]  # This container specifies the parameters to activate a task.
          reference OsAlarmActivateTaskRef: set at pre-compile, destination=OsTask  # Reference to the task that will be activated by that alarm action
        container OsAlarmCallback [0..1]  # This container specifies the parameters to call a callback OS alarm action.
          function name OsAlarmCallbackName: set at pre-compile  # Name of the function that is called when this alarm callback is triggered.
        container OsAlarmIncrementCounter [0..1]  # This container specifies the parameters to increment a counter.
          reference OsAlarmIncrementCounterRef: set at pre-compile, destination=OsCounter  # Reference to the counter that will be incremented by that alarm action
        container OsAlarmSetEvent [0..1]  # This container specifies the parameters to set an event
          reference OsAlarmSetEventRef: set at pre-compile, destination=OsEvent  # Reference to the event that will be set by that alarm action
          reference OsAlarmSetEventTaskRef: set at pre-compile, destination=OsTask  # Reference to the task that will be activated by that event
      container OsAlarmAutostart [0..1]  # If present this container defines if an alarm is started automatically at system start-up depending on the application mode.
        integer OsAlarmAlarmTime: set at pre-compile  # The relative or absolute tick value when the alarm expires for the first time. Note that for an alarm which is RELATIVE the value must be at bigger than 0.
        enumeration OsAlarmAutostartType: {ABSOLUTE, RELATIVE}, set at pre-compile  # This specifies the type of autostart for the alarm..
        integer OsAlarmCycleTime: set at pre-compile  # Cycle time of a cyclic alarm in ticks. If the value is 0 than the alarm is not cyclic.
        enumeration OsAlarmAlarmUnit: {MSEC, SEC, Ticks, USEC}, set at pre-compile, origin=Vector Informatik, default-value=Ticks  # This parameter specifies the unit for AlarmTime and CycleTime
        reference OsAlarmAppModeRef [0..8]: set at pre-compile, destination=OsAppMode  # Reference to the application modes for which the AUTOSTART shall be performed
    container OsAppMode [1..*]  # OsAppMode is the object used to define OSEK OS properties for an OSEK OS application mode. No standard attributes are defined for AppMode. In a CPU, at least one AppMode object has to be defined. [source: OSEK OIL Spec. 2.5] An OsAppMode called OSDEFAULTAPPMODE must always be there for OSEK compatilbility.
    container OsApplication [0..32]  # An AUTOSAR OS must be capable of supporting a collection of OS objects (tasks, interrupts, alarms, hooks etc.) that form a cohesive functional unit. This collection of objects is termed an OS-Application. All objects which belong to the same OS-Application have access to each other. Access means to allow to use these objects within API services. Access by other applications can be granted separately.
      boolean OsTrusted: set at pre-compile, default-value=false  # This choice specifies whether the OS Application is trusted. TRUE: The Application is trusted. FALSE: The Application is non-trusted.
      boolean OsAppGenerateStub: set at pre-compile, origin=Vector Informatik, default-value=false  # This choice specifies whether stubs for the trusted functions shall be generated. TRUE: Stub functions are generated for all trusted functions of this application. FALSE: Stub functions are not generated.
      string OsApplicationNonTrusted_Function [0..*]: set at pre-compile, origin=Vector Informatik  # List of non-trusted functions provided by this application (only for non trusted applications).
      reference OsAppEcucPartitionRef [0..1]: set at pre-compile, destination=EcucPartition  # Not Used: Denotes which "EcucPartition" is implemented by this "OSApplication". (OS module does not use this parameter.)
      reference OsRestartTask [0..1]: set at pre-compile, destination=OsTask  # Optionally one task of an OS-Application may be defined as Restart Task. Multiplicity = 1: Restart Task is activated by the Operating System if the protection hook requests it. Multiplicity = 0: No task is automatically started after a protection error happened.
      reference OsAppTaskRef [0..*]: set at pre-compile, destination=OsTask  # This container lists the references to all tasks belonging to this OS Application.
      reference OsAppIsrRef [0..*]: set at pre-compile, destination=OsIsr  # This container lists the references to all ISR belonging to this OS Application.
      reference OsAppAlarmRef [0..*]: set at pre-compile, destination=OsAlarm  # This container lists the references to all alarms belonging to this OS Application.
      reference OsAppScheduleTableRef [0..*]: set at pre-compile, destination=OsScheduleTable  # This container lists the references to all ScheduleTables belonging to this OS Application.
      reference OsAppCounterRef [0..*]: set at pre-compile, destination=OsCounter  # This container lists the references to all counters belonging to this OS Application.
      container OsApplicationHooks  # Container to structure the OS-Application-specific hooks
        boolean OsAppStartupHook: set at pre-compile  # Application specific hook routines are not supported by Microsar OS SafeContext.
        boolean OsAppShutdownHook: set at pre-compile  # Application specific hook routines are not supported by Microsar OS SafeContext.
        boolean OsAppErrorHook: set at pre-compile  # Application specific hook routines are not supported by Microsar OS SafeContext.
      container OsApplicationTrustedFunction [0..*]  # Container to structure the configration parameters of trusted functions
        function name OsTrustedFunctionName: set at pre-compile  # Trusted function (as part of a trusted OS-Application) available to other OS-Applications. This also supersedes the OSEK OIL attribute TRUSTED in APPLICATION because the optionality of this parameter is describing that already.
        string OsApplicationParams: set at pre-compile, origin=Vector Informatik  # This parameter specifies the arguments of the trusted function. Empty string means void. The parameter is used for stub generation only.
        string OsApplicationReturnType: set at pre-compile, origin=Vector Informatik  # This parameter specifies the return value data type of the trusted function. Empty string means void. The parameter is used for stub generation only.
      choice container OsApplicationMpuRegion [0..*]
        container Enable [0..1]
          string OsApplicationStartAddr: set at pre-compile, origin=Vector Informatik
          string OsApplicationEndAddr: set at pre-compile, origin=Vector Informatik
    container OsCounter [0..256]  # Configuration information for the counters that belong to the OsApplication.
      integer OsCounterMaxAllowedValue: 0..2147483647, set at pre-compile  # Maximum possible allowed value of the system counter in ticks.
      integer OsCounterMinCycle: 0..2147483647, set at pre-compile  # The MINCYCLE attribute specifies the minimum allowed number of counter ticks for a cyclic alarm linked to the counter.
      integer OsCounterTicksPerBase: 0..4294967295, set at pre-compile  # The TICKSPERBASE attribute specifies the number of ticks required to reach a counterspecific unit. The interpretation is implementation-specific.
      enumeration OsCounterType: {HARDWARE, SOFTWARE}, set at pre-compile, default-value=SOFTWARE  # This parameter contains the natural type or unit of the counter.
      float OsSecondsPerTick [0..1]: set at pre-compile  # Time of one hardware tick in seconds.
      reference OsCounterAccessingApplication [0..*]: set at pre-compile, destination=OsApplication  # Reference to applications which have an access to this object.
      container OsDriver [0..1]  # This Container contains the information who will drive the counter. This configuration is only valid if the counter has OsCounterType set to HARDWARE. If the container does not exist (multiplicity=0) the timer is managed by the OS internally (OSINTERNAL). If the container exists the OS can use the GPT interface to manage the timer. The user have to supply the GPT channel. If the counter is driven by some other (external to the OS) source (like a TPU for example) this must be described as a vendor specific extension.
        reference OsGptChannelRef [0..1]: set at pre-compile, destination=GptChannelConfiguration  # Reference to the GPT channel.
      container OsTimeConstant [0..*]  # Allows the user to define constants which can be e.g. used to compare time values with timer tick values. A time value will be converted to a timer tick value during generation and can later on accessed via the OsConstName. The conversation is done by rounding time values to the nearest fitting tick value.
        float OsTimeValue: set at pre-compile  # This parameter contains the value of the constant in seconds.
    container OsEvent [0..*]  # Representation of OS events in the configuration context. Adopted from the OSEK OIL specification.
      integer OsEventMask [0..1]: 1..2147483648, set at pre-compile  # If event mask would be set to AUTO in OIL, this parameter should be omitted here.
    container OsIsr [0..*]  # The OsIsr container represents an OSEK interrupt service routine.
      enumeration OsIsrCategory: {CATEGORY_1, CATEGORY_2}, set at pre-compile  # This attribute specifies the category of this ISR.
      boolean OsIsrEnableNesting: set at pre-compile, origin=Vector Informatik, default-value=false  # This choice defines whether IRQs with higher priority can interrupt. This attribute is valid only for ISRs of category 2. TRUE: Interrupts are enabled before entering the ISR, so ISRs with higher priority can interrupt. FALSE: Interrupts stay disabled at the start of the ISR. Note: NMIs and exceptions will interrupt independent from this choice.
      reference OsIsrResourceRef [0..*]: set at pre-compile, destination=OsResource  # This reference defines the resources accessed by this ISR.
      reference OsIsrAccessingApplication [0..*]: set at pre-compile, origin=Vector Informatik, destination=OsApplication  # The applications with access right to this OIL-object are defined here.
      container OsIsrUseResourceOccupation [0..*]  # This attribute is needed for DMA timing analysis performed by the osCAN TimingAnalyzer.
        integer OsIsrOccupationTime: set at pre-compile, origin=Vector Informatik  # Maximum duration of Resource usage in the ISR
        reference OsIsrResource: set at pre-compile, origin=Vector Informatik, destination=OsResource  # Reference to a Resource
      container OsIsrTimingProtection [0..1]  # This container contains all parameters which are related to timing protection If the container exists, the timing protection is used for this interrupt. If the container does not exist, the interrupt is not supervised regarding timing violations.
        float OsIsrAllInterruptLockBudget: set at pre-compile  # This parameter contains the maximum time for which the ISR is allowed to lock all interrupts (via SuspendAllInterrupts() or DisableAllInterrupts()) (in seconds).
        float OsIsrExecutionBudget: set at pre-compile  # The parameter contains the maximum allowed execution time of the interrupt (in seconds).
        float OsIsrOsInterruptLockBudget: set at pre-compile  # This parameter contains the maximum time for which the ISR is allowed to lock all Category 2 interrupts (via SuspendOSInterrupts()) (in seconds).
        float OsIsrTimeFrame: set at pre-compile  # This parameter contains the minimum inter-arrival time between successive interrupts (in seconds).
        boolean OsIsrOnlyMeasure: set at pre-compile, origin=Vector Informatik, default-value=false  # This choice specifies whether timing protection parameters shall only be measured. TRUE: All parameters will be measured, but timing fault detection is disabled. FALSE: Timing protection is fully enabled and the parameters are measured.
        container OsIsrResourceLock [0..*]  # This parameter contains a list of times the interrupt uses resources.
          float OsIsrResourceLockBudget: set at pre-compile  # This parameter contains the maximum time the interrupt is allowed to hold the given resource (in seconds).
          reference OsIsrResourceLockResourceRef: set at pre-compile, destination=OsResource  # Reference to the resource the locking time is depending on
      choice container OsIsrExceptionType  # Type of exception: EIINT or other exceptions.
        container GENERAL_EXCEPTION [0..1]  # Type of exception: EIINT or other exceptions.
          integer OsIsrExceptionAddress: 0..4294967295, set at pre-compile, origin=Vector Informatik  # Exception vector address. Must be a multiple of 16 The interrupt vector table is generated by the operating system automatically. All interrupts used in a software system have to be entered in the OIL-configurator.
        container EIINT [0..1]  # Type of exception: EIINT or other exceptions.
          integer OsIsrIntChannel: 0..298, set at pre-compile, origin=Vector Informatik  # Interrupt channel number.
          integer OsIsrInterruptPriority: 0..15, set at pre-compile, origin=Vector Informatik  # Interrupt priority level of the ISR. The highest priority is 0, the lowest priority is 15.
          integer OsIsrInterruptStackSize: 0..65535, set at pre-compile, origin=Vector Informatik, default-value=200  # Interrupt stack size in bytes.
      choice container OsIsrUseSpecialFunctionName  # This choice specifies whether a specific function shall be selected as the interrupt handler function. TRUE: A user defined function name can be entered as interupt handler. This is necessary if multiple interrupt sources share the same interrupt handler function. FALSE: The ISR attribute <name> is used as function name for the ISR handler. This is the default.
        container TRUE [0..1]  # This choice specifies whether a specific function shall be selected as the interrupt handler function. TRUE: A user defined function name can be entered as interupt handler. This is necessary if multiple interrupt sources share the same interrupt handler function. FALSE: The ISR attribute <name> is used as function name for the ISR handler. This is the default.
          string OsIsrFunctionName: set at pre-compile, origin=Vector Informatik  # This parameter specifies the name of the interrupt handler function.
        container FALSE [0..1]  # This choice specifies whether a specific function shall be selected as the interrupt handler function. TRUE: A user defined function name can be entered as interupt handler. This is necessary if multiple interrupt sources share the same interrupt handler function. FALSE: The ISR attribute <name> is used as function name for the ISR handler. This is the default.
    container OsOS  # OS is the object used to define OSEK OS properties for an OSEK application. Per CPU exactly one OS object has to be defined.
      enumeration OsScalabilityClass [0..1]: {SC1, SC2, SC3, SC4}, set at pre-compile  # A scalability class for each System Object "OS" has to be selected. In order to customize the operating system to the needs of the user and to take full advantage of the processor features the operating system can be scaled according to the scalability classes. If the scalability class is omitted this translates to the OIL AUTO mechanism.
      boolean OsStackMonitoring: set at pre-compile  # Select stack monitoring of Tasks/Category 2 ISRs true: Stacks are monitored false: Stacks are not monitored
      enumeration OsOSStackUsageMeasurement: {TRUE, FALSE, AUTO}, set at pre-compile, origin=Vector Informatik, default-value=AUTO  # If selected, the API function osGetStackUsage is provided to measure stack usage. Shall only be used together with stack check/monitoring. If AUTO is selected, the value of stack check is used.
      enumeration OsStatus: {EXTENDED, STANDARD}, set at pre-compile, default-value=EXTENDED  # The Status attribute specifies whether a system with standard or extended status has to be used. Automatic assigment is not supported for this attribute.
      boolean OsUseGetServiceId: set at pre-compile  # If selected, the usage of the access macros to the service ID information in the error hook is enabled.
      boolean OsUseParameterAccess: set at pre-compile  # If selected, the usage of the access macros to the context related information in the error hook is enabled.
      boolean OsUseResScheduler: set at pre-compile, default-value=false  # Not Used: The OsUseResScheduler attribute defines whether the resource RES_SCHEDULER is used within the application.
      boolean OsOSCallISRHooks: set at pre-compile, origin=Vector Informatik, default-value=false  # This choice specifies whether ISR hook routines shall be enabled. TRUE: UserPreIsrHook and UserPostIsrHook are called before and after ISR handler, respectively. This is a debug feature only. It is not certified for use in safety criticalenvironments, and will generate a warning during generation. FALSE: UserPreIsrHook and UserPostIsrHook are disabled.
      boolean OsOSSystemTimerNestable: set at pre-compile, origin=Vector Informatik, default-value=false  # Shall the System Timer be interruptible by higher priority ISRs?
      boolean OsOSMemoryProtection: set at pre-compile, origin=Vector Informatik, default-value=false  # Switches On memory protection (mandatory for SC3 and SC4)
      boolean OsOSEnumeratedUnhandledISRs: set at pre-compile, origin=Vector Informatik, default-value=false  # This attribute determines the handling of unassigned interrupt sources (no ISR configured for them). FALSE: Exceptions from unassigned interrupt sources are caught by one common handler. TRUE: the variables ossUnhandledExceptionDetail and ossUnhandledEIINTDetail are set to the exception number before calling the handler osUnhandledException.This is useful to determine the interrupt source quickly in case of an unhandled exception error.
      boolean OsOSORTIDebugSupport: set at pre-compile, origin=Vector Informatik, default-value=false  # This implementation supports ORTI debug information (ORTI-file) if this attribute is selected.
      boolean OsOSTypeHeaderInclude: set at pre-compile, origin=Vector Informatik, default-value=true  # This choice specifies whether AUTOSAR header files shall be included. TRUE: The Autosar header files are included into the header files of the operating system. FALSE: The AUTOSAR header files are not included. The AUTOSAR header files provide types like uint8, sint32, etc. The operating system doesn't use these types. Therefore it is safe to deselect this attribute.
      float OsOSCpuFrequency: set at pre-compile, origin=Vector Informatik  # CpuFrequency in MHz. Example: 16.000
      float OsOSTimerClockDivider: set at pre-compile, origin=Vector Informatik, default-value=1  # Divider to calculate the clock frequency of the system timer unit from the CPU frequency. PCLK = CpuFrequency / TimerClockDivider Example1: CpuFrequency = 48.0 [MHz]; TimerClockDivider = 2.0; system timer unit input frequency = 48.0 / 2.0 = 24.0 [MHz] Example2: CpuFrequency = 16.0 [MHz]; TimerClockDivider = 0.5; system timer unit input frequency = 16.0 / 0.5 = 32.0 [MHz]
      integer OsOSUserConfigurationVersion: 1..65535, set at pre-compile, origin=Vector Informatik, default-value=1  # This value specifies the current version of the OS configuration. It is not used by the OS at all but may be read back by the user.
      integer OsOSSystemStackSize: 0..65535, set at pre-compile, origin=Vector Informatik, default-value=200  # System and interrupt stack size in bytes.
      integer OsOSSystemTimerPriority: 0..15, set at pre-compile, origin=Vector Informatik, default-value=15  # System Timer interrupt priority.
      integer OsOSSystemTimerStackSize: 0..65535, set at pre-compile, origin=Vector Informatik, default-value=200  # Interrupt stack size for system timer ISR in bytes.
      integer OsOSTickTime: 1..4294967295, set at pre-compile, origin=Vector Informatik, default-value=1000  # This value specifies the duration of ticks of the SystemTimer in us. The OS configures the cycle time of the timer interrupt accordingly.
      enumeration OsOSSystemTimer: {OSTM0, UserDefined}, set at pre-compile, origin=Vector Informatik, default-value=OSTM0  # Select the system timer here.
      enumeration OsOSOSInternalChecks: {Additional}, set at pre-compile, origin=Vector Informatik, default-value=Additional
      enumeration OsOSCompiler: {GHS}, set at pre-compile, origin=Vector Informatik, default-value=GHS
      enumeration OsOSORTIDebugLevel: {ORTI_22_Additional}, set at pre-compile, origin=Vector Informatik, default-value=ORTI_22_Additional  # ORTI_22_Additional: Support of ORTI 2.2, additional features. This selection requires some additional runtime and memory.
      container OsHooks  # Container to structure all hooks belonging to the OS
        boolean OsErrorHook: set at pre-compile  # If selected, the ErrorHook routine is called, if an API function returns with an error code unequal to E_OK. It is also called if OS internal errors are detected. The function ErrorHook has to be provided by the application.
        boolean OsPostTaskHook: set at pre-compile  # If selected, the PostTaskHook routine will be called any time the operating system interrupts or terminates a task. The function PostTaskHook has to be provided by the application.
        boolean OsPreTaskHook: set at pre-compile  # If selected, the PreTaskHook routine will be called any time the operating system starts or resumes a task. The function PreTaskHook has to be provided by the application.
        boolean OsProtectionHook [0..1]: set at pre-compile  # Switch to enable/disable the call to the (user supplied) protection hook. true: Protection hook is called on protection error false: Protection hook is not called
        boolean OsShutdownHook: set at pre-compile  # If selected, the ShutdownHook routine will be called, if the API-function ShutdownOS is either called by the application or by the operating system. The function ShutdownHook has to be provided by the application.
        boolean OsStartupHook: set at pre-compile  # If selected, the StartupHook routine will be called by the operating system in the startup phase (after calling StartOS and before starting the first task). The function StartupHook has to be provided by the application.
      choice container OsOSSCHEDULE  # This parameter specifies whether the scheduling policy is determined automatically. AUTO: The scheduling policy is determined automatically. NON_AUTO: The scheduling policy is manually defined. This attribute should usually be set to AUTO. The exact scheduling policy is calculated from other attribute values, e.g. the tasks' properties. It is possible to preselect the SCHEDULE attribute, if there are requirements enforcing a special scheduling policy for a project. A warning message is created if there are differences between the preselected and the calculated scheduling policy and the preselected value is overwritten to the calculated value. NON: All tasks are non-preemptive. FULL: All tasks are full-preemptive. MIXED: A mixture of full- and non-preemptive tasks is allowed.
        container AUTO [0..1]  # A value will be choosen automatically during OS generation.
        container NON_AUTO [0..1]  # This parameter specifies whether the scheduling policy is determined automatically. AUTO: The scheduling policy is determined automatically. NON_AUTO: The scheduling policy is manually defined. This attribute should usually be set to AUTO. The exact scheduling policy is calculated from other attribute values, e.g. the tasks' properties. It is possible to preselect the SCHEDULE attribute, if there are requirements enforcing a special scheduling policy for a project. A warning message is created if there are differences between the preselected and the calculated scheduling policy and the preselected value is overwritten to the calculated value. NON: All tasks are non-preemptive. FULL: All tasks are full-preemptive. MIXED: A mixture of full- and non-preemptive tasks is allowed.
          enumeration OsOSSCHEDULE: {FULL, MIXED, NON}, set at pre-compile, origin=Vector Informatik  # This parameter specifies whether the scheduling policy is determined automatically. AUTO: The scheduling policy is determined automatically. NON_AUTO: The scheduling policy is manually defined. This attribute should usually be set to AUTO. The exact scheduling policy is calculated from other attribute values, e.g. the tasks' properties. It is possible to preselect the SCHEDULE attribute, if there are requirements enforcing a special scheduling policy for a project. A warning message is created if there are differences between the preselected and the calculated scheduling policy and the preselected value is overwritten to the calculated value. NON: All tasks are non-preemptive. FULL: All tasks are full-preemptive. MIXED: A mixture of full- and non-preemptive tasks is allowed.
      choice container OsOSCC  # This attribute should usually be set to AUTO. The exact conformance class can be calculated from other attribute values. It is possible to preselect the CC attribute, if there are restrictions to use a specific conformance class for a project. An error message is created if there are differences between the preselected and the calculated conformance class.
        container AUTO [0..1]  # A value will be choosen automatically during OS generation.
        container NON_AUTO [0..1]  # This attribute should usually be set to AUTO. The exact conformance class can be calculated from other attribute values. It is possible to preselect the CC attribute, if there are restrictions to use a specific conformance class for a project. An error message is created if there are differences between the preselected and the calculated conformance class.
          enumeration OsOSCC: {BCC1, BCC2, ECC1, ECC2}, set at pre-compile, origin=Vector Informatik  # This attribute should usually be set to AUTO. The exact conformance class can be calculated from other attribute values. It is possible to preselect the CC attribute, if there are restrictions to use a specific conformance class for a project. An error message is created if there are differences between the preselected and the calculated conformance class.
      choice container OsOSProtectionHookReaction  # Only PRO_SHUTDOWN is supported by this implementation.
        container Selected [0..1]  # Only PRO_SHUTDOWN is supported by this implementation.
          boolean OsOSSHUTDOWN: set at pre-compile, origin=Vector Informatik, default-value=true  # ProtectionHook may return the value PRO_SHUTDOWN.
      choice container OsOSTimingMeasurement  # This choice specifies whether timing measurement shall be applied. TRUE: Timing measurement is performed according to the setting of attribute OsOsGobalConfig. FALSE: Timing measurement is performed only for those tasks and ISRs which have timing protection configured. A warning is generated for tasks which have the attribute OnlyMeasure activated.
        container TRUE [0..1]  # This choice specifies whether timing measurement shall be applied. TRUE: Timing measurement is performed according to the setting of attribute OsOsGobalConfig. FALSE: Timing measurement is performed only for those tasks and ISRs which have timing protection configured. A warning is generated for tasks which have the attribute OnlyMeasure activated.
          enumeration OsOSGlobalConfig: {AsSelected, OnlyMeasureAll, ProtectAndMeasureAll}, set at pre-compile, origin=Vector Informatik, default-value=AsSelected  # This parameter globally specifies, how timing protection and timing measurement shall be performed. ProtectAndMeasureAll: Timing protection is provided for all tasks and ISRs. In case the timing protection subattribute OnlyMeasure is selected for a task or ISR, that setting is ignored with a warning. Timing measurement is provided for all tasks and ISRs independently from their configuration. AsSelected: Timing protection is provided as selected with the attribute TimingProtection of each task and ISR. The subattribte OnlyMeasure is respected and disables timing protection if selected for a task or ISR. Timing measurement is provided for tasks and ISRs with OnlyMeasure selected. OnlyMeasureAll: Timing Measurement is provided for all tasks and ISRs. Timing protection however is disabled for all tasks and ISRs. For each task and ISR that has a timing protection configured and not set the subattribute OnlyMeasure,
        container FALSE [0..1]  # This choice specifies whether timing measurement shall be applied. TRUE: Timing measurement is performed according to the setting of attribute OsOsGobalConfig. FALSE: Timing measurement is performed only for those tasks and ISRs which have timing protection configured. A warning is generated for tasks which have the attribute OnlyMeasure activated.
      choice container OsOSMpuRegion [0..*]
        container Enable [0..1]
          integer OsOSAccessRights: 0..4294967295, set at pre-compile, origin=Vector Informatik, default-value=0
          string OsOSStartAddr: set at pre-compile, origin=Vector Informatik
          string OsOSEndAddr: set at pre-compile, origin=Vector Informatik
      choice container OsOSPeripheralRegion [0..*]  # List of Peripheral regions which are assigned to be accessible for the corresponding application.
        container Region [0..1]  # List of Peripheral regions which are assigned to be accessible for the corresponding application.
          integer OsOSStartAddress: 0..4294967295, set at pre-compile, origin=Vector Informatik  # Specifies the start address of the peripheral region which shall be configured (StartAddress <= memory to be accessed).
          integer OsOSEndAddress: 0..4294967295, set at pre-compile, origin=Vector Informatik  # Specifies the end address of the peripheral region which shall be configured (memory to be accessed <= EndAddress).
          string OsOSIdentifier: set at pre-compile, origin=Vector Informatik  # Unique C Identifier which must be used in an application which accesses the peripheral region.
          reference OsOSACCESSING_APPLICATION [0..*]: set at pre-compile, origin=Vector Informatik, destination=OsApplication  # The applications with access right to this peripheral region are defined here.
    container OsResource [0..8192]  # An OsResource object is used to co-ordinate the concurrent access by tasks and ISRs to a shared resource, e.g. the scheduler, any program sequence, memory or any hardware area.
      enumeration OsResourceProperty: {INTERNAL, LINKED, STANDARD}, set at pre-compile, default-value=STANDARD  # This specifies the type of the resource.
      reference OsResourceAccessingApplication [0..*]: set at pre-compile, destination=OsApplication  # Reference to applications which have an access to this object.
      reference OsResourceLinkedResourceRef [0..1]: set at pre-compile, destination=OsResource  # The link to the resource. Must be valid if OsResourceProperty is LINKED. If OsResourceProperty is not LINKED the value is ignored.
    container OsScheduleTable [0..65535]  # An OsScheduleTable addresses the synchronization issue by providing an encapsulation of a statically defined set of alarms that cannot be modified at runtime.
      boolean OsScheduleTableRepeating: set at pre-compile  # true: first expiry point on the schedule table shall be processed at final expiry point delay ticks after the final expiry point is processed. false: the schedule table processing stops when the final expiry point is processed.
      integer OsScheduleTableDuration: set at pre-compile  # Defines the length of the schedule table in ticks.
      reference OsSchTblAccessingApplication [0..*]: set at pre-compile, destination=OsApplication  # Reference to applications which have an access to this object.
      reference OsScheduleTableCounterRef: set at pre-compile, destination=OsCounter  # This parameter contains a reference to the counter which drives the schedule table.
      container OsScheduleTableAutostart [0..1]  # This parameter specifies if and how the schedule table is started on startup of the Operating System. The options to start a schedule table correspond to the API calls to start schedule tables during runtime.
        enumeration OsScheduleTableAutostartType: {ABSOLUTE, RELATIVE, SYNCHRON}, set at pre-compile  # This specifies the type of the autostart for the schedule table.
        integer OsScheduleTableStartValue [0..1]: 0..18446744073709551615, set at pre-compile  # Autostart tick value when the schedule table starts. Only used if the OsScheduleTableAutostartType is ABSOLUTE or RELATIVE.
        reference OsScheduleTableAppModeRef [1..*]: set at pre-compile, destination=OsAppMode  # Reference in which application modes the schedule table should be started during startup
      container OsScheduleTableExpiryPoint [1..*]  # The point on a Schedule Table at which the OS activates tasks and/or sets events
        integer OsScheduleTblExpPointOffset: set at pre-compile  # The offset from zero (in ticks) at which the expiry point is to be processed.
        container OsScheduleTableEventSetting [0..*]  # Event that is triggered by that schedule table.
          reference OsScheduleTableSetEventRef: set at pre-compile, destination=OsEvent  # Reference to event that will be set by action
          reference OsScheduleTableSetEventTaskRef: set at pre-compile, destination=OsTask
          choice container OsScheduleTableCyclic  # This choice defines whether this activity of the ExpiryPoint shall be repeated cyclically within the ScheduleTable duration. TRUE: Activity is executed cyclically. FALSE: Activity is executed once.
            container TRUE [0..1]  # This choice defines whether this activity of the ExpiryPoint shall be repeated cyclically within the ScheduleTable duration. TRUE: Activity is executed cyclically. FALSE: Activity is executed once.
              integer OsScheduleTableCycleTime: 0..18446744073709551615, set at pre-compile, origin=Vector Informatik  # TThis value specifies the cycle time for the repetition of the activity. Note: The value has to be greater than 0
            container FALSE [0..1]  # This choice defines whether this activity of the ExpiryPoint shall be repeated cyclically within the ScheduleTable duration. TRUE: Activity is executed cyclically. FALSE: Activity is executed once.
        container OsScheduleTableTaskActivation [0..*]  # Task that is triggered by that schedule table.
          reference OsScheduleTableActivateTaskRef: set at pre-compile, destination=OsTask  # Reference to task that will be activated by action
          choice container OsScheduleTableCyclic  # This choice defines whether this activity of the ExpiryPoint shall be repeated cyclically within the ScheduleTable duration. TRUE: Activity is executed cyclically. FALSE: Activity is executed once.
            container TRUE [0..1]  # This choice defines whether this activity of the ExpiryPoint shall be repeated cyclically within the ScheduleTable duration. TRUE: Activity is executed cyclically. FALSE: Activity is executed once.
              integer OsScheduleTableCycleTime: 0..18446744073709551615, set at pre-compile, origin=Vector Informatik  # This value specifies the cycle time for the repetition of the activity. Note: The value has to be greater than 0
            container FALSE [0..1]  # This choice defines whether this activity of the ExpiryPoint shall be repeated cyclically within the ScheduleTable duration. TRUE: Activity is executed cyclically. FALSE: Activity is executed once.
        container OsScheduleTblAdjustableExpPoint [0..1]  # Adjustable expiry point
          integer OsScheduleTableMaxLengthen: 0..18446744073709551615, set at pre-compile  # The maximum positive adjustment that can be made to the expiry point offset (in ticks).
          integer OsScheduleTableMaxShorten: 0..18446744073709551615, set at pre-compile  # The maximum negative adjustment that can be made to the expiry point offset (in ticks).
      container OsScheduleTableSync [0..1]  # This parameter specifies the synchronization parameters of the schedule table.
        integer OsScheduleTblExplicitPrecision [0..1]: set at pre-compile  # This configuration is only valid if the explicit synchronisation is used.
        enumeration OsScheduleTblSyncStrategy: {EXPLICIT, IMPLICIT, NONE}, set at pre-compile, default-value=NONE  # AUTOSAR OS provides support for synchronisation in two ways: explicit and implicit.
    container OsTask [0..65533]  # This container represents an OSEK task.
      integer OsTaskActivation: 1..4294967296, set at pre-compile, default-value=1  # This attribute defines the maximum number of queued activation requests for the task. A value equal to "1" means that at any time only a single activation is permitted for this task. Note that the value must be a natural number starting at 1.
      integer OsTaskPriority: set at pre-compile  # The priority of a task is defined by the value of this attribute. This value has to be understood as a relative value, i.e. the values show only the relative ordering of the tasks. OSEK OS defines the lowest priority as zero (0); larger values correspond to higher priorities.
      enumeration OsTaskSchedule: {FULL, NON}, set at pre-compile  # The OsTaskSchedule attribute defines the preemptability of the task. If this attribute is set to NON, no internal resources may be assigned to this task.
      enumeration OsTaskTYPE: {BASIC, EXTENDED, AUTO}, set at pre-compile, origin=Vector Informatik, default-value=AUTO  # This attribute should usually be set to AUTO. The exact task type can be calculated from other attribute values. It is possible to preselect the TYPE attribute, if there are restrictions to use a special task type. An error message is created if there are differences between the preselected and the calculated task type.
      integer OsTaskStackSize: 0..65535, set at pre-compile, origin=Vector Informatik, default-value=300  # This value specifies the stack size of the task in bytes
      reference OsTaskAccessingApplication [0..*]: set at pre-compile, destination=OsApplication  # Reference to applications which have an access to this object.
      reference OsTaskEventRef [0..*]: set at pre-compile, destination=OsEvent  # This reference defines the list of events the extended task may react on.
      reference OsTaskResourceRef [0..*]: set at pre-compile, destination=OsResource  # This reference defines a list of resources accessed by this task.
      container OsTaskUseResourceOccupation [0..*]  # This attribute is needed for DMA timing analysis performed by the osCAN TimingAnalyzer.
        integer OsTaskOccupationTime: set at pre-compile, origin=Vector Informatik  # Maximum duration of Resource usage in the task
        reference OsTaskResource: set at pre-compile, origin=Vector Informatik, destination=OsResource  # Reference to a Resource
      container OsTaskAutostart [0..1]  # This container determines whether the task is activated during the system start-up procedure or not for some specific application modes. If the task shall be activated during the system start-up, this container is present and holds the references to the application modes in which the task is auto-started.
        reference OsTaskAppModeRef [1..*]: set at pre-compile, destination=OsAppMode  # Reference to application modes in which that task is activated on startup of the OS
      container OsTaskTimingProtection [0..1]  # This parameter contains all parameters regarding timing protection of the task.
        float OsTaskAllInterruptLockBudget: set at pre-compile  # This parameter contains the maximum time for which the task is allowed to lock all interrupts (via SuspendAllInterrupts() or DisableAllInterrupts()) (in seconds).
        float OsTaskExecutionBudget: set at pre-compile  # This parameter contains the maximum allowed execution time of the task (in seconds).
        float OsTaskOsInterruptLockBudget: set at pre-compile  # This parameter contains the maximum time for which the task is allowed to lock all Category 2 interrupts (via SuspendOSInterrupts()) (in seconds).
        float OsTaskTimeFrame: set at pre-compile  # The minimum inter-arrival time between activations and/or releases of a task (in seconds).
        boolean OsTaskOnlyMeasure: set at pre-compile, origin=Vector Informatik, default-value=false  # This choice specifies whether timing protection parameters shall only be measured. TRUE: All parameters will be measured, but timing fault detection is disabled. FALSE: Timing protection is fully enabled.
        container OsTaskResourceLock [0..*]  # This parameter contains the worst case time between getting and releasing a given resource (in seconds).
          float OsTaskResourceLockBudget: set at pre-compile  # This parameter contains the maximum time the task is allowed to lock the resource (in seconds)
          reference OsTaskResourceLockResourceRef: set at pre-compile, destination=OsResource  # Reference to the resource used by the task
    container OsImplementationInformation
      string OsVectorOilVersion: set at pre-compile, origin=Vector Informatik, default-value=3.2
      string OsVectorImplementationName: set at pre-compile, origin=Vector Informatik
      integer OsBswmdStyleVersion: 0..4294967296, set at pre-compile, origin=Vector Informatik, default-value=2
    container VectorCommonData
      string BswmdVersion: set at published-information, origin=Vector Informatik, default-value=6.05.00
  module config Os_Rec: definition=Os
    OsOS
      OsOSSCHEDULE
        AUTO
      OsOSCC
        AUTO
      OsOSProtectionHookReaction
        Selected
      OsOSTimingMeasurement
        TRUE
  module config Os_Pre: definition=Os
    VectorCommonData: BswmdVersion=6.05.00
    OsImplementationInformation: OsVectorOilVersion=4.0, OsVectorImplementationName=RenesasRH850_P1M.i40, OsBswmdStyleVersion=2
    OSDEFAULTAPPMODE (OsAppMode)
    SystemTimer (OsCounter): OsCounterMaxAllowedValue=2147483647, OsCounterTicksPerBase=1, OsCounterMinCycle=1, OsSecondsPerTick=1234567890, OsCounterType=SOFTWARE
