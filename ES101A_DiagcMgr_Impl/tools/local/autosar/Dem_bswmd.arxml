AUTOSAR XML (schema 4-0-3)
# COPYRIGHT
# Copyright (c) 2013 by Vector Informatik GmbH. All rights reserved.
# This software is copyright protected and proprietary to Vector Informatik GmbH.
# Vector Informatik GmbH grants to you only those rights as set out in the license conditions.
package /MICROSAR
  bsw implementation Dem_Impl: programming-language=C, sw-version=5.00.01, used-code-generator=DaVinci Configurator, vendor-id=30, ar-release-version=4.00.03, behavior=DemBehavior, preconfigured-configuration=Dem_Pre, recommended-configuration=Dem_Rec, vendor-specific-module-def=Dem
  module definition Dem [0..1]: category=VENDOR_SPECIFIC_MODULE_DEFINITION, refined-module-def=Dem, variants pre-compile/post-build-loadable  # Configuration of the Dem (Diagnostic Event Manager) module.
    container DemConfigSet  # This container groups the Diagnostic Monitor configuration setup. One such data set can be activated during initialization in case of multiple configuration sets. Currently only one configuration set is supported.
      container DemDTCClass [0..65535]  # This container groups configuration options relating to the Diagnostic Trouble code (DTC) of a monitor. It is only valid if actually used by a monitor (see DemConfigSet/DemEventParameter/DemDTCClassRef). Unused DTCClass containers are ignored.
        integer DemDTCFunctionalUnit: 0..255, set at pre-compile, default-value=255  # A 1-byte value which identifies the corresponding basic vehicle / system function which monitors this DTC. This parameter is necessary for the report of severity information and will be returned in UDS service $19 09. If this service is not used, this parameter serves no use at all. This parameter has no further influence on the function of the Dem.
        enumeration DemDTCSeverity [0..1]: {DEM_DTC_SEV_CHECK_AT_NEXT_HALT, DEM_DTC_SEV_IMMEDIATELY, DEM_DTC_SEV_MAINTENANCE_ONLY, DEM_DTC_SEV_NO_SEVERITY}, set at pre-compile  # DTC severity information. This parameter is reported by UDS service $19 09 and can serve as filter for UDS service $19 08. A missing configuration value (or parameter) is interpreted as NO_SEVERITY. This parameter has no further influence on the function of the Dem. | This parameter depends on automotive manufacturer and is optional.
        boolean DemImmediateNvStorage: set at pre-compile, default-value=false  # If enabled, this DTC will be written to NV backing storage when the related event data (extended data and snapshot data) changes. If disabled, the DTC will be persisted during shutdown. | true: immediate non-volatile storage triggering enabled false: immediate non-volatile storage triggering disabled
        integer DemObdDTC [0..1]: 1..65535, set at post-build in variant post-build-loadable / pre-compile in variant pre-compile  # Unique Diagnostic Trouble Code value for OBD. This parameter is only valid if OBD is supported (DemGeneral/DemOBDSupport == true) If a DTC is OBD relevant (i.e. has this DTC number configured) certain legislated restrictions apply to the DTC configuration. Please refer to the OBD legislation. In variant POST-BUILD-LOADABLE you must: - not add an ObdDTC number, - not delete an existing ObdDTC number. You can change the value of an existing ObdDTC number.
        integer DemUdsDTC [0..1]: 1..16777214, set at post-build in variant post-build-loadable / pre-compile in variant pre-compile  # Unique Diagnostic Trouble Code value for UDS (DTC number) | (Range: 0x000000 and 0xFFFFFF are reserved for DTC groups by ISO 14229-1)
        reference DemMILGroupRef [0..1]: set at pre-compile, origin=Vector Informatik, destination=DemMILGroup  # Reference to a MIL group that is needed if different symptoms shall use one common debounce algorithm.
        container DemCallbackInitMForF [0..*]  # Callback InitMonitorForFunction | The presence of this container sets up an initialization function (InitMonitorForFunction) for this DTC. The Dem will call this function each time the related DTC is cleared, or the operation (monitoring) cycle of the related monitor restarts. This function is usually called through a RTE port interface. This behavior can be changed by creating the sub-parameter 'DemCallbackInitMForFFnc'. | In case the container has a DemCallbackInitMForFFnc, this parameter defines the name of the function that the Dem will call. In case there is no DemCallbackInitMForFFnc, the Dem will have an R-Port requiring the interface CallbackInitMonitorForFunction, whose name is generated by using the unique callback-prefix followed by the event name.
          function name DemCallbackInitMForFFnc [0..1]: set at pre-compile  # Callback InitMonitorForFunction Function | Function name of an InitMonitorForFunction callout. If this parameter exists, it must give a valid C-Function which is called instead of using an RTE port interface. See DemGeneral/DemHeaderFileInclusion to specify a header file which declares this function.
      container DemEventParameter [1..65534]  # This container contains the configuration of diagnostic events. These represent monitors and can be mapped onto a DTC. | Note that this container definition does not explicitly define a symbolic name parameter. Instead, the short name of the container will be used in the Ecu Configuration Description to specify the symbolic name of the diagonstic event.
        integer DemEventId: 1..65535, set at pre-compile, symbolic-name-value=true, default-value=65535  # Internal identifier of a diagnostic event. This number is calculated internally and may not be configured. This parameter is only available to publish the result of this calculation. Applications using Dem APIs may not rely on the value of this parameter. Instead, use the symbolic constant (SymbolicNameValue) DemConf_DemEventParameter_<SHORT-NAME>. | This parameter should not be changeable by user, because the Id should be generated by Dem itself to prevent gaps and multiple use of an Id. The events should be sequentially ordered beginning with 1 and no gaps in between.
        enumeration DemEventKind: {DEM_EVENT_KIND_BSW, DEM_EVENT_KIND_SWC}, set at pre-compile, default-value=DEM_EVENT_KIND_SWC  # This parameter is used to distinguish between SW-C and BSW events. SW-C events are reported through the RTE port interface DiagnosticMonitor, operation SetEventStatus. BSW events are reported by C-API Dem_ReportErrorStatus. The event types may not be reported interchangeably. The critical section handling depends on this assumption.
        integer DemMaxNumberFreezeFrameRecords [0..1]: 0..255, set at pre-compile, default-value=0  # Max Number FreezeFrameRecords | This parameter defines the number of snapshot records which can be stored for this event. The parameter will be mandatory, if the snapshot numbers are CALCULATED (see DemGeneral/DemTypeOfFreezeFrameRecordNumeration) and a FreezeFrame is configured for this DemEventParameter (see DemFreezeFrameClassRef). For configured record numbers this value has no meaning and can be removed. | This parameter is only required for calculated record numeration (refer to DemTypeOfFreezeFrameRecordNumeration).
        reference DemDTCClassRef [0..1]: set at pre-compile, destination=DemDTCClass  # DTC Class Ref | This parameter defines the DTC configuration associated with the diagnostic event, i.e. maps the event onto a DTC number. | It is allowed to have events without a DTC (e.g. for ECU-internal events triggering safety reactions without being reported via diagnostic communication). The same DemDTCClass can be used from several events, to combine these (refer to chapter "Combination of diagonstic event").
        reference DemExtendedDataClassRef [0..1]: set at pre-compile, destination=DemExtendedDataClass  # ExtendedData Class Ref | This reference defines the list of extended data records available for this event.
        reference DemFreezeFrameClassRef [0..1]: set at pre-compile, destination=DemFreezeFrameClass  # FreezeFrame Class Ref | These references define the list of Data IDs (DIDs) stored in the snapshot records of this event.
        reference DemFreezeFrameRecNumClassRef [0..1]: set at pre-compile, destination=DemFreezeFrameRecNumClass  # FreezeFrameRecNum Class Ref | This parameter defines the list of dedicated snapshot record numbers associated with the diagnostic event. These record numbers are assigned to the snapshot records. The parameter will be mandatory, if the snapshot numbers are CONFIGURED (see DemGeneral/DemTypeOfFreezeFrameRecordNumeration) and a FreezeFrame is configured for this DemEventParameter (see DemFreezeFrameClassRef). For calculated record numbers this value has no meaning and can be removed. | This parameter is only required for configured record numeration (refer to DemTypeOfFreezeFrameRecordNumeration).
        container DemCallbackClearEventAllowed [0..1]  # Callback ClearEventAllowed | The presence of this container sets up a callout function 'ClearEventAllowed' for this DTC. The Dem will call this function each time the related DTC is about to be cleared by an external tool. (API Dem_ClearDTC, usually only called by Dcm) This function is usually called through a RTE port interface. This behavior can be changed by creating the sub-parameter 'DemCallbackClearEventAllowedFnc'. | In case there is a DemCallbackClearEventAllowedFnc, this parameter defines the name of the function that the Dem will call. In case there is no DemCallbackClearEventAllowedFnc, the Dem will have an R-Port requiring the interface CallbackClearEventAllowed whose name is generated by using the unique callback-prefix followed by the event name.
          function name DemCallbackClearEventAllowedFnc [0..1]: set at pre-compile  # Callback ClearEventAllowed Function | Function name of a 'ClearEventAllowed' callout. If this parameter exists, it must give a valid C-Function which is called instead of using an RTE port interface. See DemGeneral/DemHeaderFileInclusion to specify a header file which declares this function.
        container DemCallbackEventDataChanged [0..1]  # Callback EventDataChanged | The presence of this container sets up a callout function 'EventDataChanged' for this DTC. The Dem will call this function each time the stored data (extended record, snapshot record) has changed. Please note, data elements can be mapped to internal data. This callback is NOT called if such data changes, only if the stored data record is modified due to a new event report. Example: If an extended record is mapped to the fault detection counter, this API is not called each time the FDC changes even though a diagnostic service $19 06 would indeed return different data. This function is usually called through a RTE port interface. This behavior can be changed by creating the sub-parameter 'DemCallbackEventDataChangedFnc'. The presence of this container indicates that the Dem has access to an "EventDataChanged" callback. | In case there is a DemCallbackEventDataChangedFnc, this parameter defines the name of the function that the Dem will call. In case there is no DemCallbackEventDataChangedFnc, the Dem will have an R-Port requiring the interface CallbackEventDataChanged whose name is generated by using the unique callback-prefix followed by the event name.
          function name DemCallbackEventDataChangedFnc [0..1]: set at pre-compile  # Callback EventDataChanged Function | Function name of a 'EventDataChanged' callout. If this parameter exists, it must give a valid C-Function which is called instead of using an RTE port interface. See DemGeneral/DemHeaderFileInclusion to specify a header file which declares this function.
        container DemCallbackEventStatusChanged [0..*]  # Callback EventStatusChanged | The presence of this container sets up a callout function 'EventStatusChanged' for this DTC. The Dem will call this function each time the event status changes. Please note, the event status is independent of the DTC status availability mask (DemGeneral/DemDtcStatusAvailabilityMask). All transitions of status bits will be reported. Attention: Due to preemption it is possible that event status changes are reported in the wrong order. This is no issue if the Dem_Mainfunction is mapped to a non-preemptive task. This function is usually called through a RTE port interface. This behavior can be changed by creating the sub-parameter 'DemCallbackEventStatusChangedFnc'. | In case there is a DemCallbackEvenStatusChangedFnc, this parameter defines the name of the function that the Dem will call. In case there is no DemCallbackEvenStatusChangedFnc, the Dem will have an R-Port requiring the interface CallbackEventStatusChanged, whose name is generated by using the unique callback-prefix followed by the event name.
          function name DemCallbackEventStatusChangedFnc [0..1]: set at pre-compile  # Callback EventStatusChanged Function | Function name of an 'EventStatusChanged' callout. If this parameter exists, it must give a valid C-Function which is called instead of using an RTE port interface. See DemGeneral/DemHeaderFileInclusion to specify a header file which declares this function.
        container DemCallbackInitMForE [0..1]  # Callback InitMonitorForEvent | The presence of this container sets up an initialization function 'InitMonitorForEvent' for this Event. The Dem will call this function each time this event is cleared, the operation (monitoring) cycle restarts (see ./DemEventClass/DemOperationCycleRef) or ControlDTC is re-enabled ($85 01) This function is usually called through a RTE port interface. This behavior can be changed by creating the sub-parameter 'DemCallbackInitMForFFnc'. | In case the container has a DemCallbackInitMForEFnc, this parameter defines the name of the function that the Dem will call. In case there is no DemCallbackInitMForEFnc, the Dem will have an R-Port requiring the interface CallbackInitMonitorForEvent, whose name is generated by using the unique callback-prefix followed by the event name.
          function name DemCallbackInitMForEFnc [0..1]: set at pre-compile  # Callback InitMonitorForEvent Function | Function name of a 'InitMonitorForEvent' callout. If this parameter exists, it must give a valid C-Function which is called instead of using an RTE port interface. See DemGeneral/DemHeaderFileInclusion to specify a header file which declares this function.
        container DemEventClass  # This container contains further configuration parameters for the event.
          boolean DemAgingAllowed: set at pre-compile, default-value=false  # Switch to allow aging/unlearning of the event. If aging is supported, a valid aging cycle must be referenced (see DemAgingCycleRef) and a valid number of aging cycles must be set (see DemAgingCycleCounterThreshold) | true: aging allowed false: aging not allowed
          integer DemAgingCycleCounterThreshold [0..1]: 1..255, set at post-build in variant post-build-loadable / pre-compile in variant pre-compile  # AgingCycle Counter Threshold | Number of aging cycles needed to unlearn/delete the event. A value of 0 (parameter missing) is currently unsupported, and means the event is aged immediately with a passed event status. A value of 1 means the event is aged at the end of the current aging cycle (if the event is passive at that moment). Larger values represent the nth cycle e.g. 2 is the next, 3 the cycle after the next etc. This parameter is only needed in case aging is allowed for this event (see DemAgingAllowed)
          boolean DemConsiderPtoStatus: set at pre-compile, default-value=false  # This parameter is currently unused.
          enumeration DemEventDestination: {DEM_DTC_ORIGIN_MIRROR_MEMORY, DEM_DTC_ORIGIN_PRIMARY_MEMORY, DEM_DTC_ORIGIN_SECONDARY_MEMORY}, set at pre-compile, default-value=DEM_DTC_ORIGIN_PRIMARY_MEMORY  # Define the event memory this event belongs to. Events in primary memory can be reported and cleared using the 'usual' UDS services $19, $14 and so on. E.g. the will be cleared with $14 FFFFFF (independent of a valid DTC number for this event (see ../DemDTCClassRef). OBD relevant events must be located in primary memory. Events in secondary memory are not supported by UDS services and must be reported/cleared by integration specific means. Events in mirror memory are currently not supported. An event is not able to be located in more than one memory at the same time, this is a restriction because event notifications have no way to tell which event status has changed. | If no event destination is assigned to a specific event, the event is handled internally and is not visible externally to the Dcm. If more than one event destination is assigned to a specific event, the event can be present in the corresponding origins.
          integer DemEventFailureCycleCounterThreshold [0..1]: 1..255, set at pre-compile  # Event FailureCycleCounter Threshold | Number of operation cycles needed to confirm the event. A value of 0 (parameter missing) is the standard UDS behavior of confirming the event (ConfirmedDTC status bit becomes set) with the first qualified FAILED result. A value of 1 means the event becomes confirmed if it fails again in the next operation cycle. Larger values represent confirmation in the nth cycle e.g. 2 is confirmation in cycle after the next cycle, etc.
          enumeration DemEventOBDReadinessGroup: {DEM_OBD_RDY_AC, DEM_OBD_RDY_BOOSTPR, DEM_OBD_RDY_CAT, DEM_OBD_RDY_CMPRCMPT, DEM_OBD_RDY_EGSENS, DEM_OBD_RDY_ERG, DEM_OBD_RDY_EVAP, DEM_OBD_RDY_FLSYS, DEM_OBD_RDY_HCCAT, DEM_OBD_RDY_HTCAT, DEM_OBD_RDY_MISF, DEM_OBD_RDY_NONE, DEM_OBD_RDY_NOXCAT, DEM_OBD_RDY_O2SENS, DEM_OBD_RDY_O2SENSHT, DEM_OBD_RDY_PMFLT, DEM_OBD_RDY_SECAIR, DEM_OBD_RDY_FLSYS_NONCONT}, set at pre-compile, default-value=DEM_OBD_RDY_NONE  # Select the Event OBD Readiness group for PID $01 and PID $41 computation. This parameter is only needed if OBD support is enabled (see DemGeneral/DemOBDSupport) | This parameter is only applicable for emission-related ECUs.
          integer DemEventPriority: 1..256, set at post-build in variant post-build-loadable / pre-compile in variant pre-compile, default-value=2  # Set the priority of the event. This value influences the event displacement in case the respective memory is completely filled at the time of event confirmation. A lower number represent higher priority. Same level priority is allowed. Lower priority events will never displace higher priority events. Equal priority events will displace passive entries. See also DemGeneral/DemMaxNumberEventEntryPrimary, DemGeneral/DemMaxNumberEventEntrySecondary This parameter only has an effect if event displacement is supported (see DemGeneral/DemEventDisplacementSupport)
          enumeration DemEventSignificance [0..1]: {DEM_EVENT_SIGNIFICANCE_FAULT, DEM_EVENT_SIGNIFICANCE_OCCURRENCE}, set at pre-compile, default-value=DEM_EVENT_SIGNIFICANCE_FAULT  # Significance of the event, which indicates additional information concerning fault classification and resolution. This value can optionally be selected to be reported as event data (e.g. as extended data record). It has no further effect on the Dem. | It can be mapped as Dem-internal data element. It shall be configured, if it is a part of event related data.
          boolean DemFFPrestorageSupported: set at pre-compile, default-value=false  # FreezeFrame Prestorage Supported | Select the event for prestorage support. Only events with this flag enabled may request data prestorage (Port interface DiagnosticMonitor, operation PrestoreFreezeFrame). This parameter only has an effect if prestorage is enabled (see DemGeneral/DemMaxNumberPrestoredFF)
          choice reference DemAgingCycleRef [0..1]: set at pre-compile, origin=AUTOSAR_ECUC V1.0.0, destination=DemOperationCycle  # AgingCycle Ref | Select the cycle which triggers aging/unlearning of this event. This can either be the same as the operation cycle of the event (see DemOperationCycleRef) or a different cycle. Note: DemAgingCycle container references are not currently supported. Use DemOperationCycles for the same effect.
          reference DemEnableConditionGroupRef [0..1]: set at pre-compile, origin=AUTOSAR_ECUC V1.0.0, destination=DemEnableConditionGroup  # EnableCondition Group Ref | References an enable condition group. An event status report ((Pre)Failed or (Pre)Passed) will only have an effect if all EnableConditions belonging to the referenced group are met at the time of report. Otherwise the result will be discarded.
          reference DemEventFailureCycleRef [0..1]: set at pre-compile, origin=AUTOSAR_ECUC V1.0.0, destination=DemOperationCycle  # Event FailureCycle Ref | Select the cycle which is used as base of counting failures of this event. This must be the same as the operation cycle of the event (see DemOperationCycleRef). Therefore this parameter is ignored.
          reference DemOperationCycleRef: set at post-build in variant post-build-loadable / pre-compile in variant pre-compile, origin=AUTOSAR_ECUC V1.0.0, destination=DemOperationCycle  # OperationCycle Ref | Select the operation/monitoring cycle for the event. This cycle is used: - to reset the NotTestedThisCycle and FailedThisCycle bits of the event status - as the basis of event confirmation in case multiple trips are required (see DemEventFailureCycleCounterThreshold) - as the basis for healing of the WarningIndicatorRequests bit in case multiple passed cycles are required (e.g. to disable the MIL)
          reference DemStorageConditionGroupRef [0..1]: set at pre-compile, origin=AUTOSAR_ECUC V1.0.0, destination=DemStorageConditionGroup  # StorageCondition Group Ref | References a storage condition group. An event status report will not result in an event entry to be created or updated unless all StorageConditions belonging to the referenced group are met at the time of report. This means PendingDTC or ConfirmedDTC will not be set, and Indicators will not be enabled. Already stored events can still stop to age and heal, and the remaining status bits are modified if needed.
          choice container DemDebounceAlgorithmClass  # DebounceAlgorithm Class | Select the debouncing algorithm used for the event.
            container DemDebounceCounterBased [0..1]  # Debounce CounterBased | Counter based debouncing will increment a counter with each Prefailed result, and decrement the counter with each Prepassed result. A qualified 'Passed' or 'Failed' result will be generated when a given threshold value is reached. This debouncing type is ideal for cyclic monitors that generate a monitoring result regularly since it involves little overhead. The debounce value is mapped to a faultdetection count as such: If the Failed threshould is reached, FDC is 127. If the DebounceCounter is 0, FDC is 0. If the Passed threshold is reached, FDC is -128 Values between 0 and the threshold values are linearly mapped to 1..126 respectively -1..-127
              integer DemDebounceCounterDecrementStepSize: 1..32768, set at post-build in variant post-build-loadable / pre-compile in variant pre-compile, default-value=1  # DebounceCounter Decrement Step Size | The debounce counter will be decremented by this amount with each PREPASSED monitor result. Note: The value is subtracted, so it must be positive.
              integer DemDebounceCounterFailedThreshold: 1..32767, set at post-build in variant post-build-loadable / pre-compile in variant pre-compile, default-value=127  # DebounceCounter Failed Threshold | If a PREFAILED monitor result increments the debounce counter to(or above) this value, a qualified FAILED result is generated.
              integer DemDebounceCounterIncrementStepSize: 1..32767, set at post-build in variant post-build-loadable / pre-compile in variant pre-compile, default-value=1  # DebounceCounter Increment Step Size | The debounce counter will be incremented by this amount with each PREFAILED monitor result.
              boolean DemDebounceCounterJumpDown: set at post-build in variant post-build-loadable / pre-compile in variant pre-compile, default-value=true  # DebounceCounter Jump Down | Select the jump down behavior. If enabled, the debounce counter is set to the value of DemDebounceCounterJumpDownValue before decrementing, unless the counter already is smaller. This can be used to achieve constant times for a qualified PASSED result. | true: Jump-Down activated false: Jump-Down deactivated
              integer DemDebounceCounterJumpDownValue: -32768..32767, set at post-build in variant post-build-loadable / pre-compile in variant pre-compile, default-value=0  # DebounceCounter Jump Down Value | This is the debounce counter value set if a 'JumpDown' is triggered. This parameter is used only if DemDebounceCounterJumpDown is enabled.
              boolean DemDebounceCounterJumpUp: set at post-build in variant post-build-loadable / pre-compile in variant pre-compile, default-value=true  # DebounceCounter Jump Up | Select the jump up behavior. If enabled, the debounce counter is set to the value of DemDebounceCounterJumpUpValue before incrementing, unless the counter already is larger. This can be used to achieve constant times for a qualified FAILED result. | true: Jump-Up activated false: Jump-Up deactivated
              integer DemDebounceCounterJumpUpValue: -32768..32767, set at post-build in variant post-build-loadable / pre-compile in variant pre-compile, default-value=0  # DebounceCounter Jump Up Value | This is the debounce counter value which is set if a 'JumpUp' is triggered. Usually this is set to 0 as shown in ISO14229. This parameter is used only if DemDebounceCounterJumpUp is enabled.
              integer DemDebounceCounterPassedThreshold: -32768..-1, set at post-build in variant post-build-loadable / pre-compile in variant pre-compile, default-value=-128  # DebounceCounter Passed Threshold | If a PREPASSED monitor result decrements the debounce counter to (or below) this value, a qualified PASSED result is generated.
              integer DemEventDebounceCounterStorageThreshold [0..1]: 1..32767, set at post-build in variant post-build-loadable / pre-compile in variant pre-compile, origin=Vector Informatik, default-value=127  # DebounceCounter Storage Threshold | If a PREFAILED monitor result increments the debounce counter to(or above) this value, a FDC TRIP result is generated. This value has to be less or equal to DemDebounceCounterFailedThreshold This parameter is only relevant if data is stored at a time where the DTC fault detection counter passes a threshold lower than the failed threshold.
            container DemDebounceMonitorInternal [0..1]  # Debounce MonitorInternal | Monitor internal debouncing is used for monitors that implement the debouncing themselves, and only report qualified results (PASSED/FAILED) to the Dem. In order to implement the diagnostic services that report the fault detection counter, a callout function is required.
              container DemCallbackGetFDC  # Callback GetFDC | This container sets up the callout function 'DemCallbackGetFDC' for this Event. The Dem will call this function each time the value of the fault detection counter is needed, e.g. requested by the Dcm. This function is usually called through a RTE port interface. This behavior can be changed by creating the sub-parameter 'DemCallbackGetFDCFnc'. | In case the container has a DemCallbackGetFDCFnc, this parameter defines the name of the function that the Dem will call. In case there is no DemCallbackGetFDCFnc, the Dem will have a R-Port requiring the interface CallbackGetFaultDetectionCounter, whose name is generated by using the unique callback-prefix followed by the event name.
                function name DemCallbackGetFDCFnc [0..1]: set at pre-compile  # Callback GetFaultDetectionCounter Function | Function name of a 'DemCallbackGetFDC' callout. If this parameter exists, it must give a valid C-Function which is called instead of using an RTE port interface. See DemGeneral/DemHeaderFileInclusion to specify a header file which declares this function.
            container DemDebounceTimeBase [0..1]  # Debounce TimeBase | Time based debouncing will use a timer started in either passed or failed direction with an unqualified result. The timer is not restarted in case it is already running, unless a direction change is detected - e.g. after a PrePassed result the next PrePassed result will not restart the timer, a following PreFailed will stop the passed timer and start the failed timer. Timer supervision incurs a substantial runtime and RAM overhead compared to counter based denouncing and should be used sparingly. The debounce value is mapped to a faultdetection count as such: If the Failed time is reached, FDC is 127. If no timer is running (and no qualified result has been reached), FDC is 0. If the Passed time is reached, FDC is -128 If the timer is currently running in either direction, the timer is linearly mapped to 1..126 respectively -1..-127
              float DemDebounceTimeFailedThreshold: 0..3600, set at post-build in variant post-build-loadable / pre-compile in variant pre-compile  # DebounceTime Failed Threshold | Time after a PreFailed report, after which a qualified FAILED result is generated. The AUTOSAR configuration standard is to use SI units, so in the EcuC file this parameter is stored as float value in seconds - the GUI will convert the value when using a diffenent unit. | The AUTOSAR configuration standard is to use SI units, so this parameter is defined as float value in seconds. Dem configuration tools must convert this float value to the appropriate value format for the use in the software implementation of Dem.
              float DemDebounceTimeStorageThreshold [0..1]: 0..3600, set at post-build in variant post-build-loadable / pre-compile in variant pre-compile, origin=Vector Informatik  # DebounceTime Storage Threshold | If a monitor fails for this time, a FDC TRIP result is generated. This value has to be less or equal to DemDebounceTimeFailedThreshold This parameter is only relevant if data is stored at a time where the DTC fault detection counter passes a threshold lower than the failed threshold.
              float DemDebounceTimePassedThreshold: 0..3600, set at post-build in variant post-build-loadable / pre-compile in variant pre-compile  # DebounceTime Passed Threshold | Time after a PrePassed report, after which a qualified PASSED result is generated. The AUTOSAR configuration standard is to use SI units, so in the EcuC file this parameter is stored as float value in seconds - the GUI will convert the value when using a diffenent unit. | The AUTOSAR configuration standard is to use SI units, so this parameter is defined as float value in seconds. Dem configuration tools must convert this float value to the appropriate value format for the use in the software implementation of Dem.
          container DemIndicatorAttribute [0..255]  # This container maps the event to a list of indicators which can be enabled due to the event failing.
            enumeration DemIndicatorBehaviour: {DEM_INDICATOR_BLINKING, DEM_INDICATOR_BLINK_CONT, DEM_INDICATOR_CONTINUOUS}, set at pre-compile, default-value=DEM_INDICATOR_CONTINUOUS  # Select how the referenced indicator will react on this event (Blink, continuous light, application decides)
            integer DemIndicatorFailureCycleCounterThreshold [0..1]: 0..255, set at pre-compile  # Indicator FailureCycle Counter Threshold | Number of continuous failed cycles until the indicator is enabled. This parameter is only valid if DemIndicatorFailureCycleSource is set to INDICATOR. All DTCs, that are in the same MIL Group, must have the same threshold value (refer to parameter /Dem/DemGeneral/DemMILGroup).
            enumeration DemIndicatorFailureCycleSource: {DEM_FAILURE_CYCLE_EVENT, DEM_FAILURE_CYCLE_INDICATOR}, set at pre-compile, default-value=DEM_FAILURE_CYCLE_EVENT  # Indicator FailureCycle Source | Select if the indicator is enabled as defined by the event status, or if the indicator requires a different set of event status bits to determine indicator state. This feature is required if an indicator is not enabled together with the event confirmation, but e.g. uses a different cycle or confirmation threshold. This parameter is currently not supported and is assumed to be set to 'DEM_FAILURE_CYCLE_EVENT'
            integer DemIndicatorHealingCycleCounterThreshold: 0..255, set at pre-compile, default-value=3  # Indicator HealingCycle Counter Threshold | Defines the number of consecutive cycles in which the event has been tested passed, and not tested failed until this indicator heals. Currently it is only supported to set the same value for each indicator attached to this event.
            reference DemIndicatorFailureCycleRef [0..1]: set at pre-compile, destination=DemOperationCycle  # Indicator FailureCycle Ref | Set the DemOperationCycle as base of the failure counting used to confirm the indicator. This parameter is only valid if DemIndicatorFailureCycleSource is set to INDICATOR
            reference DemIndicatorHealingCycleRef: set at pre-compile, destination=DemOperationCycle  # Indicator HealingCycle Ref | Set the DemOperationCycle as base of the healing counting used to heal the indicator. This parameter is not supported. Currently the value of DemEventClass/DemOperationCycleRef is used to heal indicators. Use that setting here too, to get a consistent configuration.
            reference DemIndicatorRef: set at pre-compile, destination=DemIndicator  # Reference to the used indicator.
      container DemPidClass [0..255]  # These containers represent the different PIDs stored in the single global OBD relevant freeze frame. Each PID consists of one or several data elements.
        integer DemPidIdentifier: 0..255, set at pre-compile  # PID Identifier | PID Identifier as requested in Mode $02
        container DemPidDataElement [1..255]  # PID DataElement | These containers are used to reference the different data elements contained in the specific PID.
          choice reference DemPidDataElementClassRef: set at pre-compile, destination=[DemExternalCSDataElementClass, DemInternalDataElementClass]  # PID DataElement Class Ref | This reference contains the link to a data element class.
    container DemGeneral  # This container groups the constant configuration options, e.g. options that can not have different values in multiple configurations.
      enumeration DemAgingCycleCounterProcessing: {DEM_PROCESS_AGINGCTR_EXTERN, DEM_PROCESS_AGINGCTR_INTERN}, set at pre-compile, default-value=DEM_PROCESS_AGINGCTR_INTERN  # AgingCycle Counter Processing | This parameter is not used. The same functionality can be achieved with operation cycles.
      integer DemBswErrorBufferSize: 0..255, set at pre-compile, default-value=0  # BswError Buffer Size | Dem processing queue size. The Dem will process qualified events (Failed/Passed) during the next task cycle. This value specifies how many events can be queued. When this queue overflows you will not lose reports, but the surplus events are not processed in reporting order. Also run-time is greately increased as surplus events need to be searched for the pending event change. A sufficient queue size can not be deduced from the Dem configuration, you need to analyze how your system reports events: set the size to the maximum amount of monitors that may report a qualified result (e.g. finish debouncing) during a single task cycle of the Dem. With queue overflow the run time of the Dem_MainFunction can spike, so you need to verify its run-time does not exceed your system limit (e.g. causes a task overflow) when the maximum amount of your monitors qualify at the same time.
      enumeration DemClearDTCBehavior: {DEM_CLRRESP_NONVOLATILE_FINISH, DEM_CLRRESP_NONVOLATILE_TRIGGER, DEM_CLRRESP_VOLATILE}, set at pre-compile, default-value=DEM_CLRRESP_VOLATILE  # ClearDTC Behavior | Select the point in time a clear DTC request will result in a positive response from the Dcm. VOLATILE: The Dem will clear all DTCs in RAM before the API Dem_ClearDTC returns a final result to the Dcm. If power is cut right after that and your ECU does not allow for a controled shut down in that case, DTCs will still be visible after the ECU restarts. NONVOLATILE_TRIGGER: ClearDTC will return a final result after the NvM has been informed about the modification. This setting is not supported by this implementation. NONVOLATILE_FINISH: ClearDTC will return a final result only after the NvM has finished persisting the cleared state of DTCs. Depending on your NV system this can result in several seconds of NRC $78 - response pending. On the upside, if power is cut after the positive response, all DTCs remain cleared.
      boolean DemDTCSuppressionSupport: set at pre-compile, default-value=false  # Suppression Support (Obsolete) | This configuration switch defines, whether support for DTC suppression is enabled or not. This parameter is not supported, use parameter 'DemSuppressionSupport' instead. | true: DTC suppression support is enabled false: DTC suppression support is disabled
      boolean DemDebounceCounterBasedSupport: set at pre-compile, default-value=true  # Debounce CounterBased Support | This configuration switch defines, whether support for counter based debouncing is enabled or not (see DemConfigSet/DemEventParameter/DemEventClass/DemDebounceAlgorithmClass/DemDebounceCounterBased) If events are configured to use counter based debouncing, this option must be enabled. | true: counter based debouncing support is enabled false: counter based debouncing support is disabled
      boolean DemDebounceTimeBasedSupport: set at pre-compile, default-value=false  # Debounce TimeBased Support | This configuration switch defines, whether support for time based debouncing is enabled or not (see DemConfigSet/DemEventParameter/DemEventClass/DemDebounceAlgorithmClass/DemDebounceTimeBase) If events are configured to use timer based debouncing, this option must be enabled. | true: time based debouncing support is enabled false: time based debouncing support is disabled
      boolean DemDevErrorDetect: set at pre-compile, default-value=true  # Development Error Detect | Activate/Deactivate the Development Error Detection and Notification. If this option is enabled, integration errors are reported to the DET module (e.g. calling APIs with invalid arguments that would cause a malfunction of the Dem module). In a production system this option can be disabled as all code should be tested to correctly use the Dem API. Also see DemUseDefensiveBehavior | true: Development Error Detection and Notification activated false: Development Error Detection and Notification deactivated
      integer DemDtcStatusAvailabilityMask: 0..255, set at pre-compile, default-value=255  # DTC StatusAvailabilityMask | Mask for the supported DTC status bits of the Dem. This mask is used by UDS service 0x19. Internally, all status bits are supported as required by the Dem specification. This internal status byte is used e.g. for internal event notification callout functions. Externally, all status bits are ANDed with this mask, e.g. for diagnostic services like 0x19 or DTC status change notifications. This mask is also reported as status availability mask in the respective 0x19 subfunctions.
      boolean DemEnableConditionSupport: set at pre-compile, default-value=false  # EnableCondition Support | This configuration switch defines, whether support for enable conditions is enabled or not. If enable conditions are set up for events (DemConfigSet/DemEventParameter/DemEventClass/DemEnableConditionGroupRef) this option must be enabled. | true: support for enable conditions is enabled false: support for enable conditions is disabled
      enumeration DemEventCombinationSupport: {DEM_EVCOMB_DISABLED, DEM_EVCOMB_TYPE1, DEM_EVCOMB_TYPE2}, set at pre-compile, default-value=DEM_EVCOMB_DISABLED  # Merge several events to one specific DTC and a combined UDS DTC status byte. DISABLED: No event combination is supported. TYPE1: Multiple events can be combined to a single DTC. The DTC defines the data stored. TYPE2: Multiple events can be combined to a single DTC. Each event defines the data stored, it is implementation defined which data set is reported to the Dcm. This option is currently not implemented.
      enumeration DemEventDisplacementStrategy: {DEM_DISPLACEMENT_FULL, DEM_DISPLACEMENT_NONE, DEM_DISPLACEMENT_PRIO_OCC, DEM_DISPLACEMENT_LEGACY_403}, set at pre-compile, origin=Vector Informatik, default-value=DEM_DISPLACEMENT_LEGACY_403  # This configuration switch is back-ported from AR4.1.1 and specifies the event displacement when the event memory is currently filled completely. It replaces the AR4.0.3 parameter DemEventDisplacementSupport. Please note, the DTC selected by the displacement algorithm is only displaced if it is a better match than the new DTC that has to be entered into the memory. If the new DTC is the better match, or no matching DTCs are found in the event memory, the fall-back strategy DemEventDisplacementFallbackStrategy is implemented. NONE: No displacement. If the event memory is filled, a new event will always be displaced immediately. Please note, the only supported fall-back strategy for this case is DISCARD_NEW_EVENT. PRIO_OCC: Displacement is active. If the event memory is filled, the DTC(s) with lowest priority are selected. If multiple DTCs share this lowest priority, the oldest is selected. FULL: Displacement is active. If the event memory is filled, the DTC(s) with the lowest priority are selected. If multiple DTCs share this lowest priority, the oldest passive DTC is selected. If no passive DTCs are among the lowest priority list, the oldest active, but untested DTC is selected. LEGACY_403: Vector extension that corresponds to the displacement behavior defined in Autosar 4.0.3 If the event memory is filled, the DTC(s) with the lowest priority are selected. If multiple DTCs share this lowest priority, the oldest passive DTC is selected.
      enumeration DemExtendedDataCapture [0..1]: {DEM_TRIGGER_EVENT_MEMORY_STORAGE, DEM_TRIGGER_TESTFAILED}, set at pre-compile, default-value=DEM_TRIGGER_EVENT_MEMORY_STORAGE  # ExtendedData Capture | This parameter defines the point in time, when the extended data collection is done. TESTFAILED: The data is collected directly in the context of the SetEventStatus call. This option is not supported. MEMORY_STORAGE: The data is collected during the next Dem task cycle, in case a memory entry can be created for the DTC (see DemEventDisplacementSupport)
      enumeration DemExtendedDataVisibility [0..1]: {DEM_VISIBILITY_ALL_DTC, DEM_VISIBILITY_STOREDONLY}, set at pre-compile, origin=Vector Informatik, default-value=DEM_VISIBILITY_ALL_DTC  # ExtendedData Visibility | This parameter defines the point in time when extended data will be reported in diagnostic response messages. This parameter affects extended data records that consist solely of statistical data which is by its nature at any time available, see DemInternalDataElement: OVFLIND, SIGNIFICANCE, PRIORITY, CURRENT_FDC, MAX_FDC_DURING_CURRENT_CYCLE. Using this parameter allows to reduce visibility of such extended data records until the DTC is actually stored. ALL_DTC: The data is reported independent of an existing memory entry. STOREDONLY: The data is reported only if a memory entry exists for the reported DTC. Example: The current fault detection counter exists at any time for all DTCs. If this parameter is set to ALL_DTC, service 19 06 will report the value of the FDC for DTCs that are not currently stored. If this parameter is set to STOREDONLY, Dcm will instead send a positive response without any content for those DTCs.
      enumeration DemFreezeFrameCapture [0..1]: {DEM_TRIGGER_EVENT_MEMORY_STORAGE, DEM_TRIGGER_TESTFAILED}, set at pre-compile, default-value=DEM_TRIGGER_EVENT_MEMORY_STORAGE  # FreezeFrame Capture | This parameter defines the point in time, when the freeze frame data collection is done. TESTFAILED: The data is collected directly in the context of the SetEventStatus call. This option is not supported. MEMORY_STORAGE: The data is collected during the next Dem task cycle, in case a memory entry can be created for the DTC (see DemEventDisplacementSupport)
      string DemHeaderFileInclusion [0..*]: set at pre-compile  # HeaderFile Inclusion | Name of the header file(s) to be included by the Dem module containing the used C-callback declarations. The different callout configurations allow to specify a C-Callback instead of a port interface. If you choose so, you need to add a header file here with the appropriate declaration of the function. see DemConfigSet/DemDTCClass/DemCallbackInitMForF/DemCallbackInitMForFFnc see DemConfigSet/DemEventParameter/DemCallbackClearEventAllowed/DemCallbackClearEventAllowedFnc see DemConfigSet/DemEventParameter/DemCallbackEventDataChanged/DemCallbackEventDataChangedFnc see DemConfigSet/DemEventParameter/DemCallbackEventStatusChanged/DemCallbackEventStatusChangedFnc see DemConfigSet/DemEventParameter/DemCallbackInitMForE/DemCallbackInitMForEFnc see DemConfigSet/DemEventParameter/DemEventClass/DemDebounceAlgorithmClass/DemDebounceMonitorInternal/DemCallbackGetFDC/DemCallbackGetFDCFnc see DemGeneral/DemCallbackDTCStatusChanged/DemCallbackDTCStatusChangedFnc see DemGeneral/DemDataElementClass/DemExternalCSDataElementClass/DemDataElementReadFnc
      integer DemImmediateNvStorageLimit [0..1]: 1..255, set at pre-compile  # ImmediateNvStorage Limit | Define a limited number of immediately storage of a specific event memory entry into NVRAM (for example with DemOccurrenceCounterProcessing). In case a DTC is stored excessively often, this parameter will reduce wear on NV (Flash) memory if immediate storage is enabled for that DTC. You can set this threshold value to limit the number of storage (per event). Please note that this will not completely disable NV modification for that event. In order to correctly process aging, updates are necessary nonetheless. So a modified data set is persisted at shutdown even though the storage limit has been reached. This option is only relevant if immediate NV storage is used for DTCs (see DemGeneral/DemImmediateNvStorageSupport and DemConfigSet/DemDTCClass/DemImmediateNvStorage).
      integer DemMaxNumberEventEntryMirror: 0..255, set at pre-compile, default-value=0  # Maximum number of events which can be stored in the mirror memory. The mirror memory is currently not supported, so this value should be set to 0.
      integer DemMaxNumberEventEntryPermanent: 0..255, set at pre-compile, default-value=0  # Maximum number of events which can be stored in the permanent memory. Permanent memory is only available in case of OBD and MIL support (see DemOBDSupport and DemMILIndicatorRef) | The assignment of an event to this memory type is dynamic and used for emission-related events only.
      integer DemMaxNumberEventEntryPrimary: 1..255, set at pre-compile, default-value=8  # Maximum number of events which can be stored in the primary memory. Primary memory is the 'standard' memory reported by the standard UDS $19 services.
      integer DemMaxNumberEventEntrySecondary: 0..255, set at pre-compile, default-value=0  # Maximum number of events which can be stored in the secondary memory Secondary memory is not reported by the $19 services.
      integer DemMaxNumberPrestoredFF: 0..255, set at pre-compile, default-value=0  # Defines the maximum number for prestored freeze frames. This parameter is currently not supported. | If set to 0, then freeze frame prestorage is not supported by the ECU.
      enumeration DemOBDSupport: {DEM_OBD_NO_OBD_SUPPORT, DEM_OBD_DEP_SEC_ECU, DEM_OBD_PRIMARY_ECU, DEM_OBD_MASTER_ECU}, set at pre-compile, origin=Vector Informatik, default-value=DEM_OBD_NO_OBD_SUPPORT  # DEM_OBD_NO_OBD_SUPPORT: OBD support is disabled, the DEM operates in UDS mode. DEP_SEC_ECU: OBD support is enabled, the DEM operates in secondary/dependent ECU mode. (not supported) PRIMARY_ECU: OBD support is enabled, the DEM operates in primary ECU mode. MASTER_ECU: OBD support is enabled, the DEM operates in master ECU mode. (not supported)
      enumeration DemOccurrenceCounterProcessing: {DEM_PROCESS_OCCCTR_CDTC, DEM_PROCESS_OCCCTR_TF}, set at pre-compile, default-value=DEM_PROCESS_OCCCTR_TF  # OccurrenceCounter Processing | TF (TestFailed) : The occurrence counter is incremented each time the event becomes failed. (This requires the event to be reported 'PASSED' first!) CDTC (Confirmed): The occurrence counter is incremented each time the event would confirm - Effectively, the counter can be incremented at most once per operation cycle, unless multiple tests are required for failure in which case the counter is incremented after N cycles (see DemConfigSet/DemEventParameter/DemEventClass/DemEventFailureCycleCounterThreshold)
      enumeration DemOperationCycleProcessing: {DEM_PROCESS_OPCYC_COUNTER, DEM_PROCESS_OPCYC_STATE}, set at pre-compile, default-value=DEM_PROCESS_OPCYC_STATE  # OperationCycle Processing | OPCYC_STATE: Cycles are reported by SetOperationCycleState(Start/Stop) and the Dem counts the cycles internally. OPCYC_COUNTER: Cycles are counted externally. The current count is reported to the Dem by SetOperationCycleCounter. Only OPCYC_STATE is supported at the moment.
      boolean DemOperationCycleStatusStorage: set at pre-compile, default-value=false  # OperationCycle Status Storage | Defines if the operation cycle state is available over the power cycle (stored non-volatile) or not. If this value is disabled, operation cycles are considered 'stopped' at the time of Dem_Init. Cycles must be started first to allow monitor reports to be processed, but starting a cycle involves event status changes. So if you have operation cycles that are longer than the power cycle of your ECU, you need to enable this option. This parameter is only valid if DemOperationCycleProcessing is set to OPCYC_STATE. | true: the operation cycle state is stored non-volatile false: the operation cycle state is only stored volatile
      boolean DemPTOSupport: set at pre-compile, default-value=false  # This configuration switch defines, whether PTO support (and therefore PID $1E support) is enabled or not. This parameter is not supported.
      enumeration DemStatusBitHandlingTestFailedSinceLastClear: {DEM_STATUS_BIT_AGING_AND_DISPLACEMENT, DEM_STATUS_BIT_NORMAL, DEM_STATUS_BIT_AGING}, set at pre-compile, default-value=DEM_STATUS_BIT_NORMAL  # Status Bit TestFailedSinceLastClear Handling | This configuration switch defines whether the aging and displacement mechanism shall be applied to the "TestFailedSinceLastClear" status bits. AGING_AND_DISPLACEMENT: The status bit 'TestFailedSinceLastClear' is only set if an event can be enteren into its event memory. (In case the event is not mapped to any destination it is never set!) The status bit is reset due to aging, clearing and displacement of the memory entry. NORMAL: The status bit 'TestFailedSinceLastClear' set for all events, irrespective of successful allocation of an event memory entry. It is reset to 0 only when the event is cleared. AGING: The status bit 'TestFailedSinceLastClear' set for all events, irrespective of successful allocation of an event memory entry. It is reset to 0 when the event ages, or is cleared.
      boolean DemStatusBitStorageTestFailed: set at pre-compile, default-value=true  # Status Bit TestFailed Storage | Activate/Deactivate the permanent storage of the "TestFailed" status bits. If disabled, the TestFailed bit is reset during initilization. Please note that this does not suffice to start aging of the event. | true: storage activated false: storage deactivated
      boolean DemStorageConditionSupport: set at pre-compile, default-value=false  # StorageCondition Support | This configuration switch defines, whether support for storage conditions is enabled or not. If storage conditions are set up for events (DemConfigSet/DemEventParameter/DemEventClass/DemStorageConditionGroupRef) this option must be enabled. | true: support for storage conditions is enabled false: support for storage conditions is disabled
      float DemTaskTime: 0..0.1, set at pre-compile, origin=AUTOSAR_ECUC V1.0.0, default-value=0.01  # Allow to configure the time for the periodic cyclic task. This value is used to set up the Dem Service-Description and BSW scheduler. This time is also used as time base in case time based debouncing is supported (see DemDebounceTimeBasedSupport, DemConfigSet/DemEventParameter/DemEventClass/DemDebounceAlgorithmClass/DemDebounceTimeBase). The AUTOSAR configuration standard is to use SI units, so in the EcuC file this parameter is stored as float value in seconds - the GUI will convert the value when using a diffenent unit. | The AUTOSAR configuration standard is to use SI units, so this parameter is defined as float value in seconds. Dem configuration tools must convert this float value to the appropriate value format for the use in the software implementation of Dem. min: A negative value is not allowed. max: After event status was reported, processing shall be completed within 100ms in order to have the fault entry status information updated as soon as possible (e.g. for PID $01). upperMultiplicity: Exactly one TaskTime must be specified per configuration. lowerMultiplicity: Exactly one TaskTime must be specified per configuration.
      boolean DemTriggerDcmReports: set at pre-compile, default-value=false  # If enabled, the Dcm module is notified about DTC status changes in primary memory. This is required to implement RoE - OnDTCChange supervision, please refer to the Dcm configuration for details. | true: Dcm ROE notification activated false: Dcm ROE notification deactivated
      boolean DemTriggerDltReports: set at pre-compile, default-value=false  # Activate/Deactivate the notification to the Diagnostic Log and Trace. This parameter is currently not supported. | true: Dlt notification activated false: Dlt notification deactivated
      boolean DemTriggerFiMReports: set at pre-compile, default-value=false  # Trigger FiM Reports | Activate/Deactivate the notification to the Function Inhibition Manager. This option must be enabled if the FiM requires event notification (see FiM/FiMGeneral/FiMEventUpdateTriggeredByDem) | true: FiM notification activated false: FiM notification deactivated
      boolean DemTriggerMonitorInitBeforeClearOk: set at pre-compile, default-value=true  # Trigger MonitorInit Before Clear Ok | Defines if the monitor re-initialization has to be triggered before or after the Dem module returns DEM_CLEAR_OK. This option is not supported. InitMonitor callbacks are always triggered during the clear operation, and have completed before the final result is returned to the Dcm. | true: trigger re-initialization before DEM_CLEAR_OK false: trigger re-initialization after DEM_CLEAR_OK
      enumeration DemTypeOfDTCSupported: {DEM_DTC_TRANSLATION_ISO11992_4, DEM_DTC_TRANSLATION_ISO14229_1, DEM_DTC_TRANSLATION_ISO15031_6, DEM_DTC_TRANSLATION_SAEJ1939_73}, set at pre-compile, default-value=DEM_DTC_TRANSLATION_ISO14229_1  # This parameter defines the format returned by Dem_GetTranslationType and does not relate to/influence the supported Dem functionality. Its value is returned by some of the $19 services.
      enumeration DemTypeOfFreezeFrameRecordNumeration: {DEM_FF_RECNUM_CALCULATED, DEM_FF_RECNUM_CONFIGURED}, set at pre-compile, default-value=DEM_FF_RECNUM_CALCULATED  # Type Of FreezeFrameRecord Numeration | This parameter defines the type of assigning snapshot record numbers. CALCULATED: The snapshot records are enumerated from one up to DemConfigSet/DemEventParameter/DemMaxNumberFreezeFrameRecords for each event. Once a event memory entry is created at event confirmation time, additional snapshots are stored at each FAILED transition. CONFIGURED: The snapshot record numbers are taken from DemConfigSet/DemEventParameter/DemFreezeFrameRecNumClassRef. Storage triggers and update conditions can be configured.
      boolean DemVersionInfoApi: set at pre-compile, default-value=false  # Activate/Deactivate the version information API. | true: version information activated false: version information deactivated
      integer DemClearDTCLimit [0..1]: 1..255, set at pre-compile, origin=Vector Informatik  # ClearDTC Limit | If this parameter exists, ClearDTC will not clear more than the set amount of DTCs at once. This parameter can be used to reduce the run time of the Dem_MainFunction during ClearDTC.
      integer DemCompiledConfigId [0..1]: 0..65535, set at post-build in variant post-build-loadable / pre-compile in variant pre-compile, origin=Vector Informatik, default-value=0  # Change this value to force the Dem to clear all NV data on next initialization (startup). This is useful if the flash eeprom emulation is not cleared during flashing of a new software version.
      boolean DemUseRte: set at pre-compile, origin=Vector Informatik, default-value=true  # Globally disable the usage of RTE callbacks. All port interfaces are suppressed, and all callouts must be replaced by direct function calls.
      boolean DemImmediateNvStorageSupport [0..1]: set at pre-compile, origin=Vector Informatik, default-value=false  # ImmediateNvStorage Support | Globally force or prevent the immediate storage of changed event data to non-volatile memory. When this parameter is missing, the default AUTOSAR behavior applies: if at least one of the DemConfigSet/DemDTCClass/DemImmediateNvStorage parameters is enabled, the feature will be switched on, otherwise the feature will be switched off. When this parameter exists, the feature will behave accordingly to its setting. Please note, if this parameter is disabled but some events still have it enabled locally, these events WILL NOT be stored immediately.
      boolean DemTriggerGlobalEventDataChangedCallback [0..1]: set at pre-compile, origin=Vector Informatik, default-value=false  # Trigger GlobalEventDataChanged Callback | If this parameter exists, you can control if the port interface 'GlobalEventDataChanged' will be required or not by the Dem. It is used as a 'one for all' callout in case event data changes. If this parameter is missing, the global interface is always required in addition to any DemConfigSet/DemEventParameter/DemCallbackEventDataChanged callout as demanded by AUTOSAR.
      boolean DemTriggerGlobalEventStatusChangedCallback [0..1]: set at pre-compile, origin=Vector Informatik, default-value=false  # Trigger GlobalEventStatusChanged Callback | If this parameter exists, you can control if the port interface 'GlobalEventStatusChanged' will be required or not by the Dem. It is used as a 'one for all' callout to notify event status changes. If this parameter is missing, the global interface is always required in addition to any DemConfigSet/DemEventParameter/DemCallbackEventStatusChanged callout as demanded by AUTOSAR.
      boolean DemMultipleTripSupport [0..1]: set at pre-compile, origin=Vector Informatik, default-value=false  # When this parameter is missing, the Dem will select the confirmation handling according to the settings of DemConfigSet/DemEventParameter/DemEventClass/DemEventFailureCycleCounterThreshold You can select the confirmation algorithm manually using this parameter. It is useful if you want the generic confirmation handling algorithm although currently all events use single trip behavior, e.g. to calibrate a different value.
      boolean DemSeveritySupport [0..1]: set at pre-compile, origin=Vector Informatik, default-value=false  # Disable the support for filtering DTCs for severity. This is mainly an optimization feature in case your ECU does not support $19 subservices 08 and 09 (see Dcm configuration for details)
      boolean DemUseNvm [0..1]: set at pre-compile, origin=Vector Informatik, default-value=true  # When this parameter is missing, the Dem will select the usage of NvM based on the existence of DemNvRamBlockId containers. If the parameter exists, you can control manually if the Dem will report modified blocks to the NvM or runs completely from RAM mirrors without persistence. This can be useful in early integration phases where you have not yet completely set up the NvM but still need the Dem for production error reporting of the communication stack. The use of this parameter is discouraged in production ECUs, but could be used to implement an integration defined persistence strategy. Please note that if this option is (existing and) set to disabled all features concerning NV memory will not be available.
      boolean DemUseDefensiveBehavior [0..1]: set at pre-compile, origin=Vector Informatik, default-value=false  # If this option is enabled API function will return with an error code in case of misusage. The DET reports are controlled exclusively by DemGeneral/DemDevErrorDetect. If DET support is enabled, API misuse will also trigger a DET notification. If both DET report and this option are disabled, undefined function arguments can cause unintended side effects.
      boolean DemTriggerEventStatusChangedCallback [0..1]: set at pre-compile, origin=Vector Informatik, default-value=true  # Trigger EventStatusChanged Callback | Globally disable event status notifications. You can use this parameter to suppress all event status notification callbacks, usually because none are used in the first place. You can also use this parameter as a temporary measure to allow compilation until all notification callouts are actually available. If you want notifications, it is recommended to remove the parameter completely.
      boolean DemTriggerDtcStatusChangedCallback [0..1]: set at pre-compile, origin=Vector Informatik, default-value=true  # Trigger DtcStatusChanged Callback | Globally disable DTC status notifications. You can use this parameter to suppress all dtc status notification callbacks, usually because none are used in the first place. You can also use this parameter as a temporary measure to allow compilation until all notification callouts are actually available. If you want notifications, it is recommended to remove the parameter completely.
      boolean DemTriggerEventDataChangedCallback [0..1]: set at pre-compile, origin=Vector Informatik, default-value=true  # Trigger EventDataChanged Callback | Globally disable DTC data change notifications. You can use this parameter to suppress all data change notification callbacks, usually because none are used in the first place. You can also use this parameter as a temporary measure to allow compilation until all notification callouts are actually available. If you want notifications, it is recommended to remove the parameter completely.
      string DemUserConfigFile [0..1]: set at pre-compile, origin=Vector Informatik  # User Configuration File | Path to an external user configuration file used by the "Configurator 5" generation tool. If you want to overwrite some of the settings in the generated configuration file (Dem_Cfg.h), you can specify a path to a user defined configuration file. The user defined configuration file will be included at the end of the generated preprocessor switches. Definitions in the user defined configuration file can overwrite definitions in the generated configuration file. To specify the file name, you can use "$(var)" sequence(s) in the specified path. Each such sequence is replaced by the content of the related environment variable "var". Additionally you can use following predefined sequences: $(DpaProjectFolder) Absolute directory of the loaded *.dpa file. $(EcuProjectName) Name of the project defined in the loaded *.dpa file. $(EcucFile) Absolute directory "ECUC", defined by the loaded *.dpa file, containing files $(EcuProjectName).ecuc.arxml and $(EcuProjectName).ecuc.Initial.arxml . $(EcucFolder) Parent directory of $(EcucFile). $(SipRootPath) Absolute directory "SIP", defined by the loaded *.dpa file. $(OutputFolder) (Relative) directory "GenData", defined by the loaded *.dpa file. See setting "Root Target Folder" of Configurator 5. $(ServiceSwcFolder) Absolute directory "ServiceComponents", defined by the loaded *.dpa file. $(cwd) Current working directory when starting Configurator 5. RESTRICTIONS: Not all of the settings can be overwritten simply by triggering the preprocessor switch. Some of the options are complex and the code generator generates less or more code depending on the setting. USE SUCH A FILE ONLY AFTER DISCUSSION WITH VECTOR.
      string DemUserConfigFilePost [0..1]: set at pre-compile, origin=Vector Informatik  # User Configuration File - Late Inclusion | Path to an external user configuration file used by the "Configurator 5" generation tool. If you want to overwrite some of the settings in the generated configuration file (Dem_LCfg.h), you can specify a path to a user defined configuration file. The user defined configuration file will be included at the end of the file. Definitions in the user defined configuration file can overwrite definitions in the generated configuration file. To specify the file name, you can use "$(var)" sequence(s) in the specified path. Each such sequence is replaced by the content of the related environment variable "var". Additionally you can use following predefined sequences: $(DpaProjectFolder) Absolute directory of the loaded *.dpa file. $(EcuProjectName) Name of the project defined in the loaded *.dpa file. $(EcucFile) Absolute directory "ECUC", defined by the loaded *.dpa file, containing files $(EcuProjectName).ecuc.arxml and $(EcuProjectName).ecuc.Initial.arxml . $(EcucFolder) Parent directory of $(EcucFile). $(SipRootPath) Absolute directory "SIP", defined by the loaded *.dpa file. $(OutputFolder) (Relative) directory "GenData", defined by the loaded *.dpa file. See setting "Root Target Folder" of Configurator 5. $(ServiceSwcFolder) Absolute directory "ServiceComponents", defined by the loaded *.dpa file. $(cwd) Current working directory when starting Configurator 5. RESTRICTIONS: Usually it is sufficient to use only the DemUserConfigFile. This option should be only used with extreme caution. USE SUCH A FILE ONLY AFTER DISCUSSION WITH VECTOR.
      float DemDebounceTimeLowResThreshold [0..1]: 0.15..3600, set at pre-compile, origin=Vector Informatik, default-value=5  # TimeBased Debouncing - LowRes Timer Threshold | To reduce CPU load and reduce configuration code size, the feature Time Base Debounce can use 2 different timers: the high resolution timer will tick with the configured DemTaskTime (typ. 10ms), the additional low resolution timer will tick with 150ms. This configuration value defines the min. debounce time for an event to be handled by the low-res timer. Default: 5s Refer to configuration values DemDebounceTimeFailedThreshold and DemDebounceTimePassedThreshold of each event: - if both time values of an event are lower than the threshold (typ. 5s), the event's debounce is using the high-res timer with a jitter of DemTaskTime (typ. 10ms); - otherwise the debounce algorithms are using the low-res timer (with a jitter of 150ms) and a reduced CPU load. The AUTOSAR configuration standard is to use SI units, so in the EcuC file this parameter is stored as float value in seconds - the GUI will convert the value when using a diffenent unit.
      boolean DemTriggerControlDTCSetting [0..1]: set at pre-compile, origin=Vector Informatik, default-value=false  # Trigger ControlDTCSetting | The application is triggered if diagnostic service 0x85 - ControlDtcSetting is processed in DEM.
      boolean DemGeneralDiagnosticInfoSupport: set at pre-compile, origin=Vector Informatik, default-value=true  # General DiagnosticInfo Support | Provide the Port-Interface GeneralDiagnosticInfo.
      boolean DemEvMemOverflowIndicationSupport [0..1]: set at pre-compile, origin=Vector Informatik, default-value=true  # EventMemory Overflow Indication Support | Provide the Port-Interface EvMemOverflowIndication If this parameter is disabled, the Dem will not provide the port interface or the C functions to read the overflow status of the event memories.
      enumeration DemEventStorageTrigger: {DEM_STORAGE_TRIGGER_CONFIRMED, DEM_STORAGE_TRIGGER_FAILED, DEM_STORAGE_TRIGGER_FDC}, set at pre-compile, origin=Vector Informatik, default-value=DEM_STORAGE_TRIGGER_FAILED  # EventStorage Trigger | Define the trigger of the event storage. If an event triggers this condition, an event entry is created for it. CONFIRMED: An event entry is created once a DTC confirms (bit3 transitions 0->1). FAILED: An event entry is created once a DTC fails (bit0 transitions 0->1). FDC: An event entry is created once the fault detection counter of a DTC exceeds its DemDebounceCounterPreconfirmedThreshold. Restriction: If FDC is selected, monitor internal debouncing cannot be used to store event data at pre-Failed.
      boolean DemCalibrationLiteSupport [0..1]: set at pre-compile, origin=Vector Informatik, default-value=false  # Calibration(-Lite) Support | Activate calibration support for a predefined set of parameters. Without calibration support, the code generator will optimize the given configuration before creating the code for the config tables. This typically will result in smaller tables and faster code execution.
      boolean DemUserControlledWirSupport [0..1]: set at pre-compile, origin=Vector Informatik, default-value=false  # Status Bit WarningIndicatorRequest User Controlled | Activate the external modifiability of the WarningIndicatorRequest Status Bit. If this option is enabled, the API Dem_SetWIRStatus is provided, which allows the user to override the current WarningIndicatorRequest Bit of the DTC status. Additionally, the API Dem_GetWIRStatus can be used the read the current override status (WIR controlled / not controlled by user). If this option is enabled, overriding the WarningIndicatorRequest Bit is deactivated, and the APIs Dem_SetWIRStatus and Dem_GetWIRStatus are not available.
      enumeration DemPendingDtcProcessing: {DEM_PROCESS_PDTC_STOREDONLY, DEM_PROCESS_PDTC_ALL_DTC}, set at pre-compile, origin=Vector Informatik, default-value=DEM_PROCESS_PDTC_STOREDONLY  # Status Bit PendingDTC Processing | Select behavior of PendingDTC status bit. STOREDONLY sets the status bit2 (PendingDTC) only if a memory entry could be allocated successfully. With this setting the status bit PendingDTC is also reset when the event is displaced from memory. ALL_DTC sets the status bit2 (PendingDTC) independently from successful event storage. With this setting the status bit PendingDTC is not modified in case the DTC is displaced from memory.
      enumeration DemWarningIndicatorRequestedProcessing: {DEM_PROCESS_WIR_STOREDONLY, DEM_PROCESS_WIR_ALL_DTC}, set at pre-compile, origin=Vector Informatik, default-value=DEM_PROCESS_WIR_STOREDONLY  # Status Bit WarningIndicatorRequested Processing | Select behavior of WarningIndicatorRequested status bit. STOREDONLY sets the status bit7 (WarningIndicatorRequested) only if a memory entry could be allocated successfully. ALL_DTC sets the status bit7 (WarningIndicatorRequested) independently from successful event storage. This parameter is only relevant for single tripping events, since event confirmation is a necessary precondition for indicator activation. Reset conditions are not modified by this parameter setting.
      enumeration DemAgingBehavior: {DEM_AGING_AT_PASSED, DEM_AGING_CONT_END_OF_CYCLE, DEM_AGING_CONT_TESTED_PASSED}, set at pre-compile, origin=Vector Informatik, default-value=DEM_AGING_AT_PASSED  # This parameter selects the algorithm for the aging of the events. AGING_AT_PASSED: Initial trigger to start the aging is the test result PASSED. The aging counter is incremented at the end of the aging cycle. CONT_END_OF_CYCLE: Initial trigger to start the aging is the end of operation cycle if the event was tested PASSED and was never tested FAILED in this cycle. The aging counter is incremented at the end of the aging cycle. CONT_TESTED_PASSED: Initial trigger to start the aging is the end of operation cycle if the event was tested PASSED and was never tested FAILED in this cycle. The aging counter is incremented at the end of the aging cycle if the event was tested PASSED and was never tested FAILED in this cycle.
      enumeration DemSuppressionSupport: {DEM_DTC_SUPPRESSION, DEM_EVENT_AND_DTC_SUPPRESSION, DEM_EVENT_SUPPRESSION, DEM_NO_SUPPRESSION}, set at pre-compile, origin=Vector Informatik, default-value=DEM_NO_SUPPRESSION  # This configuration switch defines, whether support for suppression is enabled or not. DTC_SUPPRESSION: Support suppression by DTC. EVENT_AND_DTC_SUPPRESSION: Support suppression by Event and DTC. EVENT_SUPPRESSION: Support suppression by Event. NO_SUPPRESSION: Suppression is not supported.
      integer DemMaxNumberEventEntryOBDFreezeFrame: 0..255, set at pre-compile, origin=Vector Informatik, default-value=0  # Maximum number of events which can concurrently store an OBD Freeze Frame. OBD Freeze Frame memory is only available if OBD is supported.
      boolean DemAgingRetainEnvironmentalData: set at pre-compile, origin=Vector Informatik, default-value=false  # If this option is enabled, environmental data stored with a DTC is not deleted on aging. This includes snapshot data and extended data records. The data is reported for UDS services as if the DTC was still confirmed, although Bit3 is not set anymore in the DTC status byte. Aged event entries will be treated as empty as far as displacment is concerned, even if DTC displacement is deactivated by DemEventDisplacementStategy. If this option is disabled, event memory entries including all stored data are cleared on aging. This setting corresponds to the behavior defined by Autosar.
      enumeration DemEventDisplacementFallbackStrategy: {DEM_FALLBACK_DISCARD_NEW_EVENT, DEM_FALLBACK_DISPLACE_OLDEST_EVENT}, configuration-class-affection=affection-kind=PC-AFFECTS-LT-AND-PB, set at pre-compile, origin=Vector Informatik, default-value=DEM_FALLBACK_DISCARD_NEW_EVENT  # DISCARD_NEW_EVENT: Standard behavior defined by Autosar. In case no candidate for displacement is found, a new event is silently discarded. DISPLACE_OLDEST_EVENT: In case no better candidate for displacement can be found, the oldest event is displaced unconditionally.
      boolean DemResetConfirmedBitOnOverflow: set at pre-compile, origin=Vector Informatik, default-value=true  # Status Bit ConfirmedDTC Reset on Overflow | This configuration switch defines, whether the ConfirmedDTC UDS status bit is reset or not when an event memory entry will be displaced. If enabled, a DTC will immediately 'age', i.e. lose its ConfirmedDTC bit if it is displaced. If disabled, a DTC will stop aging on displacement. Its ConfirmedDTC status bit will stay active until the DTC can allocate a new aging counter, at which point the aging process will start from the beginning. Alternatively, ClearDTC will also clear such a DTC.
      reference DemMILIndicatorRef [0..1]: set at pre-compile, destination=DemIndicator  # This parameter defines the indicator representing the MIL. If no indicator is selected, the MIL is not supported by this ECU. | This paramteter is mandatory for ECUs supporting OBD (refer to DemOBDSupport).
      reference DemRestartCycleOnInitRef [0..1]: set at pre-compile, origin=Vector Informatik, destination=DemOperationCycle  # Automatically start the referenced cycle with Dem_PreInit(). BSW events need a started cycle (typically the power cycle) to not be discarded. Event changes will not be notified (Callbacks OnStatusChange, FiM, etc) since the RTE is not necessarily available at this point in time. Make sure dependent modules (e.g. FiM) are set up accordingly.
      symbolic name reference DemIgnitionCycleFunctionIdRef [0..1]: set at pre-compile, origin=Vector Informatik, destination=FiMFID  # IgnitionCycle FunctionId Ref | Define a FID that is disabled when the input signals to calculate the ignition cycle are defective. This FID is required if RatioIDs are used in OBD configurations. Otherwise it is not supported.
      container DemAgingCycle [0..256]  # AgingCycle | Aging cycles are not supported. Use OperationCycles instead.
      container DemCallbackDTCStatusChanged [0..*]  # Callback DTCStatusChanged | The presence of this container sets up a callout function 'DTCStatusChanged' for this DTC. The Dem will call this function each time a DTC status changes. This function is usually called through a RTE port interface. This behavior can be changed by creating the sub-parameter 'DemCallbackDTCStatusChangedFnc'. | In case there is a DemCallbackDTCStatusChangedFnc, this parameter defines the name of the function that the Dem will call. In case there is no DemCallbackDTCStatusChangedFnc, the Dem will have an R-Port requiring the interface CallbackDTCStatusChanged whose name is generated by using the unique callback-prefix followed by the event name.
        function name DemCallbackDTCStatusChangedFnc [0..1]: set at pre-compile  # Callback DTCStatusChanged Function | Function name of a 'DTCStatusChanged' callout. If this parameter exists, it must give a valid C-Function which is called instead of using an RTE port interface. See DemGeneral/DemHeaderFileInclusion to specify a header file which declares this function. | Note: If the parameter DemTriggerDcmReports is enabled, this parameter shall not be "Dcm_DemTriggerOnDTCStatus".
      choice container DemDataElementClass [0..255]  # DataElement Class | This container groups the configuration (parameters) of a data element. Data elements are used to build DIDs, PIDs and ExtendedDataRecords
        container DemExternalCSDataElementClass [0..1]  # External CS DataElement Class | This option sets up a callout function collect the current value of the data element. This function is usually called through a RTE client/server interface. This behavior can be changed by creating the sub-parameter 'DemDataElementUsePort'. | It defines, how the Dem can obtain the value of the data element from either a SW-C or another BSW module. Whether a client/server port or a C function-call is used, is defined by DemDataElementUsePort.
          integer DemDataElementDataSize: 1..255, set at pre-compile  # DataElement Data Size | Defines the size of the data element in bytes.
          function name DemDataElementReadFnc [0..1]: set at pre-compile  # DataElement Read Function | Function name of a 'ReadData' callout. It must resolve to a valid C-Function which is called instead of using an RTE port interface. See DemGeneral/DemHeaderFileInclusion to specify a header file which declares this function. This parameter is valid only if DemDataElementUsePort is disabled.
          boolean DemDataElementUsePort: set at pre-compile, default-value=true  # DataElement Use Port | If the option is set to enabled, a R-Port is used to collect the data. If the option is set to disabled, DemDataElementReadFnc is called as direct function call to collect the data. | If the parameter is set to False, the information is obtained by C function-call on another BSW module specified by the parameter DemDataElementReadFnc.
        container DemExternalSRDataElementClass [0..1]  # External SR DataElement Class | This option sets up a sender/receiver interface to collect the current value of the data element directly from the virtual function bus. Note that no data conversion is available, the data is stored in native encoding. Sender/Receiver communication is currently not supported.
          integer DemDataElementDataSize: 1..255, set at pre-compile  # DataElement Data Size | Defines the size of the data element in bits.
          instance reference DemDataElementInstanceRef: set at pre-compile, destination-context=ROOT-SW-COMPOSITION-PROTOTYP SW-COMPONENT-PROTOTYPE+ PORT-PROTOTYPE, destination-type=VARIABLE-DATA-PROTOTYPE  # DataElement Instance Ref | Reference to the data element.
        container DemInternalDataElementClass [0..1]  # Internal DataElement Class | This option allows to return the current value of a Dem internal value. Use this e.g. to set up an extended record that returns the current fault detection counter.
          integer DemDataElementDataSize: 1..255, set at pre-compile  # DataElement Data Size | Defines the size of the data element in bytes. Please note that resizing data elements is currently not supported. The data elements must be sized according to the data type as available in the Dem implementation. See DemInternalDataElement
          enumeration DemInternalDataElement: {DEM_AGINGCTR, DEM_OCCCTR, DEM_OCCCTR_2BYTE, DEM_OVFLIND, DEM_SIGNIFICANCE, DEM_PRIORITY, DEM_AGINGCTR_INVERTED, DEM_MAX_FDC_SINCE_LAST_CLEAR, DEM_MAX_FDC_DURING_CURRENT_CYCLE, DEM_CYCLES_SINCE_LAST_FAILED, DEM_CYCLES_SINCE_FIRST_FAILED, DEM_FAILED_CYCLES, DEM_CURRENT_FDC}, set at pre-compile  # Internal DataElement | Select the Dem-internal data value, which is mapped to the data element. AGINGCTR: (1 Byte) Current value of the aging counter, counting from 1...255. The value latches at 255 for events that are not allowed to age, otherwise the value disappears if the event is aged. This value is available only for currently stored events. OCCCTR: (1 Byte) Current value of the occurrence counter, counting from 1...255. The value latches at 255. This value is available only for currently stored events. OCCCTR_2BYTE: (2 Byte) Current value of the occurrence counter, counting from 1...65535. The value latches at 65535. This value is available only for currently stored events. OVFLIND: (1 Byte) 1 if the primary memory has overflown, 0 otherwise. Will be reset on ClearAllDTC request. This value is always available. SIGNIFICANCE: (1 Byte) 1 if the event is configured as OCCURRENCE, 0 if the event is configured as FAILURE. This value is always available. PRIORITY: (1 Byte) The DTC priority which is mapped into the environmental data. AGINGCTR_INVERTED: (1 Byte) Current value of the aging counter counting backwards from the configured maximum value down to 0. MAX_FDC_SINCE_LAST_CLEAR: (1 Byte) Maximum value of the DTC fault detection counter reached since last clear. 0 is the minimum value reported. MAX_FDC_DURING_CURRENT_CYCLE: (1 Byte) Maximum value of the DTC fault detection counter reached in the current operation cycle. 0 is the minimum value reported. CYCLES_SINCE_LAST_FAILED: (1 Byte) Number of completed operation cycles since the DTC was tested failed. Latches at 255. CYCLES_SINCE_FIRST_FAILED: (1 Byte) Number of completed operation cycles since the cycle the DTC was tested failed for the first time. Latches at 255. FAILED_CYCLES: (1 Byte) Number of completed operation cycles during which the DTC was tested failed in since last DTC clear. Latches at 255. CURRENT_FDC: (1 Byte) Current value of the DTC fault detection counter.
      container DemDidClass [0..255]  # This container represents a Data Identifier (DID) as defined by the UDS protocol. Each DID is assembled out of one or several data elements.
        integer DemDidIdentifier: 0..65535, set at post-build in variant post-build-loadable / pre-compile in variant pre-compile  # Identifier of the Data ID as returned e.g. in $19 04
        choice reference DemDidDataElementClassRef [1..255]: set at pre-compile, destination=[DemExternalCSDataElementClass, DemInternalDataElementClass]  # Did DataElement Class Ref | These references select the data elements contained in the DID. The data elements are ordered as in the XML file.
      container DemEnableCondition [0..255]  # EnableCondition | This container represents a single enable condition. Please note: enable conditions can not be used directly but must be grouped (see DemEnableConditionGroup).
        integer DemEnableConditionId: 0..255, set at pre-compile, symbolic-name-value=true, default-value=255  # EnableCondition Id | Internal identifier of the enable condition. This number is calculated internally and may not be configured. This parameter is only available to publish the result of this calculation. Applications using Dem APIs may not rely on the value of this parameter. Instead, use the symbolic constant (SymbolicNameValue) DemConf_DemEnableCondition_<SHORT-NAME>. | This parameter should not be changeable by user, because the Id should be generated by Dem itself to prevent gaps and multiple use of an Id. The enable conditions should be sequentially ordered beginning with 0 and no gaps in between.
        boolean DemEnableConditionStatus: set at pre-compile, default-value=true  # EnableCondition Status | Defines the initial status of this enable condition. The initial value will be set during pre-initialization (Dem_PreInit) and is never stored persistently. | The value is the initialization after power up (before this condition is reported the first time). true: acceptance of a diagnostic event enabled false: acceptance of a diagnostic event disabled
      container DemEnableConditionGroup [0..255]  # EnableCondition Group | This container groups several enable conditions. EventParameters only reference one of these groups, not individual enable conditions.
        reference DemEnableConditionRef [1..255]: set at pre-compile, origin=AUTOSAR_ECUC V1.0.0, destination=DemEnableCondition  # EnableCondition Ref | References an enable condition.
      container DemExtendedDataClass [0..*]  # ExtendedData Class | This class groups several extended data records. EventParameters only reference these groups, not individual extended data records.
        reference DemExtendedDataRecordClassRef [1..253]: set at pre-compile, destination=DemExtendedDataRecordClass  # ExtendedDataRecord Class Ref | This reference contains the link to an extended data class record.
      container DemExtendedDataRecordClass [0..253]  # ExtendedDataRecord Class | This container represents a single extended data record. Each extended dat arecord is assembled out of one or several data elements. | It is assembled out of one or several data elements.
        integer DemExtendedDataRecordNumber: 0..253, set at pre-compile  # ExtendedDataRecord Number | The unique identifier of the extended data record as requested and reported by $19 06. Please note that extended data records are unique per ECU, e.g. the number references a defined set of data independent of the DTC it is related to. | One or more extended data records can be assigned to one diagnostic event/DTC. 0xFF and 0xFE are resereved by ISO (therefore the maximal value equals 253).
        enumeration DemExtendedDataRecordUpdate [0..1]: {DEM_UPDATE_RECORD_NO, DEM_UPDATE_RECORD_YES}, set at pre-compile  # ExtendedDataRecord Update | This parameter defines if this record is stored once at event confirmation, or updated with each following event FAILED result. Please note that internal data elements are updated continuously and can not be frozen to their value at the time of confirmation.
        choice reference DemDataElementClassRef [1..255]: set at pre-compile, destination=[DemExternalCSDataElementClass, DemInternalDataElementClass]  # DataElement Class Ref | These references select the data elements contained in the extended data record. The data elements are ordered as in the XML file.
      container DemFreezeFrameClass [0..255]  # FreezeFrame Class | This container groups DIDs into a snapshot record. These records are sampled at different points in time, and each of these samples is identified by the snapshot record number.
        reference DemDidClassRef [1..255]: set at post-build in variant post-build-loadable / pre-compile in variant pre-compile, destination=DemDidClass  # These references select the DIDs contained in the snapshot record. The DIDs are ordered as in the XML file. | Multiple PIDs can be relevant per freeze frame.
      container DemFreezeFrameRecNumClass [0..255]  # FreezeFrameRecNum Class | This container contains a list of dedicated, different snapshot record numbers assigned to an event. These containers are only relevant in case DemGeneral/DemTypeOfFreezeFrameRecordNumeration is set to CONFIGURED. | dependency: DemTypeOfFreezeFrameRecordNumeration
        integer DemFreezeFrameRecordNumber [1..254]: 1..254, set at pre-compile  # FreezeFrameRecord Number | This parameter defines a record number for a freeze frame record. This record number is unique per freeze frame record number class. | The range of this value is defined by ISO 14229-1 (0x01 .. 0xFE).
        enumeration DemFreezeFrameRecordUpdate [1..254]: {DEM_UPDATE_RECORD_YES, DEM_UPDATE_RECORD_NO}, set at pre-compile, origin=Vector Informatik  # FreezeFrameRecord Update | This parameter defines the case, when the freeze frame record is stored/updated. DEM_UPDATE_RECORD_NO - The snapshot record is captured only once DEM_UPDATE_RECORD_YES - The snapshot is captured with each trigger, overwriting a previously captured snapshot
        enumeration DemFreezeFrameRecordTrigger [1..254]: {DEM_RECORD_TRIGGER_FDC, DEM_RECORD_TRIGGER_CONFIRMED, DEM_RECORD_TRIGGER_PENDING, DEM_RECORD_TRIGGER_TESTFAILED, DEM_RECORD_TRIGGER_TESTFAILED_FIRST_IN_CYCLE, DEM_RECORD_TRIGGER_FDC_FIRST_IN_CYCLE}, set at pre-compile, origin=Vector Informatik  # FreezeFrameRecord Trigger | FDC: The snapshot data capture is triggered by a fault detection counter passing a failure threshold (not yet supported) CONFIRMED: The snapshot data capture is triggered by the ConfirmedDTC transition 0 -> 1 PENDING: The snapshot data capture is triggered by the PendingDTC transition 0 -> 1 TESTFAILED: The snapshot data capture is triggered by the TestFailed transition 0 -> 1 TESTFAILED_FIRST_IN_CYCLE: The snapshot data capture is triggered by the first TestFailed transition 0 -> 1 in an operation cycle FDC_FIRST_IN_CYCLE: The snapshot data capture is triggered by the first DTC fault detection counter reaching the unconfirmed threshold in an operation cycle
      container DemGeneralOBD [0..1]  # This container will be used only, if the OBD support is activated (see DemGeneral/DemOBDSupport).
        integer DemOBDPid1Cvalue [0..1]: 1..17, set at pre-compile, origin=Vector Informatik, default-value=1  # OBD PID 1C value | Configuration value to assign the OBD requirements to which the vehicle or engine is certified.
        enumeration DemOBDFreezeFrameTrigger: {DEM_RECORD_TRIGGER_PENDING, DEM_RECORD_TRIGGER_CONFIRMED}, set at pre-compile, origin=Vector Informatik, default-value=DEM_RECORD_TRIGGER_CONFIRMED  # OBD FreezeFrame Trigger | Defines the point where a OBD freeze frame is taken and stored. PENDING - The Freeze Frame data capture is triggered by the PendingDTC transition 0 -> 1 CONFIRMED - The Freeze Frame data capture is triggered by theConfirmedDTC transition 0 -> 1
        integer DemOBDPermanentDtcActivationDistance [0..1]: 0..4294967295, set at pre-compile, origin=Vector Informatik, default-value=1  # OBD PermanentDtc Activation Distance | Distance after first valid Odometer value was provided after which permanent DTC storage is activated. The resolution is the same as for PID$21 and PID$31 (see parameter DemOBDInputDistanceInformation). Providing this parameter will also enable an API to activate permanent DTC storage before the configured distance is reached. If this parameter is missing, permanent DTC storage is always active and can't be suppressed.
        enumeration DemOBDFreezeFrameVisibility: {DEM_RECORD_VISIBILE_QUALIFIED_CONFIRMED, DEM_RECORD_VISIBILE_IMMEDIATELY}, set at pre-compile, origin=Vector Informatik, default-value=DEM_RECORD_VISIBILE_QUALIFIED_CONFIRMED  # OBD FreezeFrame Visibility | This configuration value defines, when the OBD Freeze Frame is visible for diagnostic requests. QUALIFIED_CONFIRMED: The OBD Freeze Frame is visible (e.g. in Mode $02) after the DTC becomes confirmed and the OBD Driving Cycle becomes/is qualified. IMMEDIATELY: The OBD Freeze Frame is visible (e.g. in Mode $02) as soon as the Freeze Frame is stored.
        boolean DemOBDPermanentMandatoryPfcAfterClear: set at pre-compile, origin=Vector Informatik, default-value=false  # OBD Permanent Mandatory Pfc After Clear | This configuration switch specifies, when a DTC will be removed from the permanent memory after the fault memory was cleared (e.g. Mode $04) and the DTC illuminates the MIL again. If this option is enabled, the DTC will be removed from permanent memory only if PFC cycle was active and MIL becomes inactive for this DTC. If this option is disabled, the DTC will be removed from permanent memory after the MIL becomes inactive for this event.
        boolean DemDelayWarmUpCycleToDcyEnd: set at pre-compile, origin=Vector Informatik, default-value=false  # Delay WarmUp Cycle To DrivingCycle End | If enabled the DEM delays the Warm-Up cycle end to the end of a qualified driving cycle. Therefore the DTCs that have configured the Warm-Up cycle as aging cycle will age at the end of the driving cycle.
        choice reference DemOBDInputAcceleratorPaddleInformation [0..1]: set at pre-compile, destination=DemExternalCSDataElementClass  # OBDInput Accelerator Paddle Information | Input variable for the accelerator paddle information, which is assigned to a specific data element used as interface for the Dem-internal PID calculations. (not supported)
        choice reference DemOBDInputAmbientPressure [0..1]: set at pre-compile, destination=DemExternalCSDataElementClass  # OBDInput Ambient Pressure | Input variable for the ambient pressure, which is assigned to a specific data element used as interface for the Dem-internal PID calculations. (not supported)
        choice reference DemOBDInputAmbientTemperature [0..1]: set at pre-compile, destination=DemExternalCSDataElementClass  # OBDInput Ambient Temperature | Input variable for the ambient temperature, which is assigned to a specific data element used as interface for the Dem-internal PID calculations. (not supported)
        choice reference DemOBDInputDistanceInformation [0..1]: set at pre-compile, destination=DemExternalCSDataElementClass  # OBDInput Distance Information | This reference requests the current odometer for PID21, PID31 and permanent DTC storage activation distance calculation, therefore this reference is mandatory if one those features is supported. The returned odometer value (4 Byte) must have a resolution of 1 kilometer or 1 mile. If no valid odometer is available the return value must be E_NOT_OK, thus the values for PID21 and PID31 reported to the tester are set to their maximum value (0xFFFF). Furthermore the permanent DTC storage activation distance calculation is not performed until a valid odometer value is received.
        choice reference DemOBDInputEngineSpeed [0..1]: set at pre-compile, destination=DemExternalCSDataElementClass  # OBDInput Engine Speed | Input variable for the engine speed, which is assigned to a specific data element used as interface for the Dem-internal PID calculations. (not supported)
        choice reference DemOBDInputEngineTemperature [0..1]: set at pre-compile, destination=DemExternalCSDataElementClass  # OBDInput Engine Temperature | Input variable for the engine temperature, which is assigned to a specific data element used as interface for the Dem-internal PID calculations. (not supported)
        choice reference DemOBDInputProgrammingEvent [0..1]: set at pre-compile, destination=DemExternalCSDataElementClass  # OBDInput Programming Event | Input variable for the programming event, which is assigned to a specific data element used as interface for the Dem-internal PID calculations. (not supported)
        choice reference DemOBDInputVehicleSpeed [0..1]: set at pre-compile, destination=DemExternalCSDataElementClass  # OBDInput Vehicle Speed | Input variable for the vehicle speed, which is assigned to a specific data element used as interface for the Dem-internal PID calculations. (not supported)
      container DemGroupOfDTC [0..255]  # This container represents a DTC group. DTC groups can be cleared by $14, if allowed by the OEM specification. In case only $14 FFFFFF may be supported, it is recommended to not configure DTC groups.
        integer DemGroupDTCs: 0..16777214, set at pre-compile, symbolic-name-value=true  # Group DTCs | DTC value of the selected group of DTC. A clear DTC request for this number will clear all DTCs that belong to this group. | (Range: 3 byte, 0x000000 is only available for the emission-related DTC group, 0xFFFFFF is reserved for 'all DTCs', according to ISO14229-1 Annex D.1,) The DTC group 'all DTCs' is always available and will not be configured.
      container DemIndicator [0..255]  # This container represents a warning indicator (e.g. indicator lamp) | Note that this container definition does not explicitly define a symbolic name parameter. Instead, the short name of the container will be used in the Ecu Configuration Description to specify the symbolic name of the INDICATOR_NAME.
        integer DemIndicatorID: 0..255, set at pre-compile, symbolic-name-value=true, default-value=255  # Internal identifier of the indicator. This number is calculated internally and may not be configured. This parameter is only available to publish the result of this calculation. Applications using Dem APIs may not rely on the value of this parameter. Instead, use the symbolic constant (SymbolicNameValue) DemConf_DemIndicator_<SHORT-NAME>.
      container DemNvRamBlockId [0..*]  # NvRam BlockId | This container represent a non-volatile memory block used by the Dem. If no permanent storage of event memory entries is required, no block needs to be configured. | The number of blocks which are necessary depends on the implementation and configuration (e.g. number of used event memories) of the Dem module.
        enumeration DemNvRamBlockIdType: {DEM_NVBLOCK_ADMIN, DEM_NVBLOCK_STATUS, DEM_NVBLOCK_PRIMARY, DEM_NVBLOCK_SECONDARY, DEM_NVBLOCK_PERMANENT, DEM_NVBLOCK_MIRROR, DEM_NVBLOCK_FREEZEFRAME, DEM_NVBLOCK_OBDIUMPR}, set at pre-compile, origin=Vector Informatik  # NvRam BlockId Type | Usage kind of this NvBlock. This parameter is used to identify which block data needs to be stored when event data is modified. Following block types exist at most once: ADMIN: Always required. STATUS: Always required. MIRROR: Only required if DemGeneral/DemMaxNumberEventEntryMirror > 0. PERMANENT: Only required if DemGeneral/DemMaxNumberEventEntryPermanent > 0. FREEZEFRAME: Only required if DemGeneral/DemOBDSupport is enabled. OBDIUMPR: Only required if DemGeneral/DemOBDSupport is enabled and DemGeneral/DemRatioId containers are configured. Following block types can exist several times, depending on the configuration: PRIMARY: The number of containers of this type must match DemGeneral/DemMaxNumberEventEntryPrimary SECONDARY: The number of containers of this type must match DemGeneral/DemMaxNumberEventEntrySecondary
        integer DemNvRamBlockIdIndex [0..1]: 0..255, set at pre-compile, origin=Vector Informatik  # NvRam BlockId Index | For non-unique block types, this index identifies the exact block (see DemNvRamBlockIdType) This parameter must NOT exist with NvBlocks of following kind: ADMIN STATUS MIRROR PERMANENT FREEZEFRAME OBDIUMPR This parameter must have a unique value for all NvBlocks of following kind: PRIMARY SECONDARY The index values must complete the range 0 - (DemMaxNumberEventEntryPrimary-1), resp. the range 0 - (DemMaxNumberEventEntrySecondary-1). The value is necessary to store the correct memory entry in case it was changed.
        symbolic name reference DemNvRamBlockIdRef: set at pre-compile, origin=AUTOSAR_ECUC V1.0.0, destination=NvMBlockDescriptor  # NvRam BlockId Ref | This reference contains the link to a non-volatile memory block. For post build time configurations worst case scenario shall be used.
      container DemOperationCycle [1..256]  # OperationCycle | This container represents a monitoring cycle. They are used to control event monitoring and aging. Although this container does not define a symbolic name value, one is generated nonetheless.
        enumeration DemOperationCycleType: {DEM_OPCYC_IGNITION, DEM_OPCYC_OBD_DCY, DEM_OPCYC_OTHER, DEM_OPCYC_POWER, DEM_OPCYC_TIME, DEM_OPCYC_WARMUP, DEM_OPCYC_IGNITION_HYBRID}, set at pre-compile, symbolic-name-value=true, default-value=DEM_OPCYC_OTHER  # OperationCycle Type | Select the operation cycle type. This value only has an effect in case of OBD ECUs, as certain actions are triggered by legislated cycle types. note: As there is no way to read the value of the parameter at run time, the short name of the DemOperationCycle container should have a meaningful name. | Further cycle types can be specified as part of the Dem delivery.
        boolean DemOperationCycleAutomaticEnd [0..1]: set at pre-compile, origin=Vector Informatik, default-value=false  # OperationCycle Automatic End | If configured to true the DEM automatically ends the current driving cycle during call of Dem_Init. Otherwise the application has to end the cycle by calling Dem_SetOperationCycleState with state DEM_CYCLE_STATE_END. Is supported only for the DCY (OBD Driving Cycle).
      container DemRatioId [0..65535]  # RatioId | This container contains the OBD specific ratio Id configuration. It is related to a specific event, a FID, and an IUMPR group. | Note that this container definition does not explicitly define a symbolic name parameter. Instead, the short name of the container will be used in the Ecu Configuration Description to specify the symbolic name of the ratio Id name.
        enumeration DemIUMPRGroup: {DEM_IUMPR_BOOSTPRS, DEM_IUMPR_CAT1, DEM_IUMPR_CAT2, DEM_IUMPR_EGR, DEM_IUMPR_EGSENSOR, DEM_IUMPR_EVAP, DEM_IUMPR_NMHCCAT, DEM_IUMPR_NOXADSORB, DEM_IUMPR_NOXCAT, DEM_IUMPR_OXS1, DEM_IUMPR_OXS2, DEM_IUMPR_PMFILTER, DEM_IUMPR_PRIVATE, DEM_IUMPR_SAIR, DEM_IUMPR_SECOXS1, DEM_IUMPR_SECOXS2, DEM_IUMPR_FLSYS}, set at pre-compile  # This parameter specifies the assigned IUMPR group of the ratio Id. Currently it is not used by the DEM and has no effect.
        enumeration DemRatioIdType: {DEM_RATIO_API, DEM_RATIO_OBSERVER}, set at pre-compile  # RatioId Type | This parameter specifies how the numerator of the ratio is calculated: OBSERVER: The numerator is incremented whenever a test result is reported. This setting is used for symmetrical monitors. API: The numerator is incremented if the related monitoring function is able to detect a fault (reported by dedicated API). This setting is used for asymmetrical monitors.
        enumeration DemIUMPRDenGroup: {DEM_IUMPR_DEN_NONE, DEM_IUMPR_DEN_PHYS_API, DEM_IUMPR_DEN_COLDSTART, DEM_IUMPR_DEN_EVAP, DEM_IUMPR_DEN_500MI}, set at pre-compile, origin=Vector Informatik  # Dem IUMPR Denominator Group | This parameter specifies the assigned denominator type which is applied in addition to the General Denominator conditions. NONE: denominator is calculated based on the general denominator conditions PHYS_API: denominator can be locked via dedicated APIs COLDSTART, EVAP, 500MI: additional conditions must be fulfilled before the denominator is incremented.
        reference DemDiagnosticEventRef: set at pre-compile, destination=DemEventParameter  # This reference contains the link to a diagnostic event.
        symbolic name reference DemFunctionIdRef: set at pre-compile, destination=FiMFID  # FunctionId Ref | This reference contains the link to a function identifier within the FiM which is used as a primary FID. The FID is used to disable IUMPR calculation in case of an input fault.
        symbolic name reference DemSecondaryFunctionIdRef [0..*]: set at pre-compile, destination=FiMFID  # Secondary FunctionId Ref | This reference contains the link to a function identifier within the FiM which is used as a secondary FID. The FID is used to disable IUMPR calculation in case of an input fault. | The "primary" and all "secondary" FID inhibitions are combined by "OR".
      container DemStorageCondition [0..255]  # StorageCondition | This container represents a single storage condition. Please note: storage conditions can not be used directly but must be grouped (see DemStorageConditionGroup).
        integer DemStorageConditionId: 0..255, set at pre-compile, symbolic-name-value=true, default-value=255  # StorageCondition Id | Internal identifier of the storage condition. This number is calculated internally and may not be configured. This parameter is only available to publish the result of this calculation. Applications using Dem APIs may not rely on the value of this parameter. Instead, use the symbolic constant (SymbolicNameValue) DemConf_DemStorageCondition_<SHORT-NAME>.
        boolean DemStorageConditionStatus: set at pre-compile, default-value=true  # StorageCondition Status | Defines the initial status of this enable condition. The initial value will be set during pre-initialization (Dem_PreInit) and is never stored persistently. | The value is the initialization after power up (before this condition is reported the first time). true: storage of a diagnostic event enabled false: storage of a diagnostic event disabled
      container DemStorageConditionGroup [0..255]  # StorageCondition Group | This container groups several storage conditions. EventParameters only reference one of these groups, not individual storage conditions.
        reference DemStorageConditionRef [1..255]: set at pre-compile, origin=AUTOSAR_ECUC V1.0.0, destination=DemStorageCondition  # StorageCondition Ref | References an storage condition.
      container DemPidConfiguration [0..1]  # PID Configuration | This container contains options controlling the support of OBD PIDs by the Dem module.
        boolean DemSupportPid01 [0..1]: set at pre-compile, origin=Vector Informatik, default-value=true  # Support PID 01 | Monitor status since DTCs cleared.
        boolean DemSupportPid1C [0..1]: set at pre-compile, origin=Vector Informatik, default-value=true  # Support PID 1C | OBD requirements to which the vehicle is designed.
        boolean DemSupportPid21 [0..1]: set at pre-compile, origin=Vector Informatik, default-value=false  # Support PID 21 | Distance travelled while MIL is activated.
        boolean DemSupportPid30 [0..1]: set at pre-compile, origin=Vector Informatik, default-value=true  # Support PID 30 | Number of WarmUp cycles since DTCs cleared.
        boolean DemSupportPid31 [0..1]: set at pre-compile, origin=Vector Informatik, default-value=false  # Support PID 31 | Distance since DTCs cleared.
        boolean DemSupportPid41 [0..1]: set at pre-compile, origin=Vector Informatik, default-value=true  # Support PID 41 | Monitor status this driving cycle.
        boolean DemSupportPid4D [0..1]: set at pre-compile, origin=Vector Informatik, default-value=false  # Support PID 4D | Time run by engine while MIL is activated.
        boolean DemSupportPid4E [0..1]: set at pre-compile, origin=Vector Informatik, default-value=false  # Support PID 4E | Time since diagnostic troublecodes cleared.
        boolean DemSupportVid08 [0..1]: set at pre-compile, origin=Vector Informatik, default-value=false  # Support VID 08 | In-use performance tracking - spark ignition vehicle.
        boolean DemSupportVid0B [0..1]: set at pre-compile, origin=Vector Informatik, default-value=false  # Support VID 0B | In-use performance tracking - compression ignition vehicle.
      container DemMILGroup [0..65534]  # This container represents a group of events that use a common trip counter to determine their MIL status. Incrementing the common trip counter is triggered by any event of the MIL group. Healing is performed individually for each event of the MIL group, but the common trip counter is only reset after all events of the group have been healed. The reference to a MIL group is configured at the DTCClass container.
      container DemPostbuild  # The content of this container is only relevant for the implementation variant PostBuild (POST-BUILD-LOADABLE). For implementation variant PreCompile all contained parameters are ignored.
        integer DemMaxSizeFreezeFrame: 0..65535, category=POST_BUILD_SPECIFIC, set at pre-compile, origin=Vector Informatik, default-value=0  # Enlarge the (RAM/NvRAM) size of the largest FrezeFrame record. This parameter is mandatory for implementation variant Post-Build, it will be ignored for implementation variant Pre-Compile configurations. It represents the size of largest defined FreezeFrame record. The minimum value is auto-calculated when you start "Validate" or "Generate" - set value 0 to force the recalculation of the min value. For Post-Build variants during the pre-compile configuration phase you can enlarge the value to reserve additional space in the NvRAM blocks. Later in the post-build phase you can choose different DIDs (or a different number of DIDs) for a defined FreezeFrame - as long as the size of the new selected DIDs still fit into the reserved space. Take care: for Post-Build implementation variants the auto-calculation will only increase the value (when it is smaller than the configured, largest FreezeFrame's size. Changing the FreezeFrame's DIDs afterwards may shorten the largest FreezeFrame's size - but this will NOT decrease this value again! Set the value to '0' and start "Validate" or "Generate" for the DEM to calculate again the minimum size. "Size of a freeze frame" is calculated as: Summarize the size of all referred DemDidClasses in a DemGeneral/DemFreezeFrameClass. The size of a DidClass is calculated as: Summarize the size of all referred DemNNDataElementClass elements by adding their DemDataElementDataSize values.
  module config Dem_Pre: definition=Dem
  module config Dem_Rec: definition=Dem
