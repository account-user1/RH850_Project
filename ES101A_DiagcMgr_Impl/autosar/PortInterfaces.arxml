AUTOSAR XML (schema 4-0-3)
package /Nexteer/Calibrations
  parameter interface Ary1D_u16_512_CalPortIf1
    parameter data prototype Ary1D: sw-calibration-access=READ-WRITE, type=Ary1D_u16_512
package /Nexteer/NvMProxy_swc/Interfaces
  client server interface NvMService_AC3_SRBS: is-service=true
    6 x operation, all with possible-error=NvMService_AC3_SRBS/E_NOT_OK:
      EraseBlock
      GetErrorStatus
        arg ErrorStatus: type=NvM_RequestResultType, direction=OUT, server-argument-impl-policy=USE-ARGUMENT-TYPE
      InvalidateNvBlock
      ReadBlock
        arg DstPtr: type=dtRef_VOID, direction=IN, server-argument-impl-policy=USE-ARGUMENT-TYPE
      SetRamBlockStatus
        arg RamBlockStatus: type=Boolean, direction=IN, server-argument-impl-policy=USE-ARGUMENT-TYPE
      WriteBlock
        arg SrcPtr: type=dtRef_const_VOID, direction=IN, server-argument-impl-policy=USE-ARGUMENT-TYPE
    error E_NOT_OK: error-code=1
  client server interface NvMService_AC3_SRBS_Defs: is-service=true
    7 x operation, all with possible-error=NvMService_AC3_SRBS_Defs/E_NOT_OK:
      EraseBlock
      GetErrorStatus
        arg ErrorStatus: type=NvM_RequestResultType, direction=OUT, server-argument-impl-policy=USE-ARGUMENT-TYPE
      InvalidateNvBlock
      ReadBlock
        arg DstPtr: type=dtRef_VOID, direction=IN, server-argument-impl-policy=USE-ARGUMENT-TYPE
      RestoreBlockDefaults
        arg DstPtr: type=dtRef_VOID, direction=IN, server-argument-impl-policy=USE-ARGUMENT-TYPE
      SetRamBlockStatus
        arg RamBlockStatus: type=Boolean, direction=IN, server-argument-impl-policy=USE-ARGUMENT-TYPE
      WriteBlock
        arg SrcPtr: type=dtRef_const_VOID, direction=IN, server-argument-impl-policy=USE-ARGUMENT-TYPE
    error E_NOT_OK: error-code=1
package /Nexteer/PortInterfaces
  28 x client server interface:
    ClrAllDiagc_PortIf1
      operation Oper
    ClrLtchCntrData_PortIf1
      operation Oper
    ClrSnpshtData_PortIf1
      operation Oper
    CnvSnpshtData_f32_PortIf1
      operation Oper
        arg SnpshtDataCnvd_Arg: type=uint32, direction=OUT, server-argument-impl-policy=USE-ARGUMENT-TYPE
        arg SnpshtData_Arg: type=float32, direction=IN, server-argument-impl-policy=USE-ARGUMENT-TYPE
    CnvSnpshtData_logl_PortIf1
      operation Oper
        arg SnpshtDataCnvd_Arg: type=uint32, direction=OUT, server-argument-impl-policy=USE-ARGUMENT-TYPE
        arg SnpshtData_Arg: type=boolean, direction=IN, server-argument-impl-policy=USE-ARGUMENT-TYPE
    CnvSnpshtData_s08_PortIf1
      operation Oper
        arg SnpshtDataCnvd_Arg: type=uint32, direction=OUT, server-argument-impl-policy=USE-ARGUMENT-TYPE
        arg SnpshtData_Arg: type=sint8, direction=IN, server-argument-impl-policy=USE-ARGUMENT-TYPE
    CnvSnpshtData_s16_PortIf1
      operation Oper
        arg SnpshtDataCnvd_Arg: type=uint32, direction=OUT, server-argument-impl-policy=USE-ARGUMENT-TYPE
        arg SnpshtData_Arg: type=sint16, direction=IN, server-argument-impl-policy=USE-ARGUMENT-TYPE
    CnvSnpshtData_s32_PortIf1
      operation Oper
        arg SnpshtDataCnvd_Arg: type=uint32, direction=OUT, server-argument-impl-policy=USE-ARGUMENT-TYPE
        arg SnpshtData_Arg: type=sint32, direction=IN, server-argument-impl-policy=USE-ARGUMENT-TYPE
    CnvSnpshtData_u08_PortIf1
      operation Oper
        arg SnpshtDataCnvd_Arg: type=uint32, direction=OUT, server-argument-impl-policy=USE-ARGUMENT-TYPE
        arg SnpshtData_Arg: type=uint8, direction=IN, server-argument-impl-policy=USE-ARGUMENT-TYPE
    CnvSnpshtData_u16_PortIf1
      operation Oper
        arg SnpshtDataCnvd_Arg: type=uint32, direction=OUT, server-argument-impl-policy=USE-ARGUMENT-TYPE
        arg SnpshtData_Arg: type=uint16, direction=IN, server-argument-impl-policy=USE-ARGUMENT-TYPE
    DiagcMgrIninCore_PortIf3
      operation Oper
        5 x arg, all with server-argument-impl-policy=USE-ARGUMENT-TYPE:
          ApplIdx_Arg: type=uint8, direction=IN
          NtcInfoArySize_Arg: type=uint8, direction=IN
          NtcInfoAry_Arg: type=Ary1D_NtcInfoRec4_DiagcMgr, direction=INOUT
          DiagcData_Arg: type=DiagcDataRec2, direction=OUT
          ProxySetNtcData_Arg: type=DiagcDataRec2, direction=OUT
    GetDiagcDataApplX_PortIf2
      operation Oper
        arg DiagcData_Arg: type=DiagcDataRec2, direction=OUT, server-argument-impl-policy=USE-ARGUMENT-TYPE
    GetMcuDiagcSpplData_PortIf1
      operation Oper
        arg McuDiagcData1_Arg: type=uint32, direction=OUT, server-argument-impl-policy=USE-ARGUMENT-TYPE
    GetNtcActv_PortIf1
      operation Oper: possible-error=GetNtcActv_PortIf1/E_NOT_OK
        arg NtcNr_Arg: type=NtcNr1, direction=IN, server-argument-impl-policy=USE-ARGUMENT-TYPE
        arg NtcActv_Arg: type=boolean, direction=OUT, server-argument-impl-policy=USE-ARGUMENT-TYPE
      error E_NOT_OK: error-code=1
    GetNtcActvCore_PortIf1
      operation Oper
        arg NtcNr_Arg: type=NtcNr1, direction=IN, server-argument-impl-policy=USE-ARGUMENT-TYPE
        arg NtcActv_Arg: type=boolean, direction=OUT, server-argument-impl-policy=USE-ARGUMENT-TYPE
    GetNtcDebCntrApplX_PortIf1
      operation Oper
        arg DebCntrIdx_Arg: type=uint8, direction=IN, server-argument-impl-policy=USE-ARGUMENT-TYPE
        arg DebCntr_Arg: type=sint16, direction=OUT, server-argument-impl-policy=USE-ARGUMENT-TYPE
    GetNtcInfoApplX_PortIf2
      operation Oper
        arg NtcInfoIdx_Arg: type=uint8, direction=IN, server-argument-impl-policy=USE-ARGUMENT-TYPE
        arg NtcInfo_Arg: type=NtcInfoRec4, direction=OUT, server-argument-impl-policy=USE-ARGUMENT-TYPE
    GetNtcQlfrSts_PortIf1
      operation Oper: possible-error=GetNtcQlfrSts_PortIf1/E_NOT_OK
        arg NtcNr_Arg: type=NtcNr1, direction=IN, server-argument-impl-policy=USE-ARGUMENT-TYPE
        arg NtcQlfr_Arg: type=SigQlfr1, direction=OUT, server-argument-impl-policy=USE-ARGUMENT-TYPE
      error E_NOT_OK: error-code=1
    GetNtcQlfrStsCore_PortIf1
      operation Oper
        arg NtcNr_Arg: type=NtcNr1, direction=IN, server-argument-impl-policy=USE-ARGUMENT-TYPE
        arg NtcQlfr_Arg: type=SigQlfr1, direction=OUT, server-argument-impl-policy=USE-ARGUMENT-TYPE
    GetNtcSts_PortIf1
      operation Oper: possible-error=GetNtcSts_PortIf1/E_NOT_OK
        arg NtcNr_Arg: type=NtcNr1, direction=IN, server-argument-impl-policy=USE-ARGUMENT-TYPE
        arg NtcInfoSts_Arg: type=uint8, direction=OUT, server-argument-impl-policy=USE-ARGUMENT-TYPE
      error E_NOT_OK: error-code=1
    GetNtcStsCore_PortIf1
      operation Oper
        arg NtcNr_Arg: type=NtcNr1, direction=IN, server-argument-impl-policy=USE-ARGUMENT-TYPE
        arg NtcInfoSts_Arg: type=uint8, direction=OUT, server-argument-impl-policy=USE-ARGUMENT-TYPE
    ReadLtchCntrData_PortIf1
      operation Oper
        arg ReadLtchCntrAry_Arg: type=Ary1D_u08_20, direction=OUT, server-argument-impl-policy=USE-ARGUMENT-TYPE
    ReadNtcFltAry_PortIf1
      operation Oper
        arg DiagcMgrReadFltInfo_Arg: type=Ary1D_ReadFltInfoRec1_20, direction=OUT, server-argument-impl-policy=USE-ARGUMENT-TYPE
    ReadNtcInfoAndDebCntr_PortIf1
      operation Oper
        arg NtcNr_Arg: type=NtcNr1, direction=IN, server-argument-impl-policy=USE-ARGUMENT-TYPE
        arg NtcInfo_Arg: type=NtcInfoRec4, direction=OUT, server-argument-impl-policy=USE-ARGUMENT-TYPE
        arg DebCntr_Arg: type=sint16, direction=OUT, server-argument-impl-policy=USE-ARGUMENT-TYPE
    ReadSnpshtData_PortIf2
      operation Oper
        arg ReadSnpshtDataAry_Arg: type=Ary1D_SnpshtDataRec2_8, direction=OUT, server-argument-impl-policy=USE-ARGUMENT-TYPE
    SetNtcSts_PortIf1
      operation Oper: possible-error=SetNtcSts_PortIf1/E_NOT_OK
        4 x arg, all with direction=IN, server-argument-impl-policy=USE-ARGUMENT-TYPE:
          NtcNr_Arg: type=NtcNr1
          NtcStInfo_Arg: type=uint8
          NtcSts_Arg: type=NtcSts1
          DebStep_Arg: type=uint16
      error E_NOT_OK: error-code=1
    SetNtcStsAndSnpshtData_PortIf1
      operation Oper: possible-error=SetNtcStsAndSnpshtData_PortIf1/E_NOT_OK
        7 x arg, all with direction=IN, server-argument-impl-policy=USE-ARGUMENT-TYPE:
          NtcNr_Arg: type=NtcNr1
          NtcStInfo_Arg: type=uint8
          NtcSts_Arg: type=NtcSts1
          DebStep_Arg: type=uint16
          SpclSnpshtData{0..2}_Arg: type=uint32
      error E_NOT_OK: error-code=1
    SetNtcStsCore_PortIf2
      operation Oper: possible-error=SetNtcStsCore_PortIf2/E_NOT_OK
        12 x arg, all with server-argument-impl-policy=USE-ARGUMENT-TYPE:
          NtcNr_Arg: type=NtcNr1, direction=IN
          NtcStInfo_Arg: type=uint8, direction=IN
          NtcSts_Arg: type=NtcSts1, direction=IN
          DebStep_Arg: type=uint16, direction=IN
          DiagcData_Arg: type=DiagcDataRec2, direction=INOUT
          ProxySetNtcData_Arg: type=DiagcDataRec2, direction=INOUT
          NtcInfo_Arg: type=NtcInfoRec4, direction=INOUT
          NtcInfoDebCntr_Arg: type=sint16, direction=INOUT
          SpclSnpshtData{0..2}_Arg: type=uint32, direction=IN
          SpclSnpshtDataPrsnt_Arg: type=boolean, direction=IN
      error E_NOT_OK: error-code=1
  6 x sender receiver interface:
    boolean_PortIf1: invalidation-policy{data-element=Logl, handle-invalid=DONT-INVALIDATE}
      data Logl: sw-calibration-access=READ-ONLY, type=boolean
    float32_PortIf1: invalidation-policy{data-element=float32_PortIf1/Val, handle-invalid=DONT-INVALIDATE}
      data Val: sw-calibration-access=READ-ONLY, type=float32
    MfgEnaSt1_PortIf1: invalidation-policy{data-element=MfgEnaSt1_PortIf1/Val, handle-invalid=DONT-INVALIDATE}
      data Val: sw-calibration-access=READ-ONLY, type=MfgEnaSt1
    SysSt1_PortIf1: invalidation-policy{data-element=SysSt1_PortIf1/Val, handle-invalid=DONT-INVALIDATE}
      data Val: sw-calibration-access=READ-ONLY, type=SysSt1
    uint32_PortIf1: invalidation-policy{data-element=uint32_PortIf1/Val, handle-invalid=DONT-INVALIDATE}
      data Val: sw-calibration-access=READ-ONLY, type=uint32
    uint8_PortIf1: invalidation-policy{data-element=uint8_PortIf1/Val, handle-invalid=DONT-INVALIDATE}
      data Val: sw-calibration-access=READ-ONLY, type=uint8
