AUTOSAR XML (schema 4-0-3)
package /Nexteer/CDD_NvMProxy_ib_bswmd/BswModuleDescriptions
  bsw module description CDD_NvMProxy: provided-entrys=CDD_NvMProxy_MainFunction
    bsw internal behavior CDD_NvMProxyBehavior
      exclusive area CDD_NvMProxy_EXCLUSIVE_AREA_0
      bsw schedulable entity CDD_NvMProxy_MainFunction: implemented-entry=CDD_NvMProxy_MainFunction
      bsw timing event CDD_NvMProxy_MainFunctionTimingEvent0: starts-on-event=CDD_NvMProxy_MainFunction, period=0.01
  bsw module entry CDD_NvMProxy_MainFunction: call-type=SCHEDULED, execution-context=TASK
