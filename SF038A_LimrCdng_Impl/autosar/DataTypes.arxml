AUTOSAR XML (schema 4-0-3)
standard types defined: float32_DataConstr, float64_DataConstr, sint16_DataConstr, sint32_DataConstr, sint8_DataConstr, uint16_DataConstr, uint32_DataConstr, uint8_DataConstr, boolean, float32, float64, sint16, sint32, sint8, uint16, uint32, uint8
package /Nexteer/DataTypes
  4 x impl type, all with type-emitter=RTE:
    Ary1D_u13p3_2: category=ARRAY, sw-calibration-access=READ-ONLY
      element Element: array-size=2, array-size-semantics=FIXED-SIZE, implementation-data-type=u13p3
    Ary1D_u9p7_2: category=ARRAY, sw-calibration-access=READ-ONLY
      element Element: array-size=2, array-size-semantics=FIXED-SIZE, implementation-data-type=u9p7
    u13p3: implementation-data-type=uint16
    u9p7: implementation-data-type=uint16
