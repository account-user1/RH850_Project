AUTOSAR XML (schema 4-0-3)
package /Nexteer/Calibrations
  parameter interface Ary1D_u13p3_2_CalPortIf1
    parameter data prototype Ary1D: sw-calibration-access=READ-WRITE, type=Ary1D_u13p3_2
  parameter interface Ary1D_u9p7_2_CalPortIf1
    parameter data prototype Ary1D: sw-calibration-access=READ-WRITE, type=Ary1D_u9p7_2
  parameter interface float32_CalPortIf1
    parameter data prototype Val: sw-calibration-access=READ-WRITE, type=float32
package /Nexteer/PortInterfaces
  client server interface FltInj_f32_PortIf1
    operation Oper
      arg SigPah_Arg: type=float32, direction=INOUT
      arg LocnKey_Arg: type=uint16, direction=IN
  sender receiver interface float32_PortIf1: invalidation-policy{data-element=Val, handle-invalid=DONT-INVALIDATE}
    data Val: sw-calibration-access=READ-ONLY, type=float32
