AUTOSAR XML (schema 4-0-3)
standard types defined: boolean, float32, uint16, uint32, uint8, boolean_CompuMethod, boolean_DataConstr, float32_DataConstr, uint16_DataConstr, uint32_DataConstr, uint8_DataConstr
package /Nexteer/DataTypes
  7 x impl type:
    FilLpRec1: category=STRUCTURE, sw-calibration-access=READ-ONLY, type-emitter=NxtrFil
      element FilSt: implementation-data-type=float32
      element FilGain: implementation-data-type=float32
      symbol props FilLpRec1
    IvtrFetFltPha1: compu {0=IVTRFETFLTPHA_NOPHASNGFETFLT, 1=IVTRFETFLTPHA_PHAASNGFETFLT, 2=IVTRFETFLTPHA_PHABSNGFETFLT, 4=IVTRFETFLTPHA_PHACSNGFETFLT}, implementation-data-type=ImplementationDataTypes/uint8, type-emitter=RTE
    IvtrFetFltTyp1: compu {0=IVTRFETFLTTYP_NOFETFLT, 1=IVTRFETFLTTYP_LOWRFETFLT, 2=IVTRFETFLTTYP_UPPRFETFLT, 4=IVTRFETFLTTYP_MPLFETFLT}, implementation-data-type=ImplementationDataTypes/uint8, type-emitter=RTE
    NtcNr1: compu {1..511=NTCNR_0X001..NTCNR_0X1FF}, implementation-data-type=ImplementationDataTypes/uint16, type-emitter=RTE
    NtcSts1: compu {0=NTCSTS_PASSD, 1=NTCSTS_FAILD, 2=NTCSTS_PREPASSD, 3=NTCSTS_PREFAILD}, implementation-data-type=ImplementationDataTypes/uint8, type-emitter=RTE
    SigQlfr1: compu {0=SIGQLFR_NORES, 1=SIGQLFR_PASSD, 2=SIGQLFR_FAILD}, implementation-data-type=ImplementationDataTypes/uint8, type-emitter=RTE
    SysSt1: compu {0=SYSST_DI, 1=SYSST_OFF, 2=SYSST_ENA, 3=SYSST_WRMININ}, implementation-data-type=ImplementationDataTypes/uint8, type-emitter=RTE
