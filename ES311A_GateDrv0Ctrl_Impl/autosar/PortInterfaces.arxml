AUTOSAR XML (schema 4-0-3)
package /Nexteer/Calibrations
  parameter interface float32_CalPortIf1
    parameter data prototype Val: sw-calibration-access=READ-WRITE, type=float32
  parameter interface uint16_CalPortIf1
    parameter data prototype Val: sw-calibration-access=READ-WRITE, type=uint16
  parameter interface uint32_CalPortIf1
    parameter data prototype Val: sw-calibration-access=READ-WRITE, type=uint32
package /Nexteer/PortInterfaces
  5 x client server interface:
    GetGpio_PortIf1
      operation Oper: possible-error=GetGpio_PortIf1/E_NOT_OK
        arg PinSt_Arg: type=boolean, direction=OUT, server-argument-impl-policy=USE-ARGUMENT-TYPE
      error E_NOT_OK: error-code=1
    GetNtcQlfrSts_PortIf1
      operation Oper: possible-error=GetNtcQlfrSts_PortIf1/E_NOT_OK
        arg NtcNr_Arg: type=NtcNr1, direction=IN, server-argument-impl-policy=USE-ARGUMENT-TYPE
        arg NtcQlfr_Arg: type=SigQlfr1, direction=OUT, server-argument-impl-policy=USE-ARGUMENT-TYPE
      error E_NOT_OK: error-code=1
    SetGpio_PortIf1
      operation Oper: possible-error=SetGpio_PortIf1/E_NOT_OK
        arg PinSt_Arg: type=boolean, direction=IN, server-argument-impl-policy=USE-ARGUMENT-TYPE
      error E_NOT_OK: error-code=1
    SetNtcSts_PortIf1
      operation Oper: possible-error=SetNtcSts_PortIf1/E_NOT_OK
        4 x arg, all with direction=IN, server-argument-impl-policy=USE-ARGUMENT-TYPE:
          NtcNr_Arg: type=NtcNr1
          NtcStInfo_Arg: type=uint8
          NtcSts_Arg: type=NtcSts1
          DebStep_Arg: type=uint16
      error E_NOT_OK: error-code=1
    SetNtcStsAndSnpshtData_PortIf1
      operation Oper: possible-error=SetNtcStsAndSnpshtData_PortIf1/E_NOT_OK
        7 x arg, all with direction=IN, server-argument-impl-policy=USE-ARGUMENT-TYPE:
          NtcNr_Arg: type=NtcNr1
          NtcStInfo_Arg: type=uint8
          NtcSts_Arg: type=NtcSts1
          DebStep_Arg: type=uint16
          SpclSnpshtData{0..2}_Arg: type=uint32
      error E_NOT_OK: error-code=1
  7 x sender receiver interface:
    boolean_PortIf1: invalidation-policy{data-element=Logl, handle-invalid=DONT-INVALIDATE}
      data Logl: sw-calibration-access=READ-ONLY, type=boolean
    float32_PortIf1: invalidation-policy{data-element=float32_PortIf1/Val, handle-invalid=DONT-INVALIDATE}
      data Val: sw-calibration-access=READ-ONLY, type=float32
    IvtrFetFltPha1_PortIf1: invalidation-policy{data-element=IvtrFetFltPha1_PortIf1/Val, handle-invalid=DONT-INVALIDATE}
      data Val: sw-calibration-access=READ-ONLY, type=IvtrFetFltPha1
    IvtrFetFltTyp1_PortIf1: invalidation-policy{data-element=IvtrFetFltTyp1_PortIf1/Val, handle-invalid=DONT-INVALIDATE}
      data Val: sw-calibration-access=READ-ONLY, type=IvtrFetFltTyp1
    SysSt1_PortIf1: invalidation-policy{data-element=SysSt1_PortIf1/Val, handle-invalid=DONT-INVALIDATE}
      data Val: sw-calibration-access=READ-ONLY, type=SysSt1
    uint32_PortIf1: invalidation-policy{data-element=uint32_PortIf1/Val, handle-invalid=DONT-INVALIDATE}
      data Val: sw-calibration-access=READ-ONLY, type=uint32
    uint8_PortIf1: invalidation-policy{data-element=uint8_PortIf1/Val, handle-invalid=DONT-INVALIDATE}
      data Val: sw-calibration-access=READ-ONLY, type=uint8
