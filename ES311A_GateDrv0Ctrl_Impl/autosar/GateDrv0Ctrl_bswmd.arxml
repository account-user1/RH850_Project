AUTOSAR XML (schema 4-0-3)
package /Nexteer
  module definition GateDrv0Ctrl [0..1]: variants pre-compile  # Configurations for GateDrv0 SWC
    container GateDrv0CtrlGenCfg  # Contains generic configurable parameters for GateDrv0
      boolean GateDrv0FetFltMtgtnEna: origin=NEXTEER, default-value=0  # GATEDRV0FETFLTMTGTNENA_ULS_LOGL: Field effect transistor fault mitigation enable. If TRUE, the gate drive component will notify the system when a FET fault is detected.
