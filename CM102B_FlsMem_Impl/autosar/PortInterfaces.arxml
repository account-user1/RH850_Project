AUTOSAR XML (schema 4-0-3)
package /Nexteer/PortInterfaces
  client server interface GetTiSpan100MicroSec32bit_PortIf1
    operation Oper
      arg RefTmr_Arg: type=uint32, direction=IN, server-argument-impl-policy=USE-ARGUMENT-TYPE
      arg TiSpan_Arg: type=uint32, direction=OUT, server-argument-impl-policy=USE-ARGUMENT-TYPE
  client server interface ResvCrcHwUnit_PortIf2
    operation Oper: possible-error=ResvCrcHwUnit_PortIf2/E_NOT_OK
      6 x arg, all with server-argument-impl-policy=USE-ARGUMENT-TYPE:
        Mod_Arg: type=CrcHwResvMod1, direction=IN
        CrcCfg_Arg: type=CrcHwResvCfg1, direction=IN
        CrcHwInRegAdr_Arg: type=uint32, direction=OUT
        CrcHwOutRegAdr_Arg: type=uint32, direction=OUT
        StrtVal_Arg: type=uint32, direction=IN
        ResvKey_Arg: type=uint32, direction=INOUT
    error E_NOT_OK: error-code=1
  client server interface SetNtcSts_PortIf1
    operation Oper: possible-error=SetNtcSts_PortIf1/E_NOT_OK
      4 x arg, all with direction=IN, server-argument-impl-policy=USE-ARGUMENT-TYPE:
        NtcNr_Arg: type=NtcNr1
        NtcStInfo_Arg: type=uint8
        NtcSts_Arg: type=NtcSts1
        DebStep_Arg: type=uint16
    error E_NOT_OK: error-code=1
  sender receiver interface boolean_PortIf1: invalidation-policy{data-element=Logl, handle-invalid=DONT-INVALIDATE}
    data Logl: sw-calibration-access=READ-ONLY, type=boolean
  sender receiver interface uint32_PortIf1: invalidation-policy{data-element=Val, handle-invalid=DONT-INVALIDATE}
    data Val: sw-calibration-access=READ-ONLY, type=uint32
