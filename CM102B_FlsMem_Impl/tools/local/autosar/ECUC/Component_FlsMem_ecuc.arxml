AUTOSAR XML (schema 4-0-3)
package /ActiveEcuC
  module config FlsMem: implementation-config-variant=VARIANT-PRE-COMPILE
    5 x FlashCRCRegnConfig, all with StartingAddress=0:
      Appl: Length=0, PredefinedCrcAddress=0, UseSymbolName=true, StartingAddressSymbol=CCT_Range_01_Start, LengthSymbol=CCT_Range_01_Length, PredefinedCrcAddressSymbol=CCT_Range_01_Address
      Cal1: Length=0, PredefinedCrcAddress=0, UseSymbolName=true, StartingAddressSymbol=CCT_Range_02_Start, LengthSymbol=CCT_Range_02_Length, PredefinedCrcAddressSymbol=CCT_Range_02_Address
      Cal2: Length=0, PredefinedCrcAddress=0, UseSymbolName=true, StartingAddressSymbol=CCT_Range_03_Start, LengthSymbol=CCT_Range_03_Length, PredefinedCrcAddressSymbol=CCT_Range_03_Address
      Cal3: Length=0, PredefinedCrcAddress=0, UseSymbolName=true, StartingAddressSymbol=CCT_Range_04_Start, LengthSymbol=CCT_Range_04_Length, PredefinedCrcAddressSymbol=CCT_Range_04_Address
      bootloader: Length=100, PredefinedCrcAddress=1234, UseSymbolName=false, StartingAddressSymbol=NULL_PTR, LengthSymbol=NULL_PTR, PredefinedCrcAddressSymbol=NULL_PTR
    ApplCRCRegnIdx: ApplCrcRegnNr=3
