AUTOSAR XML (schema 4-0-3)
package /Nexteer
  module definition HwTq1Meas [0..1]: variants pre-compile  # Configuration of the HwTq1Meas.
    container HwTq1MeasGeneral  # This container contains the configuration (parameters) of the HwTq1Meas.
      enumeration HwTq1PrtclNtcNr: {NTCNR_0X073, NTCNR_0X074, NTCNR_0X075, NTCNR_0X076, NTCNR_0X077, NTCNR_0X078, NTCNR_0X079, NTCNR_0X07A}, set at pre-compile, origin=Nexteer, default-value=NTCNR_0X075  # .
      enumeration HwTq1MfgNtcNr: {NTCNR_0X1E0, NTCNR_0X1E1, NTCNR_0X1E2, NTCNR_0X1E3}, set at pre-compile, origin=Nexteer, default-value=NTCNR_0X1E1  # .
