AUTOSAR XML (schema 4-0-3)
standard types defined: float32_DataConstr, float64_DataConstr, sint16_DataConstr, sint32_DataConstr, sint8_DataConstr, uint16_DataConstr, uint32_DataConstr, uint8_DataConstr, boolean, float32, float64, sint16, sint32, sint8, uint16, uint32, uint8
package /Nexteer/DataTypes
  6 x impl type, all with type-emitter=RTE:
    Ary1D_u4p12_6: category=ARRAY, sw-calibration-access=READ-ONLY
      element Element: array-size=6, array-size-semantics=FIXED-SIZE, implementation-data-type=u4p12
    Ary1D_u6p10_6: category=ARRAY, sw-calibration-access=READ-ONLY
      element Element: array-size=6, array-size-semantics=FIXED-SIZE, implementation-data-type=u6p10
    Ary1D_u9p7_6: category=ARRAY, sw-calibration-access=READ-ONLY
      element Element: array-size=6, array-size-semantics=FIXED-SIZE, implementation-data-type=u9p7
    u4p12: implementation-data-type=uint16
    u6p10: implementation-data-type=uint16
    u9p7: implementation-data-type=uint16
