AUTOSAR XML (schema 4-0-3)
standard types defined: boolean, uint16, uint32, uint8, boolean_CompuMethod, boolean_DataConstr, uint16_DataConstr, uint32_DataConstr, uint8_DataConstr
package /DataType/Unit
  5 x unit, all with factor-si-to-unit=1, offset-si-to-unit=0:
    U_degrees: display-name=degrees
    U_degreesYsecond: display-name=degrees/second
    U_meter: display-name=meter
    U_SED: display-name=SED
    unitless: display-name=unitless
package /Ford/DataTypes
  7 x impl type, all with category=VALUE, sw-calibration-access=READ-ONLY:
    Ford_HitchToVehAxle_L_Calc: base-type=DataType/uint8, compu {255=CxFF_Faulty, phys=raw*0.0127-0.508 for raw 0..255; unit meter} "Source signal range: [0,254]"
    Ford_TrlrAid_An3_Actl: base-type=DataType/uint16, compu {2047=Cx7FF_Faulty, phys=raw*0.125-90 for raw 0..2047; unit degrees} "Source signal range: [0,2046]", range raw 0..2047
    Ford_TrlrAid_AnRate2_Actl: base-type=DataType/uint16, compu {1023=Cx3FF_Faulty, phys=raw*0.125-50 for raw 0..1023; unit degrees/second} "Source signal range: [0,1022]", range raw 0..1023
    Ford_TrlrAid_D2_Stat:
      base-type=DataType/uint8
      compu {phys=raw for raw 0..15, 0=Cx0_NotTracking, 1=Cx1_Initializing, 2=Cx2_DriveStraighRequested, 3=Cx3_TurnRequested, 4=Cx4_TrackingLowConfidence, 5=Cx5_TrackingMediumConfidence, 6=Cx6_TrackingHighConfidence, 7=Cx7_TrackingUnknownConfidence, 8=Cx8_TrackingLost, 9=Cx9_IncorrectLighting, 10=CxA_DirtyCamera, 11=CxB_NotUsed_1, 12=CxC_NotUsed_2, 13=CxD_NotUsed_3, 14=CxE_NotUsed_4, 15=CxF_Faulty; unit SED}
      range raw 0..15
    Ford_TrlrAidTrgtId_No_Actl: base-type=DataType/uint8, compu {phys=raw for raw 0..31; unit unitless}, range raw 0..31
    Ford_TrlrRvrse_D_Stat: base-type=DataType/uint8, compu {phys=raw for raw 0..3, 0=Cx0_Off, 1=Cx1_On, 2=Cx2_TrailerReverseGuidanceLite, 3=Cx3_Faulty; unit SED}, range raw 0..3
    Ford_TrlrTrgtAcquire_D_Stat: base-type=DataType/uint8, compu {phys=raw for raw 0..7, 0=Cx0_Null, 1=Cx1_TargetAcquired, 2=Cx2_TargetNotAcquired, 3=Cx3_Processing, 4=Cx4_RVCforTBA_Activated, 5=Cx5_NotUsed_1, 6=Cx6_NotUsed_2, 7=Cx7_Faulty; unit SED}, range raw 0..7
package /Nexteer/DataTypes
  impl type NtcNr1: compu {1..511=NTCNR_0X001..NTCNR_0X1FF}, implementation-data-type=uint16, type-emitter=RTE
  impl type NtcSts1: compu {0=NTCSTS_PASSD, 1=NTCSTS_FAILD, 2=NTCSTS_PREPASSD, 3=NTCSTS_PREFAILD}, implementation-data-type=uint8, type-emitter=RTE
