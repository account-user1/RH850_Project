AUTOSAR XML (schema 4-0-3)
standard types defined: boolean, uint16, uint32, uint8, boolean_CompuMethod, boolean_DataConstr, uint16_DataConstr, uint32_DataConstr, uint8_DataConstr
package /DataType/Unit
  unit U_mYsX2: display-name=m/s^2, factor-si-to-unit=1, offset-si-to-unit=0
  unit U_Nm: display-name=Nm, factor-si-to-unit=1, offset-si-to-unit=0
package /Ford/DataTypes
  impl type Ford_BrkTot_Tq_Actl: category=VALUE, base-type=DataType/uint16, sw-calibration-access=READ-ONLY, compu {8190=Cx1FFE_Unknown, 8191=Cx1FFF_Fault, phys=raw*4 for raw 0..8191; unit Nm} "Source signal range: [0,8189]", range raw 0..8191
  impl type Ford_VehVertComp_A_Actl: category=VALUE, base-type=DataType/uint16, sw-calibration-access=READ-ONLY, compu {1022=Cx3FE_NoDataExists, 1023=Cx3FF_Fault, phys=raw*0.035-17.9 for raw 0..1023; unit m/s^2} "Source signal range: [0,1021]", range raw 0..1023
package /Nexteer/DataTypes
  impl type NtcNr1: compu {1..511=NTCNR_0X001..NTCNR_0X1FF}, implementation-data-type=uint16, type-emitter=RTE
  impl type NtcSts1: compu {0=NTCSTS_PASSD, 1=NTCSTS_FAILD, 2=NTCSTS_PREPASSD, 3=NTCSTS_PREFAILD}, implementation-data-type=ImplementationDataTypes/uint8, type-emitter=RTE
