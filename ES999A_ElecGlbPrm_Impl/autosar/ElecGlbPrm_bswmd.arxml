AUTOSAR XML (schema 4-0-3)
package /Nexteer
  module definition ElecGlbPrm [0..1]: variants pre-compile  # Configuration of the Electrical Global Paramters.
    container ElecGlbPrmCfg  # This is the container for the Electrical Gloabl paramters which are configurable
      integer InverterCount: 1..2, origin=NEXTEER, default-value=1  # Number of invereters in the system.
      integer MotCtrlInterTrigSrc: 0x00..0xFF, origin=NEXTEER, default-value=0  # This signal allows a configuration of the type of MotCtrlISR source The thought here is that various FDDs may be affected by this decision so its setting is of a global nature. Via implementation the expected setting is ELECGLBPRM_MOTCTRLINTRPTTRIGSRC_CNT_U08 = ELECGLBPRM_MOTCTRLINTRPTTRIGCFGx_CNT_U08.
      integer PwmFreqMax: 14000..22000, origin=NEXTEER, default-value=18000  # Maximum PWM Frequency - High end of PWM frequency dither range.
      integer PwmFreqMin: 14000..22000, origin=NEXTEER, default-value=14000  # Minimum PWM Frequency - Low end of PWM frequency dither range.
      integer PwmPerdMax: 45454..71429, origin=NEXTEER, default-value=71429  # Maximum PWM period in units of NanoSec.
      integer PwmPerdMin: 45454..71429, origin=NEXTEER, default-value=55555  # Minimum PWM period in units of NanoSec.
      float PwmPerdNomX2 [0..1]: 9.09090909e-05..0.0001428571429, set at pre-compile, default-value=0.000125  # Motor Control ISR Period Nominal Times 2 - This constant is 2 times ELECGLBPRM_PWMPERDNOM_MICROSEC_U7P9 in second.
      float PwmPerdNom: 45.45454545..71.42857143, origin=NEXTEER, default-value=62.5  # Pwm Period Nominal in units of MicroSec.
      integer HwTqSnsrTickCnt: 1..128, origin=NEXTEER, default-value=17  # Number of SENT ticks for the HwTq Sensor. This value is used in the RSENTnSPCT register. Note that the value here should be subtracted by 1 before being written to the register .
      boolean HwAgIfLtchEna: origin=NEXTEER, default-value=0  # Handwheel Angle Interface Latch Enable .
