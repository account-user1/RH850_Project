AUTOSAR XML (schema 4-0-3)
package /Nexteer
  module definition HwTqCorrln [0..1]: variants pre-compile  # Configuration of the HwTqCorrln.
    container HwTqCorrlnGeneral  # This container contains the configuration (parameters) of the HwTqCorrln.
      enumeration NTC_HwTqACorrlnFlt: {NTCNR_0X070, NTCNR_0X071, NTCNR_0X072, NTCNR_0X073, NTCNR_0X074, NTCNR_0X075, NTCNR_0X076, NTCNR_0X077, NTCNR_0X078, NTCNR_0X079, NTCNR_0X07A}, set at pre-compile, origin=Nexteer, default-value=NTCNR_0X070  # .
      enumeration NTC_HwTqBCorrlnFlt: {NTCNR_0X070, NTCNR_0X071, NTCNR_0X072, NTCNR_0X073, NTCNR_0X074, NTCNR_0X075, NTCNR_0X076, NTCNR_0X077, NTCNR_0X078, NTCNR_0X079, NTCNR_0X07A}, set at pre-compile, origin=Nexteer, default-value=NTCNR_0X071  # .
      enumeration NTC_HwTqCCorrlnFlt: {NTCNR_0X070, NTCNR_0X071, NTCNR_0X072, NTCNR_0X073, NTCNR_0X074, NTCNR_0X075, NTCNR_0X076, NTCNR_0X077, NTCNR_0X078, NTCNR_0X079, NTCNR_0X07A}, set at pre-compile, origin=Nexteer, default-value=NTCNR_0X072  # .
      enumeration NTC_HwTqDCorrlnFlt: {NTCNR_0X070, NTCNR_0X071, NTCNR_0X072, NTCNR_0X073, NTCNR_0X074, NTCNR_0X075, NTCNR_0X076, NTCNR_0X077, NTCNR_0X078, NTCNR_0X079, NTCNR_0X07A}, set at pre-compile, origin=Nexteer, default-value=NTCNR_0X073  # .
