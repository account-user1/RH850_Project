AUTOSAR XML (schema 4-0-3)
standard types defined: float32, uint8, float32_DataConstr, uint8_DataConstr, boolean, uint16
package /DataType/Unit
  4 x unit, all with factor-si-to-unit=1, offset-si-to-unit=0:
    U_degrees: display-name=degrees
    U_SED: display-name=SED
    unitless: display-name=unitless
    Unitless: display-name=Unitless
package /Ford/DataTypes
  6 x impl type, all with category=VALUE, sw-calibration-access=READ-ONLY:
    Ford_StePinAn_No_Cnt: base-type=DataType/uint8, compu {phys=raw for raw 0..15; unit unitless}, range raw 0..15
    Ford_StePinAn_No_Cs: base-type=DataType/uint8, compu {phys=raw for raw 0..255; unit Unitless}
    Ford_StePinComp_An_Est: base-type=uint16, compu {phys=raw*0.1-1600 for raw 0..32766; unit degrees}, range raw 0..32767
    Ford_StePinCompAnEst_D_Qf: base-type=DataType/uint8, compu {phys=raw for raw 0..3, 0=Cx0_Faulty, 1=Cx1_No_Data_Exists, 2=Cx2_Degraded, 3=Cx3_OK; unit SED}, range raw 0..3
    Ford_StePinRelInit_An_Sns: base-type=uint16, compu {65534=CxFFFE_NoDataExists, 65535=CxFFFF_Faulty, phys=raw*0.1-3200 for raw 0..65535; unit degrees} "Source signal range: [0,65533]"
    Ford_StePw_B_Rq: base-type=boolean, compu {phys=raw for raw 0..1, 0=Cx0_No, 1=Cx1_Yes; unit SED}
