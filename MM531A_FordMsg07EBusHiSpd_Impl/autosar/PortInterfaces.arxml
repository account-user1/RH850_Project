AUTOSAR XML (schema 4-0-3)
package /Ford/PortInterfaces
  6 x sender receiver interface:
    Ford_StePinAn_No_Cnt: invalidation-policy{data-element=Ford_StePinAn_No_Cnt, handle-invalid=DONT-INVALIDATE}
      data Ford_StePinAn_No_Cnt: sw-calibration-access=READ-ONLY, type=Ford_StePinAn_No_Cnt
    Ford_StePinAn_No_Cs: invalidation-policy{data-element=Ford_StePinAn_No_Cs, handle-invalid=DONT-INVALIDATE}
      data Ford_StePinAn_No_Cs: sw-calibration-access=READ-ONLY, type=Ford_StePinAn_No_Cs
    Ford_StePinComp_An_Est: invalidation-policy{data-element=Ford_StePinComp_An_Est, handle-invalid=DONT-INVALIDATE}
      data Ford_StePinComp_An_Est: sw-calibration-access=READ-ONLY, type=Ford_StePinComp_An_Est
    Ford_StePinCompAnEst_D_Qf: invalidation-policy{data-element=Ford_StePinCompAnEst_D_Qf, handle-invalid=DONT-INVALIDATE}
      data Ford_StePinCompAnEst_D_Qf: sw-calibration-access=READ-ONLY, type=Ford_StePinCompAnEst_D_Qf
    Ford_StePinRelInit_An_Sns: invalidation-policy{data-element=Ford_StePinRelInit_An_Sns, handle-invalid=DONT-INVALIDATE}
      data Ford_StePinRelInit_An_Sns: sw-calibration-access=READ-ONLY, type=Ford_StePinRelInit_An_Sns
    Ford_StePw_B_Rq: invalidation-policy{data-element=Ford_StePw_B_Rq, handle-invalid=DONT-INVALIDATE}
      data Ford_StePw_B_Rq: sw-calibration-access=READ-ONLY, type=Ford_StePw_B_Rq
package /Nexteer/PortInterfaces
  sender receiver interface float32_PortIf1: invalidation-policy{data-element=Val, handle-invalid=DONT-INVALIDATE}
    data Val: sw-calibration-access=READ-ONLY, type=float32
