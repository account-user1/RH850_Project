AUTOSAR XML (schema 4-0-3)
standard types defined: boolean, uint16, uint32, uint8, boolean_CompuMethod, boolean_DataConstr, uint16_DataConstr, uint32_DataConstr, uint8_DataConstr
package /DataType/Unit
  unit U_SED: display-name=SED, factor-si-to-unit=1, offset-si-to-unit=0
package /Ford/DataTypes
  impl type Ford_GearLvrPos_D_Actl:
    category=VALUE
    base-type=DataType/uint8
    sw-calibration-access=READ-ONLY
    compu {phys=raw for raw 0..15, 0=Cx0_Park, 1=Cx1_Reverse, 2=Cx2_Neutral, 3=Cx3_Drive, 4=Cx4_Sport_DriveSport, 5=Cx5_Low, 6=Cx6_first, 7=Cx7_second, 8=Cx8_third, 9=Cx9_fourth, 10=CxA_fifth, 11=CxB_sixth, 12=CxC_Undefined_Treat_as_Fault, 13=CxD_Undefined_Treat_as_Fault (Undefined_Treat_as__Fault), 14=CxE_Unknown_Position, 15=CxF_Fault; unit SED}
    range raw 0..15
package /Nexteer/DataTypes
  impl type NtcNr1: compu {1..511=NTCNR_0X001..NTCNR_0X1FF}, implementation-data-type=uint16, type-emitter=RTE
  impl type NtcSts1: compu {0=NTCSTS_PASSD, 1=NTCSTS_FAILD, 2=NTCSTS_PREPASSD, 3=NTCSTS_PREFAILD}, implementation-data-type=uint8, type-emitter=RTE
