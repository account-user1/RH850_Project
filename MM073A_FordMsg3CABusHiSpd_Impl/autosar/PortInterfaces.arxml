AUTOSAR XML (schema 4-0-3)
package /Ford/PortInterfaces
  6 x sender receiver interface:
    Ford_LaCurvature_No_Calc: invalidation-policy{data-element=Ford_LaCurvature_No_Calc, handle-invalid=DONT-INVALIDATE}
      data Ford_LaCurvature_No_Calc: sw-calibration-access=READ-ONLY, type=Ford_LaCurvature_No_Calc
    Ford_LaRampType_B_Req: invalidation-policy{data-element=Ford_LaRampType_B_Req, handle-invalid=DONT-INVALIDATE}
      data Ford_LaRampType_B_Req: sw-calibration-access=READ-ONLY, type=Ford_LaRampType_B_Req
    Ford_LaRefAng_No_Req: invalidation-policy{data-element=Ford_LaRefAng_No_Req, handle-invalid=DONT-INVALIDATE}
      data Ford_LaRefAng_No_Req: sw-calibration-access=READ-ONLY, type=Ford_LaRefAng_No_Req
    Ford_LdwActvIntns_D_Req: invalidation-policy{data-element=Ford_LdwActvIntns_D_Req, handle-invalid=DONT-INVALIDATE}
      data Ford_LdwActvIntns_D_Req: sw-calibration-access=READ-ONLY, type=Ford_LdwActvIntns_D_Req
    Ford_LdwActvStats_D_Req: invalidation-policy{data-element=Ford_LdwActvStats_D_Req, handle-invalid=DONT-INVALIDATE}
      data Ford_LdwActvStats_D_Req: sw-calibration-access=READ-ONLY, type=Ford_LdwActvStats_D_Req
    Ford_LkaActvStats_D2_Req: invalidation-policy{data-element=Ford_LkaActvStats_D2_Req, handle-invalid=DONT-INVALIDATE}
      data Ford_LkaActvStats_D2_Req: sw-calibration-access=READ-ONLY, type=Ford_LkaActvStats_D2_Req
package /Nexteer/Calibrations
  parameter interface uint16_CalPortIf1
    parameter data prototype Val: sw-calibration-access=READ-WRITE, type=uint16
package /Nexteer/PortInterfaces
  client server interface GetRefTmr100MicroSec32bit_PortIf1
    operation Oper
      arg RefTmr_Arg: type=uint32, direction=OUT, server-argument-impl-policy=USE-ARGUMENT-TYPE
  client server interface GetTiSpan100MicroSec32bit_PortIf1
    operation Oper
      arg RefTmr_Arg: type=uint32, direction=IN, server-argument-impl-policy=USE-ARGUMENT-TYPE
      arg TiSpan_Arg: type=uint32, direction=OUT, server-argument-impl-policy=USE-ARGUMENT-TYPE
  client server interface SetNtcSts_PortIf1
    operation Oper: possible-error=E_NOT_OK
      4 x arg, all with direction=IN, server-argument-impl-policy=USE-ARGUMENT-TYPE:
        NtcNr_Arg: type=NtcNr1
        NtcStInfo_Arg: type=uint8
        NtcSts_Arg: type=NtcSts1
        DebStep_Arg: type=uint16
    error E_NOT_OK: error-code=1
  4 x sender receiver interface:
    boolean_PortIf1: invalidation-policy{data-element=Logl, handle-invalid=DONT-INVALIDATE}
      data Logl: sw-calibration-access=READ-ONLY, type=boolean
    float32_PortIf1: invalidation-policy{data-element=float32_PortIf1/Val, handle-invalid=DONT-INVALIDATE}
      data Val: sw-calibration-access=READ-ONLY, type=float32
    uint16_PortIf1: invalidation-policy{data-element=uint16_PortIf1/Val, handle-invalid=DONT-INVALIDATE}
      data Val: sw-calibration-access=READ-ONLY, type=uint16
    uint8_PortIf1: invalidation-policy{data-element=uint8_PortIf1/Val, handle-invalid=DONT-INVALIDATE}
      data Val: sw-calibration-access=READ-ONLY, type=uint8
