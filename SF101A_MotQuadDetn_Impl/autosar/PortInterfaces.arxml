AUTOSAR XML (schema 4-0-3)
package /Nexteer/Calibrations
  parameter interface s18p13_CalPortIf1
    parameter data prototype Val: sw-calibration-access=READ-WRITE, type=s18p13
package /Nexteer/PortInterfaces
  4 x sender receiver interface:
    float32_PortIf1: invalidation-policy{data-element=float32_PortIf1/Val, handle-invalid=DONT-INVALIDATE}
      data Val: sw-calibration-access=READ-ONLY, type=float32
    MotQuad1_PortIf1: invalidation-policy{data-element=MotQuad1_PortIf1/Val, handle-invalid=DONT-INVALIDATE}
      data Val: sw-calibration-access=READ-ONLY, type=MotQuad1
    s18p13_PortIf1: invalidation-policy{data-element=s18p13_PortIf1/Val, handle-invalid=DONT-INVALIDATE}
      data Val: sw-calibration-access=READ-ONLY, type=s18p13
    sint8_PortIf1: invalidation-policy{data-element=sint8_PortIf1/Val, handle-invalid=DONT-INVALIDATE}
      data Val: sw-calibration-access=READ-ONLY, type=sint8
