AUTOSAR XML (schema 4-0-3)
package /Nexteer/NvMProxy_swc/Interfaces
  client server interface NvMService_AC3_SRBS: is-service=true
    6 x operation, all with possible-error=NvMService_AC3_SRBS/E_NOT_OK:
      EraseBlock
      GetErrorStatus
        arg ErrorStatus: type=NvM_RequestResultType, direction=OUT
      InvalidateNvBlock
      ReadBlock
        arg DstPtr: type=dtRef_VOID, direction=IN
      SetRamBlockStatus
        arg RamBlockStatus: type=Boolean, direction=IN
      WriteBlock
        arg SrcPtr: type=dtRef_const_VOID, direction=IN
    error E_NOT_OK: error-code=1
package /Nexteer/PortInterfaces
  5 x client server interface:
    NxtrSwIdsPsrInfoRd_PortIf1
      operation Oper: possible-error=NxtrSwIdsPsrInfoRd_PortIf1/E_NOT_OK
        arg PsrId: type=uint32, direction=OUT
        arg PsrRev: type=uint8, direction=OUT
      error E_NOT_OK: error-code=1
    NxtrSwIdsSwBuildDateTiRd_PortIf1
      operation Oper
        arg SwBuildDateTi: type=Ary1D_u8_20, direction=OUT
    NxtrSwIdsSwRelInfoRd_PortIf1
      operation Oper
        arg SwOrigin: type=uint8, direction=OUT
        arg SwAuthor: type=Ary1D_u8_6, direction=OUT
    NxtrSwIdsSwRelNrRd_PortIf1
      operation Oper
        arg SwRelNr: type=Ary1D_u8_16, direction=OUT
    NxtrSwIdsSwRelVerRd_PortIf1
      operation Oper
        arg SwRelVer: type=Ary1D_u8_16, direction=OUT
