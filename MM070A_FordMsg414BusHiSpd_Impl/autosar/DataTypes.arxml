AUTOSAR XML (schema 4-0-3)
standard types defined: boolean, float32, uint16, uint32, uint8, boolean_CompuMethod, boolean_DataConstr, float32_DataConstr, uint16_DataConstr, uint32_DataConstr, uint8_DataConstr
package /DataType/Unit
  4 x unit, all with factor-si-to-unit=1, offset-si-to-unit=0:
    U_Degrees: display-name=Degrees
    U_SED: display-name=SED
    unitless: display-name=unitless
    Unitless: display-name=Unitless
package /Ford/DataTypes
  4 x impl type, all with category=VALUE, sw-calibration-access=READ-ONLY:
    Ford_StePinOffst_An_Est: base-type=DataType/uint16, compu {65534=CxFFFE_NoDataExists, 65535=CxFFFF_Faulty, phys=raw*0.1-3200 for raw 0..65535; unit Degrees} "Source signal range: [0,65533]"
    Ford_StePinOffst_D_Stat: base-type=DataType/uint8, compu {phys=raw for raw 0..3, 0=Cx0_OffsetNotCalculated, 1=Cx1_StoredOffset, 2=Cx2_CoarseOffset, 3=Cx3_FineOffset; unit SED}, range raw 0..3
    Ford_StePinOffst_No_Cnt: base-type=DataType/uint8, compu {phys=raw for raw 0..15; unit unitless}, range raw 0..15
    Ford_StePinOffst_No_Cs: base-type=DataType/uint8, compu {phys=raw for raw 0..255; unit Unitless}
