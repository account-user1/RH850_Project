AUTOSAR XML (schema 4-0-3)
# COPYRIGHT
# Copyright (c) 2016 by Vector Informatik GmbH. All rights reserved.
# This software is copyright protected and proprietary to Vector Informatik GmbH.
# Vector Informatik GmbH grants to you only those rights as set out in the license conditions.
package /MICROSAR  # Xcp Preconfiguration
  module config Xcp_Pre: definition=Xcp
  module config Xcp_Rec: definition=Xcp, implementation-config-variant=VARIANT-PRE-COMPILE
