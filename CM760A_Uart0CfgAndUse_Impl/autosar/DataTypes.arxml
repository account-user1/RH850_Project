AUTOSAR XML (schema 4-0-3)
standard types defined: uint16, uint16_DataConstr, uint32_DataConstr, uint8_DataConstr, uint32, uint8
package /Nexteer/DataTypes
  4 x impl type:
    Ary1D_u8_2048_Uart0CfgAndUse: category=ARRAY, sw-calibration-access=READ-ONLY, type-emitter=Uart0CfgAndUse
      element Element: array-size=2048, array-size-semantics=FIXED-SIZE, implementation-data-type=uint8
    Ary1D_u8_8: category=ARRAY, sw-calibration-access=READ-ONLY, type-emitter=RTE  # OBSOLETE
      element Element: array-size=8, array-size-semantics=FIXED-SIZE, implementation-data-type=uint8
    ImcArbnRxDataSrc1: implementation-data-type=ImcArbnRxDataSrc2, type-emitter=RTE
    ImcArbnRxDataSrc2: implementation-data-type=uint8, type-emitter=ImcArbn
