AUTOSAR XML (schema 4-0-3)
package /Nexteer/PortInterfaces
  client server interface GetTxRateGroup_PortIf1
    operation Oper: possible-error=GetTxRateGroup_PortIf1/E_NOT_OK
      arg RateGroup_Arg: type=uint8, direction=IN, server-argument-impl-policy=USE-ARGUMENT-TYPE
      arg Buf_Arg: type=uint8, direction=OUT, server-argument-impl-policy=USE-ARGUMENT-TYPE
    error E_NOT_OK: error-code=1
  client server interface SetRxSigGroup_PortIf1
    operation Oper: possible-error=SetRxSigGroup_PortIf1/E_NOT_OK
      arg SigGroup_Arg: type=uint8, direction=IN, server-argument-impl-policy=USE-ARGUMENT-TYPE
      arg DataSrc_Arg: type=ImcArbnRxDataSrc1, direction=IN, server-argument-impl-policy=USE-ARGUMENT-TYPE
      arg Buf_Arg: type=Ary1D_u8_8, direction=IN, server-argument-impl-policy=USE-ARGUMENT-TYPE
    error E_NOT_OK: error-code=1
