AUTOSAR XML (schema 4-0-3)
package /Nexteer/Calibrations
  4 x parameter interface:
    Ary1D_u8_48_CalPortIf1
      parameter data prototype Ary1D: sw-calibration-access=READ-WRITE, type=Ary1D_u8_48
    Ary1D_u8_6_CalPortIf1
      parameter data prototype Ary1D: sw-calibration-access=READ-WRITE, type=Ary1D_u8_6
    uint32_CalPortIf1
      parameter data prototype Val: sw-calibration-access=READ-WRITE, type=uint32
    uint8_CalPortIf1
      parameter data prototype Val: sw-calibration-access=READ-WRITE, type=uint8
package /Nexteer/NvMProxy_swc/Interfaces
  client server interface NvMService_AC3_SRBS: is-service=true
    6 x operation, all with possible-error=NvMService_AC3_SRBS/E_NOT_OK:
      EraseBlock
      GetErrorStatus
        arg ErrorStatus: type=NvM_RequestResultType, direction=OUT, server-argument-impl-policy=USE-ARGUMENT-TYPE
      InvalidateNvBlock
      ReadBlock
        arg DstPtr: type=dtRef_VOID, direction=IN, server-argument-impl-policy=USE-ARGUMENT-TYPE
      SetRamBlockStatus
        arg RamBlockStatus: type=Boolean, direction=IN, server-argument-impl-policy=USE-ARGUMENT-TYPE
      WriteBlock
        arg SrcPtr: type=dtRef_const_VOID, direction=IN, server-argument-impl-policy=USE-ARGUMENT-TYPE
    error E_NOT_OK: error-code=1
package /Nexteer/PortInterfaces
  client server interface NxtrCalIdsCalDevlpRd_PortIf1
    operation Oper: possible-error=NxtrCalIdsCalDevlpRd_PortIf1/E_NOT_OK
      5 x arg, all with server-argument-impl-policy=USE-ARGUMENT-TYPE:
        CalRegn: type=uint8, direction=IN
        CalAuthor: type=Ary1D_u8_6, direction=OUT
        CalVers: type=uint8, direction=OUT
        CalTiStamp: type=uint32, direction=OUT
        CalDescr: type=Ary1D_u8_48, direction=OUT
    error E_NOT_OK: error-code=1
  client server interface NxtrCalIdsCalRelRd_PortIf1
    operation Oper
      arg CalRegn: type=uint8, direction=IN, server-argument-impl-policy=USE-ARGUMENT-TYPE
      arg RelNr: type=uint32, direction=OUT, server-argument-impl-policy=USE-ARGUMENT-TYPE
      arg RelSt: type=uint8, direction=OUT, server-argument-impl-policy=USE-ARGUMENT-TYPE
