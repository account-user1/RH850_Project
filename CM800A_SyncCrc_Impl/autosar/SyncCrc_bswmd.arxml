AUTOSAR XML (schema 4-0-3)
package /Nexteer/EcucDefs_SyncCrc
  ecuc definition collection NexteerParameterDefinition_SyncCrc: module=SyncCrc
  module definition SyncCrc [0..1]: category=VENDOR_SPECIFIC_MODULE_DEFINITION, refined-module-def=SyncCrc, variants pre-compile  # Settings for the synchronous CRC component
    container SyncCrcCommon  # Contains the common settings for SyncCrc.
      enumeration DeviceType: {P1x, P1M-C, P1M-E, P1H-C, P1H-CE, P1L-C}, origin=NEXTEER, default-value=P1x  # Selects the device that is being used for the project. Based on the selection, the number of CRC hardware units available are defined below: P1x: 4 Units P1M-C: 4 Units P1M-E: 4 Units P1H-C: 8 Units P1H-CE: 8 Units P1L-C: 2 Units
      integer ReservedCRCHardwareUnits: 0..8, set at pre-compile, origin=NEXTEER, default-value=0  # Sets the number of hardware units that are reserved from the application for dedication functions.
      enumeration AutosarWrapperEnable: {STD_OFF, STD_ON}, origin=NEXTEER, default-value=STD_OFF  # Enables the AUTOSAR function wrapper so the hardware can be used instead of the software libraries.
      symbolic name reference CrcOsApplicationReference: destination=OsApplication  # CrC Os Application Reference | This defines the application in which the Crc component is integrated.
  bsw implementation SyncCrc_Impl: programming-language=C, sw-version=5.0.0, used-code-generator=cMICROSAR, vendor-id=30, ar-release-version=4.2.0, preconfigured-configuration=SyncCrc_Pre, recommended-configuration=SyncCrc_Rec, vendor-specific-module-def=SyncCrc
  module config SyncCrc_Rec: definition=SyncCrc
