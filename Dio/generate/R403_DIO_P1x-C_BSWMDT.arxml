AUTOSAR XML (schema 4-0-3)
# COPYRIGHT
# Copyright(c) 2015-2017  Renesas Electronics Corporation
package /Renesas/EcucDefs_Dio
  bsw implementation Dio_Impl: programming-language=C, sw-version=1.0.4, vendor-id=59, ar-release-version=4.0.3, behavior=BswInternalBehavior_0, vendor-api-infix=Renesas
    code-descriptors:
      code Dio_Code: artifact-descriptors=autosar-engineering-object={short-label=artifactDescriptor, category=artifactDescriptorCategory}
    resource consumption ResourceConsumption
      memory section CODE: sw-addrmethod=CODE
  bsw module description Dio: module-id=120
    provided-entrys:
      Dio_ReadChannel
      Dio_WriteChannel
      Dio_ReadPort
      Dio_WritePort
      Dio_ReadChannelGroup
      Dio_WriteChannelGroup
      Dio_Init
      Dio_FlipChannel
      Dio_GetVersionInfo
      Dio_MaskedWritePort
    bsw internal behavior BswInternalBehavior_0
      exclusive area DIO_REGISTER_PROTECTION
      10 x bsw called entity:
        BswCalledEntity_0: implemented-entry=Dio_ReadChannel
        BswCalledEntity_1: can-enter-exclusive-area=DIO_REGISTER_PROTECTION, implemented-entry=Dio_WriteChannel
        BswCalledEntity_2: implemented-entry=Dio_ReadPort
        BswCalledEntity_3: can-enter-exclusive-area=DIO_REGISTER_PROTECTION, implemented-entry=Dio_WritePort
        BswCalledEntity_4: implemented-entry=Dio_ReadChannelGroup
        BswCalledEntity_5: can-enter-exclusive-area=DIO_REGISTER_PROTECTION, implemented-entry=Dio_WriteChannelGroup
        BswCalledEntity_6: implemented-entry=Dio_Init
        BswCalledEntity_7: can-enter-exclusive-area=DIO_REGISTER_PROTECTION, implemented-entry=Dio_FlipChannel
        BswCalledEntity_8: implemented-entry=Dio_GetVersionInfo
        BswCalledEntity_9: can-enter-exclusive-area=DIO_REGISTER_PROTECTION, implemented-entry=Dio_MaskedWritePort
  10 x bsw module entry, all with is-synchronous=true, call-type=REGULAR, execution-context=TASK, sw-service-impl-policy=STANDARD:
    Dio_ReadChannel: service-id=0, is-reentrant=true
    Dio_WriteChannel: service-id=1, is-reentrant=true
    Dio_ReadPort: service-id=2, is-reentrant=true
    Dio_WritePort: service-id=3, is-reentrant=true
    Dio_ReadChannelGroup: service-id=4, is-reentrant=true
    Dio_WriteChannelGroup: service-id=5, is-reentrant=true
    Dio_Init: service-id=16, is-reentrant=false
    Dio_FlipChannel: service-id=17, is-reentrant=true
    Dio_GetVersionInfo: service-id=18, is-reentrant=true
    Dio_MaskedWritePort: service-id=19, is-reentrant=true
