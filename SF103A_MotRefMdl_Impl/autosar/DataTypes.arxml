AUTOSAR XML (schema 4-0-3)
standard types defined: boolean, dtRef_const_VOID, dtRef_VOID, float32, float64, sint16, sint16_least, sint32, sint32_least, sint64, sint8, sint8_least, uint16, uint16_least, uint32, uint32_least, uint64, uint8, uint8_least, boolean_CompuMethod, boolean_DataConstr, float32_DataConstr, float64_DataConstr, sint16_DataConstr, sint16_least_DataConstr, sint32_DataConstr, sint32_least_DataConstr, sint64_DataConstr, sint8_DataConstr, sint8_least_DataConstr, uint16_DataConstr, uint16_least_DataConstr, uint32_DataConstr, uint32_least_DataConstr, uint64_DataConstr, uint8_DataConstr, uint8_least_DataConstr
package /Nexteer/DataTypeMappingSets
  data type mapping set Nexteer
    data-type-maps:
      application-data-type=A{1..5}, implementation-data-type=PlatformTypes/float32
      application-data-type=Ag1, implementation-data-type=PlatformTypes/float32
      application-data-type=Ag{10..17}, implementation-data-type=PlatformTypes/float32
      application-data-type=Ag18, implementation-data-type=u12p4
      application-data-type=Ag19, implementation-data-type=PlatformTypes/float32
      application-data-type=Ag2, implementation-data-type=PlatformTypes/float32
      application-data-type=Ag3, implementation-data-type=PlatformTypes/float32
      application-data-type=Ag4, implementation-data-type=s2p13
      application-data-type=Ag5, implementation-data-type=u0p16
      application-data-type=Ag6, implementation-data-type=s18p13
      application-data-type=Ag7, implementation-data-type=s18p13
      application-data-type=Ag8, implementation-data-type=s15p16
      application-data-type=Ag9, implementation-data-type=u0p16
      application-data-type=AgAry1D1, implementation-data-type=Ary1D_s2p13_1024
      application-data-type=AgAry1D2, implementation-data-type=Ary1D_u0p16_8
      application-data-type=AgAry1D3, implementation-data-type=Ary1D_s2p13_1025
      application-data-type=AgAry1D4, implementation-data-type=Ary1D_f32_8
      application-data-type=AgAry1D5, implementation-data-type=Ary1D_u12p4_16
      application-data-type=AgAry2D1, implementation-data-type=Ary2D_u12p4_9_16
      application-data-type=Cnt1, implementation-data-type=PlatformTypes/uint8
      application-data-type=Cnt10, implementation-data-type=PlatformTypes/uint16
      application-data-type=Cnt11, implementation-data-type=PlatformTypes/uint16
      application-data-type=Cnt{12..14}, implementation-data-type=PlatformTypes/uint8
      application-data-type=Cnt15, implementation-data-type=PlatformTypes/uint32
      application-data-type=Cnt16, implementation-data-type=PlatformTypes/uint16
      application-data-type=Cnt17, implementation-data-type=PlatformTypes/uint32
      application-data-type=Cnt18, implementation-data-type=PlatformTypes/uint8
      application-data-type=Cnt19, implementation-data-type=PlatformTypes/uint8
      application-data-type=Cnt2, implementation-data-type=PlatformTypes/sint8
      application-data-type=Cnt20, implementation-data-type=PlatformTypes/sint16
      application-data-type=Cnt21, implementation-data-type=PlatformTypes/uint8
      application-data-type=Cnt22, implementation-data-type=PlatformTypes/uint8
      application-data-type=Cnt23, implementation-data-type=u16p0
      application-data-type=Cnt24, implementation-data-type=PlatformTypes/uint8
      application-data-type=Cnt25, implementation-data-type=PlatformTypes/uint8
      application-data-type=Cnt26, implementation-data-type=u16p0
      application-data-type=Cnt{27..29}, implementation-data-type=PlatformTypes/uint8
      application-data-type=Cnt3, implementation-data-type=PlatformTypes/uint16
      application-data-type=Cnt30, implementation-data-type=PlatformTypes/uint8
      application-data-type=Cnt31, implementation-data-type=PlatformTypes/uint16
      application-data-type=Cnt32, implementation-data-type=PlatformTypes/float32
      application-data-type=Cnt33, implementation-data-type=PlatformTypes/uint8
      application-data-type=Cnt34, implementation-data-type=PlatformTypes/float32
      application-data-type=Cnt35, implementation-data-type=PlatformTypes/sint16
      application-data-type=Cnt4, implementation-data-type=PlatformTypes/uint16
      application-data-type=Cnt5, implementation-data-type=PlatformTypes/uint16
      application-data-type=Cnt6, implementation-data-type=PlatformTypes/uint8
      application-data-type=Cnt7, implementation-data-type=PlatformTypes/uint8
      application-data-type=Cnt8, implementation-data-type=PlatformTypes/uint32
      application-data-type=Cnt9, implementation-data-type=PlatformTypes/uint16
      application-data-type=CntAry1D1, implementation-data-type=Ary1D_u16p0_2
      application-data-type=CntAry1D2, implementation-data-type=Ary1D_u32_8
      application-data-type=CntAry1D3, implementation-data-type=Ary1D_u16_257
      application-data-type=CntAry1D4, implementation-data-type=Ary1D_u16p0_2
      application-data-type=CntAry1D5, implementation-data-type=Ary1D_u8_22
      application-data-type=CntAry1D6, implementation-data-type=Ary1D_s16_22
      application-data-type=Curr{1..7}, implementation-data-type=PlatformTypes/float32
      application-data-type=Curr8, implementation-data-type=u9p7
      application-data-type=Curr9, implementation-data-type=PlatformTypes/float32
      application-data-type=CurrAry1D1, implementation-data-type=Ary1D_u9p7_16
      application-data-type=CurrAry1D2, implementation-data-type=Ary1D_u9p7_6
      application-data-type=CurrAry1D3, implementation-data-type=Ary1D_u9p7_7
      application-data-type=CurrSqd1, implementation-data-type=PlatformTypes/float32
      application-data-type=Frq1, implementation-data-type=PlatformTypes/float32
      application-data-type=Frq10, implementation-data-type=PlatformTypes/float32
      application-data-type=Frq2, implementation-data-type=PlatformTypes/float32
      application-data-type=Frq3, implementation-data-type=u10p6
      application-data-type=Frq4, implementation-data-type=u10p6
      application-data-type=Frq5, implementation-data-type=u9p7
      application-data-type=Frq6, implementation-data-type=u9p7
      application-data-type=Frq{7..9}, implementation-data-type=PlatformTypes/float32
      application-data-type=FrqAry1D1, implementation-data-type=Ary1D_u10p6_4
      application-data-type=FrqAry1D2, implementation-data-type=Ary1D_u10p6_4
      application-data-type=FrqAry1D3, implementation-data-type=Ary1D_u9p7_4
      application-data-type=FrqAry1D4, implementation-data-type=Ary1D_u9p7_4
      application-data-type=Gain{1..8}, implementation-data-type=PlatformTypes/float32
      application-data-type=HwAgOffsRecAppl1, implementation-data-type=HwAgOffsRec1
      application-data-type=Indu1, implementation-data-type=PlatformTypes/float32
      application-data-type=Indu2, implementation-data-type=PlatformTypes/float32
      application-data-type=Logl1, implementation-data-type=PlatformTypes/boolean
      application-data-type=MotCon1, implementation-data-type=PlatformTypes/float32
      application-data-type=MotPrmNomEolRecAppl2, implementation-data-type=MotPrmNomEolRec2
      application-data-type=MotPrmNomEolRecAppl3, implementation-data-type=MotPrmNomEolRec3
      application-data-type=R{1..8}, implementation-data-type=PlatformTypes/float32
      application-data-type=Rate1, implementation-data-type=PlatformTypes/float32
      application-data-type=Rate10, implementation-data-type=PlatformTypes/float32
      application-data-type=Rate{2..9}, implementation-data-type=PlatformTypes/float32
      application-data-type=Spd1, implementation-data-type=PlatformTypes/float32
      application-data-type=Spd2, implementation-data-type=u9p7
      application-data-type=Spd3, implementation-data-type=PlatformTypes/float32
      application-data-type=Spd4, implementation-data-type=PlatformTypes/float32
      application-data-type=SpdAry1D1, implementation-data-type=Ary1D_u9p7_12
      application-data-type=SpdAry1D2, implementation-data-type=Ary1D_u9p7_9
      application-data-type=T{1..5}, implementation-data-type=PlatformTypes/float32
      application-data-type=T6, implementation-data-type=s11p4
      application-data-type=T7, implementation-data-type=s8p7
      application-data-type=T8, implementation-data-type=PlatformTypes/float32
      application-data-type=TAry1D1, implementation-data-type=Ary1D_s11p4_14
      application-data-type=TAry1D2, implementation-data-type=Ary1D_s8p7_14
      application-data-type=Ti1, implementation-data-type=PlatformTypes/uint32
      application-data-type=Ti{10..12}, implementation-data-type=PlatformTypes/float32
      application-data-type=Ti{2..6}, implementation-data-type=PlatformTypes/uint32
      application-data-type=Ti7, implementation-data-type=PlatformTypes/float32
      application-data-type=Ti8, implementation-data-type=PlatformTypes/float32
      application-data-type=Ti9, implementation-data-type=PlatformTypes/uint32
      application-data-type=Tq1, implementation-data-type=PlatformTypes/float32
      application-data-type=Tq10, implementation-data-type=PlatformTypes/float32
      application-data-type=Tq11, implementation-data-type=s4p11
      application-data-type=Tq12, implementation-data-type=u5p11
      application-data-type=Tq13, implementation-data-type=u4p12
      application-data-type=Tq14, implementation-data-type=u5p11
      application-data-type=Tq{15..19}, implementation-data-type=PlatformTypes/float32
      application-data-type=Tq2, implementation-data-type=PlatformTypes/float32
      application-data-type=Tq3, implementation-data-type=PlatformTypes/float32
      application-data-type=Tq4, implementation-data-type=u5p11
      application-data-type=Tq5, implementation-data-type=s4p11
      application-data-type=Tq6, implementation-data-type=u8p8
      application-data-type=Tq7, implementation-data-type=u5p11
      application-data-type=Tq8, implementation-data-type=PlatformTypes/float32
      application-data-type=Tq9, implementation-data-type=PlatformTypes/float32
      application-data-type=TqAry1D1, implementation-data-type=Ary1D_s4p11_20
      application-data-type=TqAry1D10, implementation-data-type=Ary1D_u4p12_12
      application-data-type=TqAry1D11, implementation-data-type=Ary1D_u5p11_13
      application-data-type=TqAry1D2, implementation-data-type=Ary1D_u8p8_20
      application-data-type=TqAry1D3, implementation-data-type=Ary1D_u5p11_5
      application-data-type=TqAry1D4, implementation-data-type=Ary1D_s4p11_20
      application-data-type=TqAry1D5, implementation-data-type=Ary1D_u5p11_5
      application-data-type=TqAry1D6, implementation-data-type=Ary1D_u4p12_11
      application-data-type=TqAry1D7, implementation-data-type=Ary1D_u5p11_16
      application-data-type=TqAry1D8, implementation-data-type=Ary1D_u8p8_8
      application-data-type=TqAry1D9, implementation-data-type=Ary1D_u8p8_2
      application-data-type=TqAry2D1, implementation-data-type=Ary2D_s4p11_12_20
      application-data-type=TqAry2D2, implementation-data-type=Ary2D_u8p8_12_20
      application-data-type=TqAry2D3, implementation-data-type=Ary2D_u5p11_12_5
      application-data-type=TqAry2D4, implementation-data-type=Ary2D_s4p11_12_20
      application-data-type=TqAry2D5, implementation-data-type=Ary2D_u5p11_12_5
      application-data-type=TqAry2D6, implementation-data-type=Ary2D_u5p11_9_16
      application-data-type=TqAry2D7, implementation-data-type=Ary2D_u8p8_9_8
      application-data-type=TqAry2D8, implementation-data-type=Ary2D_u5p11_12_13
      application-data-type=Uls1, implementation-data-type=PlatformTypes/float32
      application-data-type=Uls10, implementation-data-type=PlatformTypes/float32
      application-data-type=Uls11, implementation-data-type=u2p14
      application-data-type=Uls{12..14}, implementation-data-type=PlatformTypes/float32
      application-data-type=Uls15, implementation-data-type=u1p15
      application-data-type=Uls16, implementation-data-type=PlatformTypes/float32
      application-data-type=Uls17, implementation-data-type=u8p8
      application-data-type=Uls18, implementation-data-type=u9p7
      application-data-type=Uls19, implementation-data-type=u8p8
      application-data-type=Uls2, implementation-data-type=PlatformTypes/float32
      application-data-type=Uls20, implementation-data-type=u4p12
      application-data-type=Uls21, implementation-data-type=PlatformTypes/float32
      application-data-type=Uls22, implementation-data-type=PlatformTypes/float32
      application-data-type=Uls23, implementation-data-type=u8p8
      application-data-type=Uls24, implementation-data-type=PlatformTypes/uint8
      application-data-type=Uls3, implementation-data-type=PlatformTypes/sint8
      application-data-type=Uls4, implementation-data-type=u2p14
      application-data-type=Uls{5..9}, implementation-data-type=PlatformTypes/float32
      application-data-type=UlsAry1D1, implementation-data-type=Ary1D_u2p14_5
      application-data-type=UlsAry1D10, implementation-data-type=Ary1D_u8p8_4
      application-data-type=UlsAry1D11, implementation-data-type=Ary1D_u8p8_14
      application-data-type=UlsAry1D12, implementation-data-type=Ary1D_u1p15_2
      application-data-type=UlsAry1D13, implementation-data-type=Ary1D_u4p12_12
      application-data-type=UlsAry1D14, implementation-data-type=Ary1D_u4p12_14
      application-data-type=UlsAry1D15, implementation-data-type=Ary1D_u8p8_14
      application-data-type=UlsAry1D2, implementation-data-type=Ary1D_u2p14_2
      application-data-type=UlsAry1D3, implementation-data-type=Ary1D_u2p14_16
      application-data-type=UlsAry1D4, implementation-data-type=Ary1D_u2p14_6
      application-data-type=UlsAry1D5, implementation-data-type=Ary1D_u1p15_11
      application-data-type=UlsAry1D6, implementation-data-type=Ary1D_f32_8
      application-data-type=UlsAry1D7, implementation-data-type=Ary1D_u8p8_4
      application-data-type=UlsAry1D8, implementation-data-type=Ary1D_u9p7_4
      application-data-type=UlsAry1D9, implementation-data-type=Ary1D_u8p8_8
      application-data-type=UlsAry2D1, implementation-data-type=Ary2D_u2p14_12_5
      application-data-type=UlsAry2D2, implementation-data-type=Ary2D_u2p14_7_6
      application-data-type=UlsAry2D3, implementation-data-type=Ary2D_u8p8_9_8
      application-data-type=UlsAry2D4, implementation-data-type=Ary2D_u8p8_9_4
      application-data-type=Vel{1..3}, implementation-data-type=PlatformTypes/float32
      application-data-type=Vel4, implementation-data-type=u11p5
      application-data-type=Vel5, implementation-data-type=PlatformTypes/float32
      application-data-type=Vel6, implementation-data-type=u7p9
      application-data-type=Vel7, implementation-data-type=u12p4
      application-data-type=Vel8, implementation-data-type=PlatformTypes/float32
      application-data-type=Vel9, implementation-data-type=PlatformTypes/float32
      application-data-type=VelAry1D1, implementation-data-type=Ary1D_u11p5_4
      application-data-type=VelAry1D2, implementation-data-type=Ary1D_u11p5_11
      application-data-type=VelAry1D3, implementation-data-type=Ary1D_u11p5_10
      application-data-type=VelAry1D4, implementation-data-type=Ary1D_u7p9_4
      application-data-type=VelAry1D5, implementation-data-type=Ary1D_u12p4_13
      application-data-type=VelAry2D1, implementation-data-type=Ary2D_u7p9_8_4
      application-data-type=VelAry2D2, implementation-data-type=Ary2D_u7p9_9_4
      application-data-type=VelAry2D3, implementation-data-type=Ary2D_u12p4_12_13
      application-data-type=Volt1, implementation-data-type=PlatformTypes/float32
      application-data-type=Volt{10..17}, implementation-data-type=PlatformTypes/float32
      application-data-type=Volt18, implementation-data-type=u3p13
      application-data-type=Volt{2..9}, implementation-data-type=PlatformTypes/float32
      application-data-type=VoltAry1D1, implementation-data-type=Ary1D_u3p13_10
      application-data-type=VoltGain1, implementation-data-type=PlatformTypes/float32
      application-data-type=VoltTi1, implementation-data-type=PlatformTypes/uint32
      application-data-type=VoltTi2, implementation-data-type=PlatformTypes/uint32
package /Nexteer/DataTypes
  70 x application array data type, all with category=ARRAY, sw-calibration-access=READ-ONLY:
    AgAry1D1
      element Element: category=VALUE, type=Ag4, array-size-semantics=FIXED-SIZE, max-number-of-elements=1024
    AgAry1D2
      element Element: category=VALUE, type=Ag5, array-size-semantics=FIXED-SIZE, max-number-of-elements=8
    AgAry1D3
      element Element: category=VALUE, type=Ag4, array-size-semantics=FIXED-SIZE, max-number-of-elements=1025
    AgAry1D4
      element Element: category=VALUE, type=Ag14, array-size-semantics=FIXED-SIZE, max-number-of-elements=8
    AgAry1D5
      element Element: category=VALUE, type=Ag18, array-size-semantics=FIXED-SIZE, max-number-of-elements=16
    AgAry2D1
      element Element: category=ARRAY, type=AgAry1D5, array-size-semantics=FIXED-SIZE, max-number-of-elements=9
    CntAry1D1
      element Element: category=VALUE, type=Cnt23, array-size-semantics=FIXED-SIZE, max-number-of-elements=2
    CntAry1D2
      element Element: category=VALUE, type=Cnt15, array-size-semantics=FIXED-SIZE, max-number-of-elements=8
    CntAry1D3
      element Element: category=VALUE, type=Cnt16, array-size-semantics=FIXED-SIZE, max-number-of-elements=257
    CntAry1D4
      element Element: category=VALUE, type=Cnt26, array-size-semantics=FIXED-SIZE, max-number-of-elements=2
    CntAry1D5
      element Element: category=VALUE, type=Cnt19, array-size-semantics=FIXED-SIZE, max-number-of-elements=22
    CntAry1D6
      element Element: category=VALUE, type=Cnt35, array-size-semantics=FIXED-SIZE, max-number-of-elements=22
    CurrAry1D1
      element Element: category=VALUE, type=Curr8, array-size-semantics=FIXED-SIZE, max-number-of-elements=16
    CurrAry1D2
      element Element: category=VALUE, type=Curr8, array-size-semantics=FIXED-SIZE, max-number-of-elements=6
    CurrAry1D3
      element Element: category=VALUE, type=Curr8, array-size-semantics=FIXED-SIZE, max-number-of-elements=7
    FrqAry1D1
      element Element: category=VALUE, type=Frq3, array-size-semantics=FIXED-SIZE, max-number-of-elements=4
    FrqAry1D2
      element Element: category=VALUE, type=Frq4, array-size-semantics=FIXED-SIZE, max-number-of-elements=4
    FrqAry1D3
      element Element: category=VALUE, type=Frq5, array-size-semantics=FIXED-SIZE, max-number-of-elements=4
    FrqAry1D4
      element Element: category=VALUE, type=Frq6, array-size-semantics=FIXED-SIZE, max-number-of-elements=4
    SpdAry1D1
      element Element: category=VALUE, type=Spd2, array-size-semantics=FIXED-SIZE, max-number-of-elements=12
    SpdAry1D2
      element Element: category=VALUE, type=Spd2, array-size-semantics=FIXED-SIZE, max-number-of-elements=9
    TAry1D1
      element Element: category=VALUE, type=T6, array-size-semantics=FIXED-SIZE, max-number-of-elements=14
    TAry1D2
      element Element: category=VALUE, type=T7, array-size-semantics=FIXED-SIZE, max-number-of-elements=14
    TqAry1D1
      element Element: category=VALUE, type=Tq5, array-size-semantics=FIXED-SIZE, max-number-of-elements=20
    TqAry1D10
      element Element: category=VALUE, type=Tq13, array-size-semantics=FIXED-SIZE, max-number-of-elements=12
    TqAry1D11
      element Element: category=VALUE, type=Tq12, array-size-semantics=FIXED-SIZE, max-number-of-elements=13
    TqAry1D2
      element Element: category=VALUE, type=Tq6, array-size-semantics=FIXED-SIZE, max-number-of-elements=20
    TqAry1D3
      element Element: category=VALUE, type=Tq7, array-size-semantics=FIXED-SIZE, max-number-of-elements=5
    TqAry1D4
      element Element: category=VALUE, type=Tq11, array-size-semantics=FIXED-SIZE, max-number-of-elements=20
    TqAry1D5
      element Element: category=VALUE, type=Tq12, array-size-semantics=FIXED-SIZE, max-number-of-elements=5
    TqAry1D6
      element Element: category=VALUE, type=Tq13, array-size-semantics=FIXED-SIZE, max-number-of-elements=11
    TqAry1D7
      element Element: category=VALUE, type=Tq14, array-size-semantics=FIXED-SIZE, max-number-of-elements=16
    TqAry1D8
      element Element: category=VALUE, type=Tq6, array-size-semantics=FIXED-SIZE, max-number-of-elements=8
    TqAry1D9
      element Element: category=VALUE, type=Tq6, array-size-semantics=FIXED-SIZE, max-number-of-elements=2
    TqAry2D1
      element Element: category=ARRAY, type=TqAry1D1, array-size-semantics=FIXED-SIZE, max-number-of-elements=12
    TqAry2D2
      element Element: category=ARRAY, type=TqAry1D2, array-size-semantics=FIXED-SIZE, max-number-of-elements=12
    TqAry2D3
      element Element: category=ARRAY, type=TqAry1D3, array-size-semantics=FIXED-SIZE, max-number-of-elements=12
    TqAry2D4
      element Element: category=ARRAY, type=TqAry1D4, array-size-semantics=FIXED-SIZE, max-number-of-elements=12
    TqAry2D5
      element Element: category=ARRAY, type=TqAry1D5, array-size-semantics=FIXED-SIZE, max-number-of-elements=12
    TqAry2D6
      element Element: category=ARRAY, type=TqAry1D7, array-size-semantics=FIXED-SIZE, max-number-of-elements=9
    TqAry2D7
      element Element: category=ARRAY, type=TqAry1D8, array-size-semantics=FIXED-SIZE, max-number-of-elements=9
    TqAry2D8
      element Element: category=ARRAY, type=TqAry1D11, array-size-semantics=FIXED-SIZE, max-number-of-elements=12
    UlsAry1D1
      element Element: category=VALUE, type=Uls4, array-size-semantics=FIXED-SIZE, max-number-of-elements=5
    UlsAry1D10
      element Element: category=VALUE, type=Uls19, array-size-semantics=FIXED-SIZE, max-number-of-elements=4
    UlsAry1D11
      element Element: category=VALUE, type=Uls17, array-size-semantics=FIXED-SIZE, max-number-of-elements=14
    UlsAry1D12
      element Element: category=VALUE, type=Uls15, array-size-semantics=FIXED-SIZE, max-number-of-elements=2
    UlsAry1D13
      element Element: category=VALUE, type=Uls20, array-size-semantics=FIXED-SIZE, max-number-of-elements=12
    UlsAry1D14
      element Element: category=VALUE, type=Uls20, array-size-semantics=FIXED-SIZE, max-number-of-elements=14
    UlsAry1D15
      element Element: category=VALUE, type=Uls23, array-size-semantics=FIXED-SIZE, max-number-of-elements=14
    UlsAry1D2
      element Element: category=VALUE, type=Uls4, array-size-semantics=FIXED-SIZE, max-number-of-elements=2
    UlsAry1D3
      element Element: category=VALUE, type=Uls11, array-size-semantics=FIXED-SIZE, max-number-of-elements=16
    UlsAry1D4
      element Element: category=VALUE, type=Uls11, array-size-semantics=FIXED-SIZE, max-number-of-elements=6
    UlsAry1D5
      element Element: category=VALUE, type=Uls15, array-size-semantics=FIXED-SIZE, max-number-of-elements=11
    UlsAry1D6
      element Element: category=VALUE, type=Uls12, array-size-semantics=FIXED-SIZE, max-number-of-elements=8
    UlsAry1D7
      element Element: category=VALUE, type=Uls17, array-size-semantics=FIXED-SIZE, max-number-of-elements=4
    UlsAry1D8
      element Element: category=VALUE, type=Uls18, array-size-semantics=FIXED-SIZE, max-number-of-elements=4
    UlsAry1D9
      element Element: category=VALUE, type=Uls17, array-size-semantics=FIXED-SIZE, max-number-of-elements=8
    UlsAry2D1
      element Element: category=ARRAY, type=UlsAry1D1, array-size-semantics=FIXED-SIZE, max-number-of-elements=12
    UlsAry2D2
      element Element: category=ARRAY, type=UlsAry1D4, array-size-semantics=FIXED-SIZE, max-number-of-elements=7
    UlsAry2D3
      element Element: category=ARRAY, type=UlsAry1D9, array-size-semantics=FIXED-SIZE, max-number-of-elements=9
    UlsAry2D4
      element Element: category=ARRAY, type=UlsAry1D10, array-size-semantics=FIXED-SIZE, max-number-of-elements=9
    VelAry1D1
      element Element: category=VALUE, type=Vel4, array-size-semantics=FIXED-SIZE, max-number-of-elements=4
    VelAry1D2
      element Element: category=VALUE, type=Vel4, array-size-semantics=FIXED-SIZE, max-number-of-elements=11
    VelAry1D3
      element Element: category=VALUE, type=Vel4, array-size-semantics=FIXED-SIZE, max-number-of-elements=10
    VelAry1D4
      element Element: category=VALUE, type=Vel6, array-size-semantics=FIXED-SIZE, max-number-of-elements=4
    VelAry1D5
      element Element: category=VALUE, type=Vel7, array-size-semantics=FIXED-SIZE, max-number-of-elements=13
    VelAry2D1
      element Element: category=ARRAY, type=VelAry1D4, array-size-semantics=FIXED-SIZE, max-number-of-elements=8
    VelAry2D2
      element Element: category=ARRAY, type=VelAry1D4, array-size-semantics=FIXED-SIZE, max-number-of-elements=9
    VelAry2D3
      element Element: category=ARRAY, type=VelAry1D5, array-size-semantics=FIXED-SIZE, max-number-of-elements=12
    VoltAry1D1
      element Element: category=VALUE, type=Volt18, array-size-semantics=FIXED-SIZE, max-number-of-elements=10
  206 x app type, all with sw-calibration-access=READ-ONLY:
    A1: category=VALUE, range phys -10..10, unit=m/s^2
    A2: category=VALUE, range phys -180..180, unit=m/s^2
    A3: category=VALUE, range phys -50..50, unit=kph/s
    A4: category=VALUE, range phys 0.1..10, unit=m/s^2
    A5: category=VALUE, range phys 0.1..10, unit=kph/s
    Ag1: category=VALUE, range phys 0..6.25, unit=MotDeg
    Ag10: category=VALUE, range phys 0..6.2832, unit=MotRad
    Ag11: category=VALUE, range phys 10..40, unit=MotDeg/HwDeg
    Ag12: category=VALUE, range phys -1.62..1.62, unit=MotRad
    Ag13: category=VALUE, range phys 0.001..0.1, unit=MotRad
    Ag14: category=VALUE, range phys -3.1415927..3.1415927, unit=MotRad
    Ag15: category=VALUE, range phys -1440..1440, unit=HwDeg
    Ag16: category=VALUE, range phys 0..20, unit=HwDeg
    Ag17: category=VALUE, range phys 0..1440, unit=HwDeg
    Ag18: category=VALUE, compu {phys=raw*16; unit FixdPt}, range phys 0..1440, unit=HwDeg
    Ag19: category=VALUE, range phys -900..900, unit=HwDeg
    Ag2: category=VALUE, range phys -11796480..11796480, unit=MotDeg
    Ag3: category=VALUE, range phys 0..0.999, unit=MotRevElec
    Ag4: category=VALUE, compu {raw=phys*8192; unit FixdPt}, range phys -0.05555555556..0.05555555556, unit=MotRev
    Ag5: category=VALUE, compu {raw=phys*65536; unit FixdPt}, range phys 0..0.9999847412, unit=MotRev
    Ag6: category=VALUE, compu {raw=phys*8192; unit FixdPt}, range phys 0..6.25, unit=MotDeg
    Ag7: category=VALUE, compu {raw=phys*8192; unit FixdPt}, range phys -262144..262143.9998, unit=MotDeg
    Ag8: category=VALUE, compu {raw=phys*65536; unit FixdPt}, range phys -32768..32767.999984741, unit=MotRev
    Ag9: category=VALUE, compu {raw=phys*65536; unit FixdPt}, range phys 0..0.9999847412, unit=MotRevElec
    Cnt1: category=VALUE, range phys 1..4, unit=Cnt
    Cnt10: category=VALUE, range phys 1..10000, unit=Cnt
    Cnt11: category=VALUE, range phys 0..10000, unit=Cnt
    Cnt12: category=VALUE, range phys 0..3, unit=Cnt
    Cnt13: category=VALUE, range phys 0..3, unit=Cnt
    Cnt14: category=VALUE, range phys 2..12, unit=Cnt
    Cnt15: category=VALUE, range phys 0..4294967295, unit=Cnt
    Cnt16: category=VALUE, range phys 0..65535, unit=Cnt
    Cnt17: category=VALUE, range phys 0..67108863, unit=Cnt
    Cnt18: category=VALUE, range phys 0..31, unit=Cnt
    Cnt19: category=VALUE, range phys 0..255, unit=Cnt
    Cnt2: category=VALUE, range phys -1..1, unit=Cnt
    Cnt20: category=VALUE, range phys -512..511, unit=Cnt
    Cnt21: category=VALUE, range phys 1..3, unit=Cnt
    Cnt22: category=VALUE, range phys 0..7, unit=Cnt
    Cnt23: category=VALUE, range phys 0..100, unit=Cnt
    Cnt24: category=VALUE, range phys 0..42, unit=Cnt
    Cnt25: category=VALUE, range phys 0..2, unit=Cnt
    Cnt26: category=VALUE, range phys 0..200, unit=Cnt
    Cnt27: category=VALUE, range phys 0..8, unit=Cnt
    Cnt28: category=VALUE, range phys 1..5, unit=Cnt
    Cnt29: category=VALUE, range phys 1..20, unit=Cnt
    Cnt3: category=VALUE, range phys 0..1, unit=Cnt
    Cnt30: category=VALUE, range phys 0..20, unit=Cnt
    Cnt31: category=VALUE, range phys 0..4095, unit=Cnt
    Cnt32: category=VALUE, range phys 0..360, unit=Cnt
    Cnt33: category=VALUE, range phys 0..22, unit=Cnt
    Cnt34: category=VALUE, range phys -900..900, unit=Cnt
    Cnt35: category=VALUE, range phys -500..500, unit=Cnt
    Cnt4: category=VALUE, range phys 0..31, unit=Cnt
    Cnt5: category=VALUE, range phys 0..32767, unit=Cnt
    Cnt6: category=VALUE, range phys 0..63, unit=Cnt
    Cnt7: category=VALUE, range phys 20..160, unit=Cnt
    Cnt8: category=VALUE, range phys 0..1800, unit=Cnt
    Cnt9: category=VALUE, range phys 1..1000, unit=Cnt
    Curr1: category=VALUE, range phys -145..145, unit=Amp
    Curr2: category=VALUE, range phys 0..50, unit=Amp
    Curr3: category=VALUE, range phys 10..100, unit=Amp
    Curr4: category=VALUE, range phys -450..450, unit=Amp
    Curr5: category=VALUE, range phys -1000..1000, unit=Amp
    Curr6: category=VALUE, range phys 0..200, unit=Amp
    Curr7: category=VALUE, range phys -200..200, unit=Amp
    Curr8: category=VALUE, compu {raw=phys*128; unit FixdPt}, range phys 0..200, unit=Amp
    Curr9: category=VALUE, range phys 0.01..20, unit=Amp
    CurrSqd1: category=VALUE, range phys 0..40000, unit=Amp^2
    Frq1: category=VALUE, range phys 0.1..10, unit=Hz
    Frq10: category=VALUE, range phys 1..100, unit=Hz
    Frq2: category=VALUE, range phys 1..200, unit=Hz
    Frq3: category=VALUE, compu {raw=phys*64; unit FixdPt}, range phys 0..750, unit=Hz
    Frq4: category=VALUE, compu {raw=phys*64; unit FixdPt}, range phys 0..1000, unit=Hz
    Frq5: category=VALUE, compu {raw=phys*128; unit FixdPt}, range phys 0..500, unit=Hz
    Frq6: category=VALUE, compu {raw=phys*128; unit FixdPt}, range phys 0..400, unit=Hz
    Frq7: category=VALUE, range phys 5..100, unit=Hz
    Frq8: category=VALUE, range phys 5..31.25, unit=Hz
    Frq9: category=VALUE, range phys 0.0039..100, unit=Hz
    Gain1: category=VALUE, range phys 0..200, unit=degC/Volt
    Gain2: category=VALUE, range phys 70..76, unit=Amp/V
    Gain3: category=VALUE, range phys 56..60, unit=Amp/V
    Gain4: category=VALUE, range phys 0..76, unit=Amp/V
    Gain5: category=VALUE, range phys 0..0.006, unit=ohm/degC
    Gain6: category=VALUE, range phys -0.0015..0, unit=V/MotRad/S/degC
    Gain7: category=VALUE, range phys 0..0.0045, unit=ohm/degC
    Gain8: category=VALUE, range phys 0..0.1, unit=MotNm/MotRad/S
    Indu1: category=VALUE, range phys 3e-05..0.00041, unit=H
    Indu2: category=VALUE, range phys 0..0.0023, unit=H
    Logl1: category=BOOLEAN, range phys 0..1
    MotCon1: category=VALUE, range phys 0.025..0.075, unit=V/MotRad/Sec
    R1: category=VALUE, range phys 0..0.2, unit=ohm
    R2: category=VALUE, range phys 0..45, unit=ohm
    R3: category=VALUE, range phys 0..2.25, unit=ohm
    R4: category=VALUE, range phys 0..3.6, unit=ohm
    R5: category=VALUE, range phys 0.005..0.125, unit=ohm
    R6: category=VALUE, range phys 0.005..0.12565, unit=ohm
    R7: category=VALUE, range phys -0.5..0.5, unit=ohm
    R8: category=VALUE, range phys 0..0.1, unit=ohm
    Rate1: category=VALUE, range phys 0.1..500, unit=Uls/S
    Rate10: category=VALUE, range phys 1..1200, unit=VehDeg/S^2
    Rate2: category=VALUE, range phys 0..500, unit=Uls/S
    Rate3: category=VALUE, range phys 0..1000, unit=Uls/S
    Rate4: category=VALUE, range phys 0.1..10, unit=Uls/S
    Rate5: category=VALUE, range phys -120..120, unit=VehDeg/S
    Rate6: category=VALUE, range phys 0.1..400, unit=m/s^2
    Rate7: category=VALUE, range phys 0.1..500, unit=kph/s^2
    Rate8: category=VALUE, range phys 1..50, unit=kph/s
    Rate9: category=VALUE, range phys 0.1..120, unit=VehDeg/S
    Spd1: category=VALUE, range phys 0..511, unit=kph
    Spd2: category=VALUE, compu {raw=phys*128; unit FixdPt}, range phys 0..511, unit=kph
    Spd3: category=VALUE, range phys 0..255, unit=kph
    Spd4: category=VALUE, range phys 0.1..511, unit=kph
    T1: category=VALUE, range phys -50..150, unit=degC
    T2: category=VALUE, range phys -50..200, unit=degC
    T3: category=VALUE, range phys -50..300, unit=degC
    T4: category=VALUE, range phys -100..150, unit=degC
    T5: category=VALUE, range phys -40..150, unit=degC
    T6: category=VALUE, compu {phys=raw*16; unit FixdPt}, range phys -50..150, unit=degC
    T7: category=VALUE, compu {raw=phys*128; unit FixdPt}, range phys -50..150, unit=degC
    T8: category=VALUE, range phys 0..10, unit=degC
    Ti1: category=VALUE, range phys 0..25000, unit=nS
    Ti10: category=VALUE, range phys 0..0.0002, unit=sec
    Ti11: category=VALUE, range phys 9.1e-05..0.000143, unit=sec
    Ti12: category=VALUE, range phys 0..0.05, unit=sec
    Ti2: category=VALUE, range phys 1..1000, unit=nS
    Ti3: category=VALUE, range phys 0..71429, unit=nS
    Ti4: category=VALUE, range phys 55555..71429, unit=nS
    Ti5: category=VALUE, range phys 6666..8572, unit=nS
    Ti6: category=VALUE, range phys 0..30000, unit=nS
    Ti7: category=VALUE, range phys 0..4295, unit=uS
    Ti8: category=VALUE, range phys 0..71429, unit=nS
    Ti9: category=VALUE, range phys 0..4294967295, unit=nS
    Tq1: category=VALUE, range phys -8.8..8.8, unit=MotNm
    Tq10: category=VALUE, range phys 0..8.8, unit=MotNm
    Tq11: category=VALUE, compu {raw=phys*2048; unit FixdPt}, range phys -1..15.99, unit=MotNm
    Tq12: category=VALUE, compu {raw=phys*2048; unit FixdPt}, range phys 0..8.8, unit=MotNm
    Tq13: category=VALUE, compu {phys=raw*4096; unit FixdPt}, range phys 0..8.8, unit=MotNm
    Tq14: category=VALUE, compu {raw=phys*2048; unit FixdPt}, range phys 0..0.5, unit=MotNm
    Tq15: category=VALUE, range phys 0..0.3, unit=MotNm
    Tq16: category=VALUE, range phys 0..64, unit=HwNm
    Tq17: category=VALUE, range phys 0..63, unit=HwNm
    Tq18: category=VALUE, range phys 0..10, unit=HwNm
    Tq19: category=VALUE, range phys 0..1799, unit=HwNm
    Tq2: category=VALUE, range phys -10..10, unit=HwNm
    Tq3: category=VALUE, range phys 0..8.8, unit=HwNm
    Tq4: category=VALUE, compu {raw=phys*2048; unit FixdPt}, range phys 0..8, unit=MotNm
    Tq5: category=VALUE, compu {raw=phys*2048; unit FixdPt}, range phys -10..10, unit=MotNm
    Tq6: category=VALUE, compu {raw=phys*256; unit FixdPt}, range phys 0..10, unit=HwNm
    Tq7: category=VALUE, compu {raw=phys*2048; unit FixdPt}, range phys 0..1.1, unit=MotNm
    Tq8: category=VALUE, range phys -3..3, unit=MotNm
    Tq9: category=VALUE, range phys -8..8, unit=MotNm
    Uls1: category=VALUE, range phys 0.5..1, unit=Uls
    Uls10: category=VALUE, range phys 0..20, unit=Uls
    Uls11: category=VALUE, compu {raw=phys*16384; unit FixdPt}, range phys 0..2, unit=Uls
    Uls12: category=VALUE, range phys -1..1, unit=Uls
    Uls13: category=VALUE, range phys -100..100, unit=Uls
    Uls14: category=VALUE, range phys 1..2, unit=Uls
    Uls15: category=VALUE, compu {phys=raw*32768; unit FixdPt}, range phys 0..1, unit=Uls
    Uls16: category=VALUE, range phys 0.1..10, unit=Uls
    Uls17: category=VALUE, compu {raw=phys*256; unit FixdPt}, range phys 0..1, unit=Uls
    Uls18: category=VALUE, compu {raw=phys*128; unit FixdPt}, range phys 0..1, unit=Uls
    Uls19: category=VALUE, compu {raw=phys*256; unit FixdPt}, range phys 0..2.5, unit=Uls
    Uls2: category=VALUE, range phys 0..1, unit=Uls
    Uls20: category=VALUE, compu {phys=raw*4096; unit FixdPt}, range phys 0..10, unit=Uls
    Uls21: category=VALUE, range phys 0..2, unit=Uls
    Uls22: category=VALUE, range phys 0..10, unit=Uls
    Uls23: category=VALUE, compu {raw=phys*256; unit FixdPt}, range phys 0..1, unit=Uls
    Uls24: category=VALUE, range phys 0..255, unit=Uls
    Uls3: category=VALUE, range phys -1..1, unit=Uls
    Uls4: category=VALUE, compu {raw=phys*16384; unit FixdPt}, range phys 0..1, unit=Uls
    Uls5: category=VALUE, range phys -1000000000..1000000000, unit=Uls
    Uls6: category=VALUE, range phys 0..200, unit=Uls
    Uls7: category=VALUE, range phys -25..25, unit=Uls
    Uls8: category=VALUE, range phys -200..200, unit=Uls
    Uls9: category=VALUE, range phys 0.98..1, unit=Uls
    Vel1: category=VALUE, range phys -1350..1350, unit=MotRad/s
    Vel2: category=VALUE, range phys 0..1350, unit=MotRad/s
    Vel3: category=VALUE, range phys -42..42, unit=HwRad/s
    Vel4: category=VALUE, compu {raw=phys*32; unit FixdPt}, range phys 0..1350, unit=MotRad/s
    Vel5: category=VALUE, range phys 0..0.5, unit=HwDeg/s
    Vel6: category=VALUE, compu {phys=raw*512; unit FixdPt}, range phys 0..42, unit=HwRad/s
    Vel7: category=VALUE, compu {phys=raw*16; unit FixdPt}, range phys 0..1350, unit=MotRad/s
    Vel8: category=VALUE, range phys 0..128, unit=MotRad/s
    Vel9: category=VALUE, range phys 0..127, unit=MotRad/s
    Volt1: category=VALUE, range phys 6..26.5, unit=V
    Volt10: category=VALUE, range phys 2.5..4.8, unit=V
    Volt11: category=VALUE, range phys 0.3..2.5, unit=V
    Volt12: category=VALUE, range phys 2.5..3, unit=V
    Volt13: category=VALUE, range phys 2..2.5, unit=V
    Volt14: category=VALUE, range phys 0..4800, unit=V
    Volt15: category=VALUE, range phys 0..48000, unit=V
    Volt16: category=VALUE, range phys 0..1, unit=V
    Volt17: category=VALUE, range phys -26.5..26.5, unit=V
    Volt18: category=VALUE, compu {raw=phys*8192; unit FixdPt}, range phys 0..5, unit=V
    Volt2: category=VALUE, range phys 6..16, unit=V
    Volt3: category=VALUE, range phys 0..5, unit=V
    Volt4: category=VALUE, range phys 0..26.5, unit=V
    Volt5: category=VALUE, range phys 0..16, unit=V
    Volt6: category=VALUE, range phys 0..40, unit=V
    Volt7: category=VALUE, range phys 0.3..4.8, unit=V
    Volt8: category=VALUE, range phys 2.8..3, unit=V
    Volt9: category=VALUE, range phys 2..2.3, unit=V
    VoltGain1: category=VALUE, range phys -1..1, unit=VoltPerVoltNanoSec
    VoltTi1: category=VALUE, range phys 0..1040000, unit=VnS
    VoltTi2: category=VALUE, range phys 233330..1325008, unit=VnS
  application record data type HwAgOffsRecAppl1: category=STRUCTURE, sw-calibration-access=READ-ONLY
    application record element OffsTrim: category=VALUE, type=Ag19
    application record element OffsTrimPrfmdSts: category=BOOLEAN, type=Logl1
  application record data type MotPrmNomEolRecAppl2: category=STRUCTURE, sw-calibration-access=READ-ONLY
    application record element MotKeNom: category=VALUE, type=MotCon1
    application record element MotRNom: category=VALUE, type=R6
  application record data type MotPrmNomEolRecAppl3: category=STRUCTURE, sw-calibration-access=READ-ONLY
    application record element MotBackEmfConNom: category=VALUE, type=MotCon1
    application record element MotRNom: category=VALUE, type=R6
  371 x impl type:
    AdrMpgReqTyp1: compu {phys=raw for raw 0, phys=raw for raw 1}, implementation-data-type=ImplementationDataTypes/uint8, type-emitter=RTE
    AnHwTqScaFacRec1: category=STRUCTURE, sw-calibration-access=READ-ONLY, type-emitter=RTE
      element SnsrSca: implementation-data-type=ImplementationDataTypes/float32
      element SnsrScaPrfmdSts: implementation-data-type=ImplementationDataTypes/boolean
    Ary1D_CrcHwStsRec1_4: category=ARRAY, sw-calibration-access=READ-ONLY, type-emitter=RTE
      element Element: array-size=4, array-size-semantics=FIXED-SIZE, implementation-data-type=CrcHwStsRec1
    Ary1D_CrcHwStsRec1_8: category=ARRAY, sw-calibration-access=READ-ONLY, type-emitter=RTE  # OBSOLETE
      element Element: array-size=8, array-size-semantics=FIXED-SIZE, implementation-data-type=CrcHwStsRec1
    Ary1D_CrcHwStsRec2_8: category=ARRAY, sw-calibration-access=READ-ONLY, type-emitter=RTE
      element Element: array-size=8, array-size-semantics=FIXED-SIZE, implementation-data-type=CrcHwStsRec2
    Ary1D_f32_12: category=ARRAY, sw-calibration-access=READ-ONLY, type-emitter=RTE
      element Element: array-size=12, array-size-semantics=FIXED-SIZE, implementation-data-type=ImplementationDataTypes/float32
    Ary1D_f32_2: category=ARRAY, sw-calibration-access=READ-ONLY, type-emitter=RTE
      element Element: array-size=2, array-size-semantics=FIXED-SIZE, implementation-data-type=ImplementationDataTypes/float32
    Ary1D_f32_26: category=ARRAY, sw-calibration-access=READ-ONLY, type-emitter=RTE
      element Element: array-size=26, array-size-semantics=FIXED-SIZE, implementation-data-type=ImplementationDataTypes/float32
    Ary1D_f32_3: category=ARRAY, sw-calibration-access=READ-ONLY, type-emitter=RTE
      element Element: array-size=3, array-size-semantics=FIXED-SIZE, implementation-data-type=ImplementationDataTypes/float32
    Ary1D_f32_30: category=ARRAY, sw-calibration-access=READ-ONLY, type-emitter=RTE
      element Element: array-size=30, array-size-semantics=FIXED-SIZE, implementation-data-type=ImplementationDataTypes/float32
    Ary1D_f32_4: category=ARRAY, sw-calibration-access=READ-ONLY, type-emitter=RTE
      element Element: array-size=4, array-size-semantics=FIXED-SIZE, implementation-data-type=ImplementationDataTypes/float32
    Ary1D_f32_5: category=ARRAY, sw-calibration-access=READ-ONLY, type-emitter=RTE
      element Element: array-size=5, array-size-semantics=FIXED-SIZE, implementation-data-type=ImplementationDataTypes/float32
    Ary1D_f32_72: category=ARRAY, sw-calibration-access=READ-ONLY, type-emitter=RTE
      element Element: array-size=72, array-size-semantics=FIXED-SIZE, implementation-data-type=ImplementationDataTypes/float32
    Ary1D_f32_8: category=ARRAY, sw-calibration-access=READ-ONLY, type-emitter=RTE
      element Element: array-size=8, array-size-semantics=FIXED-SIZE, implementation-data-type=ImplementationDataTypes/float32
    Ary1D_f32_StHlthSigStc1: category=ARRAY, sw-calibration-access=READ-ONLY, type-emitter=StHlthSigStc
      element Element: array-size=65535, array-size-semantics=VARIABLE-SIZE, implementation-data-type=ImplementationDataTypes/float32
    Ary1D_logl_2: category=ARRAY, sw-calibration-access=READ-ONLY, type-emitter=RTE
      element Element: array-size=2, array-size-semantics=FIXED-SIZE, implementation-data-type=ImplementationDataTypes/boolean
    Ary1D_logl_4_01: category=ARRAY, sw-calibration-access=READ-ONLY, type-emitter=RTE
      element Element: array-size=4, array-size-semantics=FIXED-SIZE, implementation-data-type=ImplementationDataTypes/boolean
    Ary1D_NtcFltInfoRec2_20: category=ARRAY, sw-calibration-access=READ-ONLY, type-emitter=RTE
      element Element: array-size=20, array-size-semantics=FIXED-SIZE, implementation-data-type=NtcFltInfoRec2
    Ary1D_ReadFltInfoRec1_20: category=ARRAY, sw-calibration-access=READ-ONLY, type-emitter=RTE
      element Element: array-size=20, array-size-semantics=FIXED-SIZE, implementation-data-type=ReadFltInfoRec1
    Ary1D_s10p5_8: category=ARRAY, sw-calibration-access=READ-ONLY, type-emitter=RTE
      element Element: array-size=8, array-size-semantics=FIXED-SIZE, implementation-data-type=s10p5
    Ary1D_s11p4_11: category=ARRAY, sw-calibration-access=READ-ONLY, type-emitter=RTE
      element Element: array-size=11, array-size-semantics=FIXED-SIZE, implementation-data-type=s11p4
    Ary1D_s11p4_14: category=ARRAY, sw-calibration-access=READ-ONLY, type-emitter=RTE
      element Element: array-size=14, array-size-semantics=FIXED-SIZE, implementation-data-type=s11p4
    Ary1D_s11p4_5: category=ARRAY, sw-calibration-access=READ-ONLY, type-emitter=RTE
      element Element: array-size=5, array-size-semantics=FIXED-SIZE, implementation-data-type=s11p4
    Ary1D_s14p1_8: category=ARRAY, sw-calibration-access=READ-ONLY, type-emitter=RTE
      element Element: array-size=8, array-size-semantics=FIXED-SIZE, implementation-data-type=s14p1
    Ary1D_s15p0_4: category=ARRAY, sw-calibration-access=READ-ONLY, type-emitter=RTE
      element Element: array-size=4, array-size-semantics=FIXED-SIZE, implementation-data-type=s15p0
    Ary1D_s16_22: category=ARRAY, sw-calibration-access=READ-ONLY, type-emitter=RTE
      element Element: array-size=22, array-size-semantics=FIXED-SIZE, implementation-data-type=ImplementationDataTypes/sint16
    Ary1D_s1p14_12: category=ARRAY, sw-calibration-access=READ-ONLY, type-emitter=RTE
      element Element: array-size=12, array-size-semantics=FIXED-SIZE, implementation-data-type=s1p14
    Ary1D_s1p14_128: category=ARRAY, sw-calibration-access=READ-ONLY, type-emitter=RTE
      element Element: array-size=128, array-size-semantics=FIXED-SIZE, implementation-data-type=s1p14
    Ary1D_s1p14_512: category=ARRAY, sw-calibration-access=READ-ONLY, type-emitter=RTE
      element Element: array-size=512, array-size-semantics=FIXED-SIZE, implementation-data-type=s1p14
    Ary1D_s2p13_1024: category=ARRAY, sw-calibration-access=READ-ONLY, type-emitter=RTE
      element Element: array-size=1024, array-size-semantics=FIXED-SIZE, implementation-data-type=s2p13
    Ary1D_s2p13_1025: category=ARRAY, sw-calibration-access=READ-ONLY, type-emitter=RTE
      element Element: array-size=1025, array-size-semantics=FIXED-SIZE, implementation-data-type=s2p13
    Ary1D_s4p11_11: category=ARRAY, sw-calibration-access=READ-ONLY, type-emitter=RTE
      element Element: array-size=11, array-size-semantics=FIXED-SIZE, implementation-data-type=s4p11
    Ary1D_s4p11_12: category=ARRAY, sw-calibration-access=READ-ONLY, type-emitter=RTE
      element Element: array-size=12, array-size-semantics=FIXED-SIZE, implementation-data-type=s4p11
    Ary1D_s4p11_20: category=ARRAY, sw-calibration-access=READ-ONLY, type-emitter=RTE
      element Element: array-size=20, array-size-semantics=FIXED-SIZE, implementation-data-type=s4p11
    Ary1D_s4p11_4: category=ARRAY, sw-calibration-access=READ-ONLY, type-emitter=RTE
      element Element: array-size=4, array-size-semantics=FIXED-SIZE, implementation-data-type=s4p11
    Ary1D_s4p11_5: category=ARRAY, sw-calibration-access=READ-ONLY, type-emitter=RTE
      element Element: array-size=5, array-size-semantics=FIXED-SIZE, implementation-data-type=s4p11
    Ary1D_s4p11_8: category=ARRAY, sw-calibration-access=READ-ONLY, type-emitter=RTE
      element Element: array-size=8, array-size-semantics=FIXED-SIZE, implementation-data-type=s4p11
    Ary1D_s7p8_11: category=ARRAY, sw-calibration-access=READ-ONLY, type-emitter=RTE
      element Element: array-size=11, array-size-semantics=FIXED-SIZE, implementation-data-type=s7p8
    Ary1D_s7p8_12: category=ARRAY, sw-calibration-access=READ-ONLY, type-emitter=RTE
      element Element: array-size=12, array-size-semantics=FIXED-SIZE, implementation-data-type=s7p8
    Ary1D_s7p8_20: category=ARRAY, sw-calibration-access=READ-ONLY, type-emitter=RTE
      element Element: array-size=20, array-size-semantics=FIXED-SIZE, implementation-data-type=s7p8
    Ary1D_s7p8_5: category=ARRAY, sw-calibration-access=READ-ONLY, type-emitter=RTE
      element Element: array-size=5, array-size-semantics=FIXED-SIZE, implementation-data-type=s7p8
    Ary1D_s7p8_6: category=ARRAY, sw-calibration-access=READ-ONLY, type-emitter=RTE
      element Element: array-size=6, array-size-semantics=FIXED-SIZE, implementation-data-type=s7p8
    Ary1D_s8p7_12: category=ARRAY, sw-calibration-access=READ-ONLY, type-emitter=RTE
      element Element: array-size=12, array-size-semantics=FIXED-SIZE, implementation-data-type=s8p7
    Ary1D_s8p7_14: category=ARRAY, sw-calibration-access=READ-ONLY, type-emitter=RTE
      element Element: array-size=14, array-size-semantics=FIXED-SIZE, implementation-data-type=s8p7
    Ary1D_s8p7_3: category=ARRAY, sw-calibration-access=READ-ONLY, type-emitter=RTE
      element Element: array-size=3, array-size-semantics=FIXED-SIZE, implementation-data-type=s8p7
    Ary1D_sm5p12_128: category=ARRAY, sw-calibration-access=READ-ONLY, type-emitter=RTE
      element Element: array-size=128, array-size-semantics=FIXED-SIZE, implementation-data-type=sm5p12
    Ary1D_sm6p13_144: category=ARRAY, sw-calibration-access=READ-ONLY, type-emitter=RTE
      element Element: array-size=144, array-size-semantics=FIXED-SIZE, implementation-data-type=sm6p13
    Ary1D_SnpshtDataRec2_8: category=ARRAY, sw-calibration-access=READ-ONLY, type-emitter=RTE
      element Element: array-size=8, array-size-semantics=FIXED-SIZE, implementation-data-type=SnpshtDataRec2
    Ary1D_u08_12: category=ARRAY, sw-calibration-access=READ-ONLY, type-emitter=RTE
      element Element: array-size=12, array-size-semantics=FIXED-SIZE, implementation-data-type=ImplementationDataTypes/uint8
    Ary1D_u08_2: category=ARRAY, sw-calibration-access=READ-ONLY, type-emitter=RTE
      element Element: array-size=2, array-size-semantics=FIXED-SIZE, implementation-data-type=ImplementationDataTypes/uint8
    Ary1D_u08_20: category=ARRAY, sw-calibration-access=READ-ONLY, type-emitter=RTE
      element Element: array-size=20, array-size-semantics=FIXED-SIZE, implementation-data-type=ImplementationDataTypes/uint8
    Ary1D_u08_22: category=ARRAY, sw-calibration-access=READ-ONLY, type-emitter=RTE
      element Element: array-size=22, array-size-semantics=FIXED-SIZE, implementation-data-type=ImplementationDataTypes/uint8
    Ary1D_u08_225: category=ARRAY, sw-calibration-access=READ-ONLY, type-emitter=RTE
      element Element: array-size=225, array-size-semantics=FIXED-SIZE, implementation-data-type=ImplementationDataTypes/uint8
    Ary1D_u08_255: category=ARRAY, sw-calibration-access=READ-ONLY, type-emitter=StHlthSigStc
      element Element: array-size=255, array-size-semantics=FIXED-SIZE, implementation-data-type=ImplementationDataTypes/uint8
    Ary1D_u08_3: category=ARRAY, sw-calibration-access=READ-ONLY, type-emitter=RTE
      element Element: array-size=3, array-size-semantics=FIXED-SIZE, implementation-data-type=ImplementationDataTypes/uint8
    Ary1D_u08_8: category=ARRAY, sw-calibration-access=READ-ONLY, type-emitter=RTE
      element Element: array-size=8, array-size-semantics=FIXED-SIZE, implementation-data-type=ImplementationDataTypes/uint8
    Ary1D_u08_StHlthSigStc1: category=ARRAY, type-emitter=StHlthSigStc
      element Element: array-size=65535, array-size-semantics=VARIABLE-SIZE, implementation-data-type=ImplementationDataTypes/uint8
    Ary1D_u0p16_10: category=ARRAY, sw-calibration-access=READ-ONLY, type-emitter=RTE
      element Element: array-size=10, array-size-semantics=FIXED-SIZE, implementation-data-type=u0p16
    Ary1D_u0p16_2: category=ARRAY, sw-calibration-access=READ-ONLY, type-emitter=RTE
      element Element: array-size=2, array-size-semantics=FIXED-SIZE, implementation-data-type=u0p16
    Ary1D_u0p16_3: category=ARRAY, sw-calibration-access=READ-ONLY, type-emitter=RTE
      element Element: array-size=3, array-size-semantics=FIXED-SIZE, implementation-data-type=u0p16
    Ary1D_u0p16_8: category=ARRAY, sw-calibration-access=READ-ONLY, type-emitter=RTE
      element Element: array-size=8, array-size-semantics=FIXED-SIZE, implementation-data-type=u0p16
    Ary1D_u10p6_10: category=ARRAY, sw-calibration-access=READ-ONLY, type-emitter=RTE
      element Element: array-size=10, array-size-semantics=FIXED-SIZE, implementation-data-type=u10p6
    Ary1D_u10p6_12: category=ARRAY, sw-calibration-access=READ-ONLY, type-emitter=RTE
      element Element: array-size=12, array-size-semantics=FIXED-SIZE, implementation-data-type=u10p6
    Ary1D_u10p6_13: category=ARRAY, sw-calibration-access=READ-ONLY, type-emitter=RTE
      element Element: array-size=13, array-size-semantics=FIXED-SIZE, implementation-data-type=u10p6
    Ary1D_u10p6_2: category=ARRAY, sw-calibration-access=READ-ONLY, type-emitter=RTE
      element Element: array-size=2, array-size-semantics=FIXED-SIZE, implementation-data-type=u10p6
    Ary1D_u10p6_3: category=ARRAY, sw-calibration-access=READ-ONLY, type-emitter=RTE
      element Element: array-size=3, array-size-semantics=FIXED-SIZE, implementation-data-type=u10p6
    Ary1D_u10p6_4: category=ARRAY, sw-calibration-access=READ-ONLY, type-emitter=RTE
      element Element: array-size=4, array-size-semantics=FIXED-SIZE, implementation-data-type=u10p6
    Ary1D_u10p6_5: category=ARRAY, sw-calibration-access=READ-ONLY, type-emitter=RTE
      element Element: array-size=5, array-size-semantics=FIXED-SIZE, implementation-data-type=u10p6
    Ary1D_u10p6_7: category=ARRAY, sw-calibration-access=READ-ONLY, type-emitter=RTE
      element Element: array-size=7, array-size-semantics=FIXED-SIZE, implementation-data-type=u10p6
    Ary1D_u10p6_8: category=ARRAY, sw-calibration-access=READ-ONLY, type-emitter=RTE
      element Element: array-size=8, array-size-semantics=FIXED-SIZE, implementation-data-type=u10p6
    Ary1D_u10p6_9: category=ARRAY, sw-calibration-access=READ-ONLY, type-emitter=RTE
      element Element: array-size=9, array-size-semantics=FIXED-SIZE, implementation-data-type=u10p6
    Ary1D_u11p5_10: category=ARRAY, sw-calibration-access=READ-ONLY, type-emitter=RTE
      element Element: array-size=10, array-size-semantics=FIXED-SIZE, implementation-data-type=u11p5
    Ary1D_u11p5_11: category=ARRAY, sw-calibration-access=READ-ONLY, type-emitter=RTE
      element Element: array-size=11, array-size-semantics=FIXED-SIZE, implementation-data-type=u11p5
    Ary1D_u11p5_12: category=ARRAY, sw-calibration-access=READ-ONLY, type-emitter=RTE
      element Element: array-size=12, array-size-semantics=FIXED-SIZE, implementation-data-type=u11p5
    Ary1D_u11p5_13: category=ARRAY, sw-calibration-access=READ-ONLY, type-emitter=RTE
      element Element: array-size=13, array-size-semantics=FIXED-SIZE, implementation-data-type=u11p5
    Ary1D_u11p5_4: category=ARRAY, sw-calibration-access=READ-ONLY, type-emitter=RTE
      element Element: array-size=4, array-size-semantics=FIXED-SIZE, implementation-data-type=u11p5
    Ary1D_u11p5_6: category=ARRAY, sw-calibration-access=READ-ONLY, type-emitter=RTE
      element Element: array-size=6, array-size-semantics=FIXED-SIZE, implementation-data-type=u11p5
    Ary1D_u11p5_7: category=ARRAY, sw-calibration-access=READ-ONLY, type-emitter=RTE
      element Element: array-size=7, array-size-semantics=FIXED-SIZE, implementation-data-type=u11p5
    Ary1D_u11p5_8: category=ARRAY, sw-calibration-access=READ-ONLY, type-emitter=RTE
      element Element: array-size=8, array-size-semantics=FIXED-SIZE, implementation-data-type=u11p5
    Ary1D_u11p5_9: category=ARRAY, sw-calibration-access=READ-ONLY, type-emitter=RTE
      element Element: array-size=9, array-size-semantics=FIXED-SIZE, implementation-data-type=u11p5
    Ary1D_u12p4_12: category=ARRAY, sw-calibration-access=READ-ONLY, type-emitter=RTE
      element Element: array-size=12, array-size-semantics=FIXED-SIZE, implementation-data-type=u12p4
    Ary1D_u12p4_13: category=ARRAY, sw-calibration-access=READ-ONLY, type-emitter=RTE
      element Element: array-size=13, array-size-semantics=FIXED-SIZE, implementation-data-type=u12p4
    Ary1D_u12p4_16: category=ARRAY, sw-calibration-access=READ-ONLY, type-emitter=RTE
      element Element: array-size=16, array-size-semantics=FIXED-SIZE, implementation-data-type=u12p4
    Ary1D_u12p4_2: category=ARRAY, sw-calibration-access=READ-ONLY, type-emitter=RTE
      element Element: array-size=2, array-size-semantics=FIXED-SIZE, implementation-data-type=u12p4
    Ary1D_u12p4_4: category=ARRAY, sw-calibration-access=READ-ONLY, type-emitter=RTE
      element Element: array-size=4, array-size-semantics=FIXED-SIZE, implementation-data-type=u12p4
    Ary1D_u12p4_7: category=ARRAY, sw-calibration-access=READ-ONLY, type-emitter=RTE
      element Element: array-size=7, array-size-semantics=FIXED-SIZE, implementation-data-type=u12p4
    Ary1D_u12p4_9: category=ARRAY, sw-calibration-access=READ-ONLY, type-emitter=RTE
      element Element: array-size=9, array-size-semantics=FIXED-SIZE, implementation-data-type=u12p4
    Ary1D_u13p3_2: category=ARRAY, sw-calibration-access=READ-ONLY, type-emitter=RTE
      element Element: array-size=2, array-size-semantics=FIXED-SIZE, implementation-data-type=u13p3
    Ary1D_u13p3_6: category=ARRAY, sw-calibration-access=READ-ONLY, type-emitter=RTE
      element Element: array-size=6, array-size-semantics=FIXED-SIZE, implementation-data-type=u13p3
    Ary1D_u15p1_12: category=ARRAY, sw-calibration-access=READ-ONLY, type-emitter=RTE
      element Element: array-size=12, array-size-semantics=FIXED-SIZE, implementation-data-type=u15p1
    Ary1D_u16_257: category=ARRAY, sw-calibration-access=READ-ONLY, type-emitter=RTE
      element Element: array-size=257, array-size-semantics=FIXED-SIZE, implementation-data-type=ImplementationDataTypes/uint16
    Ary1D_u16_3: category=ARRAY, sw-calibration-access=READ-ONLY, type-emitter=RTE
      element Element: array-size=3, array-size-semantics=FIXED-SIZE, implementation-data-type=ImplementationDataTypes/uint16
    Ary1D_u16_512: category=ARRAY, sw-calibration-access=READ-ONLY, type-emitter=RTE
      element Element: array-size=512, array-size-semantics=FIXED-SIZE, implementation-data-type=ImplementationDataTypes/uint16
    Ary1D_u16p0_2: category=ARRAY, sw-calibration-access=READ-ONLY, type-emitter=RTE
      element Element: array-size=2, array-size-semantics=FIXED-SIZE, implementation-data-type=u16p0
    Ary1D_u16p0_20: category=ARRAY, sw-calibration-access=READ-ONLY, type-emitter=RTE
      element Element: array-size=20, array-size-semantics=FIXED-SIZE, implementation-data-type=u16p0
    Ary1D_u16p0_22: category=ARRAY, sw-calibration-access=READ-ONLY, type-emitter=RTE
      element Element: array-size=22, array-size-semantics=FIXED-SIZE, implementation-data-type=u16p0
    Ary1D_u16p0_8: category=ARRAY, sw-calibration-access=READ-ONLY, type-emitter=RTE
      element Element: array-size=8, array-size-semantics=FIXED-SIZE, implementation-data-type=u16p0
    Ary1D_u1p15_10: category=ARRAY, sw-calibration-access=READ-ONLY, type-emitter=RTE
      element Element: array-size=10, array-size-semantics=FIXED-SIZE, implementation-data-type=u1p15
    Ary1D_u1p15_11: category=ARRAY, sw-calibration-access=READ-ONLY, type-emitter=RTE
      element Element: array-size=11, array-size-semantics=FIXED-SIZE, implementation-data-type=u1p15
    Ary1D_u1p15_12: category=ARRAY, sw-calibration-access=READ-ONLY, type-emitter=RTE
      element Element: array-size=12, array-size-semantics=FIXED-SIZE, implementation-data-type=u1p15
    Ary1D_u1p15_2: category=ARRAY, sw-calibration-access=READ-ONLY, type-emitter=RTE
      element Element: array-size=2, array-size-semantics=FIXED-SIZE, implementation-data-type=u1p15
    Ary1D_u1p15_4: category=ARRAY, sw-calibration-access=READ-ONLY, type-emitter=RTE
      element Element: array-size=4, array-size-semantics=FIXED-SIZE, implementation-data-type=u1p15
    Ary1D_u1p15_5: category=ARRAY, sw-calibration-access=READ-ONLY, type-emitter=RTE
      element Element: array-size=5, array-size-semantics=FIXED-SIZE, implementation-data-type=u1p15
    Ary1D_u1p15_6: category=ARRAY, sw-calibration-access=READ-ONLY, type-emitter=RTE
      element Element: array-size=6, array-size-semantics=FIXED-SIZE, implementation-data-type=u1p15
    Ary1D_u1p15_9: category=ARRAY, sw-calibration-access=READ-ONLY, type-emitter=RTE
      element Element: array-size=9, array-size-semantics=FIXED-SIZE, implementation-data-type=u1p15
    Ary1D_u2p14_10: category=ARRAY, sw-calibration-access=READ-ONLY, type-emitter=RTE
      element Element: array-size=10, array-size-semantics=FIXED-SIZE, implementation-data-type=u2p14
    Ary1D_u2p14_12: category=ARRAY, sw-calibration-access=READ-ONLY, type-emitter=RTE
      element Element: array-size=12, array-size-semantics=FIXED-SIZE, implementation-data-type=u2p14
    Ary1D_u2p14_16: category=ARRAY, sw-calibration-access=READ-ONLY, type-emitter=RTE
      element Element: array-size=16, array-size-semantics=FIXED-SIZE, implementation-data-type=u2p14
    Ary1D_u2p14_2: category=ARRAY, sw-calibration-access=READ-ONLY, type-emitter=RTE
      element Element: array-size=2, array-size-semantics=FIXED-SIZE, implementation-data-type=u2p14
    Ary1D_u2p14_3: category=ARRAY, sw-calibration-access=READ-ONLY, type-emitter=RTE
      element Element: array-size=3, array-size-semantics=FIXED-SIZE, implementation-data-type=u2p14
    Ary1D_u2p14_4: category=ARRAY, sw-calibration-access=READ-ONLY, type-emitter=RTE
      element Element: array-size=4, array-size-semantics=FIXED-SIZE, implementation-data-type=u2p14
    Ary1D_u2p14_5: category=ARRAY, sw-calibration-access=READ-ONLY, type-emitter=RTE
      element Element: array-size=5, array-size-semantics=FIXED-SIZE, implementation-data-type=u2p14
    Ary1D_u2p14_6: category=ARRAY, sw-calibration-access=READ-ONLY, type-emitter=RTE
      element Element: array-size=6, array-size-semantics=FIXED-SIZE, implementation-data-type=u2p14
    Ary1D_u2p14_7: category=ARRAY, sw-calibration-access=READ-ONLY, type-emitter=RTE
      element Element: array-size=7, array-size-semantics=FIXED-SIZE, implementation-data-type=u2p14
    Ary1D_u2p14_8: category=ARRAY, sw-calibration-access=READ-ONLY, type-emitter=RTE
      element Element: array-size=8, array-size-semantics=FIXED-SIZE, implementation-data-type=u2p14
    Ary1D_u2p14_9: category=ARRAY, sw-calibration-access=READ-ONLY, type-emitter=RTE
      element Element: array-size=9, array-size-semantics=FIXED-SIZE, implementation-data-type=u2p14
    Ary1D_u32_4: category=ARRAY, sw-calibration-access=READ-ONLY, type-emitter=RTE
      element Element: array-size=4, array-size-semantics=FIXED-SIZE, implementation-data-type=ImplementationDataTypes/uint32
    Ary1D_u32_50: category=ARRAY, sw-calibration-access=READ-ONLY, type-emitter=StHlthSigStc
      element Element: array-size=50, array-size-semantics=FIXED-SIZE, implementation-data-type=ImplementationDataTypes/uint32
    Ary1D_u32_512: category=ARRAY, sw-calibration-access=READ-ONLY, type-emitter=RTE
      element Element: array-size=512, array-size-semantics=FIXED-SIZE, implementation-data-type=ImplementationDataTypes/uint32
    Ary1D_u32_8: category=ARRAY, sw-calibration-access=READ-ONLY, type-emitter=RTE
      element Element: array-size=8, array-size-semantics=FIXED-SIZE, implementation-data-type=ImplementationDataTypes/uint32
    Ary1D_u32_StHlthSigStc1: category=ARRAY, type-emitter=StHlthSigStc
      element Element: array-size=65535, array-size-semantics=VARIABLE-SIZE, implementation-data-type=ImplementationDataTypes/uint32
    Ary1D_u3p13_10: category=ARRAY, sw-calibration-access=READ-ONLY, type-emitter=RTE
      element Element: array-size=10, array-size-semantics=FIXED-SIZE, implementation-data-type=u3p13
    Ary1D_u3p13_13: category=ARRAY, sw-calibration-access=READ-ONLY, type-emitter=RTE
      element Element: array-size=13, array-size-semantics=FIXED-SIZE, implementation-data-type=u3p13
    Ary1D_u3p13_5: category=ARRAY, sw-calibration-access=READ-ONLY, type-emitter=RTE
      element Element: array-size=5, array-size-semantics=FIXED-SIZE, implementation-data-type=u3p13
    Ary1D_u3p13_8: category=ARRAY, sw-calibration-access=READ-ONLY, type-emitter=RTE
      element Element: array-size=8, array-size-semantics=FIXED-SIZE, implementation-data-type=u3p13
    Ary1D_u4p12_10: category=ARRAY, sw-calibration-access=READ-ONLY, type-emitter=RTE
      element Element: array-size=10, array-size-semantics=FIXED-SIZE, implementation-data-type=u4p12
    Ary1D_u4p12_11: category=ARRAY, sw-calibration-access=READ-ONLY, type-emitter=RTE
      element Element: array-size=11, array-size-semantics=FIXED-SIZE, implementation-data-type=u4p12
    Ary1D_u4p12_12: category=ARRAY, sw-calibration-access=READ-ONLY, type-emitter=RTE
      element Element: array-size=12, array-size-semantics=FIXED-SIZE, implementation-data-type=u4p12
    Ary1D_u4p12_13: category=ARRAY, sw-calibration-access=READ-ONLY, type-emitter=RTE
      element Element: array-size=13, array-size-semantics=FIXED-SIZE, implementation-data-type=u4p12
    Ary1D_u4p12_14: category=ARRAY, sw-calibration-access=READ-ONLY, type-emitter=RTE
      element Element: array-size=14, array-size-semantics=FIXED-SIZE, implementation-data-type=u4p12
    Ary1D_u4p12_2: category=ARRAY, sw-calibration-access=READ-ONLY, type-emitter=RTE
      element Element: array-size=2, array-size-semantics=FIXED-SIZE, implementation-data-type=u4p12
    Ary1D_u4p12_20: category=ARRAY, sw-calibration-access=READ-ONLY, type-emitter=RTE
      element Element: array-size=20, array-size-semantics=FIXED-SIZE, implementation-data-type=u4p12
    Ary1D_u4p12_3: category=ARRAY, sw-calibration-access=READ-ONLY, type-emitter=RTE
      element Element: array-size=3, array-size-semantics=FIXED-SIZE, implementation-data-type=u4p12
    Ary1D_u4p12_4: category=ARRAY, sw-calibration-access=READ-ONLY, type-emitter=RTE
      element Element: array-size=4, array-size-semantics=FIXED-SIZE, implementation-data-type=u4p12
    Ary1D_u4p12_5: category=ARRAY, sw-calibration-access=READ-ONLY, type-emitter=RTE
      element Element: array-size=5, array-size-semantics=FIXED-SIZE, implementation-data-type=u4p12
    Ary1D_u4p12_6: category=ARRAY, sw-calibration-access=READ-ONLY, type-emitter=RTE
      element Element: array-size=6, array-size-semantics=FIXED-SIZE, implementation-data-type=u4p12
    Ary1D_u4p12_7: category=ARRAY, sw-calibration-access=READ-ONLY, type-emitter=RTE
      element Element: array-size=7, array-size-semantics=FIXED-SIZE, implementation-data-type=u4p12
    Ary1D_u4p12_8: category=ARRAY, sw-calibration-access=READ-ONLY, type-emitter=RTE
      element Element: array-size=8, array-size-semantics=FIXED-SIZE, implementation-data-type=u4p12
    Ary1D_u5p11_10: category=ARRAY, sw-calibration-access=READ-ONLY, type-emitter=RTE
      element Element: array-size=10, array-size-semantics=FIXED-SIZE, implementation-data-type=u5p11
    Ary1D_u5p11_11: category=ARRAY, sw-calibration-access=READ-ONLY, type-emitter=RTE
      element Element: array-size=11, array-size-semantics=FIXED-SIZE, implementation-data-type=u5p11
    Ary1D_u5p11_12: category=ARRAY, sw-calibration-access=READ-ONLY, type-emitter=RTE
      element Element: array-size=12, array-size-semantics=FIXED-SIZE, implementation-data-type=u5p11
    Ary1D_u5p11_13: category=ARRAY, sw-calibration-access=READ-ONLY, type-emitter=RTE
      element Element: array-size=13, array-size-semantics=FIXED-SIZE, implementation-data-type=u5p11
    Ary1D_u5p11_14: category=ARRAY, sw-calibration-access=READ-ONLY, type-emitter=RTE
      element Element: array-size=14, array-size-semantics=FIXED-SIZE, implementation-data-type=u5p11
    Ary1D_u5p11_16: category=ARRAY, sw-calibration-access=READ-ONLY, type-emitter=RTE
      element Element: array-size=16, array-size-semantics=FIXED-SIZE, implementation-data-type=u5p11
    Ary1D_u5p11_17: category=ARRAY, sw-calibration-access=READ-ONLY, type-emitter=RTE
      element Element: array-size=17, array-size-semantics=FIXED-SIZE, implementation-data-type=u5p11
    Ary1D_u5p11_5: category=ARRAY, sw-calibration-access=READ-ONLY, type-emitter=RTE
      element Element: array-size=5, array-size-semantics=FIXED-SIZE, implementation-data-type=u5p11
    Ary1D_u5p11_6: category=ARRAY, sw-calibration-access=READ-ONLY, type-emitter=RTE
      element Element: array-size=6, array-size-semantics=FIXED-SIZE, implementation-data-type=u5p11
    Ary1D_u5p11_8: category=ARRAY, sw-calibration-access=READ-ONLY, type-emitter=RTE
      element Element: array-size=8, array-size-semantics=FIXED-SIZE, implementation-data-type=u5p11
    Ary1D_u6p10_10: category=ARRAY, sw-calibration-access=READ-ONLY, type-emitter=RTE
      element Element: array-size=10, array-size-semantics=FIXED-SIZE, implementation-data-type=u6p10
    Ary1D_u6p10_17: category=ARRAY, sw-calibration-access=READ-ONLY, type-emitter=RTE
      element Element: array-size=17, array-size-semantics=FIXED-SIZE, implementation-data-type=u6p10
    Ary1D_u6p10_6: category=ARRAY, sw-calibration-access=READ-ONLY, type-emitter=RTE
      element Element: array-size=6, array-size-semantics=FIXED-SIZE, implementation-data-type=u6p10
    Ary1D_u6p10_9: category=ARRAY, sw-calibration-access=READ-ONLY, type-emitter=RTE
      element Element: array-size=9, array-size-semantics=FIXED-SIZE, implementation-data-type=u6p10
    Ary1D_u7p9_12: category=ARRAY, sw-calibration-access=READ-ONLY, type-emitter=RTE
      element Element: array-size=12, array-size-semantics=FIXED-SIZE, implementation-data-type=u7p9
    Ary1D_u7p9_3: category=ARRAY, sw-calibration-access=READ-ONLY, type-emitter=RTE
      element Element: array-size=3, array-size-semantics=FIXED-SIZE, implementation-data-type=u7p9
    Ary1D_u7p9_4: category=ARRAY, sw-calibration-access=READ-ONLY, type-emitter=RTE
      element Element: array-size=4, array-size-semantics=FIXED-SIZE, implementation-data-type=u7p9
    Ary1D_u7p9_6: category=ARRAY, sw-calibration-access=READ-ONLY, type-emitter=RTE
      element Element: array-size=6, array-size-semantics=FIXED-SIZE, implementation-data-type=u7p9
    Ary1D_u8_22: category=ARRAY, sw-calibration-access=READ-ONLY, type-emitter=RTE
      element Element: array-size=22, array-size-semantics=FIXED-SIZE, implementation-data-type=PlatformTypes/uint8
    Ary1D_u8p8_10: category=ARRAY, sw-calibration-access=READ-ONLY, type-emitter=RTE
      element Element: array-size=10, array-size-semantics=FIXED-SIZE, implementation-data-type=u8p8
    Ary1D_u8p8_11: category=ARRAY, sw-calibration-access=READ-ONLY, type-emitter=RTE
      element Element: array-size=11, array-size-semantics=FIXED-SIZE, implementation-data-type=u8p8
    Ary1D_u8p8_12: category=ARRAY, sw-calibration-access=READ-ONLY, type-emitter=RTE
      element Element: array-size=12, array-size-semantics=FIXED-SIZE, implementation-data-type=u8p8
    Ary1D_u8p8_13: category=ARRAY, sw-calibration-access=READ-ONLY, type-emitter=RTE
      element Element: array-size=13, array-size-semantics=FIXED-SIZE, implementation-data-type=u8p8
    Ary1D_u8p8_14: category=ARRAY, sw-calibration-access=READ-ONLY, type-emitter=RTE
      element Element: array-size=14, array-size-semantics=FIXED-SIZE, implementation-data-type=u8p8
    Ary1D_u8p8_2: category=ARRAY, sw-calibration-access=READ-ONLY, type-emitter=RTE
      element Element: array-size=2, array-size-semantics=FIXED-SIZE, implementation-data-type=u8p8
    Ary1D_u8p8_20: category=ARRAY, sw-calibration-access=READ-ONLY, type-emitter=RTE
      element Element: array-size=20, array-size-semantics=FIXED-SIZE, implementation-data-type=u8p8
    Ary1D_u8p8_3: category=ARRAY, sw-calibration-access=READ-ONLY, type-emitter=RTE
      element Element: array-size=3, array-size-semantics=FIXED-SIZE, implementation-data-type=u8p8
    Ary1D_u8p8_4: category=ARRAY, sw-calibration-access=READ-ONLY, type-emitter=RTE
      element Element: array-size=4, array-size-semantics=FIXED-SIZE, implementation-data-type=u8p8
    Ary1D_u8p8_5: category=ARRAY, sw-calibration-access=READ-ONLY, type-emitter=RTE
      element Element: array-size=5, array-size-semantics=FIXED-SIZE, implementation-data-type=u8p8
    Ary1D_u8p8_6: category=ARRAY, sw-calibration-access=READ-ONLY, type-emitter=RTE
      element Element: array-size=6, array-size-semantics=FIXED-SIZE, implementation-data-type=u8p8
    Ary1D_u8p8_7: category=ARRAY, sw-calibration-access=READ-ONLY, type-emitter=RTE
      element Element: array-size=7, array-size-semantics=FIXED-SIZE, implementation-data-type=u8p8
    Ary1D_u8p8_8: category=ARRAY, sw-calibration-access=READ-ONLY, type-emitter=RTE
      element Element: array-size=8, array-size-semantics=FIXED-SIZE, implementation-data-type=u8p8
    Ary1D_u8p8_9: category=ARRAY, sw-calibration-access=READ-ONLY, type-emitter=RTE
      element Element: array-size=9, array-size-semantics=FIXED-SIZE, implementation-data-type=u8p8
    Ary1D_u9p7_10: category=ARRAY, sw-calibration-access=READ-ONLY, type-emitter=RTE
      element Element: array-size=10, array-size-semantics=FIXED-SIZE, implementation-data-type=u9p7
    Ary1D_u9p7_11: category=ARRAY, sw-calibration-access=READ-ONLY, type-emitter=RTE
      element Element: array-size=11, array-size-semantics=FIXED-SIZE, implementation-data-type=u9p7
    Ary1D_u9p7_12: category=ARRAY, sw-calibration-access=READ-ONLY, type-emitter=RTE
      element Element: array-size=12, array-size-semantics=FIXED-SIZE, implementation-data-type=u9p7
    Ary1D_u9p7_16: category=ARRAY, sw-calibration-access=READ-ONLY, type-emitter=RTE
      element Element: array-size=16, array-size-semantics=FIXED-SIZE, implementation-data-type=u9p7
    Ary1D_u9p7_2: category=ARRAY, sw-calibration-access=READ-ONLY, type-emitter=RTE
      element Element: array-size=2, array-size-semantics=FIXED-SIZE, implementation-data-type=u9p7
    Ary1D_u9p7_3: category=ARRAY, sw-calibration-access=READ-ONLY, type-emitter=RTE
      element Element: array-size=3, array-size-semantics=FIXED-SIZE, implementation-data-type=u9p7
    Ary1D_u9p7_4: category=ARRAY, sw-calibration-access=READ-ONLY, type-emitter=RTE
      element Element: array-size=4, array-size-semantics=FIXED-SIZE, implementation-data-type=u9p7
    Ary1D_u9p7_5: category=ARRAY, sw-calibration-access=READ-ONLY, type-emitter=RTE
      element Element: array-size=5, array-size-semantics=FIXED-SIZE, implementation-data-type=u9p7
    Ary1D_u9p7_6: category=ARRAY, sw-calibration-access=READ-ONLY, type-emitter=RTE
      element Element: array-size=6, array-size-semantics=FIXED-SIZE, implementation-data-type=u9p7
    Ary1D_u9p7_7: category=ARRAY, sw-calibration-access=READ-ONLY, type-emitter=RTE
      element Element: array-size=7, array-size-semantics=FIXED-SIZE, implementation-data-type=u9p7
    Ary1D_u9p7_8: category=ARRAY, sw-calibration-access=READ-ONLY, type-emitter=RTE
      element Element: array-size=8, array-size-semantics=FIXED-SIZE, implementation-data-type=u9p7
    Ary1D_u9p7_9: category=ARRAY, sw-calibration-access=READ-ONLY, type-emitter=RTE
      element Element: array-size=9, array-size-semantics=FIXED-SIZE, implementation-data-type=u9p7
    Ary2D_f32_3_3: category=ARRAY, sw-calibration-access=READ-ONLY, type-emitter=RTE
      element Element: array-size=3, array-size-semantics=FIXED-SIZE, implementation-data-type=Ary1D_f32_3
    Ary2D_f32_4_2: category=ARRAY, sw-calibration-access=READ-ONLY, type-emitter=RTE
      element Element: array-size=4, array-size-semantics=FIXED-SIZE, implementation-data-type=Ary1D_f32_2
    Ary2D_f32_4_5: category=ARRAY, sw-calibration-access=READ-ONLY, type-emitter=RTE
      element Element: array-size=4, array-size-semantics=FIXED-SIZE, implementation-data-type=Ary1D_f32_5
    Ary2D_f32_4_8: category=ARRAY, sw-calibration-access=READ-ONLY, type-emitter=RTE
      element Element: array-size=4, array-size-semantics=FIXED-SIZE, implementation-data-type=Ary1D_f32_8
    Ary2D_f32_5_4: category=ARRAY, sw-calibration-access=READ-ONLY, type-emitter=RTE
      element Element: array-size=5, array-size-semantics=FIXED-SIZE, implementation-data-type=Ary1D_f32_4
    Ary2D_f32_5_5: category=ARRAY, sw-calibration-access=READ-ONLY, type-emitter=RTE
      element Element: array-size=5, array-size-semantics=FIXED-SIZE, implementation-data-type=Ary1D_f32_5
    Ary2D_f32_8_4: category=ARRAY, sw-calibration-access=READ-ONLY, type-emitter=RTE
      element Element: array-size=8, array-size-semantics=FIXED-SIZE, implementation-data-type=Ary1D_f32_4
    Ary2D_s1p14_10_12: category=ARRAY, sw-calibration-access=READ-ONLY, type-emitter=RTE
      element Element: array-size=10, array-size-semantics=FIXED-SIZE, implementation-data-type=Ary1D_s1p14_12
    Ary2D_s4p11_11_8: category=ARRAY, sw-calibration-access=READ-ONLY, type-emitter=RTE
      element Element: array-size=11, array-size-semantics=FIXED-SIZE, implementation-data-type=Ary1D_s4p11_8
    Ary2D_s4p11_12_11: category=ARRAY, sw-calibration-access=READ-ONLY, type-emitter=RTE
      element Element: array-size=12, array-size-semantics=FIXED-SIZE, implementation-data-type=Ary1D_s4p11_11
    Ary2D_s4p11_12_20: category=ARRAY, sw-calibration-access=READ-ONLY, type-emitter=RTE
      element Element: array-size=12, array-size-semantics=FIXED-SIZE, implementation-data-type=Ary1D_s4p11_20
    Ary2D_s4p11_8_11: category=ARRAY, sw-calibration-access=READ-ONLY, type-emitter=RTE
      element Element: array-size=8, array-size-semantics=FIXED-SIZE, implementation-data-type=Ary1D_s4p11_11
    Ary2D_s7p8_11_12: category=ARRAY, sw-calibration-access=READ-ONLY, type-emitter=RTE
      element Element: array-size=11, array-size-semantics=FIXED-SIZE, implementation-data-type=Ary1D_s7p8_12
    Ary2D_s7p8_12_11: category=ARRAY, sw-calibration-access=READ-ONLY, type-emitter=RTE
      element Element: array-size=12, array-size-semantics=FIXED-SIZE, implementation-data-type=Ary1D_s7p8_11
    Ary2D_s7p8_3_5: category=ARRAY, sw-calibration-access=READ-ONLY, type-emitter=RTE
      element Element: array-size=3, array-size-semantics=FIXED-SIZE, implementation-data-type=Ary1D_s7p8_5
    Ary2D_s7p8_3_6: category=ARRAY, sw-calibration-access=READ-ONLY, type-emitter=RTE
      element Element: array-size=3, array-size-semantics=FIXED-SIZE, implementation-data-type=Ary1D_s7p8_6
    Ary2D_s7p8_4_5: category=ARRAY, sw-calibration-access=READ-ONLY, type-emitter=RTE
      element Element: array-size=4, array-size-semantics=FIXED-SIZE, implementation-data-type=Ary1D_s7p8_5
    Ary2D_s7p8_9_5: category=ARRAY, sw-calibration-access=READ-ONLY, type-emitter=RTE
      element Element: array-size=9, array-size-semantics=FIXED-SIZE, implementation-data-type=Ary1D_s7p8_5
    Ary2D_s7p8_9_6: category=ARRAY, sw-calibration-access=READ-ONLY, type-emitter=RTE
      element Element: array-size=9, array-size-semantics=FIXED-SIZE, implementation-data-type=Ary1D_s7p8_6
    Ary2D_u08_2_2: category=ARRAY, sw-calibration-access=READ-ONLY, type-emitter=RTE
      element Element: array-size=2, array-size-semantics=FIXED-SIZE, implementation-data-type=Ary1D_u08_2
    Ary2D_u0p16_20_8: category=ARRAY, sw-calibration-access=READ-ONLY, type-emitter=RTE
      element Element: array-size=20, array-size-semantics=FIXED-SIZE, implementation-data-type=Ary1D_u0p16_8
    Ary2D_u0p16_4_2: category=ARRAY, sw-calibration-access=READ-ONLY, type-emitter=RTE
      element Element: array-size=4, array-size-semantics=FIXED-SIZE, implementation-data-type=Ary1D_u0p16_2
    Ary2D_u10p6_3_7: category=ARRAY, sw-calibration-access=READ-ONLY, type-emitter=RTE
      element Element: array-size=3, array-size-semantics=FIXED-SIZE, implementation-data-type=Ary1D_u10p6_7
    Ary2D_u10p6_8_12: category=ARRAY, sw-calibration-access=READ-ONLY, type-emitter=RTE
      element Element: array-size=8, array-size-semantics=FIXED-SIZE, implementation-data-type=Ary1D_u10p6_12
    Ary2D_u10p6_8_9: category=ARRAY, sw-calibration-access=READ-ONLY, type-emitter=RTE
      element Element: array-size=8, array-size-semantics=FIXED-SIZE, implementation-data-type=Ary1D_u10p6_9
    Ary2D_u12p4_12_13: category=ARRAY, sw-calibration-access=READ-ONLY, type-emitter=RTE
      element Element: array-size=12, array-size-semantics=FIXED-SIZE, implementation-data-type=Ary1D_u12p4_13
    Ary2D_u12p4_4_2: category=ARRAY, sw-calibration-access=READ-ONLY, type-emitter=RTE
      element Element: array-size=4, array-size-semantics=FIXED-SIZE, implementation-data-type=Ary1D_u12p4_2
    Ary2D_u12p4_5_4: category=ARRAY, sw-calibration-access=READ-ONLY, type-emitter=RTE
      element Element: array-size=5, array-size-semantics=FIXED-SIZE, implementation-data-type=Ary1D_u12p4_4
    Ary2D_u12p4_8_12: category=ARRAY, sw-calibration-access=READ-ONLY, type-emitter=RTE
      element Element: array-size=8, array-size-semantics=FIXED-SIZE, implementation-data-type=Ary1D_u12p4_12
    Ary2D_u12p4_9_16: category=ARRAY, sw-calibration-access=READ-ONLY, type-emitter=RTE
      element Element: array-size=9, array-size-semantics=FIXED-SIZE, implementation-data-type=Ary1D_u12p4_16
    Ary2D_u16_3_8: category=ARRAY, sw-calibration-access=READ-ONLY, type-emitter=RTE
      element Element: array-size=3, array-size-semantics=FIXED-SIZE, implementation-data-type=Ary1D_u16p0_8
    Ary2D_u16_8_3: category=ARRAY, sw-calibration-access=READ-ONLY, type-emitter=RTE
      element Element: array-size=8, array-size-semantics=FIXED-SIZE, implementation-data-type=Ary1D_u16_3
    Ary2D_u1p15_12_5: category=ARRAY, sw-calibration-access=READ-ONLY, type-emitter=RTE
      element Element: array-size=12, array-size-semantics=FIXED-SIZE, implementation-data-type=Ary1D_u1p15_5
    Ary2D_u1p15_5_4: category=ARRAY, sw-calibration-access=READ-ONLY, type-emitter=RTE
      element Element: array-size=5, array-size-semantics=FIXED-SIZE, implementation-data-type=Ary1D_u1p15_4
    Ary2D_u1p15_8_4: category=ARRAY, sw-calibration-access=READ-ONLY, type-emitter=RTE
      element Element: array-size=8, array-size-semantics=FIXED-SIZE, implementation-data-type=Ary1D_u1p15_4
    Ary2D_u2p14_12_5: category=ARRAY, sw-calibration-access=READ-ONLY, type-emitter=RTE
      element Element: array-size=12, array-size-semantics=FIXED-SIZE, implementation-data-type=Ary1D_u2p14_5
    Ary2D_u2p14_5_10: category=ARRAY, sw-calibration-access=READ-ONLY, type-emitter=RTE
      element Element: array-size=5, array-size-semantics=FIXED-SIZE, implementation-data-type=Ary1D_u2p14_10
    Ary2D_u2p14_5_8: category=ARRAY, sw-calibration-access=READ-ONLY, type-emitter=RTE
      element Element: array-size=5, array-size-semantics=FIXED-SIZE, implementation-data-type=Ary1D_u2p14_8
    Ary2D_u2p14_6_5: category=ARRAY, sw-calibration-access=READ-ONLY, type-emitter=RTE
      element Element: array-size=6, array-size-semantics=FIXED-SIZE, implementation-data-type=Ary1D_u2p14_5
    Ary2D_u2p14_6_7: category=ARRAY, sw-calibration-access=READ-ONLY, type-emitter=RTE
      element Element: array-size=6, array-size-semantics=FIXED-SIZE, implementation-data-type=Ary1D_u2p14_7
    Ary2D_u2p14_7_6: category=ARRAY, sw-calibration-access=READ-ONLY, type-emitter=RTE
      element Element: array-size=7, array-size-semantics=FIXED-SIZE, implementation-data-type=Ary1D_u2p14_6
    Ary2D_u2p14_7_8: category=ARRAY, sw-calibration-access=READ-ONLY, type-emitter=RTE
      element Element: array-size=7, array-size-semantics=FIXED-SIZE, implementation-data-type=Ary1D_u2p14_8
    Ary2D_u3p13_12_13: category=ARRAY, sw-calibration-access=READ-ONLY, type-emitter=RTE
      element Element: array-size=12, array-size-semantics=FIXED-SIZE, implementation-data-type=Ary1D_u3p13_13
    Ary2D_u3p13_20_8: category=ARRAY, sw-calibration-access=READ-ONLY, type-emitter=RTE
      element Element: array-size=20, array-size-semantics=FIXED-SIZE, implementation-data-type=Ary1D_u3p13_8
    Ary2D_u4p12_12_20: category=ARRAY, sw-calibration-access=READ-ONLY, type-emitter=RTE
      element Element: array-size=12, array-size-semantics=FIXED-SIZE, implementation-data-type=Ary1D_u4p12_20
    Ary2D_u4p12_12_5: category=ARRAY, sw-calibration-access=READ-ONLY, type-emitter=RTE
      element Element: array-size=12, array-size-semantics=FIXED-SIZE, implementation-data-type=Ary1D_u4p12_5
    Ary2D_u4p12_12_8: category=ARRAY, sw-calibration-access=READ-ONLY, type-emitter=RTE
      element Element: array-size=12, array-size-semantics=FIXED-SIZE, implementation-data-type=Ary1D_u4p12_8
    Ary2D_u4p12_13_3: category=ARRAY, sw-calibration-access=READ-ONLY, type-emitter=RTE
      element Element: array-size=13, array-size-semantics=FIXED-SIZE, implementation-data-type=Ary1D_u4p12_3
    Ary2D_u4p12_3_13: category=ARRAY, sw-calibration-access=READ-ONLY, type-emitter=RTE
      element Element: array-size=3, array-size-semantics=FIXED-SIZE, implementation-data-type=Ary1D_u4p12_13
    Ary2D_u4p12_6_7: category=ARRAY, sw-calibration-access=READ-ONLY, type-emitter=RTE
      element Element: array-size=6, array-size-semantics=FIXED-SIZE, implementation-data-type=Ary1D_u4p12_7
    Ary2D_u5p11_12_13: category=ARRAY, sw-calibration-access=READ-ONLY, type-emitter=RTE
      element Element: array-size=12, array-size-semantics=FIXED-SIZE, implementation-data-type=Ary1D_u5p11_13
    Ary2D_u5p11_12_5: category=ARRAY, sw-calibration-access=READ-ONLY, type-emitter=RTE
      element Element: array-size=12, array-size-semantics=FIXED-SIZE, implementation-data-type=Ary1D_u5p11_5
    Ary2D_u5p11_9_16: category=ARRAY, sw-calibration-access=READ-ONLY, type-emitter=RTE
      element Element: array-size=9, array-size-semantics=FIXED-SIZE, implementation-data-type=Ary1D_u5p11_16
    Ary2D_u6p10_5_9: category=ARRAY, sw-calibration-access=READ-ONLY, type-emitter=RTE
      element Element: array-size=5, array-size-semantics=FIXED-SIZE, implementation-data-type=Ary1D_u6p10_9
    Ary2D_u6p10_8_9: category=ARRAY, sw-calibration-access=READ-ONLY, type-emitter=RTE
      element Element: array-size=8, array-size-semantics=FIXED-SIZE, implementation-data-type=Ary1D_u6p10_9
    Ary2D_u7p9_8_4: category=ARRAY, sw-calibration-access=READ-ONLY, type-emitter=RTE
      element Element: array-size=8, array-size-semantics=FIXED-SIZE, implementation-data-type=Ary1D_u7p9_4
    Ary2D_u7p9_9_4: category=ARRAY, sw-calibration-access=READ-ONLY, type-emitter=RTE
      element Element: array-size=9, array-size-semantics=FIXED-SIZE, implementation-data-type=Ary1D_u7p9_4
    Ary2D_u8p8_12_20: category=ARRAY, sw-calibration-access=READ-ONLY, type-emitter=RTE
      element Element: array-size=12, array-size-semantics=FIXED-SIZE, implementation-data-type=Ary1D_u8p8_20
    Ary2D_u8p8_3_5: category=ARRAY, sw-calibration-access=READ-ONLY, type-emitter=RTE
      element Element: array-size=3, array-size-semantics=FIXED-SIZE, implementation-data-type=Ary1D_u8p8_5
    Ary2D_u8p8_3_6: category=ARRAY, sw-calibration-access=READ-ONLY, type-emitter=RTE
      element Element: array-size=3, array-size-semantics=FIXED-SIZE, implementation-data-type=Ary1D_u8p8_6
    Ary2D_u8p8_5_10: category=ARRAY, sw-calibration-access=READ-ONLY, type-emitter=RTE
      element Element: array-size=5, array-size-semantics=FIXED-SIZE, implementation-data-type=Ary1D_u8p8_10
    Ary2D_u8p8_5_8: category=ARRAY, sw-calibration-access=READ-ONLY, type-emitter=RTE
      element Element: array-size=5, array-size-semantics=FIXED-SIZE, implementation-data-type=Ary1D_u8p8_8
    Ary2D_u8p8_6_5: category=ARRAY, sw-calibration-access=READ-ONLY, type-emitter=RTE
      element Element: array-size=6, array-size-semantics=FIXED-SIZE, implementation-data-type=Ary1D_u8p8_5
    Ary2D_u8p8_9_4: category=ARRAY, sw-calibration-access=READ-ONLY, type-emitter=RTE
      element Element: array-size=9, array-size-semantics=FIXED-SIZE, implementation-data-type=Ary1D_u8p8_4
    Ary2D_u8p8_9_5: category=ARRAY, sw-calibration-access=READ-ONLY, type-emitter=RTE
      element Element: array-size=9, array-size-semantics=FIXED-SIZE, implementation-data-type=Ary1D_u8p8_5
    Ary2D_u8p8_9_6: category=ARRAY, sw-calibration-access=READ-ONLY, type-emitter=RTE
      element Element: array-size=9, array-size-semantics=FIXED-SIZE, implementation-data-type=Ary1D_u8p8_6
    Ary2D_u8p8_9_8: category=ARRAY, sw-calibration-access=READ-ONLY, type-emitter=RTE
      element Element: array-size=9, array-size-semantics=FIXED-SIZE, implementation-data-type=Ary1D_u8p8_8
    BattSwdVltgCorrlnSts1: compu {0=BSVCS_NOFLT, 1=BSVCS_BATTVLTGSWD2FLT, 2=BSVCS_BATTVLTGSWD1FLT, 3=BSVCS_BATTVLTGFLT, 4=BSVCS_NOCORRLN}, implementation-data-type=ImplementationDataTypes/uint8, type-emitter=RTE
    BattVltgSt1: compu {0=BATTVLTGST_NORMOPER, 1=BATTVLTGST_HIVLTGWARN, 2=BATTVLTGST_HIVLTGCRIT, 3=BATTVLTGST_HIVLTGOFF, 4=BATTVLTGST_LOVLTGWARN, 5=BATTVLTGST_LOVLTGCRIT, 6=BATTVLTGST_LOVLTGOFF}, implementation-data-type=ImplementationDataTypes/uint8, type-emitter=RTE
    CalCopySts1: compu {0=CALCOPYSTS_NOTRDY, 1=CALCOPYSTS_COPYPNDING, 2=CALCOPYSTS_COPYCMPL, 3=CALCOPYSTS_PROCERR}, implementation-data-type=ImplementationDataTypes/uint8, type-emitter=RTE
    CrcHwResvCfg1: compu {0=CRCHWRESVCFG_32BITCRC32BITWIDTH, 1=CRCHWRESVCFG_32BITCRC16BITWIDTH, 2=CRCHWRESVCFG_32BITCRC8BITWIDTH, 3=CRCHWRESVCFG_16BITCRC16BITWIDTH, 4=CRCHWRESVCFG_16BITCRC8BITWIDTH, 5=CRCHWRESVCFG_8BITCRC, 6=CRCHWRESVCFG_8BITCRCH2F}, implementation-data-type=ImplementationDataTypes/uint8, type-emitter=RTE
    CrcHwResvMod1: compu {0=CRCHWRESVMOD_RELS, 1=CRCHWRESVMOD_RESV}, implementation-data-type=ImplementationDataTypes/uint8, type-emitter=RTE
    CrcHwSts1: compu {0=CRCHWSTS_NOTAVL, 1=CRCHWSTS_AVL, 2=CRCHWSTS_BUSY, 3=CRCHWSTS_NOTENAD, 4=CRCHWSTS_RESV, 255=CRCHWSTS_IDXINVLD}, implementation-data-type=ImplementationDataTypes/uint8, type-emitter=RTE
    CrcHwStsRec1: category=STRUCTURE, sw-calibration-access=READ-ONLY, type-emitter=RTE  # OBSOLETE
      element TaskId: implementation-data-type=ImplementationDataTypes/uint16
      element CrcHwSts: implementation-data-type=CrcHwSts1
    CrcHwStsRec2: category=STRUCTURE, sw-calibration-access=READ-ONLY, type-emitter=RTE
      element TaskId: implementation-data-type=ImplementationDataTypes/uint32
      element CrcHwSts: implementation-data-type=CrcHwSts1
    CurrMeasEolGainCal3PhaRec1: category=STRUCTURE, sw-calibration-access=READ-ONLY, type-emitter=RTE
      element CurrMeasMotCurrEolGainA: implementation-data-type=ImplementationDataTypes/float32
      element CurrMeasMotCurrEolGainB: implementation-data-type=ImplementationDataTypes/float32
      element CurrMeasMotCurrEolGainC: implementation-data-type=ImplementationDataTypes/float32
      symbol props CurrMeasEolGainCal3PhaRec1
    CurrMeasEolGainCalRec1: category=STRUCTURE, sw-calibration-access=READ-ONLY, type-emitter=RTE
      6 x element, all with category=TYPE_REFERENCE, implementation-data-type=ImplementationDataTypes/float32:
        CurrMeasMotCurrEolGainA
        CurrMeasMotCurrEolGainB
        CurrMeasMotCurrEolGainC
        CurrMeasMotCurrEolGainD
        CurrMeasMotCurrEolGainE
        CurrMeasMotCurrEolGainF
      symbol props CurrMeasEolGainCalRec1
    CurrMeasEolOffsCal3PhaRec1: category=STRUCTURE, sw-calibration-access=READ-ONLY, type-emitter=RTE
      7 x element, all with category=TYPE_REFERENCE, implementation-data-type=ImplementationDataTypes/float32:
        CurrMeasEolOffsHiBrdgVltg
        CurrMeasMotCurrEolOffsDifA
        CurrMeasMotCurrEolOffsDifB
        CurrMeasMotCurrEolOffsDifC
        CurrMeasMotCurrOffsLoAvrgA
        CurrMeasMotCurrOffsLoAvrgB
        CurrMeasMotCurrOffsLoAvrgC
      symbol props CurrMeasEolOffsCal3PhaRec1
    CurrMeasEolOffsCalRec1: category=STRUCTURE, sw-calibration-access=READ-ONLY, type-emitter=RTE
      13 x element, all with category=TYPE_REFERENCE, implementation-data-type=ImplementationDataTypes/float32:
        CurrMeasEolOffsHiBrdgVltg
        CurrMeasMotCurrEolOffsDifA
        CurrMeasMotCurrEolOffsDifB
        CurrMeasMotCurrEolOffsDifC
        CurrMeasMotCurrEolOffsDifD
        CurrMeasMotCurrEolOffsDifE
        CurrMeasMotCurrEolOffsDifF
        CurrMeasMotCurrOffsLoAvrgA
        CurrMeasMotCurrOffsLoAvrgB
        CurrMeasMotCurrOffsLoAvrgC
        CurrMeasMotCurrOffsLoAvrgD
        CurrMeasMotCurrOffsLoAvrgE
        CurrMeasMotCurrOffsLoAvrgF
      symbol props CurrMeasEolOffsCalRec1
    CurrMeasEolOffsGainCalRec1: category=STRUCTURE, sw-calibration-access=READ-ONLY, type-emitter=RTE
      6 x element, all with category=TYPE_REFERENCE, implementation-data-type=ImplementationDataTypes/float32:
        CurrMeasMotCurrOffsZeroAvrgA
        CurrMeasMotCurrOffsZeroAvrgB
        CurrMeasMotCurrOffsZeroAvrgC
        CurrMeasMotCurrEolGainA
        CurrMeasMotCurrEolGainB
        CurrMeasMotCurrEolGainC
      symbol props CurrMeasEolOffsGainCalRec1
    DutyCycExcddDataRec1: category=STRUCTURE, sw-calibration-access=READ-ONLY, type-emitter=RTE
      element ExcddCnt: implementation-data-type=ImplementationDataTypes/uint8
      element IgnCnt: implementation-data-type=ImplementationDataTypes/uint8
      symbol props DutyCycExcddDataRec1
    DutyCycThermProtnFilStValRec1: category=STRUCTURE, sw-calibration-access=READ-ONLY, type-emitter=RTE
      4 x element, all with category=TYPE_REFERENCE, implementation-data-type=ImplementationDataTypes/uint8:
        Fil{3..6}StVal
      symbol props DutyCycThermProtnFilStValRec1
    EgyModSt1: compu {0=EGYMODST_NORM, 1=EGYMODST_PRDN, 2=EGYMODST_TRANSPT, 3=EGYMODST_FLS}, implementation-data-type=ImplementationDataTypes/uint8, type-emitter=RTE
    EOLGainOffs1: category=STRUCTURE, sw-calibration-access=READ-ONLY, type-emitter=RTE
      19 x element, all with category=TYPE_REFERENCE, implementation-data-type=ImplementationDataTypes/float32:
        CurrMeasEolOffsHiBrdgVltg
        CurrMeasMotCurrEolGainA
        CurrMeasMotCurrEolGainB
        CurrMeasMotCurrEolGainC
        CurrMeasMotCurrEolGainD
        CurrMeasMotCurrEolGainE
        CurrMeasMotCurrEolGainF
        CurrMeasMotCurrEolOffsDifA
        CurrMeasMotCurrEolOffsDifB
        CurrMeasMotCurrEolOffsDifC
        CurrMeasMotCurrEolOffsDifD
        CurrMeasMotCurrEolOffsDifE
        CurrMeasMotCurrEolOffsDifF
        CurrMeasMotCurrOffsLoAvrgA
        CurrMeasMotCurrOffsLoAvrgB
        CurrMeasMotCurrOffsLoAvrgC
        CurrMeasMotCurrOffsLoAvrgD
        CurrMeasMotCurrOffsLoAvrgE
        CurrMeasMotCurrOffsLoAvrgF
      symbol props EOLGainOffs1
    EotNvmDataRec1: category=STRUCTURE, sw-calibration-access=READ-ONLY, type-emitter=RTE
      4 x element, all with category=TYPE_REFERENCE:
        CwEot: implementation-data-type=ImplementationDataTypes/float32
        CcwEot: implementation-data-type=ImplementationDataTypes/float32
        CwEotDetd: implementation-data-type=ImplementationDataTypes/boolean
        CcwEotDetd: implementation-data-type=ImplementationDataTypes/boolean
    FilHpRec1: category=STRUCTURE, sw-calibration-access=READ-ONLY, type-emitter=NxtrFil
      element FilLpRec: implementation-data-type=FilLpRec1
      element CorrnFac: implementation-data-type=ImplementationDataTypes/float32
    FilLpRec1: category=STRUCTURE, sw-calibration-access=READ-ONLY, type-emitter=NxtrFil
      element FilSt: implementation-data-type=ImplementationDataTypes/float32
      element FilGain: implementation-data-type=ImplementationDataTypes/float32
      symbol props FilLpRec1
    FilNotchGainRec1: category=STRUCTURE, sw-calibration-access=READ-ONLY, type-emitter=RTE
      5 x element, all with category=TYPE_REFERENCE, implementation-data-type=ImplementationDataTypes/float32:
        FilGainB{0..2}
        FilGainA1
        FilGainA2
    FilNotchStRec1: category=STRUCTURE, sw-calibration-access=READ-ONLY, type-emitter=RTE
      element FilSt1: implementation-data-type=ImplementationDataTypes/float32
      element FilSt2: implementation-data-type=ImplementationDataTypes/float32
    GetSegMod1: compu {0=GETSEGMOD_ADRINFO, 1=GETSEGMOD_STDINFO, 2=GETSEGMOD_ADRMPG}, implementation-data-type=ImplementationDataTypes/uint8, type-emitter=RTE
    GmAutnmsDrvgIfFltRespDi1: compu {0=GMAUTNMSDRVGIFFLTRESPDI_TMPINHBD, 1=GMAUTNMSDRVGIFFLTRESPDI_NORM, 2=GMAUTNMSDRVGIFFLTRESPDI_FAILD}, implementation-data-type=ImplementationDataTypes/uint8, type-emitter=RTE
    GmAutnmsSteerCmdSts1: compu {0=GMAUTNMSSTEERCMDSTS_UKWN, 1=GMAUTNMSSTEERCMDSTS_TMPINHBD, 2=GMAUTNMSSTEERCMDSTS_RDY, 3=GMAUTNMSSTEERCMDSTS_ACT, 4=GMAUTNMSSTEERCMDSTS_TMPLIMD, 5=GMAUTNMSSTEERCMDSTS_EMGYSTEERPROF, 6=GMAUTNMSSTEERCMDSTS_FAILD}, implementation-data-type=ImplementationDataTypes/uint8, type-emitter=RTE
    GmBackUpSysPwrModAuthentd1: compu {0=GMBACKUPSYSPWRMODAUTHENTD_OFF, 1=GMBACKUPSYSPWRMODAUTHENTD_ACSY, 2=GMBACKUPSYSPWRMODAUTHENTD_RUN, 3=GMBACKUPSYSPWRMODAUTHENTD_PRPN, 4=GMBACKUPSYSPWRMODAUTHENTD_STRTREQ}, implementation-data-type=ImplementationDataTypes/uint8, type-emitter=RTE
    GmDrvrIntvDetnSt1: compu {0=GMDDRVRINTVDETNST_ININ, 1=GMDDRVRINTVDETNST_TRUE, 2=GMDDRVRINTVDETNST_FALSE, 3=GMDDRVRINTVDETNST_DISAD}, implementation-data-type=ImplementationDataTypes/uint8, type-emitter=RTE
    GmDualEcuOperSts1: compu {0=GMDUALECUOPERSTS_ININ, 1=GMDUALECUOPERSTS_FAILOPER, 2=GMDUALECUOPERSTS_SNGCTRLR, 3=GMDUALECUOPERSTS_FAILD}, implementation-data-type=ImplementationDataTypes/uint8, type-emitter=RTE
    GmFctDiArbnSts1: compu {0=GMFCTDIARBNSTS_WAIT, 1=GMFCTDIARBNSTS_INPROC, 2=GMFCTDIARBNSTS_PASSD, 3=GMFCTDIARBNSTS_SWBASDMTGTNFAIL, 4=GMFCTDIARBNSTS_TIMEOUTFAIL}, implementation-data-type=ImplementationDataTypes/uint8, type-emitter=RTE
    GmOvrlStMgrApaSt1: compu {0=GMOVRLSTMGRAPAST_TMPINHB, 1=GMOVRLSTMGRAPAST_AVLCTRL, 2=GMOVRLSTMGRAPAST_ACTV, 3=GMOVRLSTMGRAPAST_PRMNTFAILD, 4=GMOVRLSTMGRAPAST_MFGDI}, implementation-data-type=ImplementationDataTypes/uint8, type-emitter=RTE
    GmOvrlStMgrHaptcSt1: compu {0=GMOVRLSTMGRHAPTCST_INACTVNOTPLS, 1=GMOVRLSTMGRHAPTCST_ACTVPLS, 2=GMOVRLSTMGRHAPTCST_WAITAFTPLS, 3=GMOVRLSTMGRHAPTCST_INACTVRDYPLS, 4=GMOVRLSTMGRHAPTCST_DI}, implementation-data-type=ImplementationDataTypes/uint8, type-emitter=RTE
    GmSecuAcsFlg1:
      compu {0=GMSECUACSFLG_DIAGCCTRLMGRSECULVLLOCKD, 1=GMSECUACSFLG_DIAGCCTRLMGRSECULVL1, 2=GMSECUACSFLG_DIAGCCTRLMGRSECULVL2, 3=GMSECUACSFLG_DIAGCCTRLMGRSECULVL3, 5=GMSECUACSFLG_DIAGCCTRLMGRSECULVL5, 6=GMSECUACSFLG_DIAGCCTRLMGRSECULVL6, 7=GMSECUACSFLG_DIAGCCTRLMGRSECULVL7, 9=GMSECUACSFLG_DIAGCCTRLMGRSECULVL9, 10=GMSECUACSFLG_DIAGCCTRLMGRSECULVL10, 11=GMSECUACSFLG_DIAGCCTRLMGRSECULVL11}
      implementation-data-type=ImplementationDataTypes/uint8
      type-emitter=RTE
    GmSteerCmdLimrSt1: compu {0=GMSTEERCMDLIMRST_UKWN, 1=GMSTEERCMDLIMRST_NORM, 2=GMSTEERCMDLIMRST_SFTYLIMEXCDD, 3=GMSTEERCMDLIMRST_THERM, 4=GMSTEERCMDLIMRST_VLTG, 5=GMSTEERCMDLIMRST_LSH, 6=GMSTEERCMDLIMRST_FRICLIMD, 7=GMSTEERCMDLIMRST_ECUFLTLIMD}, implementation-data-type=ImplementationDataTypes/uint8, type-emitter=RTE
    GmSteerCmdMsgSrc1: compu {0=GMSTEERCMDMSGSRC_PRIMCTRLR, 1=GMSTEERCMDMSGSRC_RDNTCTRLR, 2=GMSTEERCMDMSGSRC_DUALECUFAILD}, implementation-data-type=ImplementationDataTypes/uint8, type-emitter=RTE
    GmSteerCmdMsgSts1: compu {0=GMSTEERCMDMSGSTS_NORMCOM, 1=GMSTEERCMDMSGSTS_PRIMCOMFAILD, 2=GMSTEERCMDMSGSTS_RDNTCOMFAILD, 3=GMSTEERCMDMSGSTS_DUALECUCOMFAILD}, implementation-data-type=ImplementationDataTypes/uint8, type-emitter=RTE
    GmSteerMod1: compu {0=GMSTEERMOD_BASEPS, 1=GMSTEERMOD_SEMIATNMS, 2=GMSTEERMOD_FULLYATNMS}, implementation-data-type=ImplementationDataTypes/uint8, type-emitter=RTE
    GmSysPwrMod1: compu {0=GMSYSPWRMOD_OFF, 1=GMSYSPWRMOD_ACSY, 2=GMSYSPWRMOD_RUN, 3=GMSYSPWRMOD_CRK, 4=GMSYSPWRMOD_PRPN}, implementation-data-type=ImplementationDataTypes/uint8, type-emitter=RTE
    GmSysPwrModAuthentd1: compu {0=GMSYSPWRMODAUTHENTD_OFF, 1=GMSYSPWRMODAUTHENTD_ACSY, 2=GMSYSPWRMODAUTHENTD_RUN, 3=GMSYSPWRMODAUTHENTD_STRTREQ, 4=GMSYSPWRMODAUTHENTD_PRPN}, implementation-data-type=ImplementationDataTypes/uint8, type-emitter=RTE
    GmTqArbnEscSt1: compu {0=GMTQARBNESCST_INACTV, 1=GMTQARBNESCST_ACTV, 2=GMTQARBNESCST_TMPLIMD, 3=GMTQARBNESCST_PRMNTFAILD, 4=GMTQARBNESCST_MFGDI}, implementation-data-type=ImplementationDataTypes/uint8, type-emitter=RTE
    GmTqArbnLkaSt1: compu {0=GMTQARBNLKAST_INACTV, 1=GMTQARBNLKAST_ACTV, 2=GMTQARBNLKAST_TMPLIMD, 3=GMTQARBNLKAST_PRMNTFAILD, 4=GMTQARBNLKAST_MFGDI}, implementation-data-type=ImplementationDataTypes/uint8, type-emitter=RTE
    GmTqArbnTrfcJamAssiSt1: compu {0=GMTQARBNTRFCJAMASSIST_INACTV, 1=GMTQARBNTRFCJAMASSIST_ACTV, 2=GMTQARBNTRFCJAMASSIST_TMPLIMD, 3=GMTQARBNTRFCJAMASSIST_PRMNTFAILD, 4=GMTQARBNTRFCJAMASSIST_MFGDI}, implementation-data-type=ImplementationDataTypes/uint8, type-emitter=RTE
    GmTrsmShiftLvrPosnAuthentd1:
      compu {0=GMTRSMSHIFTLVRPOSNAUTHENTD_BTWNRNG, 1=GMTRSMSHIFTLVRPOSNAUTHENTD_PARKRNG, 2=GMTRSMSHIFTLVRPOSNAUTHENTD_RVSRNG, 3=GMTRSMSHIFTLVRPOSNAUTHENTD_NEUTRNG, 4=GMTRSMSHIFTLVRPOSNAUTHENTD_FWDRNGA, 5=GMTRSMSHIFTLVRPOSNAUTHENTD_FWDRNGB, 6=GMTRSMSHIFTLVRPOSNAUTHENTD_FWDRNGC, 7=GMTRSMSHIFTLVRPOSNAUTHENTD_FWDRNGD, 8=GMTRSMSHIFTLVRPOSNAUTHENTD_FWDRNGE, 9=GMTRSMSHIFTLVRPOSNAUTHENTD_FWDRNGF, 10=GMTRSMSHIFTLVRPOSNAUTHENTD_FWDRNGG, 11=GMTRSMSHIFTLVRPOSNAUTHENTD_FWDRNGH, 12=GMTRSMSHIFTLVRPOSNAUTHENTD_FWDRNGI, 13=GMTRSMSHIFTLVRPOSNAUTHENTD_FWDRNGJ, 14=GMTRSMSHIFTLVRPOSNAUTHENTD_LVRPOSNUNKWN}
      implementation-data-type=ImplementationDataTypes/uint8
      type-emitter=RTE
    GmVehHlthMgrSt1: compu {0=GMVEHHLTHMGRST_ININ, 1..5=GMVEHHLTHMGRST_DEGRADEDMOD1..GMVEHHLTHMGRST_DEGRADEDMOD5, 6=GMVEHHLTHMGRST_NORMOPER}, implementation-data-type=ImplementationDataTypes/uint8, type-emitter=RTE
    GmVehModMgrSt1: compu {0=GMVEHMODMGRST_UKWN, 1=GMVEHMODMGRST_MAN, 2=GMVEHMODMGRST_AUTNMSSUPVD, 3=GMVEHMODMGRST_SUPVROVRD, 4=GMVEHMODMGRST_AUTNMSUNSUPVD, 5=GMVEHMODMGRST_FAILD}, implementation-data-type=ImplementationDataTypes/uint8, type-emitter=RTE
    HwAgOffsRec1: category=STRUCTURE, sw-calibration-access=READ-ONLY, type-emitter=RTE
      element OffsTrim: implementation-data-type=ImplementationDataTypes/float32
      element OffsTrimPrfmdSts: implementation-data-type=ImplementationDataTypes/boolean
    HwAgSnsrTrimRec1: category=STRUCTURE, sw-calibration-access=READ-ONLY, type-emitter=RTE
      element TrimVal: implementation-data-type=ImplementationDataTypes/float32
      element TrimPrfmd: implementation-data-type=ImplementationDataTypes/boolean
    HwAgSnsrTyp1: compu {0=HWAGSNSRTYP_NOSNSR, 1=HWAGSNSRTYP_A1335}, implementation-data-type=ImplementationDataTypes/uint8, type-emitter=RTE
    HwAgTrajCmdSt1: compu {0=HWAGTRAJCMDST_WAIT, 1=HWAGTRAJCMDST_HWAGA, 2=HWAGTRAJCMDST_CONVEL, 3=HWAGTRAJCMDST_HWAGDECEL, 4=HWAGTRAJCMDST_HLD}, implementation-data-type=ImplementationDataTypes/uint16, type-emitter=RTE
    HwTqOffsRec1: category=STRUCTURE, sw-calibration-access=READ-ONLY, type-emitter=RTE
      element OffsTrim: implementation-data-type=ImplementationDataTypes/float32
      element OffsTrimPrfmdSts: implementation-data-type=ImplementationDataTypes/boolean
    ImcArbnRxDataSrc1: implementation-data-type=ImcArbnRxDataSrc2, type-emitter=RTE
    ImcArbnRxDataSrc2: implementation-data-type=ImplementationDataTypes/uint8, type-emitter=ImcArbn
    ImcArbnRxExtdSts1: implementation-data-type=ImcArbnRxExtdSts2, type-emitter=RTE
    ImcArbnRxExtdSts2: implementation-data-type=ImplementationDataTypes/uint8, type-emitter=ImcArbn
    ImcArbnRxSts1: compu {0=IMCARBNRXSTS_NODATA, 1=IMCARBNRXSTS_VLD, phys=raw for raw 2}, implementation-data-type=ImplementationDataTypes/uint8, type-emitter=RTE
    LoaSt1: compu {0=LOAST_NORM, 1=LOAST_LIMD, 2=LOAST_SWBASDMTGTN, 3=LOAST_FADEOUT, 4=LOAST_CTRLDSHTDWNREQD, 5=LOAST_IMDTSHTDWNREQD}, implementation-data-type=ImplementationDataTypes/uint8, type-emitter=RTE
    MaxHwAgCwAndCcwRec2: category=STRUCTURE, sw-calibration-access=READ-ONLY, type-emitter=RTE
      element HwAgCcwMax: implementation-data-type=ImplementationDataTypes/float32
      element HwAgCwMax: implementation-data-type=ImplementationDataTypes/float32
      element HwAgOverTrvlCnt: implementation-data-type=ImplementationDataTypes/uint8
    MfgEnaSt1: compu {0=MFGENAST_PRDNMOD, 1=MFGENAST_MFGMOD, 2=MFGENAST_TESTMOD}, implementation-data-type=ImplementationDataTypes/uint8, type-emitter=RTE
    MotAgEolPrmRec1: category=STRUCTURE, sw-calibration-access=READ-ONLY, type-emitter=RTE
      12 x element, all with category=TYPE_REFERENCE:
        SinOffs: implementation-data-type=u3p13
        CosOffs: implementation-data-type=u3p13
        SinAmpRecpr: implementation-data-type=u3p13
        CosAmpRecpr: implementation-data-type=u3p13
        SinDelta: implementation-data-type=s2p13
        SinHrmncTbl: implementation-data-type=Ary1D_sm6p13_144
        CosHrmncTbl: implementation-data-type=Ary1D_sm6p13_144
        SinGainCorrd: implementation-data-type=u1p15
        CosGainCorrd: implementation-data-type=u1p15
        SinOffsCorrd: implementation-data-type=s2p13
        CosOffsCorrd: implementation-data-type=s2p13
        CosDeltaRecpr: implementation-data-type=u3p13
    MotAgMeasEolPrmRec1: category=STRUCTURE, sw-calibration-access=READ-ONLY, type-emitter=RTE
      5 x element, all with category=TYPE_REFERENCE, implementation-data-type=ImplementationDataTypes/float32:
        SinOffs
        CosOffs
        SinAmpRecpr
        CosAmpRecpr
        SinDelta
    MotAgRtPrmRec1: category=STRUCTURE, sw-calibration-access=READ-ONLY, type-emitter=RTE
      14 x element, all with category=TYPE_REFERENCE, implementation-data-type=ImplementationDataTypes/float32:
        SinRtOffs
        SinRtAmpRecpr
        CosRtOffs
        CosRtAmpRecpr
        SinGainCorrd
        CosGainCorrd
        SinOffsCorrd
        CosOffsCorrd
        CosSinNomRatio
        SinCosNomRatio
        RtToNomRatioLoLim
        RtToNomRatioHiLim
        PrevSinRtOffs
        PrevCosRtOffs
    MotAgStVariRec1: category=STRUCTURE, sw-calibration-access=READ-ONLY, type-emitter=RTE
      4 x element, all with category=TYPE_REFERENCE, implementation-data-type=ImplementationDataTypes/float32:
        MotAgSinMax
        MotAgSinMin
        MotAgCosMax
        MotAgCosMin
    MotCurrEolCalSt2: compu {0=MCECS_OFFSCMDSTRT, 1=MCECS_OFFSCMDHI, 2=MCECS_OFFSCMDLO, 3=MCECS_OFFSCMDZERO, 4=MCECS_OFFSCMDEND, 5=MCECS_GAINCMDAD, 6=MCECS_GAINCMDBE, 7=MCECS_GAINCMDCF, 8=MCECS_CMDSAFEST}, implementation-data-type=ImplementationDataTypes/uint8, type-emitter=RTE
    MotPrmNomEolRec2: category=STRUCTURE, sw-calibration-access=READ-ONLY, type-emitter=RTE
      element MotKeNom: implementation-data-type=PlatformTypes/float32
      element MotRNom: implementation-data-type=PlatformTypes/float32
      symbol props MotPrmNomEolRec2
    MotPrmNomEolRec3: category=STRUCTURE, sw-calibration-access=READ-ONLY, type-emitter=RTE
      element MotBackEmfConNom: implementation-data-type=ImplementationDataTypes/float32
      element MotRNom: implementation-data-type=ImplementationDataTypes/float32
      symbol props MotPrmNomEolRec3
    MotQuad1: compu {1..4=MOTQUAD_QUAD1..MOTQUAD_QUAD4}, implementation-data-type=ImplementationDataTypes/uint8, type-emitter=RTE
    MotRplCoggPrmRec2: category=STRUCTURE, sw-calibration-access=READ-ONLY, type-emitter=RTE
      9 x element, all with category=TYPE_REFERENCE:
        CoggOrder1: implementation-data-type=ImplementationDataTypes/uint16
        CoggOrder1X: implementation-data-type=s1p14
        CoggOrder1Y: implementation-data-type=s1p14
        CoggOrder2: implementation-data-type=ImplementationDataTypes/uint16
        CoggOrder2X: implementation-data-type=s1p14
        CoggOrder2Y: implementation-data-type=s1p14
        CoggOrder3: implementation-data-type=ImplementationDataTypes/uint16
        CoggOrder3X: implementation-data-type=s1p14
        CoggOrder3Y: implementation-data-type=s1p14
    NtcFltInfoRec2: category=STRUCTURE, sw-calibration-access=READ-ONLY, type-emitter=RTE
      element NtcNr: implementation-data-type=NtcNrWithResd1
      element AgiCntr: implementation-data-type=ImplementationDataTypes/uint8
      element Sts: implementation-data-type=ImplementationDataTypes/uint8
    NtcInfoRec4: category=STRUCTURE, sw-calibration-access=READ-ONLY, type-emitter=DiagcMgr
      element NtcStInfo: implementation-data-type=ImplementationDataTypes/uint8
      element Sts: implementation-data-type=ImplementationDataTypes/uint8
      element AgiCntr: implementation-data-type=ImplementationDataTypes/uint8
    NtcNr1: compu {1..511=NTCNR_0X001..NTCNR_0X1FF}, implementation-data-type=ImplementationDataTypes/uint16, type-emitter=RTE
    NtcNrWithResd1: compu {0=NTCNR_RESD, 1..511=NTCNR_0X001..NTCNR_0X1FF}, implementation-data-type=ImplementationDataTypes/uint16, type-emitter=RTE
    NtcSts1: compu {0=NTCSTS_PASSD, 1=NTCSTS_FAILD, 2=NTCSTS_PREPASSD, 3=NTCSTS_PREFAILD}, implementation-data-type=ImplementationDataTypes/uint8, type-emitter=RTE
    PassFailCntrDiagcRec1: category=STRUCTURE, sw-calibration-access=READ-ONLY, type-emitter=RTE
      5 x element, all with category=TYPE_REFERENCE:
        Cntr: implementation-data-type=ImplementationDataTypes/float32
        Thd: implementation-data-type=ImplementationDataTypes/float32
        NegStep: implementation-data-type=ImplementationDataTypes/float32
        PosStep: implementation-data-type=ImplementationDataTypes/float32
        Sts: implementation-data-type=SigQlfr1
    PwrDiscnctSts1: compu {0=PWRDISCNCTSTS_WAITFORSTRTA, 1=PWRDISCNCTSTS_VRFYDISCNCTOPEN, 2=PWRDISCNCTSTS_WAITFORSTRTB, 3=PWRDISCNCTSTS_VRFYCLS, 4=PWRDISCNCTSTS_SEQFAIL, 5=PWRDISCNCTSTS_RTDIAGC}, implementation-data-type=ImplementationDataTypes/uint8, type-emitter=RTE
    ReadFltInfoRec1: category=STRUCTURE, sw-calibration-access=READ-ONLY, type-emitter=RTE
      4 x element, all with category=TYPE_REFERENCE:
        NtcNr: implementation-data-type=NtcNrWithResd1
        AgiCntr: implementation-data-type=ImplementationDataTypes/uint8
        Sts: implementation-data-type=ImplementationDataTypes/uint8
        NtcStInfo: implementation-data-type=ImplementationDataTypes/uint8
    s10p5: implementation-data-type=ImplementationDataTypes/sint16, type-emitter=RTE
    s11p4: implementation-data-type=ImplementationDataTypes/sint16, type-emitter=RTE
    s14p1: implementation-data-type=ImplementationDataTypes/sint16, type-emitter=RTE
    s15p0: implementation-data-type=ImplementationDataTypes/sint16, type-emitter=RTE
    s15p16: implementation-data-type=ImplementationDataTypes/sint32, type-emitter=RTE
    s18p13: implementation-data-type=ImplementationDataTypes/sint32, type-emitter=RTE
    s1p14: implementation-data-type=ImplementationDataTypes/sint16, type-emitter=RTE
    s2p13: implementation-data-type=ImplementationDataTypes/sint16, type-emitter=RTE
    s3p12: implementation-data-type=ImplementationDataTypes/sint16, type-emitter=RTE
    s4p11: implementation-data-type=ImplementationDataTypes/sint16, type-emitter=RTE
    s5p10: implementation-data-type=ImplementationDataTypes/sint16, type-emitter=RTE
    s6p9: implementation-data-type=ImplementationDataTypes/sint16, type-emitter=RTE
    s7p8: implementation-data-type=ImplementationDataTypes/sint16, type-emitter=RTE
    s8p7: implementation-data-type=ImplementationDataTypes/sint16, type-emitter=RTE
    SelnCaseSt1: compu {0=SELNCASEST_FCENTR, 1=SELNCASEST_VEHDYN, 2=SELNCASEST_WHLSPD, 3=SELNCASEST_STORDLSTPOSN, 4=SELNCASEST_CORRDPINIONAG}, implementation-data-type=ImplementationDataTypes/uint8, type-emitter=RTE
    SigQlfr1: compu {0=SIGQLFR_NORES, 1=SIGQLFR_PASSD, 2=SIGQLFR_FAILD}, implementation-data-type=ImplementationDataTypes/uint8, type-emitter=RTE
    sm5p12: implementation-data-type=ImplementationDataTypes/sint8, type-emitter=RTE
    sm6p13: implementation-data-type=ImplementationDataTypes/sint8, type-emitter=RTE
    SnpshtDataRec2: category=STRUCTURE, sw-calibration-access=READ-ONLY, type-emitter=RTE
      12 x element, all with category=TYPE_REFERENCE:
        SpclSnpshtData{0..2}: implementation-data-type=ImplementationDataTypes/uint32
        MicroDiagcData: implementation-data-type=ImplementationDataTypes/uint32
        IgnCntr: implementation-data-type=ImplementationDataTypes/uint32
        HwTq: implementation-data-type=s5p10
        MotTq: implementation-data-type=s5p10
        BrdgVltg: implementation-data-type=u6p10
        EcuT: implementation-data-type=s8p7
        NtcNr: implementation-data-type=NtcNrWithResd1
        NtcStInfo: implementation-data-type=ImplementationDataTypes/uint8
        SysSt: implementation-data-type=SysSt1
    SnsrLrndOffsRec1: category=STRUCTURE, sw-calibration-access=READ-ONLY, type-emitter=RTE
      15 x element, all with category=TYPE_REFERENCE:
        HwAgLrndTi: implementation-data-type=ImplementationDataTypes/float32
        YawRateElpdTi: implementation-data-type=ImplementationDataTypes/float32
        HwTqLrngCovariMtrx: implementation-data-type=Ary2D_f32_3_3
        HwTqLrngEstimnVect: implementation-data-type=Ary1D_f32_3
        YawRateOffs: implementation-data-type=s6p9
        HwAgOffs: implementation-data-type=s5p10
        HwTqOffs: implementation-data-type=s3p12
        HwAgLrngYawOffsRef: implementation-data-type=s6p9
        HwAgLrngHwAgFilSt: implementation-data-type=s11p4
        HwAgLrngSysTqFilSt: implementation-data-type=s10p5
        HwTqLrngHwAgRef: implementation-data-type=s11p4
        HwTqLrngSampleCntNeg: implementation-data-type=ImplementationDataTypes/uint16
        HwTqLrngSampleCntPos: implementation-data-type=ImplementationDataTypes/uint16
        HwTqLrngSts: implementation-data-type=ImplementationDataTypes/uint8
        YawRateOffsVld: implementation-data-type=ImplementationDataTypes/boolean
    SteerMod1: compu {0=STEERMOD_BASEPS, 1=STEERMOD_SEMIATNMS, 2=STEERMOD_FULLYATNMS}, implementation-data-type=ImplementationDataTypes/uint8, type-emitter=RTE
    StHlthMonSig3:
      compu {0=STHLTHMONSIG_ECUTFILTD, 1=STHLTHMONSIG_ASSIDUETOVLTG, 2=STHLTHMONSIG_DIGTQSNSRA, 3=STHLTHMONSIG_DIGTQSNSRB, 4=STHLTHMONSIG_DIGTQIDPTSIG, 5=STHLTHMONSIG_DUTYCYC, 6=STHLTHMONSIG_EOTIMPCT, 7=STHLTHMONSIG_MOTPOS, 8=STHLTHMONSIG_MOTPOSABDIFF, 9=STHLTHMONSIG_MOTPOSACDIFF, 10=STHLTHMONSIG_MOTPOSBCDIFF, 11=STHLTHMONSIG_CURRMOTSUMABC, 12=STHLTHMONSIG_CURRMOTSUMDEF, 13=STHLTHMONSIG_MOTPOSPHASEA, 14=STHLTHMONSIG_MOTPOSPHASEB, 15=STHLTHMONSIG_MOTPOSPHASEC, 16=STHLTHMONSIG_MOTPOSPHASED, 17=STHLTHMONSIG_MOTPOSPHASEE, 18=STHLTHMONSIG_MOTPOSPHASEF, 19=STHLTHMONSIG_BITCORRN, 20=STHLTHMONSIG_FRICESTIMN, 21=STHLTHMONSIG_WHLIMBREJCTN}
      implementation-data-type=ImplementationDataTypes/uint8
      type-emitter=RTE
    StHlthMonSig4:
      compu {0=STHLTHMONSIG_ECUTFILTD, 1=STHLTHMONSIG_ASSIDUETOVLTG, 2=STHLTHMONSIG_DIGTQSNSRA, 3=STHLTHMONSIG_DIGTQSNSRB, 4=STHLTHMONSIG_DIGTQIDPTSIG, 5=STHLTHMONSIG_DUTYCYC, 6=STHLTHMONSIG_EOTIMPCT, 7=STHLTHMONSIG_MOTPOS, 8=STHLTHMONSIG_MOTPOSABDIFF, 9=STHLTHMONSIG_MOTPOSACDIFF, 10=STHLTHMONSIG_MOTPOSBCDIFF, 11=STHLTHMONSIG_CURRMOTSUMABC, 12=STHLTHMONSIG_CURRMOTSUMDEF, 13=STHLTHMONSIG_MOTPOSPHASEA, 14=STHLTHMONSIG_MOTPOSPHASEB, 15=STHLTHMONSIG_MOTPOSPHASEC, 16=STHLTHMONSIG_MOTPOSPHASED, 17=STHLTHMONSIG_MOTPOSPHASEE, 18=STHLTHMONSIG_MOTPOSPHASEF, 19=STHLTHMONSIG_BITCORRN, 20=STHLTHMONSIG_FRICESTIMN, 21=STHLTHMONSIG_WHLIMBREJCTN, 22=STHLTHMONSIG_DIGTQSNSRC, 23=STHLTHMONSIG_DIGTQSNSRD}
      implementation-data-type=ImplementationDataTypes/uint8
      type-emitter=RTE
    StordLstPrmRec1: category=STRUCTURE, sw-calibration-access=READ-ONLY, type-emitter=RTE
      element PinionAg: implementation-data-type=ImplementationDataTypes/float32
      element PinionAgVld: implementation-data-type=ImplementationDataTypes/boolean
    StrtUpSt1: compu {1=STRTUPST_PWRDISCNCTATESTCMPL, 2=STRTUPST_PWRDISCNCTBTESTCMPL, 3=STRTUPST_TMPLMONININTESTCMPL, 4=STRTUPST_MOTDRVRININCMPL, 5=STRTUPST_CURRMEASWRMININTESTCMPL, 6=STRTUPST_WARMININCMPL, 7=STRTUPST_RUN, 8=STRTUPST_DISABLE}, implementation-data-type=ImplementationDataTypes/uint8, type-emitter=RTE
    SysFricDataRec1: category=STRUCTURE, sw-calibration-access=READ-ONLY, type-emitter=RTE
      6 x element, all with category=TYPE_REFERENCE:
        FricOffs: implementation-data-type=ImplementationDataTypes/float32
        BasLineFric: implementation-data-type=Ary1D_f32_4
        VehLrndFric: implementation-data-type=Ary1D_f32_4
        Hys: implementation-data-type=Ary2D_f32_8_4
        RngCntr: implementation-data-type=Ary2D_u16_8_3
        SysFricLrngOperMod: implementation-data-type=SysFricLrngOperMod1
    SysFricLrngOperMod1: compu {0=SYSFRICLRNGOPERMOD_CALIBRATION, 1=SYSFRICLRNGOPERMOD_NORMAL, 2=SYSFRICLRNGOPERMOD_CLEAR, 3=SYSFRICLRNGOPERMOD_IDLE, 4=SYSFRICLRNGOPERMOD_BASELINE}, implementation-data-type=ImplementationDataTypes/uint8, type-emitter=RTE
    SysFricNonLrngDataRec1: category=STRUCTURE, sw-calibration-access=READ-ONLY, type-emitter=RTE
      element EolFric: implementation-data-type=ImplementationDataTypes/float32
      element EnaFricLrng: implementation-data-type=ImplementationDataTypes/boolean
      element EnaFricOffsOutp: implementation-data-type=ImplementationDataTypes/boolean
    SysSt1: compu {0=SYSST_DI, 1=SYSST_OFF, 2=SYSST_ENA, 3=SYSST_WRMININ}, implementation-data-type=ImplementationDataTypes/uint8, type-emitter=RTE
    TrigReg1: compu {85=TRIGREG_MST, 170=TRIGREG_CHKR, 255=TRIGREG_MSTANDCHKR}, implementation-data-type=ImplementationDataTypes/uint8, type-emitter=EcmOutpAndDiagc
    u0p16: implementation-data-type=ImplementationDataTypes/uint16, type-emitter=RTE
    u10p6: implementation-data-type=ImplementationDataTypes/uint16, type-emitter=RTE
    u11p5: implementation-data-type=ImplementationDataTypes/uint16, type-emitter=RTE
    u12p4: implementation-data-type=ImplementationDataTypes/uint16, type-emitter=RTE
    u13p3: implementation-data-type=ImplementationDataTypes/uint16, type-emitter=RTE
    u15p1: implementation-data-type=ImplementationDataTypes/uint16, type-emitter=RTE
    u16p0: implementation-data-type=ImplementationDataTypes/uint16, type-emitter=RTE
    u1p15: implementation-data-type=ImplementationDataTypes/uint16, type-emitter=RTE
    u2p14: implementation-data-type=ImplementationDataTypes/uint16, type-emitter=RTE
    u3p13: implementation-data-type=ImplementationDataTypes/uint16, type-emitter=RTE
    u4p12: implementation-data-type=ImplementationDataTypes/uint16, type-emitter=RTE
    u5p11: implementation-data-type=ImplementationDataTypes/uint16, type-emitter=RTE
    u6p10: implementation-data-type=ImplementationDataTypes/uint16, type-emitter=RTE
    u7p9: implementation-data-type=ImplementationDataTypes/uint16, type-emitter=RTE
    u8p8: implementation-data-type=ImplementationDataTypes/uint16, type-emitter=RTE
    u9p7: implementation-data-type=ImplementationDataTypes/uint16, type-emitter=RTE
    WhlImbRejctnCmpPeakRec1: category=STRUCTURE, sw-calibration-access=READ-ONLY, type-emitter=RTE
      6 x element, all with category=TYPE_REFERENCE:
        LePeakPrev: implementation-data-type=ImplementationDataTypes/float32
        RiPeakPrev: implementation-data-type=ImplementationDataTypes/float32
        MaxCompPerc: implementation-data-type=ImplementationDataTypes/float32
        ActvCmpBand{1..3}: implementation-data-type=ImplementationDataTypes/uint32
package /Nexteer/DataTypes/CompuMethods
  compu method MotCurrEolCalSt1: 1=MCECS_OFFSCMDHI, 2=MCECS_OFFSCMDLO, 3=MCECS_OFFSCMDZERO, 4=MCECS_OFFSCMDEND, 5=MCECS_GAINCMDAD, 6=MCECS_GAINCMDBE, 7=MCECS_GAINCMDCF, 8=MCECS_CMDSAFEST
package /Nexteer/Units
  39 x unit, all with factor-si-to-unit=1, offset-si-to-unit=0:
    Ampr: display-name=Amp
    AmprPerVolt: display-name=Amp/V
    AmprSqd: display-name=Amp^2
    Cnt: display-name=Cnt
    DegCgrd: display-name=degC
    DegCgrdPerVolt: display-name=degC/Volt
    FixdPt
    Henry: display-name=H
    HwDeg: display-name=HwDeg
    HwDegPerSec: display-name=HwDeg/s
    HwNwtMtr: display-name=HwNm
    HwRadPerSec: display-name=HwRad/s
    Hz: display-name=Hz
    Kph: display-name=kph
    KphPerSec: display-name=kph/s
    KphPerSecSqd: display-name=kph/s^2
    MicroSec: display-name=uS
    MotDeg: display-name=MotDeg
    MotDegPerHwDeg: display-name=MotDeg/HwDeg
    MotNwtMtr: display-name=MotNm
    MotNwtMtrPerMotRadPerSec: display-name=MotNm/MotRad/S
    MotRad: display-name=MotRad
    MotRadPerSec: display-name=MotRad/s
    MotRev: display-name=MotRev
    MotRevElec: display-name=MotRevElec
    MtrPerSecSqd: display-name=m/s^2
    NanoSec: display-name=nS
    Ohm: display-name=ohm
    OhmPerDegCgrd: display-name=ohm/degC
    Sec: display-name=sec
    Uls: display-name=Uls
    UlsPerSec: display-name=Uls/S
    VehDegPerSec: display-name=VehDeg/S
    VehDegPerSecSqd: display-name=VehDeg/S^2
    Volt: display-name=V
    VoltNanoSec: display-name=VnS
    VoltPerMotRadPerSec: display-name=V/MotRad/Sec
    VoltPerMotRadPerSecPerDegCgrd: display-name=V/MotRad/S/degC
    VoltPerVoltNanoSec
