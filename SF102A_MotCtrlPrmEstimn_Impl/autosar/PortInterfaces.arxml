AUTOSAR XML (schema 4-0-3)
package /Nexteer/Calibrations
  14 x parameter interface:
    Ary2D_u2p14_6_7_PortIf1
      parameter data prototype Ary2D: sw-calibration-access=READ-WRITE, type=Ary2D_u2p14_6_7
    CurrAry1D1
      parameter data prototype Ary1D: sw-calibration-access=READ-WRITE, type=CurrAry1D1
    CurrAry1D2
      parameter data prototype Ary1D: sw-calibration-access=READ-WRITE, type=CurrAry1D2
    CurrAry1D3
      parameter data prototype Ary1D: sw-calibration-access=READ-WRITE, type=CurrAry1D3
    float32_CalPortIf1
      parameter data prototype Val: sw-calibration-access=READ-WRITE, type=float32
    Gain4
      parameter data prototype Val: sw-calibration-access=READ-WRITE, type=Gain5
    Gain5
      parameter data prototype Val: sw-calibration-access=READ-WRITE, type=Gain6
    Gain6
      parameter data prototype Val: sw-calibration-access=READ-WRITE, type=Gain7
    Indu1
      parameter data prototype Val: sw-calibration-access=READ-WRITE, type=Indu1
    MotCon1
      parameter data prototype Val: sw-calibration-access=READ-WRITE, type=MotCon1
    R2
      parameter data prototype Val: sw-calibration-access=READ-WRITE, type=R6
    R3
      parameter data prototype Val: sw-calibration-access=READ-WRITE, type=R8
    T4
      parameter data prototype Val: sw-calibration-access=READ-WRITE, type=T5
    UlsAry1D2
      parameter data prototype Ary1D: sw-calibration-access=READ-WRITE, type=UlsAry1D3
package /Nexteer/NvMProxy_swc/Interfaces
  client server interface NvMService_AC3_SRBS: is-service=true
    6 x operation, all with possible-error=NvMService_AC3_SRBS/E_NOT_OK:
      EraseBlock
      GetErrorStatus
        arg ErrorStatus: type=NvM_RequestResultType, direction=OUT, server-argument-impl-policy=USE-ARGUMENT-TYPE
      InvalidateNvBlock
      ReadBlock
        arg DstPtr: type=dtRef_VOID, direction=IN, server-argument-impl-policy=USE-ARGUMENT-TYPE
      SetRamBlockStatus
        arg RamBlockStatus: type=Boolean, direction=IN, server-argument-impl-policy=USE-ARGUMENT-TYPE
      WriteBlock
        arg SrcPtr: type=dtRef_const_VOID, direction=IN, server-argument-impl-policy=USE-ARGUMENT-TYPE
    error E_NOT_OK: error-code=1
package /Nexteer/PortInterfaces
  client server interface GetMotPrmNomEol2
    operation Oper: possible-error=GetMotPrmNomEol2/E_NOT_OK
      arg MotBackEmfConNom_Arg: type=MotCon1, direction=OUT, server-argument-impl-policy=USE-ARGUMENT-TYPE
      arg MotRNom_Arg: type=R6, direction=OUT, server-argument-impl-policy=USE-ARGUMENT-TYPE
    error E_NOT_OK: error-code=1
  client server interface SetMotPrmNomEol2
    operation Oper: possible-error=SetMotPrmNomEol2/E_NOT_OK
      arg MotBackEmfConNom_Arg: type=MotCon1, direction=IN, server-argument-impl-policy=USE-ARGUMENT-TYPE
      arg MotRNom_Arg: type=R6, direction=IN, server-argument-impl-policy=USE-ARGUMENT-TYPE
    error E_NOT_OK: error-code=1
  10 x sender receiver interface:
    boolean_PortIf1: invalidation-policy{data-element=Logl, handle-invalid=DONT-INVALIDATE}
      data Logl: sw-calibration-access=READ-ONLY, type=boolean
    Curr2: invalidation-policy{data-element=Curr2/Val, handle-invalid=DONT-INVALIDATE}
      data Val: sw-calibration-access=READ-ONLY, type=Curr6
    Curr3: invalidation-policy{data-element=Curr3/Val, handle-invalid=DONT-INVALIDATE}
      data Val: sw-calibration-access=READ-ONLY, type=Curr7
    Indu2: invalidation-policy{data-element=Indu2/Val, handle-invalid=DONT-INVALIDATE}
      data Val: sw-calibration-access=READ-ONLY, type=Indu1
    MotCon1: invalidation-policy{data-element=MotCon1/Val, handle-invalid=DONT-INVALIDATE}
      data Val: sw-calibration-access=READ-ONLY, type=MotCon1
    R6: invalidation-policy{data-element=R6/Val, handle-invalid=DONT-INVALIDATE}
      data Val: sw-calibration-access=READ-ONLY, type=R6
    T1: invalidation-policy{data-element=T1/Val, handle-invalid=DONT-INVALIDATE}
      data Val: sw-calibration-access=READ-ONLY, type=T1
    T5: invalidation-policy{data-element=T5/Val, handle-invalid=DONT-INVALIDATE}
      data Val: sw-calibration-access=READ-ONLY, type=T2
    T6: invalidation-policy{data-element=T6/Val, handle-invalid=DONT-INVALIDATE}
      data Val: sw-calibration-access=READ-ONLY, type=T3
    uint8_PortIf1: invalidation-policy{data-element=uint8_PortIf1/Val, handle-invalid=DONT-INVALIDATE}
      data Val: sw-calibration-access=READ-ONLY, type=uint8
