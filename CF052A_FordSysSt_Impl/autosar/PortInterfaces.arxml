AUTOSAR XML (schema 4-0-3)
package /Ford/PortInterfaces
  4 x sender receiver interface:
    Ford_EPAS_Failure: invalidation-policy{data-element=Ford_EPAS_Failure, handle-invalid=DONT-INVALIDATE}
      data Ford_EPAS_Failure: sw-calibration-access=READ-ONLY, type=Ford_EPAS_Failure
    Ford_PwPckTq_D_Stat: invalidation-policy{data-element=Ford_PwPckTq_D_Stat, handle-invalid=DONT-INVALIDATE}
      data Ford_PwPckTq_D_Stat: sw-calibration-access=READ-ONLY, type=Ford_PwPckTq_D_Stat
    Ford_SteMdule_D_Stat: invalidation-policy{data-element=Ford_SteMdule_D_Stat, handle-invalid=DONT-INVALIDATE}
      data Ford_SteMdule_D_Stat: sw-calibration-access=READ-ONLY, type=Ford_SteMdule_D_Stat
    FordEpsSysSt1_PortIf1: invalidation-policy{data-element=FordEpsSysSt1_PortIf1/Val, handle-invalid=DONT-INVALIDATE}
      data Val: sw-calibration-access=READ-ONLY, type=FordEpsSysSt1
package /Nexteer/Calibrations
  parameter interface float32_CalPortIf1
    parameter data prototype Val: sw-calibration-access=READ-WRITE, type=float32
package /Nexteer/PortInterfaces
  client server interface GetGpio_PortIf1
    operation Oper: possible-error=GetGpio_PortIf1/E_NOT_OK
      arg PinSt_Arg: type=boolean, direction=OUT, server-argument-impl-policy=USE-ARGUMENT-TYPE
    error E_NOT_OK: error-code=1
  client server interface GetNtcQlfrSts_PortIf1
    operation Oper: possible-error=GetNtcQlfrSts_PortIf1/E_NOT_OK
      arg NtcNr_Arg: type=NtcNr1, direction=IN, server-argument-impl-policy=USE-ARGUMENT-TYPE
      arg NtcQlfr_Arg: type=SigQlfr1, direction=OUT, server-argument-impl-policy=USE-ARGUMENT-TYPE
    error E_NOT_OK: error-code=1
  5 x sender receiver interface:
    boolean_PortIf1: invalidation-policy{data-element=Logl, handle-invalid=DONT-INVALIDATE}
      data Logl: sw-calibration-access=READ-ONLY, type=boolean
    float32_PortIf1: invalidation-policy{data-element=float32_PortIf1/Val, handle-invalid=DONT-INVALIDATE}
      data Val: sw-calibration-access=READ-ONLY, type=float32
    FordVltgOperSt1_PortIf1: invalidation-policy{data-element=FordVltgOperSt1_PortIf1/Val, handle-invalid=DONT-INVALIDATE}
      data Val: sw-calibration-access=READ-ONLY, type=FordVltgOperSt1
    LoaSt1_PortIf1: invalidation-policy{data-element=LoaSt1_PortIf1/Val, handle-invalid=DONT-INVALIDATE}
      data Val: sw-calibration-access=READ-ONLY, type=LoaSt1
    SysSt1_PortIf1: invalidation-policy{data-element=SysSt1_PortIf1/Val, handle-invalid=DONT-INVALIDATE}
      data Val: sw-calibration-access=READ-ONLY, type=SysSt1
