AUTOSAR XML (schema 4-0-3)
package /ComponentTypes
  complex device driver sw component type CDD_Adcf0CfgAndUse
    behavior CDD_Adcf0CfgAndUse_InternalBehavior
      ar-typed-per-instance-memorys:
        data Adcf0DiagcEndPtr: sw-calibration-access=READ-ONLY, type=uint8
        data Adcf0DiagcStrtPtr: sw-calibration-access=READ-ONLY, type=uint8
      timing event CDD_Adcf0CfgAndUse_InitEvent: start-on-event=Adcf0CfgAndUseInit1, period=0
      runnable Adcf0CfgAndUseInit1
  swc implementation CDD_Adcf0CfgAndUse_Implementation: behavior=CDD_Adcf0CfgAndUse_InternalBehavior
    code-descriptors:
      code Default: artifact-descriptors=autosar-engineering-object={short-label=Default, category=SWSRC}
