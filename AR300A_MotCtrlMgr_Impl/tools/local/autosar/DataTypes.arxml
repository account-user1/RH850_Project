AUTOSAR XML (schema 4-0-3)
standard types defined: float32_DataConstr, float64_DataConstr, sint16_DataConstr, sint32_DataConstr, sint8_DataConstr, uint16_DataConstr, uint32_DataConstr, uint8_DataConstr, boolean, float32, float64, sint16, sint32, sint8, uint16, uint32, uint8
package /DataTypes
  5 x impl type, all with type-emitter=RTE:
    Ary_s32: category=ARRAY, sw-calibration-access=READ-ONLY
      element Element: array-size=2, array-size-semantics=FIXED-SIZE, implementation-data-type=sint32
    Ary_u16: category=ARRAY, sw-calibration-access=READ-ONLY
      element Element: array-size=2, array-size-semantics=FIXED-SIZE, implementation-data-type=uint16
    Ary_u32: category=ARRAY, sw-calibration-access=READ-ONLY
      element Element: array-size=2, array-size-semantics=FIXED-SIZE, implementation-data-type=uint32
    TestEnum_u16: compu {0=TestEnum_u16_Element1, 256=TestEnum_u16_Element2, 65535=TestEnum_u16_Element3}, implementation-data-type=uint16
    TestEnum_u32: compu {0=TestEnum_u32_Element1, 65536=TestEnum_u32_Element2, 4294967295=TestEnum_u32_Element3}, implementation-data-type=uint32
