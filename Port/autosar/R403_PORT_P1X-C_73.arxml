[part 5 of 5: package /Renesas/EcucDefs_Port]
AUTOSAR XML (schema 4-0-3)
# COPYRIGHT
# Copyright(c) 2015 - 2017 Renesas Electronics Corporation
package /Renesas/EcucDefs_Port  (continued)
  module definition Port: refined-module-def=Port, variants post-build  (continued)
    container PortConfigSet: multiple-configuration-container=true  (continued)
      container PortGroup6  # This container contains the configuration (parameters) for Port Group 0.
        container PortPin0  # This container contains the configuration (parameters) for Port Pin 0.
          boolean PortPinDirectionChangeable: set at post-build, origin=Renesas_v1.0.0, default-value=false  # Parameter to indicate if the direction is changeable on a port pin during runtime. true: Port Pin direction changeable enabled. false: Port Pin direction changeable disabled.
          boolean PortPinDioAltModeChangeable: set at post-build, origin=Renesas_v1.0.0, default-value=false  # Parameter to indicate if the mode of a port pin is changeable between DIO and Alternate during runtime by API functions Port_SetToDioMode and Port_SetToAlternateMode. Including these APIs is controlled by PortSetToDioAltModeApi. true: Dio Alternate mode is changeable. false: Dio Alternate mode is not changeable.
          boolean PortPinModeChangeable: set at post-build, origin=Renesas_v1.0.0, default-value=false  # Parameter to indicate if the mode of a port pin is changeable during runtime by API function Port_SetPinMode. Including this API is controlled by PortSetPinModeApi. true: Port Pin mode is changeable. false: Port Pin mode is not changeable.
          enumeration PortPinLevelValue: {PORT_PIN_LEVEL_LOW, PORT_PIN_LEVEL_HIGH}, set at post-build, origin=Renesas_v1.0.0, default-value=PORT_PIN_LEVEL_LOW  # Parameter to indicate port pin level value for a port pin. PORT_PIN_LEVEL_LOW: Port pin Level is low. PORT_PIN_LEVEL_HIGH: Port pin Level is high.
          enumeration PortPinInitialMode: {GTM1I6_ALT1_IN, GTMAT1O1_ALT1_OUT, SENT4RX_ALT3_IN, CSIH1CSS6_ALT4_OUT, DIO}, set at post-build, origin=Renesas_v1.0.0, default-value=DIO  # Mode of the port pin for use with Port_Init() function. <Input name>_ALT<Alternative instance>_IN: Provides alternative instance for selected input. <Output name>_ALT<Alternative instance>_OUT: Provides alternative instance for selected output.
          enumeration PortPinDirection: {PORT_PIN_OUT, PORT_PIN_IN}, set at post-build, origin=Renesas_v1.0.0, default-value=PORT_PIN_IN  # The initial direction of the pin (IN or OUT). If the direction is not changeable, the value configured here is fixed. The direction must match the pin mode. PORT_PIN_IN: Port pin direction set as input. PORT_PIN_OUT: Port pin direction set as output.
          boolean PortInputBufferControl: set at post-build, origin=Renesas_v1.0.0, default-value=false  # This parameter is used as one of the factors to enable/disable port pins input buffer in DIO Mode (PMC=0). true: Port pin's input buffer is ready to be enabled in DIO Mode. false: Port pin's input buffer is disabled in DIO Mode.
          boolean PortBiDirectionControl: set at post-build, origin=Renesas_v1.0.0, default-value=false  # This parameter forces port pins input buffer and output buffer at the same time. If activated, the effect is valid independently from any other port settings. true: Activate forced Bi-directional IO buffer of the port pin. false: Deactivate forced Bi-directional IO buffer of the port pin.
          boolean PortIpControl: set at post-build, origin=Renesas_v1.0.0, default-value=false  # This parameter is used to enable/disable the direct IO control of port pins input buffer and output buffer. true: Enables the direct IO control of port pins input buffer and output buffer by the corresponding control signals of IP_ENI3(0) and IP_ENO3(0) from internal peripheral IPs. This register is valid only in Control Mode (PMC=1). false: Disables the direct IO control of port pins input buffer and output buffer.
          boolean PortPullUpOption: set at post-build, origin=Renesas_v1.0.0, default-value=false  # This register switches on or off the port pins pull-up resistor. true: Port pin's pull-up resistor is enabled. false: Port pin's pull-up resistor is disabled.
          boolean PortPullDownOption: set at post-build, origin=Renesas_v1.0.0, default-value=false  # This parameter switches on or off the port pins pull-down resistor. true: Port pin's pull-down resistor is enabled. false: Port pin's pull-down resistor is disabled.
          enumeration PortOpenDrainControl_Expansion: {PushPull, OpenDrain_N_Channel, OpenDrain_P_Channel}, set at post-build, origin=Renesas_v1.0.2, default-value=PushPull  # This parameter selects port pins output buffer function in combination of PODC and PODCE . | PushPull Specifies the PushPull type output circuit characteristics and updates both PODC and PODCE registers as 0 0 respectively. OpenDrain_N_Channel specifies the N-ch open drain type output circuit characteristics and updates the PODC and PODCE registers as 1 0 respectively. OpenDrain_P_Channel specifies the P-ch open drain type output circuit characteristics and updates the PODC and PODCE registers as 1 1 respectively.
          boolean PortOutputLevelInversion: set at post-build, origin=Renesas_v1.0.0, default-value=false  # This parameter specifies whether the output level from a pin is inverted or not. true: Pin output level is inverted. false: Pin output level is not inverted.
          enumeration PortDriveStrengthControl: {SLOW, FAST}, set at post-build, origin=Renesas_v1.0.0, default-value=SLOW  # This parameter selects the port pins output drive strength as high strength or low strength type. This functionality is also referred to fast (high strength) and slow (low strength) behavior of output buffer. SLOW: Lower drive strength (slow mode) is selected for port pin's output buffer. FAST: Higher drive strength (fast mode) is selected for port pin's output buffer.
          boolean PortUniversalCharacteristicCntrl: set at post-build, origin=Renesas_v1.0.0, default-value=false  # This parameter selects the port pins output drive strength as high or low type. The PortDriveStrengthControl must be enabled for this feature. | false: PortDriveStrengthControl parameter specifies the output driver strength of the port pin. true : Number of output buffer characteristics selection capability is expanded, the maximum of 4 characteristics selection is possible PUCCn PDSCn 0 0 Output characteristic selection 1 (400 Ohm buffer) 0 1 Output characteristic selection 2 (200 Ohm buffer) 1 0 Output characteristic selection 3 (100 Ohm buffer) 1 1 Output characteristic selection 4 (50 Ohm buffer)
          enumeration PortInputSelection: {TYPE1_SHMT1, TYPE2_SHMT4}, set at post-build, origin=Renesas_v1.0.0, default-value=TYPE1_SHMT1  # This setting specifies the input buffer characteristics. TYPE1_SHMT1: TYPE 1 buffer is selected. TYPE2_SHMT4: TYPE 2 buffer is selected.
        container PortPin1  # This container contains the configuration (parameters) for Port Pin 0.
          boolean PortPinDirectionChangeable: set at post-build, origin=Renesas_v1.0.0, default-value=false  # Parameter to indicate if the direction is changeable on a port pin during runtime. true: Port Pin direction changeable enabled. false: Port Pin direction changeable disabled.
          boolean PortPinDioAltModeChangeable: set at post-build, origin=Renesas_v1.0.0, default-value=false  # Parameter to indicate if the mode of a port pin is changeable between DIO and Alternate during runtime by API functions Port_SetToDioMode and Port_SetToAlternateMode. Including these APIs is controlled by PortSetToDioAltModeApi. true: Dio Alternate mode is changeable. false: Dio Alternate mode is not changeable.
          boolean PortPinModeChangeable: set at post-build, origin=Renesas_v1.0.0, default-value=false  # Parameter to indicate if the mode of a port pin is changeable during runtime by API function Port_SetPinMode. Including this API is controlled by PortSetPinModeApi. true: Port Pin mode is changeable. false: Port Pin mode is not changeable.
          enumeration PortPinLevelValue: {PORT_PIN_LEVEL_LOW, PORT_PIN_LEVEL_HIGH}, set at post-build, origin=Renesas_v1.0.0, default-value=PORT_PIN_LEVEL_LOW  # Parameter to indicate port pin level value for a port pin. PORT_PIN_LEVEL_LOW: Port pin Level is low. PORT_PIN_LEVEL_HIGH: Port pin Level is high.
          enumeration PortPinInitialMode: {GTM1I6_ALT1_IN, GTMAT1O1N_ALT1_OUT, SENT5RX_ALT3_IN, CSIH0CSS7_ALT4_OUT, DIO}, set at post-build, origin=Renesas_v1.0.0, default-value=DIO  # Mode of the port pin for use with Port_Init() function. <Input name>_ALT<Alternative instance>_IN: Provides alternative instance for selected input. <Output name>_ALT<Alternative instance>_OUT: Provides alternative instance for selected output.
          enumeration PortPinDirection: {PORT_PIN_OUT, PORT_PIN_IN}, set at post-build, origin=Renesas_v1.0.0, default-value=PORT_PIN_IN  # The initial direction of the pin (IN or OUT). If the direction is not changeable, the value configured here is fixed. The direction must match the pin mode. PORT_PIN_IN: Port pin direction set as input. PORT_PIN_OUT: Port pin direction set as output.
          boolean PortInputBufferControl: set at post-build, origin=Renesas_v1.0.0, default-value=false  # This parameter is used as one of the factors to enable/disable port pins input buffer in DIO Mode (PMC=0). true: Port pin's input buffer is ready to be enabled in DIO Mode. false: Port pin's input buffer is disabled in DIO Mode.
          boolean PortBiDirectionControl: set at post-build, origin=Renesas_v1.0.0, default-value=false  # This parameter forces port pins input buffer and output buffer at the same time. If activated, the effect is valid independently from any other port settings. true: Activate forced Bi-directional IO buffer of the port pin. false: Deactivate forced Bi-directional IO buffer of the port pin.
          boolean PortIpControl: set at post-build, origin=Renesas_v1.0.0, default-value=false  # This parameter is used to enable/disable the direct IO control of port pins input buffer and output buffer. true: Enables the direct IO control of port pins input buffer and output buffer by the corresponding control signals of IP_ENI3(0) and IP_ENO3(0) from internal peripheral IPs. This register is valid only in Control Mode (PMC=1). false: Disables the direct IO control of port pins input buffer and output buffer.
          boolean PortPullUpOption: set at post-build, origin=Renesas_v1.0.0, default-value=false  # This register switches on or off the port pins pull-up resistor. true: Port pin's pull-up resistor is enabled. false: Port pin's pull-up resistor is disabled.
          boolean PortPullDownOption: set at post-build, origin=Renesas_v1.0.0, default-value=false  # This parameter switches on or off the port pins pull-down resistor. true: Port pin's pull-down resistor is enabled. false: Port pin's pull-down resistor is disabled.
          enumeration PortOpenDrainControl_Expansion: {PushPull, OpenDrain_N_Channel, OpenDrain_P_Channel}, set at post-build, origin=Renesas_v1.0.2, default-value=PushPull  # This parameter selects port pins output buffer function in combination of PODC and PODCE . | PushPull Specifies the PushPull type output circuit characteristics and updates both PODC and PODCE registers as 0 0 respectively. OpenDrain_N_Channel specifies the N-ch open drain type output circuit characteristics and updates the PODC and PODCE registers as 1 0 respectively. OpenDrain_P_Channel specifies the P-ch open drain type output circuit characteristics and updates the PODC and PODCE registers as 1 1 respectively.
          boolean PortOutputLevelInversion: set at post-build, origin=Renesas_v1.0.0, default-value=false  # This parameter specifies whether the output level from a pin is inverted or not. true: Pin output level is inverted. false: Pin output level is not inverted.
          enumeration PortDriveStrengthControl: {SLOW, FAST}, set at post-build, origin=Renesas_v1.0.0, default-value=SLOW  # This parameter selects the port pins output drive strength as high strength or low strength type. This functionality is also referred to fast (high strength) and slow (low strength) behavior of output buffer. SLOW: Lower drive strength (slow mode) is selected for port pin's output buffer. FAST: Higher drive strength (fast mode) is selected for port pin's output buffer.
          boolean PortUniversalCharacteristicCntrl: set at post-build, origin=Renesas_v1.0.0, default-value=false  # This parameter selects the port pins output drive strength as high or low type. The PortDriveStrengthControl must be enabled for this feature. | false: PortDriveStrengthControl parameter specifies the output driver strength of the port pin. true : Number of output buffer characteristics selection capability is expanded, the maximum of 4 characteristics selection is possible PUCCn PDSCn 0 0 Output characteristic selection 1 (400 Ohm buffer) 0 1 Output characteristic selection 2 (200 Ohm buffer) 1 0 Output characteristic selection 3 (100 Ohm buffer) 1 1 Output characteristic selection 4 (50 Ohm buffer)
          enumeration PortInputSelection: {TYPE1_SHMT1, TYPE2_SHMT4}, set at post-build, origin=Renesas_v1.0.0, default-value=TYPE1_SHMT1  # This setting specifies the input buffer characteristics. TYPE1_SHMT1: TYPE 1 buffer is selected. TYPE2_SHMT4: TYPE 2 buffer is selected.
        container PortPin2  # This container contains the configuration (parameters) for Port Pin 0.
          boolean PortPinDirectionChangeable: set at post-build, origin=Renesas_v1.0.0, default-value=false  # Parameter to indicate if the direction is changeable on a port pin during runtime. true: Port Pin direction changeable enabled. false: Port Pin direction changeable disabled.
          boolean PortPinDioAltModeChangeable: set at post-build, origin=Renesas_v1.0.0, default-value=false  # Parameter to indicate if the mode of a port pin is changeable between DIO and Alternate during runtime by API functions Port_SetToDioMode and Port_SetToAlternateMode. Including these APIs is controlled by PortSetToDioAltModeApi. true: Dio Alternate mode is changeable. false: Dio Alternate mode is not changeable.
          boolean PortPinModeChangeable: set at post-build, origin=Renesas_v1.0.0, default-value=false  # Parameter to indicate if the mode of a port pin is changeable during runtime by API function Port_SetPinMode. Including this API is controlled by PortSetPinModeApi. true: Port Pin mode is changeable. false: Port Pin mode is not changeable.
          enumeration PortPinLevelValue: {PORT_PIN_LEVEL_LOW, PORT_PIN_LEVEL_HIGH}, set at post-build, origin=Renesas_v1.0.0, default-value=PORT_PIN_LEVEL_LOW  # Parameter to indicate port pin level value for a port pin. PORT_PIN_LEVEL_LOW: Port pin Level is low. PORT_PIN_LEVEL_HIGH: Port pin Level is high.
          enumeration PortPinInitialMode: {GTM0I6_ALT1_IN, GTMAT0O6_ALT1_OUT, SENT4RX_ALT3_IN, CSIH1CSS7_ALT4_OUT, DIO}, set at post-build, origin=Renesas_v1.0.0, default-value=DIO  # Mode of the port pin for use with Port_Init() function. <Input name>_ALT<Alternative instance>_IN: Provides alternative instance for selected input. <Output name>_ALT<Alternative instance>_OUT: Provides alternative instance for selected output.
          enumeration PortPinDirection: {PORT_PIN_OUT, PORT_PIN_IN}, set at post-build, origin=Renesas_v1.0.0, default-value=PORT_PIN_IN  # The initial direction of the pin (IN or OUT). If the direction is not changeable, the value configured here is fixed. The direction must match the pin mode. PORT_PIN_IN: Port pin direction set as input. PORT_PIN_OUT: Port pin direction set as output.
          boolean PortInputBufferControl: set at post-build, origin=Renesas_v1.0.0, default-value=false  # This parameter is used as one of the factors to enable/disable port pins input buffer in DIO Mode (PMC=0). true: Port pin's input buffer is ready to be enabled in DIO Mode. false: Port pin's input buffer is disabled in DIO Mode.
          boolean PortBiDirectionControl: set at post-build, origin=Renesas_v1.0.0, default-value=false  # This parameter forces port pins input buffer and output buffer at the same time. If activated, the effect is valid independently from any other port settings. true: Activate forced Bi-directional IO buffer of the port pin. false: Deactivate forced Bi-directional IO buffer of the port pin.
          boolean PortPullUpOption: set at post-build, origin=Renesas_v1.0.0, default-value=false  # This register switches on or off the port pins pull-up resistor. true: Port pin's pull-up resistor is enabled. false: Port pin's pull-up resistor is disabled.
          boolean PortPullDownOption: set at post-build, origin=Renesas_v1.0.0, default-value=false  # This parameter switches on or off the port pins pull-down resistor. true: Port pin's pull-down resistor is enabled. false: Port pin's pull-down resistor is disabled.
          enumeration PortOpenDrainControl_Expansion: {PushPull, OpenDrain_N_Channel, OpenDrain_P_Channel}, set at post-build, origin=Renesas_v1.0.2, default-value=PushPull  # This parameter selects port pins output buffer function in combination of PODC and PODCE . | PushPull Specifies the PushPull type output circuit characteristics and updates both PODC and PODCE registers as 0 0 respectively. OpenDrain_N_Channel specifies the N-ch open drain type output circuit characteristics and updates the PODC and PODCE registers as 1 0 respectively. OpenDrain_P_Channel specifies the P-ch open drain type output circuit characteristics and updates the PODC and PODCE registers as 1 1 respectively.
          boolean PortOutputLevelInversion: set at post-build, origin=Renesas_v1.0.0, default-value=false  # This parameter specifies whether the output level from a pin is inverted or not. true: Pin output level is inverted. false: Pin output level is not inverted.
          enumeration PortDriveStrengthControl: {SLOW, FAST}, set at post-build, origin=Renesas_v1.0.0, default-value=SLOW  # This parameter selects the port pins output drive strength as high strength or low strength type. This functionality is also referred to fast (high strength) and slow (low strength) behavior of output buffer. SLOW: Lower drive strength (slow mode) is selected for port pin's output buffer. FAST: Higher drive strength (fast mode) is selected for port pin's output buffer.
          boolean PortUniversalCharacteristicCntrl: set at post-build, origin=Renesas_v1.0.0, default-value=false  # This parameter selects the port pins output drive strength as high or low type. The PortDriveStrengthControl must be enabled for this feature. | false: PortDriveStrengthControl parameter specifies the output driver strength of the port pin. true : Number of output buffer characteristics selection capability is expanded, the maximum of 4 characteristics selection is possible PUCCn PDSCn 0 0 Output characteristic selection 1 (400 Ohm buffer) 0 1 Output characteristic selection 2 (200 Ohm buffer) 1 0 Output characteristic selection 3 (100 Ohm buffer) 1 1 Output characteristic selection 4 (50 Ohm buffer)
          enumeration PortInputSelection: {TYPE1_SHMT1, TYPE2_SHMT4}, set at post-build, origin=Renesas_v1.0.0, default-value=TYPE1_SHMT1  # This setting specifies the input buffer characteristics. TYPE1_SHMT1: TYPE 1 buffer is selected. TYPE2_SHMT4: TYPE 2 buffer is selected.
        container PortPin3  # This container contains the configuration (parameters) for Port Pin 0.
          boolean PortPinDirectionChangeable: set at post-build, origin=Renesas_v1.0.0, default-value=false  # Parameter to indicate if the direction is changeable on a port pin during runtime. true: Port Pin direction changeable enabled. false: Port Pin direction changeable disabled.
          boolean PortPinDioAltModeChangeable: set at post-build, origin=Renesas_v1.0.0, default-value=false  # Parameter to indicate if the mode of a port pin is changeable between DIO and Alternate during runtime by API functions Port_SetToDioMode and Port_SetToAlternateMode. Including these APIs is controlled by PortSetToDioAltModeApi. true: Dio Alternate mode is changeable. false: Dio Alternate mode is not changeable.
          boolean PortPinModeChangeable: set at post-build, origin=Renesas_v1.0.0, default-value=false  # Parameter to indicate if the mode of a port pin is changeable during runtime by API function Port_SetPinMode. Including this API is controlled by PortSetPinModeApi. true: Port Pin mode is changeable. false: Port Pin mode is not changeable.
          enumeration PortPinLevelValue: {PORT_PIN_LEVEL_LOW, PORT_PIN_LEVEL_HIGH}, set at post-build, origin=Renesas_v1.0.0, default-value=PORT_PIN_LEVEL_LOW  # Parameter to indicate port pin level value for a port pin. PORT_PIN_LEVEL_LOW: Port pin Level is low. PORT_PIN_LEVEL_HIGH: Port pin Level is high.
          enumeration PortPinInitialMode: {GTM0I3_ALT1_IN, GTMAT0O7_ALT1_OUT, SENT5RX_ALT3_IN, MCAN0TX_ALT4_OUT, DIO}, set at post-build, origin=Renesas_v1.0.0, default-value=DIO  # Mode of the port pin for use with Port_Init() function. <Input name>_ALT<Alternative instance>_IN: Provides alternative instance for selected input. <Output name>_ALT<Alternative instance>_OUT: Provides alternative instance for selected output.
          enumeration PortPinDirection: {PORT_PIN_OUT, PORT_PIN_IN}, set at post-build, origin=Renesas_v1.0.0, default-value=PORT_PIN_IN  # The initial direction of the pin (IN or OUT). If the direction is not changeable, the value configured here is fixed. The direction must match the pin mode. PORT_PIN_IN: Port pin direction set as input. PORT_PIN_OUT: Port pin direction set as output.
          boolean PortInputBufferControl: set at post-build, origin=Renesas_v1.0.0, default-value=false  # This parameter is used as one of the factors to enable/disable port pins input buffer in DIO Mode (PMC=0). true: Port pin's input buffer is ready to be enabled in DIO Mode. false: Port pin's input buffer is disabled in DIO Mode.
          boolean PortBiDirectionControl: set at post-build, origin=Renesas_v1.0.0, default-value=false  # This parameter forces port pins input buffer and output buffer at the same time. If activated, the effect is valid independently from any other port settings. true: Activate forced Bi-directional IO buffer of the port pin. false: Deactivate forced Bi-directional IO buffer of the port pin.
          boolean PortIpControl: set at post-build, origin=Renesas_v1.0.0, default-value=false  # This parameter is used to enable/disable the direct IO control of port pins input buffer and output buffer. true: Enables the direct IO control of port pins input buffer and output buffer by the corresponding control signals of IP_ENI3(0) and IP_ENO3(0) from internal peripheral IPs. This register is valid only in Control Mode (PMC=1). false: Disables the direct IO control of port pins input buffer and output buffer.
          boolean PortPullUpOption: set at post-build, origin=Renesas_v1.0.0, default-value=false  # This register switches on or off the port pins pull-up resistor. true: Port pin's pull-up resistor is enabled. false: Port pin's pull-up resistor is disabled.
          boolean PortPullDownOption: set at post-build, origin=Renesas_v1.0.0, default-value=false  # This parameter switches on or off the port pins pull-down resistor. true: Port pin's pull-down resistor is enabled. false: Port pin's pull-down resistor is disabled.
          enumeration PortOpenDrainControl_Expansion: {PushPull, OpenDrain_N_Channel, OpenDrain_P_Channel}, set at post-build, origin=Renesas_v1.0.2, default-value=PushPull  # This parameter selects port pins output buffer function in combination of PODC and PODCE . | PushPull Specifies the PushPull type output circuit characteristics and updates both PODC and PODCE registers as 0 0 respectively. OpenDrain_N_Channel specifies the N-ch open drain type output circuit characteristics and updates the PODC and PODCE registers as 1 0 respectively. OpenDrain_P_Channel specifies the P-ch open drain type output circuit characteristics and updates the PODC and PODCE registers as 1 1 respectively.
          boolean PortOutputLevelInversion: set at post-build, origin=Renesas_v1.0.0, default-value=false  # This parameter specifies whether the output level from a pin is inverted or not. true: Pin output level is inverted. false: Pin output level is not inverted.
          enumeration PortDriveStrengthControl: {SLOW, FAST}, set at post-build, origin=Renesas_v1.0.0, default-value=SLOW  # This parameter selects the port pins output drive strength as high strength or low strength type. This functionality is also referred to fast (high strength) and slow (low strength) behavior of output buffer. SLOW: Lower drive strength (slow mode) is selected for port pin's output buffer. FAST: Higher drive strength (fast mode) is selected for port pin's output buffer.
          boolean PortUniversalCharacteristicCntrl: set at post-build, origin=Renesas_v1.0.0, default-value=false  # This parameter selects the port pins output drive strength as high or low type. The PortDriveStrengthControl must be enabled for this feature. | false: PortDriveStrengthControl parameter specifies the output driver strength of the port pin. true : Number of output buffer characteristics selection capability is expanded, the maximum of 4 characteristics selection is possible PUCCn PDSCn 0 0 Output characteristic selection 1 (400 Ohm buffer) 0 1 Output characteristic selection 2 (200 Ohm buffer) 1 0 Output characteristic selection 3 (100 Ohm buffer) 1 1 Output characteristic selection 4 (50 Ohm buffer)
          enumeration PortInputSelection: {TYPE1_SHMT1, TYPE2_SHMT4}, set at post-build, origin=Renesas_v1.0.0, default-value=TYPE1_SHMT1  # This setting specifies the input buffer characteristics. TYPE1_SHMT1: TYPE 1 buffer is selected. TYPE2_SHMT4: TYPE 2 buffer is selected.
        container PortPin4  # This container contains the configuration (parameters) for Port Pin 0.
          boolean PortPinDirectionChangeable: set at post-build, origin=Renesas_v1.0.0, default-value=false  # Parameter to indicate if the direction is changeable on a port pin during runtime. true: Port Pin direction changeable enabled. false: Port Pin direction changeable disabled.
          boolean PortPinDioAltModeChangeable: set at post-build, origin=Renesas_v1.0.0, default-value=false  # Parameter to indicate if the mode of a port pin is changeable between DIO and Alternate during runtime by API functions Port_SetToDioMode and Port_SetToAlternateMode. Including these APIs is controlled by PortSetToDioAltModeApi. true: Dio Alternate mode is changeable. false: Dio Alternate mode is not changeable.
          boolean PortPinModeChangeable: set at post-build, origin=Renesas_v1.0.0, default-value=false  # Parameter to indicate if the mode of a port pin is changeable during runtime by API function Port_SetPinMode. Including this API is controlled by PortSetPinModeApi. true: Port Pin mode is changeable. false: Port Pin mode is not changeable.
          enumeration PortPinLevelValue: {PORT_PIN_LEVEL_LOW, PORT_PIN_LEVEL_HIGH}, set at post-build, origin=Renesas_v1.0.0, default-value=PORT_PIN_LEVEL_LOW  # Parameter to indicate port pin level value for a port pin. PORT_PIN_LEVEL_LOW: Port pin Level is low. PORT_PIN_LEVEL_HIGH: Port pin Level is high.
          enumeration PortPinInitialMode: {GTM0I4_ALT1_IN, INTP9_ALT4_IN, DIO}, set at post-build, origin=Renesas_v1.0.0, default-value=DIO  # Mode of the port pin for use with Port_Init() function. <Input name>_ALT<Alternative instance>_IN: Provides alternative instance for selected input. <Output name>_ALT<Alternative instance>_OUT: Provides alternative instance for selected output.
          enumeration PortPinDirection: {PORT_PIN_OUT, PORT_PIN_IN}, set at post-build, origin=Renesas_v1.0.0, default-value=PORT_PIN_IN  # The initial direction of the pin (IN or OUT). If the direction is not changeable, the value configured here is fixed. The direction must match the pin mode. PORT_PIN_IN: Port pin direction set as input. PORT_PIN_OUT: Port pin direction set as output.
          boolean PortInputBufferControl: set at post-build, origin=Renesas_v1.0.0, default-value=false  # This parameter is used as one of the factors to enable/disable port pins input buffer in DIO Mode (PMC=0). true: Port pin's input buffer is ready to be enabled in DIO Mode. false: Port pin's input buffer is disabled in DIO Mode.
          boolean PortBiDirectionControl: set at post-build, origin=Renesas_v1.0.0, default-value=false  # This parameter forces port pins input buffer and output buffer at the same time. If activated, the effect is valid independently from any other port settings. true: Activate forced Bi-directional IO buffer of the port pin. false: Deactivate forced Bi-directional IO buffer of the port pin.
          boolean PortPullUpOption: set at post-build, origin=Renesas_v1.0.0, default-value=false  # This register switches on or off the port pins pull-up resistor. true: Port pin's pull-up resistor is enabled. false: Port pin's pull-up resistor is disabled.
          boolean PortPullDownOption: set at post-build, origin=Renesas_v1.0.0, default-value=false  # This parameter switches on or off the port pins pull-down resistor. true: Port pin's pull-down resistor is enabled. false: Port pin's pull-down resistor is disabled.
          enumeration PortOpenDrainControl_Expansion: {PushPull, OpenDrain_N_Channel, OpenDrain_P_Channel}, set at post-build, origin=Renesas_v1.0.2, default-value=PushPull  # This parameter selects port pins output buffer function in combination of PODC and PODCE . | PushPull Specifies the PushPull type output circuit characteristics and updates both PODC and PODCE registers as 0 0 respectively. OpenDrain_N_Channel specifies the N-ch open drain type output circuit characteristics and updates the PODC and PODCE registers as 1 0 respectively. OpenDrain_P_Channel specifies the P-ch open drain type output circuit characteristics and updates the PODC and PODCE registers as 1 1 respectively.
          boolean PortOutputLevelInversion: set at post-build, origin=Renesas_v1.0.0, default-value=false  # This parameter specifies whether the output level from a pin is inverted or not. true: Pin output level is inverted. false: Pin output level is not inverted.
          enumeration PortDriveStrengthControl: {SLOW, FAST}, set at post-build, origin=Renesas_v1.0.0, default-value=SLOW  # This parameter selects the port pins output drive strength as high strength or low strength type. This functionality is also referred to fast (high strength) and slow (low strength) behavior of output buffer. SLOW: Lower drive strength (slow mode) is selected for port pin's output buffer. FAST: Higher drive strength (fast mode) is selected for port pin's output buffer.
          boolean PortUniversalCharacteristicCntrl: set at post-build, origin=Renesas_v1.0.0, default-value=false  # This parameter selects the port pins output drive strength as high or low type. The PortDriveStrengthControl must be enabled for this feature. | false: PortDriveStrengthControl parameter specifies the output driver strength of the port pin. true : Number of output buffer characteristics selection capability is expanded, the maximum of 4 characteristics selection is possible PUCCn PDSCn 0 0 Output characteristic selection 1 (400 Ohm buffer) 0 1 Output characteristic selection 2 (200 Ohm buffer) 1 0 Output characteristic selection 3 (100 Ohm buffer) 1 1 Output characteristic selection 4 (50 Ohm buffer)
          enumeration PortInputSelection: {TYPE1_SHMT1, TYPE2_SHMT4}, set at post-build, origin=Renesas_v1.0.0, default-value=TYPE1_SHMT1  # This setting specifies the input buffer characteristics. TYPE1_SHMT1: TYPE 1 buffer is selected. TYPE2_SHMT4: TYPE 2 buffer is selected.
        container PortPin5  # This container contains the configuration (parameters) for Port Pin 0.
          boolean PortPinDirectionChangeable: set at post-build, origin=Renesas_v1.0.0, default-value=false  # Parameter to indicate if the direction is changeable on a port pin during runtime. true: Port Pin direction changeable enabled. false: Port Pin direction changeable disabled.
          boolean PortPinDioAltModeChangeable: set at post-build, origin=Renesas_v1.0.0, default-value=false  # Parameter to indicate if the mode of a port pin is changeable between DIO and Alternate during runtime by API functions Port_SetToDioMode and Port_SetToAlternateMode. Including these APIs is controlled by PortSetToDioAltModeApi. true: Dio Alternate mode is changeable. false: Dio Alternate mode is not changeable.
          boolean PortPinModeChangeable: set at post-build, origin=Renesas_v1.0.0, default-value=false  # Parameter to indicate if the mode of a port pin is changeable during runtime by API function Port_SetPinMode. Including this API is controlled by PortSetPinModeApi. true: Port Pin mode is changeable. false: Port Pin mode is not changeable.
          enumeration PortPinLevelValue: {PORT_PIN_LEVEL_LOW, PORT_PIN_LEVEL_HIGH}, set at post-build, origin=Renesas_v1.0.0, default-value=PORT_PIN_LEVEL_LOW  # Parameter to indicate port pin level value for a port pin. PORT_PIN_LEVEL_LOW: Port pin Level is low. PORT_PIN_LEVEL_HIGH: Port pin Level is high.
          enumeration PortPinInitialMode: {GTM0I0_ALT1_IN, DIO}, set at post-build, origin=Renesas_v1.0.0, default-value=DIO  # Mode of the port pin for use with Port_Init() function. <Input name>_ALT<Alternative instance>_IN: Provides alternative instance for selected input. <Output name>_ALT<Alternative instance>_OUT: Provides alternative instance for selected output.
          enumeration PortPinDirection: {PORT_PIN_OUT, PORT_PIN_IN}, set at post-build, origin=Renesas_v1.0.0, default-value=PORT_PIN_IN  # The initial direction of the pin (IN or OUT). If the direction is not changeable, the value configured here is fixed. The direction must match the pin mode. PORT_PIN_IN: Port pin direction set as input. PORT_PIN_OUT: Port pin direction set as output.
          boolean PortInputBufferControl: set at post-build, origin=Renesas_v1.0.0, default-value=false  # This parameter is used as one of the factors to enable/disable port pins input buffer in DIO Mode (PMC=0). true: Port pin's input buffer is ready to be enabled in DIO Mode. false: Port pin's input buffer is disabled in DIO Mode.
          boolean PortBiDirectionControl: set at post-build, origin=Renesas_v1.0.0, default-value=false  # This parameter forces port pins input buffer and output buffer at the same time. If activated, the effect is valid independently from any other port settings. true: Activate forced Bi-directional IO buffer of the port pin. false: Deactivate forced Bi-directional IO buffer of the port pin.
          boolean PortPullUpOption: set at post-build, origin=Renesas_v1.0.0, default-value=false  # This register switches on or off the port pins pull-up resistor. true: Port pin's pull-up resistor is enabled. false: Port pin's pull-up resistor is disabled.
          boolean PortPullDownOption: set at post-build, origin=Renesas_v1.0.0, default-value=false  # This parameter switches on or off the port pins pull-down resistor. true: Port pin's pull-down resistor is enabled. false: Port pin's pull-down resistor is disabled.
          enumeration PortOpenDrainControl_Expansion: {PushPull, OpenDrain_N_Channel, OpenDrain_P_Channel}, set at post-build, origin=Renesas_v1.0.2, default-value=PushPull  # This parameter selects port pins output buffer function in combination of PODC and PODCE . | PushPull Specifies the PushPull type output circuit characteristics and updates both PODC and PODCE registers as 0 0 respectively. OpenDrain_N_Channel specifies the N-ch open drain type output circuit characteristics and updates the PODC and PODCE registers as 1 0 respectively. OpenDrain_P_Channel specifies the P-ch open drain type output circuit characteristics and updates the PODC and PODCE registers as 1 1 respectively.
          boolean PortOutputLevelInversion: set at post-build, origin=Renesas_v1.0.0, default-value=false  # This parameter specifies whether the output level from a pin is inverted or not. true: Pin output level is inverted. false: Pin output level is not inverted.
          enumeration PortDriveStrengthControl: {SLOW, FAST}, set at post-build, origin=Renesas_v1.0.0, default-value=SLOW  # This parameter selects the port pins output drive strength as high strength or low strength type. This functionality is also referred to fast (high strength) and slow (low strength) behavior of output buffer. SLOW: Lower drive strength (slow mode) is selected for port pin's output buffer. FAST: Higher drive strength (fast mode) is selected for port pin's output buffer.
          boolean PortUniversalCharacteristicCntrl: set at post-build, origin=Renesas_v1.0.0, default-value=false  # This parameter selects the port pins output drive strength as high or low type. The PortDriveStrengthControl must be enabled for this feature. | false: PortDriveStrengthControl parameter specifies the output driver strength of the port pin. true : Number of output buffer characteristics selection capability is expanded, the maximum of 4 characteristics selection is possible PUCCn PDSCn 0 0 Output characteristic selection 1 (400 Ohm buffer) 0 1 Output characteristic selection 2 (200 Ohm buffer) 1 0 Output characteristic selection 3 (100 Ohm buffer) 1 1 Output characteristic selection 4 (50 Ohm buffer)
          enumeration PortInputSelection: {TYPE1_SHMT1, TYPE2_SHMT4}, set at post-build, origin=Renesas_v1.0.0, default-value=TYPE1_SHMT1  # This setting specifies the input buffer characteristics. TYPE1_SHMT1: TYPE 1 buffer is selected. TYPE2_SHMT4: TYPE 2 buffer is selected.
        container PortPin6  # This container contains the configuration (parameters) for Port Pin 0.
          boolean PortPinDirectionChangeable: set at post-build, origin=Renesas_v1.0.0, default-value=false  # Parameter to indicate if the direction is changeable on a port pin during runtime. true: Port Pin direction changeable enabled. false: Port Pin direction changeable disabled.
          boolean PortPinDioAltModeChangeable: set at post-build, origin=Renesas_v1.0.0, default-value=false  # Parameter to indicate if the mode of a port pin is changeable between DIO and Alternate during runtime by API functions Port_SetToDioMode and Port_SetToAlternateMode. Including these APIs is controlled by PortSetToDioAltModeApi. true: Dio Alternate mode is changeable. false: Dio Alternate mode is not changeable.
          boolean PortPinModeChangeable: set at post-build, origin=Renesas_v1.0.0, default-value=false  # Parameter to indicate if the mode of a port pin is changeable during runtime by API function Port_SetPinMode. Including this API is controlled by PortSetPinModeApi. true: Port Pin mode is changeable. false: Port Pin mode is not changeable.
          enumeration PortPinLevelValue: {PORT_PIN_LEVEL_LOW, PORT_PIN_LEVEL_HIGH}, set at post-build, origin=Renesas_v1.0.0, default-value=PORT_PIN_LEVEL_LOW  # Parameter to indicate port pin level value for a port pin. PORT_PIN_LEVEL_LOW: Port pin Level is low. PORT_PIN_LEVEL_HIGH: Port pin Level is high.
          enumeration PortPinInitialMode: {GTM0I2_ALT1_IN, DIO}, set at post-build, origin=Renesas_v1.0.0, default-value=DIO  # Mode of the port pin for use with Port_Init() function. <Input name>_ALT<Alternative instance>_IN: Provides alternative instance for selected input. <Output name>_ALT<Alternative instance>_OUT: Provides alternative instance for selected output.
          enumeration PortPinDirection: {PORT_PIN_OUT, PORT_PIN_IN}, set at post-build, origin=Renesas_v1.0.0, default-value=PORT_PIN_IN  # The initial direction of the pin (IN or OUT). If the direction is not changeable, the value configured here is fixed. The direction must match the pin mode. PORT_PIN_IN: Port pin direction set as input. PORT_PIN_OUT: Port pin direction set as output.
          boolean PortInputBufferControl: set at post-build, origin=Renesas_v1.0.0, default-value=false  # This parameter is used as one of the factors to enable/disable port pins input buffer in DIO Mode (PMC=0). true: Port pin's input buffer is ready to be enabled in DIO Mode. false: Port pin's input buffer is disabled in DIO Mode.
          boolean PortBiDirectionControl: set at post-build, origin=Renesas_v1.0.0, default-value=false  # This parameter forces port pins input buffer and output buffer at the same time. If activated, the effect is valid independently from any other port settings. true: Activate forced Bi-directional IO buffer of the port pin. false: Deactivate forced Bi-directional IO buffer of the port pin.
          boolean PortPullUpOption: set at post-build, origin=Renesas_v1.0.0, default-value=false  # This register switches on or off the port pins pull-up resistor. true: Port pin's pull-up resistor is enabled. false: Port pin's pull-up resistor is disabled.
          boolean PortPullDownOption: set at post-build, origin=Renesas_v1.0.0, default-value=false  # This parameter switches on or off the port pins pull-down resistor. true: Port pin's pull-down resistor is enabled. false: Port pin's pull-down resistor is disabled.
          enumeration PortOpenDrainControl_Expansion: {PushPull, OpenDrain_N_Channel, OpenDrain_P_Channel}, set at post-build, origin=Renesas_v1.0.2, default-value=PushPull  # This parameter selects port pins output buffer function in combination of PODC and PODCE . | PushPull Specifies the PushPull type output circuit characteristics and updates both PODC and PODCE registers as 0 0 respectively. OpenDrain_N_Channel specifies the N-ch open drain type output circuit characteristics and updates the PODC and PODCE registers as 1 0 respectively. OpenDrain_P_Channel specifies the P-ch open drain type output circuit characteristics and updates the PODC and PODCE registers as 1 1 respectively.
          boolean PortOutputLevelInversion: set at post-build, origin=Renesas_v1.0.0, default-value=false  # This parameter specifies whether the output level from a pin is inverted or not. true: Pin output level is inverted. false: Pin output level is not inverted.
          enumeration PortDriveStrengthControl: {SLOW, FAST}, set at post-build, origin=Renesas_v1.0.0, default-value=SLOW  # This parameter selects the port pins output drive strength as high strength or low strength type. This functionality is also referred to fast (high strength) and slow (low strength) behavior of output buffer. SLOW: Lower drive strength (slow mode) is selected for port pin's output buffer. FAST: Higher drive strength (fast mode) is selected for port pin's output buffer.
          boolean PortUniversalCharacteristicCntrl: set at post-build, origin=Renesas_v1.0.0, default-value=false  # This parameter selects the port pins output drive strength as high or low type. The PortDriveStrengthControl must be enabled for this feature. | false: PortDriveStrengthControl parameter specifies the output driver strength of the port pin. true : Number of output buffer characteristics selection capability is expanded, the maximum of 4 characteristics selection is possible PUCCn PDSCn 0 0 Output characteristic selection 1 (400 Ohm buffer) 0 1 Output characteristic selection 2 (200 Ohm buffer) 1 0 Output characteristic selection 3 (100 Ohm buffer) 1 1 Output characteristic selection 4 (50 Ohm buffer)
          enumeration PortInputSelection: {TYPE1_SHMT1, TYPE2_SHMT4}, set at post-build, origin=Renesas_v1.0.0, default-value=TYPE1_SHMT1  # This setting specifies the input buffer characteristics. TYPE1_SHMT1: TYPE 1 buffer is selected. TYPE2_SHMT4: TYPE 2 buffer is selected.
        container PortPin10  # This container contains the configuration (parameters) for Port Pin 0.
          boolean PortPinDirectionChangeable: set at post-build, origin=Renesas_v1.0.0, default-value=false  # Parameter to indicate if the direction is changeable on a port pin during runtime. true: Port Pin direction changeable enabled. false: Port Pin direction changeable disabled.
          boolean PortPinDioAltModeChangeable: set at post-build, origin=Renesas_v1.0.0, default-value=false  # Parameter to indicate if the mode of a port pin is changeable between DIO and Alternate during runtime by API functions Port_SetToDioMode and Port_SetToAlternateMode. Including these APIs is controlled by PortSetToDioAltModeApi. true: Dio Alternate mode is changeable. false: Dio Alternate mode is not changeable.
          boolean PortPinModeChangeable: set at post-build, origin=Renesas_v1.0.0, default-value=false  # Parameter to indicate if the mode of a port pin is changeable during runtime by API function Port_SetPinMode. Including this API is controlled by PortSetPinModeApi. true: Port Pin mode is changeable. false: Port Pin mode is not changeable.
          enumeration PortPinLevelValue: {PORT_PIN_LEVEL_LOW, PORT_PIN_LEVEL_HIGH}, set at post-build, origin=Renesas_v1.0.0, default-value=PORT_PIN_LEVEL_LOW  # Parameter to indicate port pin level value for a port pin. PORT_PIN_LEVEL_LOW: Port pin Level is low. PORT_PIN_LEVEL_HIGH: Port pin Level is high.
          enumeration PortPinInitialMode: {GTM0I7_ALT1_IN, CSIH3SCI1_ALT2_IN, CSIH3SCO1_ALT2_OUT, DIO}, set at post-build, origin=Renesas_v1.0.0, default-value=DIO  # Mode of the port pin for use with Port_Init() function. <Input name>_ALT<Alternative instance>_IN: Provides alternative instance for selected input. <Output name>_ALT<Alternative instance>_OUT: Provides alternative instance for selected output.
          enumeration PortPinDirection: {PORT_PIN_OUT, PORT_PIN_IN}, set at post-build, origin=Renesas_v1.0.0, default-value=PORT_PIN_IN  # The initial direction of the pin (IN or OUT). If the direction is not changeable, the value configured here is fixed. The direction must match the pin mode. PORT_PIN_IN: Port pin direction set as input. PORT_PIN_OUT: Port pin direction set as output.
          boolean PortInputBufferControl: set at post-build, origin=Renesas_v1.0.0, default-value=false  # This parameter is used as one of the factors to enable/disable port pins input buffer in DIO Mode (PMC=0). true: Port pin's input buffer is ready to be enabled in DIO Mode. false: Port pin's input buffer is disabled in DIO Mode.
          boolean PortBiDirectionControl: set at post-build, origin=Renesas_v1.0.0, default-value=false  # This parameter forces port pins input buffer and output buffer at the same time. If activated, the effect is valid independently from any other port settings. true: Activate forced Bi-directional IO buffer of the port pin. false: Deactivate forced Bi-directional IO buffer of the port pin.
          boolean PortIpControl: set at post-build, origin=Renesas_v1.0.0, default-value=false  # This parameter is used to enable/disable the direct IO control of port pins input buffer and output buffer. true: Enables the direct IO control of port pins input buffer and output buffer by the corresponding control signals of IP_ENI3(0) and IP_ENO3(0) from internal peripheral IPs. This register is valid only in Control Mode (PMC=1). false: Disables the direct IO control of port pins input buffer and output buffer.
          boolean PortPullUpOption: set at post-build, origin=Renesas_v1.0.0, default-value=false  # This register switches on or off the port pins pull-up resistor. true: Port pin's pull-up resistor is enabled. false: Port pin's pull-up resistor is disabled.
          boolean PortPullDownOption: set at post-build, origin=Renesas_v1.0.0, default-value=false  # This parameter switches on or off the port pins pull-down resistor. true: Port pin's pull-down resistor is enabled. false: Port pin's pull-down resistor is disabled.
          enumeration PortOpenDrainControl_Expansion: {PushPull, OpenDrain_N_Channel, OpenDrain_P_Channel}, set at post-build, origin=Renesas_v1.0.2, default-value=PushPull  # This parameter selects port pins output buffer function in combination of PODC and PODCE . | PushPull Specifies the PushPull type output circuit characteristics and updates both PODC and PODCE registers as 0 0 respectively. OpenDrain_N_Channel specifies the N-ch open drain type output circuit characteristics and updates the PODC and PODCE registers as 1 0 respectively. OpenDrain_P_Channel specifies the P-ch open drain type output circuit characteristics and updates the PODC and PODCE registers as 1 1 respectively.
          boolean PortOutputLevelInversion: set at post-build, origin=Renesas_v1.0.0, default-value=false  # This parameter specifies whether the output level from a pin is inverted or not. true: Pin output level is inverted. false: Pin output level is not inverted.
          enumeration PortDriveStrengthControl: {SLOW, FAST}, set at post-build, origin=Renesas_v1.0.0, default-value=SLOW  # This parameter selects the port pins output drive strength as high strength or low strength type. This functionality is also referred to fast (high strength) and slow (low strength) behavior of output buffer. SLOW: Lower drive strength (slow mode) is selected for port pin's output buffer. FAST: Higher drive strength (fast mode) is selected for port pin's output buffer.
          boolean PortUniversalCharacteristicCntrl: set at post-build, origin=Renesas_v1.0.0, default-value=false  # This parameter selects the port pins output drive strength as high or low type. The PortDriveStrengthControl must be enabled for this feature. | false: PortDriveStrengthControl parameter specifies the output driver strength of the port pin. true : Number of output buffer characteristics selection capability is expanded, the maximum of 4 characteristics selection is possible PUCCn PDSCn 0 0 Output characteristic selection 1 (400 Ohm buffer) 0 1 Output characteristic selection 2 (200 Ohm buffer) 1 0 Output characteristic selection 3 (100 Ohm buffer) 1 1 Output characteristic selection 4 (50 Ohm buffer)
          enumeration PortInputSelection: {TYPE1_SHMT1, TYPE2_SHMT4}, set at post-build, origin=Renesas_v1.0.0, default-value=TYPE1_SHMT1  # This setting specifies the input buffer characteristics. TYPE1_SHMT1: TYPE 1 buffer is selected. TYPE2_SHMT4: TYPE 2 buffer is selected.
        container PortPin11  # This container contains the configuration (parameters) for Port Pin 0.
          boolean PortPinDirectionChangeable: set at post-build, origin=Renesas_v1.0.0, default-value=false  # Parameter to indicate if the direction is changeable on a port pin during runtime. true: Port Pin direction changeable enabled. false: Port Pin direction changeable disabled.
          boolean PortPinDioAltModeChangeable: set at post-build, origin=Renesas_v1.0.0, default-value=false  # Parameter to indicate if the mode of a port pin is changeable between DIO and Alternate during runtime by API functions Port_SetToDioMode and Port_SetToAlternateMode. Including these APIs is controlled by PortSetToDioAltModeApi. true: Dio Alternate mode is changeable. false: Dio Alternate mode is not changeable.
          boolean PortPinModeChangeable: set at post-build, origin=Renesas_v1.0.0, default-value=false  # Parameter to indicate if the mode of a port pin is changeable during runtime by API function Port_SetPinMode. Including this API is controlled by PortSetPinModeApi. true: Port Pin mode is changeable. false: Port Pin mode is not changeable.
          enumeration PortPinLevelValue: {PORT_PIN_LEVEL_LOW, PORT_PIN_LEVEL_HIGH}, set at post-build, origin=Renesas_v1.0.0, default-value=PORT_PIN_LEVEL_LOW  # Parameter to indicate port pin level value for a port pin. PORT_PIN_LEVEL_LOW: Port pin Level is low. PORT_PIN_LEVEL_HIGH: Port pin Level is high.
          enumeration PortPinInitialMode: {GTM0I3_ALT1_IN, CSIH3CSS0_ALT2_OUT, DIO}, set at post-build, origin=Renesas_v1.0.0, default-value=DIO  # Mode of the port pin for use with Port_Init() function. <Input name>_ALT<Alternative instance>_IN: Provides alternative instance for selected input. <Output name>_ALT<Alternative instance>_OUT: Provides alternative instance for selected output.
          enumeration PortPinDirection: {PORT_PIN_OUT, PORT_PIN_IN}, set at post-build, origin=Renesas_v1.0.0, default-value=PORT_PIN_IN  # The initial direction of the pin (IN or OUT). If the direction is not changeable, the value configured here is fixed. The direction must match the pin mode. PORT_PIN_IN: Port pin direction set as input. PORT_PIN_OUT: Port pin direction set as output.
          boolean PortInputBufferControl: set at post-build, origin=Renesas_v1.0.0, default-value=false  # This parameter is used as one of the factors to enable/disable port pins input buffer in DIO Mode (PMC=0). true: Port pin's input buffer is ready to be enabled in DIO Mode. false: Port pin's input buffer is disabled in DIO Mode.
          boolean PortBiDirectionControl: set at post-build, origin=Renesas_v1.0.0, default-value=false  # This parameter forces port pins input buffer and output buffer at the same time. If activated, the effect is valid independently from any other port settings. true: Activate forced Bi-directional IO buffer of the port pin. false: Deactivate forced Bi-directional IO buffer of the port pin.
          boolean PortPullUpOption: set at post-build, origin=Renesas_v1.0.0, default-value=false  # This register switches on or off the port pins pull-up resistor. true: Port pin's pull-up resistor is enabled. false: Port pin's pull-up resistor is disabled.
          boolean PortPullDownOption: set at post-build, origin=Renesas_v1.0.0, default-value=false  # This parameter switches on or off the port pins pull-down resistor. true: Port pin's pull-down resistor is enabled. false: Port pin's pull-down resistor is disabled.
          enumeration PortOpenDrainControl_Expansion: {PushPull, OpenDrain_N_Channel, OpenDrain_P_Channel}, set at post-build, origin=Renesas_v1.0.2, default-value=PushPull  # This parameter selects port pins output buffer function in combination of PODC and PODCE . | PushPull Specifies the PushPull type output circuit characteristics and updates both PODC and PODCE registers as 0 0 respectively. OpenDrain_N_Channel specifies the N-ch open drain type output circuit characteristics and updates the PODC and PODCE registers as 1 0 respectively. OpenDrain_P_Channel specifies the P-ch open drain type output circuit characteristics and updates the PODC and PODCE registers as 1 1 respectively.
          boolean PortOutputLevelInversion: set at post-build, origin=Renesas_v1.0.0, default-value=false  # This parameter specifies whether the output level from a pin is inverted or not. true: Pin output level is inverted. false: Pin output level is not inverted.
          enumeration PortDriveStrengthControl: {SLOW, FAST}, set at post-build, origin=Renesas_v1.0.0, default-value=SLOW  # This parameter selects the port pins output drive strength as high strength or low strength type. This functionality is also referred to fast (high strength) and slow (low strength) behavior of output buffer. SLOW: Lower drive strength (slow mode) is selected for port pin's output buffer. FAST: Higher drive strength (fast mode) is selected for port pin's output buffer.
          boolean PortUniversalCharacteristicCntrl: set at post-build, origin=Renesas_v1.0.0, default-value=false  # This parameter selects the port pins output drive strength as high or low type. The PortDriveStrengthControl must be enabled for this feature. | false: PortDriveStrengthControl parameter specifies the output driver strength of the port pin. true : Number of output buffer characteristics selection capability is expanded, the maximum of 4 characteristics selection is possible PUCCn PDSCn 0 0 Output characteristic selection 1 (400 Ohm buffer) 0 1 Output characteristic selection 2 (200 Ohm buffer) 1 0 Output characteristic selection 3 (100 Ohm buffer) 1 1 Output characteristic selection 4 (50 Ohm buffer)
          enumeration PortInputSelection: {TYPE1_SHMT1, TYPE2_SHMT4}, set at post-build, origin=Renesas_v1.0.0, default-value=TYPE1_SHMT1  # This setting specifies the input buffer characteristics. TYPE1_SHMT1: TYPE 1 buffer is selected. TYPE2_SHMT4: TYPE 2 buffer is selected.
        container PortPin12  # This container contains the configuration (parameters) for Port Pin 0.
          boolean PortPinDirectionChangeable: set at post-build, origin=Renesas_v1.0.0, default-value=false  # Parameter to indicate if the direction is changeable on a port pin during runtime. true: Port Pin direction changeable enabled. false: Port Pin direction changeable disabled.
          boolean PortPinDioAltModeChangeable: set at post-build, origin=Renesas_v1.0.0, default-value=false  # Parameter to indicate if the mode of a port pin is changeable between DIO and Alternate during runtime by API functions Port_SetToDioMode and Port_SetToAlternateMode. Including these APIs is controlled by PortSetToDioAltModeApi. true: Dio Alternate mode is changeable. false: Dio Alternate mode is not changeable.
          boolean PortPinModeChangeable: set at post-build, origin=Renesas_v1.0.0, default-value=false  # Parameter to indicate if the mode of a port pin is changeable during runtime by API function Port_SetPinMode. Including this API is controlled by PortSetPinModeApi. true: Port Pin mode is changeable. false: Port Pin mode is not changeable.
          enumeration PortPinLevelValue: {PORT_PIN_LEVEL_LOW, PORT_PIN_LEVEL_HIGH}, set at post-build, origin=Renesas_v1.0.0, default-value=PORT_PIN_LEVEL_LOW  # Parameter to indicate port pin level value for a port pin. PORT_PIN_LEVEL_LOW: Port pin Level is low. PORT_PIN_LEVEL_HIGH: Port pin Level is high.
          enumeration PortPinInitialMode: {GTM1I6_ALT1_IN, CSIH3SI1_ALT2_IN, DIO}, set at post-build, origin=Renesas_v1.0.0, default-value=DIO  # Mode of the port pin for use with Port_Init() function. <Input name>_ALT<Alternative instance>_IN: Provides alternative instance for selected input. <Output name>_ALT<Alternative instance>_OUT: Provides alternative instance for selected output.
          enumeration PortPinDirection: {PORT_PIN_OUT, PORT_PIN_IN}, set at post-build, origin=Renesas_v1.0.0, default-value=PORT_PIN_IN  # The initial direction of the pin (IN or OUT). If the direction is not changeable, the value configured here is fixed. The direction must match the pin mode. PORT_PIN_IN: Port pin direction set as input. PORT_PIN_OUT: Port pin direction set as output.
          boolean PortInputBufferControl: set at post-build, origin=Renesas_v1.0.0, default-value=false  # This parameter is used as one of the factors to enable/disable port pins input buffer in DIO Mode (PMC=0). true: Port pin's input buffer is ready to be enabled in DIO Mode. false: Port pin's input buffer is disabled in DIO Mode.
          boolean PortBiDirectionControl: set at post-build, origin=Renesas_v1.0.0, default-value=false  # This parameter forces port pins input buffer and output buffer at the same time. If activated, the effect is valid independently from any other port settings. true: Activate forced Bi-directional IO buffer of the port pin. false: Deactivate forced Bi-directional IO buffer of the port pin.
          boolean PortPullUpOption: set at post-build, origin=Renesas_v1.0.0, default-value=false  # This register switches on or off the port pins pull-up resistor. true: Port pin's pull-up resistor is enabled. false: Port pin's pull-up resistor is disabled.
          boolean PortPullDownOption: set at post-build, origin=Renesas_v1.0.0, default-value=false  # This parameter switches on or off the port pins pull-down resistor. true: Port pin's pull-down resistor is enabled. false: Port pin's pull-down resistor is disabled.
          enumeration PortOpenDrainControl_Expansion: {PushPull, OpenDrain_N_Channel, OpenDrain_P_Channel}, set at post-build, origin=Renesas_v1.0.2, default-value=PushPull  # This parameter selects port pins output buffer function in combination of PODC and PODCE . | PushPull Specifies the PushPull type output circuit characteristics and updates both PODC and PODCE registers as 0 0 respectively. OpenDrain_N_Channel specifies the N-ch open drain type output circuit characteristics and updates the PODC and PODCE registers as 1 0 respectively. OpenDrain_P_Channel specifies the P-ch open drain type output circuit characteristics and updates the PODC and PODCE registers as 1 1 respectively.
          boolean PortOutputLevelInversion: set at post-build, origin=Renesas_v1.0.0, default-value=false  # This parameter specifies whether the output level from a pin is inverted or not. true: Pin output level is inverted. false: Pin output level is not inverted.
          enumeration PortDriveStrengthControl: {SLOW, FAST}, set at post-build, origin=Renesas_v1.0.0, default-value=SLOW  # This parameter selects the port pins output drive strength as high strength or low strength type. This functionality is also referred to fast (high strength) and slow (low strength) behavior of output buffer. SLOW: Lower drive strength (slow mode) is selected for port pin's output buffer. FAST: Higher drive strength (fast mode) is selected for port pin's output buffer.
          boolean PortUniversalCharacteristicCntrl: set at post-build, origin=Renesas_v1.0.0, default-value=false  # This parameter selects the port pins output drive strength as high or low type. The PortDriveStrengthControl must be enabled for this feature. | false: PortDriveStrengthControl parameter specifies the output driver strength of the port pin. true : Number of output buffer characteristics selection capability is expanded, the maximum of 4 characteristics selection is possible PUCCn PDSCn 0 0 Output characteristic selection 1 (400 Ohm buffer) 0 1 Output characteristic selection 2 (200 Ohm buffer) 1 0 Output characteristic selection 3 (100 Ohm buffer) 1 1 Output characteristic selection 4 (50 Ohm buffer)
          enumeration PortInputSelection: {TYPE1_SHMT1, TYPE2_SHMT4}, set at post-build, origin=Renesas_v1.0.0, default-value=TYPE1_SHMT1  # This setting specifies the input buffer characteristics. TYPE1_SHMT1: TYPE 1 buffer is selected. TYPE2_SHMT4: TYPE 2 buffer is selected.
        container PortPin13  # This container contains the configuration (parameters) for Port Pin 0.
          boolean PortPinDirectionChangeable: set at post-build, origin=Renesas_v1.0.0, default-value=false  # Parameter to indicate if the direction is changeable on a port pin during runtime. true: Port Pin direction changeable enabled. false: Port Pin direction changeable disabled.
          boolean PortPinDioAltModeChangeable: set at post-build, origin=Renesas_v1.0.0, default-value=false  # Parameter to indicate if the mode of a port pin is changeable between DIO and Alternate during runtime by API functions Port_SetToDioMode and Port_SetToAlternateMode. Including these APIs is controlled by PortSetToDioAltModeApi. true: Dio Alternate mode is changeable. false: Dio Alternate mode is not changeable.
          boolean PortPinModeChangeable: set at post-build, origin=Renesas_v1.0.0, default-value=false  # Parameter to indicate if the mode of a port pin is changeable during runtime by API function Port_SetPinMode. Including this API is controlled by PortSetPinModeApi. true: Port Pin mode is changeable. false: Port Pin mode is not changeable.
          enumeration PortPinLevelValue: {PORT_PIN_LEVEL_LOW, PORT_PIN_LEVEL_HIGH}, set at post-build, origin=Renesas_v1.0.0, default-value=PORT_PIN_LEVEL_LOW  # Parameter to indicate port pin level value for a port pin. PORT_PIN_LEVEL_LOW: Port pin Level is low. PORT_PIN_LEVEL_HIGH: Port pin Level is high.
          enumeration PortPinInitialMode: {GTM1I7_ALT1_IN, CSIH3SO1_ALT2_OUT, CSIH3DCS_ALT2_IN, DIO}, set at post-build, origin=Renesas_v1.0.0, default-value=DIO  # Mode of the port pin for use with Port_Init() function. <Input name>_ALT<Alternative instance>_IN: Provides alternative instance for selected input. <Output name>_ALT<Alternative instance>_OUT: Provides alternative instance for selected output.
          enumeration PortPinDirection: {PORT_PIN_OUT, PORT_PIN_IN}, set at post-build, origin=Renesas_v1.0.0, default-value=PORT_PIN_IN  # The initial direction of the pin (IN or OUT). If the direction is not changeable, the value configured here is fixed. The direction must match the pin mode. PORT_PIN_IN: Port pin direction set as input. PORT_PIN_OUT: Port pin direction set as output.
          boolean PortInputBufferControl: set at post-build, origin=Renesas_v1.0.0, default-value=false  # This parameter is used as one of the factors to enable/disable port pins input buffer in DIO Mode (PMC=0). true: Port pin's input buffer is ready to be enabled in DIO Mode. false: Port pin's input buffer is disabled in DIO Mode.
          boolean PortBiDirectionControl: set at post-build, origin=Renesas_v1.0.0, default-value=false  # This parameter forces port pins input buffer and output buffer at the same time. If activated, the effect is valid independently from any other port settings. true: Activate forced Bi-directional IO buffer of the port pin. false: Deactivate forced Bi-directional IO buffer of the port pin.
          boolean PortIpControl: set at post-build, origin=Renesas_v1.0.0, default-value=false  # This parameter is used to enable/disable the direct IO control of port pins input buffer and output buffer. true: Enables the direct IO control of port pins input buffer and output buffer by the corresponding control signals of IP_ENI3(0) and IP_ENO3(0) from internal peripheral IPs. This register is valid only in Control Mode (PMC=1). false: Disables the direct IO control of port pins input buffer and output buffer.
          boolean PortPullUpOption: set at post-build, origin=Renesas_v1.0.0, default-value=false  # This register switches on or off the port pins pull-up resistor. true: Port pin's pull-up resistor is enabled. false: Port pin's pull-up resistor is disabled.
          boolean PortPullDownOption: set at post-build, origin=Renesas_v1.0.0, default-value=false  # This parameter switches on or off the port pins pull-down resistor. true: Port pin's pull-down resistor is enabled. false: Port pin's pull-down resistor is disabled.
          enumeration PortOpenDrainControl_Expansion: {PushPull, OpenDrain_N_Channel, OpenDrain_P_Channel}, set at post-build, origin=Renesas_v1.0.2, default-value=PushPull  # This parameter selects port pins output buffer function in combination of PODC and PODCE . | PushPull Specifies the PushPull type output circuit characteristics and updates both PODC and PODCE registers as 0 0 respectively. OpenDrain_N_Channel specifies the N-ch open drain type output circuit characteristics and updates the PODC and PODCE registers as 1 0 respectively. OpenDrain_P_Channel specifies the P-ch open drain type output circuit characteristics and updates the PODC and PODCE registers as 1 1 respectively.
          boolean PortOutputLevelInversion: set at post-build, origin=Renesas_v1.0.0, default-value=false  # This parameter specifies whether the output level from a pin is inverted or not. true: Pin output level is inverted. false: Pin output level is not inverted.
          enumeration PortDriveStrengthControl: {SLOW, FAST}, set at post-build, origin=Renesas_v1.0.0, default-value=SLOW  # This parameter selects the port pins output drive strength as high strength or low strength type. This functionality is also referred to fast (high strength) and slow (low strength) behavior of output buffer. SLOW: Lower drive strength (slow mode) is selected for port pin's output buffer. FAST: Higher drive strength (fast mode) is selected for port pin's output buffer.
          boolean PortUniversalCharacteristicCntrl: set at post-build, origin=Renesas_v1.0.0, default-value=false  # This parameter selects the port pins output drive strength as high or low type. The PortDriveStrengthControl must be enabled for this feature. | false: PortDriveStrengthControl parameter specifies the output driver strength of the port pin. true : Number of output buffer characteristics selection capability is expanded, the maximum of 4 characteristics selection is possible PUCCn PDSCn 0 0 Output characteristic selection 1 (400 Ohm buffer) 0 1 Output characteristic selection 2 (200 Ohm buffer) 1 0 Output characteristic selection 3 (100 Ohm buffer) 1 1 Output characteristic selection 4 (50 Ohm buffer)
          enumeration PortInputSelection: {TYPE1_SHMT1, TYPE2_SHMT4}, set at post-build, origin=Renesas_v1.0.0, default-value=TYPE1_SHMT1  # This setting specifies the input buffer characteristics. TYPE1_SHMT1: TYPE 1 buffer is selected. TYPE2_SHMT4: TYPE 2 buffer is selected.
      container PortGroup7  # This container contains the configuration (parameters) for Port Group 0.
        container PortPin0  # This container contains the configuration (parameters) for Port Pin 0.
          boolean PortPinDirectionChangeable: set at post-build, origin=Renesas_v1.0.0, default-value=false  # Parameter to indicate if the direction is changeable on a port pin during runtime. true: Port Pin direction changeable enabled. false: Port Pin direction changeable disabled.
          boolean PortPinDioAltModeChangeable: set at post-build, origin=Renesas_v1.0.0, default-value=false  # Parameter to indicate if the mode of a port pin is changeable between DIO and Alternate during runtime by API functions Port_SetToDioMode and Port_SetToAlternateMode. Including these APIs is controlled by PortSetToDioAltModeApi. true: Dio Alternate mode is changeable. false: Dio Alternate mode is not changeable.
          boolean PortPinModeChangeable: set at post-build, origin=Renesas_v1.0.0, default-value=false  # Parameter to indicate if the mode of a port pin is changeable during runtime by API function Port_SetPinMode. Including this API is controlled by PortSetPinModeApi. true: Port Pin mode is changeable. false: Port Pin mode is not changeable.
          enumeration PortPinLevelValue: {PORT_PIN_LEVEL_LOW, PORT_PIN_LEVEL_HIGH}, set at post-build, origin=Renesas_v1.0.0, default-value=PORT_PIN_LEVEL_LOW  # Parameter to indicate port pin level value for a port pin. PORT_PIN_LEVEL_LOW: Port pin Level is low. PORT_PIN_LEVEL_HIGH: Port pin Level is high.
          enumeration PortPinInitialMode: {GTM0I6_ALT1_IN, CSIH3RYI_ALT4_IN, CSIH3RYO_ALT4_OUT, DIO}, set at post-build, origin=Renesas_v1.0.0, default-value=DIO  # Mode of the port pin for use with Port_Init() function. <Input name>_ALT<Alternative instance>_IN: Provides alternative instance for selected input. <Output name>_ALT<Alternative instance>_OUT: Provides alternative instance for selected output.
          enumeration PortPinDirection: {PORT_PIN_OUT, PORT_PIN_IN}, set at post-build, origin=Renesas_v1.0.0, default-value=PORT_PIN_IN  # The initial direction of the pin (IN or OUT). If the direction is not changeable, the value configured here is fixed. The direction must match the pin mode. PORT_PIN_IN: Port pin direction set as input. PORT_PIN_OUT: Port pin direction set as output.
          boolean PortInputBufferControl: set at post-build, origin=Renesas_v1.0.0, default-value=false  # This parameter is used as one of the factors to enable/disable port pins input buffer in DIO Mode (PMC=0). true: Port pin's input buffer is ready to be enabled in DIO Mode. false: Port pin's input buffer is disabled in DIO Mode.
          boolean PortBiDirectionControl: set at post-build, origin=Renesas_v1.0.0, default-value=false  # This parameter forces port pins input buffer and output buffer at the same time. If activated, the effect is valid independently from any other port settings. true: Activate forced Bi-directional IO buffer of the port pin. false: Deactivate forced Bi-directional IO buffer of the port pin.
          boolean PortIpControl: set at post-build, origin=Renesas_v1.0.0, default-value=false  # This parameter is used to enable/disable the direct IO control of port pins input buffer and output buffer. true: Enables the direct IO control of port pins input buffer and output buffer by the corresponding control signals of IP_ENI3(0) and IP_ENO3(0) from internal peripheral IPs. This register is valid only in Control Mode (PMC=1). false: Disables the direct IO control of port pins input buffer and output buffer.
          boolean PortPullUpOption: set at post-build, origin=Renesas_v1.0.0, default-value=false  # This register switches on or off the port pins pull-up resistor. true: Port pin's pull-up resistor is enabled. false: Port pin's pull-up resistor is disabled.
          boolean PortPullDownOption: set at post-build, origin=Renesas_v1.0.0, default-value=false  # This parameter switches on or off the port pins pull-down resistor. true: Port pin's pull-down resistor is enabled. false: Port pin's pull-down resistor is disabled.
          enumeration PortOpenDrainControl_Expansion: {PushPull, OpenDrain_N_Channel, OpenDrain_P_Channel}, set at post-build, origin=Renesas_v1.0.2, default-value=PushPull  # This parameter selects port pins output buffer function in combination of PODC and PODCE . | PushPull Specifies the PushPull type output circuit characteristics and updates both PODC and PODCE registers as 0 0 respectively. OpenDrain_N_Channel specifies the N-ch open drain type output circuit characteristics and updates the PODC and PODCE registers as 1 0 respectively. OpenDrain_P_Channel specifies the P-ch open drain type output circuit characteristics and updates the PODC and PODCE registers as 1 1 respectively.
          boolean PortOutputLevelInversion: set at post-build, origin=Renesas_v1.0.0, default-value=false  # This parameter specifies whether the output level from a pin is inverted or not. true: Pin output level is inverted. false: Pin output level is not inverted.
          enumeration PortDriveStrengthControl: {SLOW, FAST}, set at post-build, origin=Renesas_v1.0.0, default-value=SLOW  # This parameter selects the port pins output drive strength as high strength or low strength type. This functionality is also referred to fast (high strength) and slow (low strength) behavior of output buffer. SLOW: Lower drive strength (slow mode) is selected for port pin's output buffer. FAST: Higher drive strength (fast mode) is selected for port pin's output buffer.
          boolean PortUniversalCharacteristicCntrl: set at post-build, origin=Renesas_v1.0.0, default-value=false  # This parameter selects the port pins output drive strength as high or low type. The PortDriveStrengthControl must be enabled for this feature. | false: PortDriveStrengthControl parameter specifies the output driver strength of the port pin. true : Number of output buffer characteristics selection capability is expanded, the maximum of 4 characteristics selection is possible PUCCn PDSCn 0 0 Output characteristic selection 1 (400 Ohm buffer) 0 1 Output characteristic selection 2 (200 Ohm buffer) 1 0 Output characteristic selection 3 (100 Ohm buffer) 1 1 Output characteristic selection 4 (50 Ohm buffer)
          enumeration PortInputSelection: {TYPE1_SHMT1, TYPE2_SHMT4}, set at post-build, origin=Renesas_v1.0.0, default-value=TYPE1_SHMT1  # This setting specifies the input buffer characteristics. TYPE1_SHMT1: TYPE 1 buffer is selected. TYPE2_SHMT4: TYPE 2 buffer is selected.
        container PortPin1  # This container contains the configuration (parameters) for Port Pin 0.
          boolean PortPinDirectionChangeable: set at post-build, origin=Renesas_v1.0.0, default-value=false  # Parameter to indicate if the direction is changeable on a port pin during runtime. true: Port Pin direction changeable enabled. false: Port Pin direction changeable disabled.
          boolean PortPinDioAltModeChangeable: set at post-build, origin=Renesas_v1.0.0, default-value=false  # Parameter to indicate if the mode of a port pin is changeable between DIO and Alternate during runtime by API functions Port_SetToDioMode and Port_SetToAlternateMode. Including these APIs is controlled by PortSetToDioAltModeApi. true: Dio Alternate mode is changeable. false: Dio Alternate mode is not changeable.
          boolean PortPinModeChangeable: set at post-build, origin=Renesas_v1.0.0, default-value=false  # Parameter to indicate if the mode of a port pin is changeable during runtime by API function Port_SetPinMode. Including this API is controlled by PortSetPinModeApi. true: Port Pin mode is changeable. false: Port Pin mode is not changeable.
          enumeration PortPinLevelValue: {PORT_PIN_LEVEL_LOW, PORT_PIN_LEVEL_HIGH}, set at post-build, origin=Renesas_v1.0.0, default-value=PORT_PIN_LEVEL_LOW  # Parameter to indicate port pin level value for a port pin. PORT_PIN_LEVEL_LOW: Port pin Level is low. PORT_PIN_LEVEL_HIGH: Port pin Level is high.
          enumeration PortPinInitialMode: {GTM1I2_ALT1_IN, DIO}, set at post-build, origin=Renesas_v1.0.0, default-value=DIO  # Mode of the port pin for use with Port_Init() function. <Input name>_ALT<Alternative instance>_IN: Provides alternative instance for selected input. <Output name>_ALT<Alternative instance>_OUT: Provides alternative instance for selected output.
          enumeration PortPinDirection: {PORT_PIN_OUT, PORT_PIN_IN}, set at post-build, origin=Renesas_v1.0.0, default-value=PORT_PIN_IN  # The initial direction of the pin (IN or OUT). If the direction is not changeable, the value configured here is fixed. The direction must match the pin mode. PORT_PIN_IN: Port pin direction set as input. PORT_PIN_OUT: Port pin direction set as output.
          boolean PortInputBufferControl: set at post-build, origin=Renesas_v1.0.0, default-value=false  # This parameter is used as one of the factors to enable/disable port pins input buffer in DIO Mode (PMC=0). true: Port pin's input buffer is ready to be enabled in DIO Mode. false: Port pin's input buffer is disabled in DIO Mode.
          boolean PortBiDirectionControl: set at post-build, origin=Renesas_v1.0.0, default-value=false  # This parameter forces port pins input buffer and output buffer at the same time. If activated, the effect is valid independently from any other port settings. true: Activate forced Bi-directional IO buffer of the port pin. false: Deactivate forced Bi-directional IO buffer of the port pin.
          boolean PortPullUpOption: set at post-build, origin=Renesas_v1.0.0, default-value=false  # This register switches on or off the port pins pull-up resistor. true: Port pin's pull-up resistor is enabled. false: Port pin's pull-up resistor is disabled.
          boolean PortPullDownOption: set at post-build, origin=Renesas_v1.0.0, default-value=false  # This parameter switches on or off the port pins pull-down resistor. true: Port pin's pull-down resistor is enabled. false: Port pin's pull-down resistor is disabled.
          enumeration PortOpenDrainControl_Expansion: {PushPull, OpenDrain_N_Channel, OpenDrain_P_Channel}, set at post-build, origin=Renesas_v1.0.2, default-value=PushPull  # This parameter selects port pins output buffer function in combination of PODC and PODCE . | PushPull Specifies the PushPull type output circuit characteristics and updates both PODC and PODCE registers as 0 0 respectively. OpenDrain_N_Channel specifies the N-ch open drain type output circuit characteristics and updates the PODC and PODCE registers as 1 0 respectively. OpenDrain_P_Channel specifies the P-ch open drain type output circuit characteristics and updates the PODC and PODCE registers as 1 1 respectively.
          boolean PortOutputLevelInversion: set at post-build, origin=Renesas_v1.0.0, default-value=false  # This parameter specifies whether the output level from a pin is inverted or not. true: Pin output level is inverted. false: Pin output level is not inverted.
          enumeration PortDriveStrengthControl: {SLOW, FAST}, set at post-build, origin=Renesas_v1.0.0, default-value=SLOW  # This parameter selects the port pins output drive strength as high strength or low strength type. This functionality is also referred to fast (high strength) and slow (low strength) behavior of output buffer. SLOW: Lower drive strength (slow mode) is selected for port pin's output buffer. FAST: Higher drive strength (fast mode) is selected for port pin's output buffer.
          boolean PortUniversalCharacteristicCntrl: set at post-build, origin=Renesas_v1.0.0, default-value=false  # This parameter selects the port pins output drive strength as high or low type. The PortDriveStrengthControl must be enabled for this feature. | false: PortDriveStrengthControl parameter specifies the output driver strength of the port pin. true : Number of output buffer characteristics selection capability is expanded, the maximum of 4 characteristics selection is possible PUCCn PDSCn 0 0 Output characteristic selection 1 (400 Ohm buffer) 0 1 Output characteristic selection 2 (200 Ohm buffer) 1 0 Output characteristic selection 3 (100 Ohm buffer) 1 1 Output characteristic selection 4 (50 Ohm buffer)
          enumeration PortInputSelection: {TYPE1_SHMT1, TYPE2_SHMT4}, set at post-build, origin=Renesas_v1.0.0, default-value=TYPE1_SHMT1  # This setting specifies the input buffer characteristics. TYPE1_SHMT1: TYPE 1 buffer is selected. TYPE2_SHMT4: TYPE 2 buffer is selected.
        container PortPin2  # This container contains the configuration (parameters) for Port Pin 0.
          boolean PortPinDirectionChangeable: set at post-build, origin=Renesas_v1.0.0, default-value=false  # Parameter to indicate if the direction is changeable on a port pin during runtime. true: Port Pin direction changeable enabled. false: Port Pin direction changeable disabled.
          boolean PortPinDioAltModeChangeable: set at post-build, origin=Renesas_v1.0.0, default-value=false  # Parameter to indicate if the mode of a port pin is changeable between DIO and Alternate during runtime by API functions Port_SetToDioMode and Port_SetToAlternateMode. Including these APIs is controlled by PortSetToDioAltModeApi. true: Dio Alternate mode is changeable. false: Dio Alternate mode is not changeable.
          boolean PortPinModeChangeable: set at post-build, origin=Renesas_v1.0.0, default-value=false  # Parameter to indicate if the mode of a port pin is changeable during runtime by API function Port_SetPinMode. Including this API is controlled by PortSetPinModeApi. true: Port Pin mode is changeable. false: Port Pin mode is not changeable.
          enumeration PortPinLevelValue: {PORT_PIN_LEVEL_LOW, PORT_PIN_LEVEL_HIGH}, set at post-build, origin=Renesas_v1.0.0, default-value=PORT_PIN_LEVEL_LOW  # Parameter to indicate port pin level value for a port pin. PORT_PIN_LEVEL_LOW: Port pin Level is low. PORT_PIN_LEVEL_HIGH: Port pin Level is high.
          enumeration PortPinInitialMode: {GTM0I7_ALT1_IN, DIO}, set at post-build, origin=Renesas_v1.0.0, default-value=DIO  # Mode of the port pin for use with Port_Init() function. <Input name>_ALT<Alternative instance>_IN: Provides alternative instance for selected input. <Output name>_ALT<Alternative instance>_OUT: Provides alternative instance for selected output.
          enumeration PortPinDirection: {PORT_PIN_OUT, PORT_PIN_IN}, set at post-build, origin=Renesas_v1.0.0, default-value=PORT_PIN_IN  # The initial direction of the pin (IN or OUT). If the direction is not changeable, the value configured here is fixed. The direction must match the pin mode. PORT_PIN_IN: Port pin direction set as input. PORT_PIN_OUT: Port pin direction set as output.
          boolean PortInputBufferControl: set at post-build, origin=Renesas_v1.0.0, default-value=false  # This parameter is used as one of the factors to enable/disable port pins input buffer in DIO Mode (PMC=0). true: Port pin's input buffer is ready to be enabled in DIO Mode. false: Port pin's input buffer is disabled in DIO Mode.
          boolean PortBiDirectionControl: set at post-build, origin=Renesas_v1.0.0, default-value=false  # This parameter forces port pins input buffer and output buffer at the same time. If activated, the effect is valid independently from any other port settings. true: Activate forced Bi-directional IO buffer of the port pin. false: Deactivate forced Bi-directional IO buffer of the port pin.
          boolean PortPullUpOption: set at post-build, origin=Renesas_v1.0.0, default-value=false  # This register switches on or off the port pins pull-up resistor. true: Port pin's pull-up resistor is enabled. false: Port pin's pull-up resistor is disabled.
          boolean PortPullDownOption: set at post-build, origin=Renesas_v1.0.0, default-value=false  # This parameter switches on or off the port pins pull-down resistor. true: Port pin's pull-down resistor is enabled. false: Port pin's pull-down resistor is disabled.
          enumeration PortOpenDrainControl_Expansion: {PushPull, OpenDrain_N_Channel, OpenDrain_P_Channel}, set at post-build, origin=Renesas_v1.0.2, default-value=PushPull  # This parameter selects port pins output buffer function in combination of PODC and PODCE . | PushPull Specifies the PushPull type output circuit characteristics and updates both PODC and PODCE registers as 0 0 respectively. OpenDrain_N_Channel specifies the N-ch open drain type output circuit characteristics and updates the PODC and PODCE registers as 1 0 respectively. OpenDrain_P_Channel specifies the P-ch open drain type output circuit characteristics and updates the PODC and PODCE registers as 1 1 respectively.
          boolean PortOutputLevelInversion: set at post-build, origin=Renesas_v1.0.0, default-value=false  # This parameter specifies whether the output level from a pin is inverted or not. true: Pin output level is inverted. false: Pin output level is not inverted.
          enumeration PortDriveStrengthControl: {SLOW, FAST}, set at post-build, origin=Renesas_v1.0.0, default-value=SLOW  # This parameter selects the port pins output drive strength as high strength or low strength type. This functionality is also referred to fast (high strength) and slow (low strength) behavior of output buffer. SLOW: Lower drive strength (slow mode) is selected for port pin's output buffer. FAST: Higher drive strength (fast mode) is selected for port pin's output buffer.
          boolean PortUniversalCharacteristicCntrl: set at post-build, origin=Renesas_v1.0.0, default-value=false  # This parameter selects the port pins output drive strength as high or low type. The PortDriveStrengthControl must be enabled for this feature. | false: PortDriveStrengthControl parameter specifies the output driver strength of the port pin. true : Number of output buffer characteristics selection capability is expanded, the maximum of 4 characteristics selection is possible PUCCn PDSCn 0 0 Output characteristic selection 1 (400 Ohm buffer) 0 1 Output characteristic selection 2 (200 Ohm buffer) 1 0 Output characteristic selection 3 (100 Ohm buffer) 1 1 Output characteristic selection 4 (50 Ohm buffer)
          enumeration PortInputSelection: {TYPE1_SHMT1, TYPE2_SHMT4}, set at post-build, origin=Renesas_v1.0.0, default-value=TYPE1_SHMT1  # This setting specifies the input buffer characteristics. TYPE1_SHMT1: TYPE 1 buffer is selected. TYPE2_SHMT4: TYPE 2 buffer is selected.
        container PortPin3  # This container contains the configuration (parameters) for Port Pin 0.
          boolean PortPinDirectionChangeable: set at post-build, origin=Renesas_v1.0.0, default-value=false  # Parameter to indicate if the direction is changeable on a port pin during runtime. true: Port Pin direction changeable enabled. false: Port Pin direction changeable disabled.
          boolean PortPinDioAltModeChangeable: set at post-build, origin=Renesas_v1.0.0, default-value=false  # Parameter to indicate if the mode of a port pin is changeable between DIO and Alternate during runtime by API functions Port_SetToDioMode and Port_SetToAlternateMode. Including these APIs is controlled by PortSetToDioAltModeApi. true: Dio Alternate mode is changeable. false: Dio Alternate mode is not changeable.
          boolean PortPinModeChangeable: set at post-build, origin=Renesas_v1.0.0, default-value=false  # Parameter to indicate if the mode of a port pin is changeable during runtime by API function Port_SetPinMode. Including this API is controlled by PortSetPinModeApi. true: Port Pin mode is changeable. false: Port Pin mode is not changeable.
          enumeration PortPinLevelValue: {PORT_PIN_LEVEL_LOW, PORT_PIN_LEVEL_HIGH}, set at post-build, origin=Renesas_v1.0.0, default-value=PORT_PIN_LEVEL_LOW  # Parameter to indicate port pin level value for a port pin. PORT_PIN_LEVEL_LOW: Port pin Level is low. PORT_PIN_LEVEL_HIGH: Port pin Level is high.
          enumeration PortPinInitialMode: {GTM0I3_ALT1_IN, DIO}, set at post-build, origin=Renesas_v1.0.0, default-value=DIO  # Mode of the port pin for use with Port_Init() function. <Input name>_ALT<Alternative instance>_IN: Provides alternative instance for selected input. <Output name>_ALT<Alternative instance>_OUT: Provides alternative instance for selected output.
          enumeration PortPinDirection: {PORT_PIN_OUT, PORT_PIN_IN}, set at post-build, origin=Renesas_v1.0.0, default-value=PORT_PIN_IN  # The initial direction of the pin (IN or OUT). If the direction is not changeable, the value configured here is fixed. The direction must match the pin mode. PORT_PIN_IN: Port pin direction set as input. PORT_PIN_OUT: Port pin direction set as output.
          boolean PortInputBufferControl: set at post-build, origin=Renesas_v1.0.0, default-value=false  # This parameter is used as one of the factors to enable/disable port pins input buffer in DIO Mode (PMC=0). true: Port pin's input buffer is ready to be enabled in DIO Mode. false: Port pin's input buffer is disabled in DIO Mode.
          boolean PortBiDirectionControl: set at post-build, origin=Renesas_v1.0.0, default-value=false  # This parameter forces port pins input buffer and output buffer at the same time. If activated, the effect is valid independently from any other port settings. true: Activate forced Bi-directional IO buffer of the port pin. false: Deactivate forced Bi-directional IO buffer of the port pin.
          boolean PortPullUpOption: set at post-build, origin=Renesas_v1.0.0, default-value=false  # This register switches on or off the port pins pull-up resistor. true: Port pin's pull-up resistor is enabled. false: Port pin's pull-up resistor is disabled.
          boolean PortPullDownOption: set at post-build, origin=Renesas_v1.0.0, default-value=false  # This parameter switches on or off the port pins pull-down resistor. true: Port pin's pull-down resistor is enabled. false: Port pin's pull-down resistor is disabled.
          enumeration PortOpenDrainControl_Expansion: {PushPull, OpenDrain_N_Channel, OpenDrain_P_Channel}, set at post-build, origin=Renesas_v1.0.2, default-value=PushPull  # This parameter selects port pins output buffer function in combination of PODC and PODCE . | PushPull Specifies the PushPull type output circuit characteristics and updates both PODC and PODCE registers as 0 0 respectively. OpenDrain_N_Channel specifies the N-ch open drain type output circuit characteristics and updates the PODC and PODCE registers as 1 0 respectively. OpenDrain_P_Channel specifies the P-ch open drain type output circuit characteristics and updates the PODC and PODCE registers as 1 1 respectively.
          boolean PortOutputLevelInversion: set at post-build, origin=Renesas_v1.0.0, default-value=false  # This parameter specifies whether the output level from a pin is inverted or not. true: Pin output level is inverted. false: Pin output level is not inverted.
          enumeration PortDriveStrengthControl: {SLOW, FAST}, set at post-build, origin=Renesas_v1.0.0, default-value=SLOW  # This parameter selects the port pins output drive strength as high strength or low strength type. This functionality is also referred to fast (high strength) and slow (low strength) behavior of output buffer. SLOW: Lower drive strength (slow mode) is selected for port pin's output buffer. FAST: Higher drive strength (fast mode) is selected for port pin's output buffer.
          boolean PortUniversalCharacteristicCntrl: set at post-build, origin=Renesas_v1.0.0, default-value=false  # This parameter selects the port pins output drive strength as high or low type. The PortDriveStrengthControl must be enabled for this feature. | false: PortDriveStrengthControl parameter specifies the output driver strength of the port pin. true : Number of output buffer characteristics selection capability is expanded, the maximum of 4 characteristics selection is possible PUCCn PDSCn 0 0 Output characteristic selection 1 (400 Ohm buffer) 0 1 Output characteristic selection 2 (200 Ohm buffer) 1 0 Output characteristic selection 3 (100 Ohm buffer) 1 1 Output characteristic selection 4 (50 Ohm buffer)
          enumeration PortInputSelection: {TYPE1_SHMT1, TYPE2_SHMT4}, set at post-build, origin=Renesas_v1.0.0, default-value=TYPE1_SHMT1  # This setting specifies the input buffer characteristics. TYPE1_SHMT1: TYPE 1 buffer is selected. TYPE2_SHMT4: TYPE 2 buffer is selected.
        container PortPin4  # This container contains the configuration (parameters) for Port Pin 0.
          boolean PortPinDirectionChangeable: set at post-build, origin=Renesas_v1.0.0, default-value=false  # Parameter to indicate if the direction is changeable on a port pin during runtime. true: Port Pin direction changeable enabled. false: Port Pin direction changeable disabled.
          boolean PortPinDioAltModeChangeable: set at post-build, origin=Renesas_v1.0.0, default-value=false  # Parameter to indicate if the mode of a port pin is changeable between DIO and Alternate during runtime by API functions Port_SetToDioMode and Port_SetToAlternateMode. Including these APIs is controlled by PortSetToDioAltModeApi. true: Dio Alternate mode is changeable. false: Dio Alternate mode is not changeable.
          boolean PortPinModeChangeable: set at post-build, origin=Renesas_v1.0.0, default-value=false  # Parameter to indicate if the mode of a port pin is changeable during runtime by API function Port_SetPinMode. Including this API is controlled by PortSetPinModeApi. true: Port Pin mode is changeable. false: Port Pin mode is not changeable.
          enumeration PortPinLevelValue: {PORT_PIN_LEVEL_LOW, PORT_PIN_LEVEL_HIGH}, set at post-build, origin=Renesas_v1.0.0, default-value=PORT_PIN_LEVEL_LOW  # Parameter to indicate port pin level value for a port pin. PORT_PIN_LEVEL_LOW: Port pin Level is low. PORT_PIN_LEVEL_HIGH: Port pin Level is high.
          enumeration PortPinInitialMode: {GTM1I6_ALT1_IN, CSIH3CSS7_ALT3_OUT, DIO}, set at post-build, origin=Renesas_v1.0.0, default-value=DIO  # Mode of the port pin for use with Port_Init() function. <Input name>_ALT<Alternative instance>_IN: Provides alternative instance for selected input. <Output name>_ALT<Alternative instance>_OUT: Provides alternative instance for selected output.
          enumeration PortPinDirection: {PORT_PIN_OUT, PORT_PIN_IN}, set at post-build, origin=Renesas_v1.0.0, default-value=PORT_PIN_IN  # The initial direction of the pin (IN or OUT). If the direction is not changeable, the value configured here is fixed. The direction must match the pin mode. PORT_PIN_IN: Port pin direction set as input. PORT_PIN_OUT: Port pin direction set as output.
          boolean PortInputBufferControl: set at post-build, origin=Renesas_v1.0.0, default-value=false  # This parameter is used as one of the factors to enable/disable port pins input buffer in DIO Mode (PMC=0). true: Port pin's input buffer is ready to be enabled in DIO Mode. false: Port pin's input buffer is disabled in DIO Mode.
          boolean PortBiDirectionControl: set at post-build, origin=Renesas_v1.0.0, default-value=false  # This parameter forces port pins input buffer and output buffer at the same time. If activated, the effect is valid independently from any other port settings. true: Activate forced Bi-directional IO buffer of the port pin. false: Deactivate forced Bi-directional IO buffer of the port pin.
          boolean PortPullUpOption: set at post-build, origin=Renesas_v1.0.0, default-value=false  # This register switches on or off the port pins pull-up resistor. true: Port pin's pull-up resistor is enabled. false: Port pin's pull-up resistor is disabled.
          boolean PortPullDownOption: set at post-build, origin=Renesas_v1.0.0, default-value=false  # This parameter switches on or off the port pins pull-down resistor. true: Port pin's pull-down resistor is enabled. false: Port pin's pull-down resistor is disabled.
          enumeration PortOpenDrainControl_Expansion: {PushPull, OpenDrain_N_Channel, OpenDrain_P_Channel}, set at post-build, origin=Renesas_v1.0.2, default-value=PushPull  # This parameter selects port pins output buffer function in combination of PODC and PODCE . | PushPull Specifies the PushPull type output circuit characteristics and updates both PODC and PODCE registers as 0 0 respectively. OpenDrain_N_Channel specifies the N-ch open drain type output circuit characteristics and updates the PODC and PODCE registers as 1 0 respectively. OpenDrain_P_Channel specifies the P-ch open drain type output circuit characteristics and updates the PODC and PODCE registers as 1 1 respectively.
          boolean PortOutputLevelInversion: set at post-build, origin=Renesas_v1.0.0, default-value=false  # This parameter specifies whether the output level from a pin is inverted or not. true: Pin output level is inverted. false: Pin output level is not inverted.
          enumeration PortDriveStrengthControl: {SLOW, FAST}, set at post-build, origin=Renesas_v1.0.0, default-value=SLOW  # This parameter selects the port pins output drive strength as high strength or low strength type. This functionality is also referred to fast (high strength) and slow (low strength) behavior of output buffer. SLOW: Lower drive strength (slow mode) is selected for port pin's output buffer. FAST: Higher drive strength (fast mode) is selected for port pin's output buffer.
          boolean PortUniversalCharacteristicCntrl: set at post-build, origin=Renesas_v1.0.0, default-value=false  # This parameter selects the port pins output drive strength as high or low type. The PortDriveStrengthControl must be enabled for this feature. | false: PortDriveStrengthControl parameter specifies the output driver strength of the port pin. true : Number of output buffer characteristics selection capability is expanded, the maximum of 4 characteristics selection is possible PUCCn PDSCn 0 0 Output characteristic selection 1 (400 Ohm buffer) 0 1 Output characteristic selection 2 (200 Ohm buffer) 1 0 Output characteristic selection 3 (100 Ohm buffer) 1 1 Output characteristic selection 4 (50 Ohm buffer)
          enumeration PortInputSelection: {TYPE1_SHMT1, TYPE2_SHMT4}, set at post-build, origin=Renesas_v1.0.0, default-value=TYPE1_SHMT1  # This setting specifies the input buffer characteristics. TYPE1_SHMT1: TYPE 1 buffer is selected. TYPE2_SHMT4: TYPE 2 buffer is selected.
        container PortPin5  # This container contains the configuration (parameters) for Port Pin 0.
          boolean PortPinDirectionChangeable: set at post-build, origin=Renesas_v1.0.0, default-value=false  # Parameter to indicate if the direction is changeable on a port pin during runtime. true: Port Pin direction changeable enabled. false: Port Pin direction changeable disabled.
          boolean PortPinDioAltModeChangeable: set at post-build, origin=Renesas_v1.0.0, default-value=false  # Parameter to indicate if the mode of a port pin is changeable between DIO and Alternate during runtime by API functions Port_SetToDioMode and Port_SetToAlternateMode. Including these APIs is controlled by PortSetToDioAltModeApi. true: Dio Alternate mode is changeable. false: Dio Alternate mode is not changeable.
          boolean PortPinModeChangeable: set at post-build, origin=Renesas_v1.0.0, default-value=false  # Parameter to indicate if the mode of a port pin is changeable during runtime by API function Port_SetPinMode. Including this API is controlled by PortSetPinModeApi. true: Port Pin mode is changeable. false: Port Pin mode is not changeable.
          enumeration PortPinLevelValue: {PORT_PIN_LEVEL_LOW, PORT_PIN_LEVEL_HIGH}, set at post-build, origin=Renesas_v1.0.0, default-value=PORT_PIN_LEVEL_LOW  # Parameter to indicate port pin level value for a port pin. PORT_PIN_LEVEL_LOW: Port pin Level is low. PORT_PIN_LEVEL_HIGH: Port pin Level is high.
          enumeration PortPinInitialMode: {GTM1I7_ALT1_IN, CSIH3CSS6_ALT3_OUT, DIO}, set at post-build, origin=Renesas_v1.0.0, default-value=DIO  # Mode of the port pin for use with Port_Init() function. <Input name>_ALT<Alternative instance>_IN: Provides alternative instance for selected input. <Output name>_ALT<Alternative instance>_OUT: Provides alternative instance for selected output.
          enumeration PortPinDirection: {PORT_PIN_OUT, PORT_PIN_IN}, set at post-build, origin=Renesas_v1.0.0, default-value=PORT_PIN_IN  # The initial direction of the pin (IN or OUT). If the direction is not changeable, the value configured here is fixed. The direction must match the pin mode. PORT_PIN_IN: Port pin direction set as input. PORT_PIN_OUT: Port pin direction set as output.
          boolean PortInputBufferControl: set at post-build, origin=Renesas_v1.0.0, default-value=false  # This parameter is used as one of the factors to enable/disable port pins input buffer in DIO Mode (PMC=0). true: Port pin's input buffer is ready to be enabled in DIO Mode. false: Port pin's input buffer is disabled in DIO Mode.
          boolean PortBiDirectionControl: set at post-build, origin=Renesas_v1.0.0, default-value=false  # This parameter forces port pins input buffer and output buffer at the same time. If activated, the effect is valid independently from any other port settings. true: Activate forced Bi-directional IO buffer of the port pin. false: Deactivate forced Bi-directional IO buffer of the port pin.
          boolean PortPullUpOption: set at post-build, origin=Renesas_v1.0.0, default-value=false  # This register switches on or off the port pins pull-up resistor. true: Port pin's pull-up resistor is enabled. false: Port pin's pull-up resistor is disabled.
          boolean PortPullDownOption: set at post-build, origin=Renesas_v1.0.0, default-value=false  # This parameter switches on or off the port pins pull-down resistor. true: Port pin's pull-down resistor is enabled. false: Port pin's pull-down resistor is disabled.
          enumeration PortOpenDrainControl_Expansion: {PushPull, OpenDrain_N_Channel, OpenDrain_P_Channel}, set at post-build, origin=Renesas_v1.0.2, default-value=PushPull  # This parameter selects port pins output buffer function in combination of PODC and PODCE . | PushPull Specifies the PushPull type output circuit characteristics and updates both PODC and PODCE registers as 0 0 respectively. OpenDrain_N_Channel specifies the N-ch open drain type output circuit characteristics and updates the PODC and PODCE registers as 1 0 respectively. OpenDrain_P_Channel specifies the P-ch open drain type output circuit characteristics and updates the PODC and PODCE registers as 1 1 respectively.
          boolean PortOutputLevelInversion: set at post-build, origin=Renesas_v1.0.0, default-value=false  # This parameter specifies whether the output level from a pin is inverted or not. true: Pin output level is inverted. false: Pin output level is not inverted.
          enumeration PortDriveStrengthControl: {SLOW, FAST}, set at post-build, origin=Renesas_v1.0.0, default-value=SLOW  # This parameter selects the port pins output drive strength as high strength or low strength type. This functionality is also referred to fast (high strength) and slow (low strength) behavior of output buffer. SLOW: Lower drive strength (slow mode) is selected for port pin's output buffer. FAST: Higher drive strength (fast mode) is selected for port pin's output buffer.
          boolean PortUniversalCharacteristicCntrl: set at post-build, origin=Renesas_v1.0.0, default-value=false  # This parameter selects the port pins output drive strength as high or low type. The PortDriveStrengthControl must be enabled for this feature. | false: PortDriveStrengthControl parameter specifies the output driver strength of the port pin. true : Number of output buffer characteristics selection capability is expanded, the maximum of 4 characteristics selection is possible PUCCn PDSCn 0 0 Output characteristic selection 1 (400 Ohm buffer) 0 1 Output characteristic selection 2 (200 Ohm buffer) 1 0 Output characteristic selection 3 (100 Ohm buffer) 1 1 Output characteristic selection 4 (50 Ohm buffer)
          enumeration PortInputSelection: {TYPE1_SHMT1, TYPE2_SHMT4}, set at post-build, origin=Renesas_v1.0.0, default-value=TYPE1_SHMT1  # This setting specifies the input buffer characteristics. TYPE1_SHMT1: TYPE 1 buffer is selected. TYPE2_SHMT4: TYPE 2 buffer is selected.
      container PortGroup9  # This container contains the configuration (parameters) for Port Group 0.
        container PortPin7  # This container contains the configuration (parameters) for Port Pin 0.
          boolean PortPinDirectionChangeable: set at post-build, origin=Renesas_v1.0.0, default-value=false  # Parameter to indicate if the direction is changeable on a port pin during runtime. true: Port Pin direction changeable enabled. false: Port Pin direction changeable disabled.
          boolean PortPinDioAltModeChangeable: set at post-build, origin=Renesas_v1.0.0, default-value=false  # Parameter to indicate if the mode of a port pin is changeable between DIO and Alternate during runtime by API functions Port_SetToDioMode and Port_SetToAlternateMode. Including these APIs is controlled by PortSetToDioAltModeApi. true: Dio Alternate mode is changeable. false: Dio Alternate mode is not changeable.
          boolean PortPinModeChangeable: set at post-build, origin=Renesas_v1.0.0, default-value=false  # Parameter to indicate if the mode of a port pin is changeable during runtime by API function Port_SetPinMode. Including this API is controlled by PortSetPinModeApi. true: Port Pin mode is changeable. false: Port Pin mode is not changeable.
          enumeration PortPinLevelValue: {PORT_PIN_LEVEL_LOW, PORT_PIN_LEVEL_HIGH}, set at post-build, origin=Renesas_v1.0.0, default-value=PORT_PIN_LEVEL_LOW  # Parameter to indicate port pin level value for a port pin. PORT_PIN_LEVEL_LOW: Port pin Level is low. PORT_PIN_LEVEL_HIGH: Port pin Level is high.
          enumeration PortPinInitialMode: {GTMAT1O0N_ALT1_OUT_SUPP_PFC_PMCSR, DIO_SUPP_PFC_PMCSR}, set at post-build, origin=Renesas_v1.0.0, default-value=DIO_SUPP_PFC_PMCSR  # Mode of the port pin for use with Port_Init() function. <Input name>_ALT<Alternative instance>_IN: Provides alternative instance for selected input. <Output name>_ALT<Alternative instance>_OUT: Provides alternative instance for selected output.
          enumeration PortPinDirection: {PORT_PIN_OUT, PORT_PIN_IN}, set at post-build, origin=Renesas_v1.0.0, default-value=PORT_PIN_IN  # The initial direction of the pin (IN or OUT). If the direction is not changeable, the value configured here is fixed. The direction must match the pin mode. PORT_PIN_IN: Port pin direction set as input. PORT_PIN_OUT: Port pin direction set as output.
          boolean PortInputBufferControl: set at post-build, origin=Renesas_v1.0.0, default-value=false  # This parameter is used as one of the factors to enable/disable port pins input buffer in DIO Mode (PMC=0). true: Port pin's input buffer is ready to be enabled in DIO Mode. false: Port pin's input buffer is disabled in DIO Mode.
          boolean PortBiDirectionControl: set at post-build, origin=Renesas_v1.0.0, default-value=false  # This parameter forces port pins input buffer and output buffer at the same time. If activated, the effect is valid independently from any other port settings. true: Activate forced Bi-directional IO buffer of the port pin. false: Deactivate forced Bi-directional IO buffer of the port pin.
          boolean PortIpControl: set at post-build, origin=Renesas_v1.0.0, default-value=false  # This parameter is used to enable/disable the direct IO control of port pins input buffer and output buffer. true: Enables the direct IO control of port pins input buffer and output buffer by the corresponding control signals of IP_ENI3(0) and IP_ENO3(0) from internal peripheral IPs. This register is valid only in Control Mode (PMC=1). false: Disables the direct IO control of port pins input buffer and output buffer.
          boolean PortPullUpOption: set at post-build, origin=Renesas_v1.0.0, default-value=false  # This register switches on or off the port pins pull-up resistor. true: Port pin's pull-up resistor is enabled. false: Port pin's pull-up resistor is disabled.
          boolean PortPullDownOption: set at post-build, origin=Renesas_v1.0.0, default-value=false  # This parameter switches on or off the port pins pull-down resistor. true: Port pin's pull-down resistor is enabled. false: Port pin's pull-down resistor is disabled.
          enumeration PortOpenDrainControl_Expansion: {PushPull, OpenDrain_N_Channel, OpenDrain_P_Channel}, set at post-build, origin=Renesas_v1.0.2, default-value=PushPull  # This parameter selects port pins output buffer function in combination of PODC and PODCE . | PushPull Specifies the PushPull type output circuit characteristics and updates both PODC and PODCE registers as 0 0 respectively. OpenDrain_N_Channel specifies the N-ch open drain type output circuit characteristics and updates the PODC and PODCE registers as 1 0 respectively. OpenDrain_P_Channel specifies the P-ch open drain type output circuit characteristics and updates the PODC and PODCE registers as 1 1 respectively.
          boolean PortOutputLevelInversion: set at post-build, origin=Renesas_v1.0.0, default-value=false  # This parameter specifies whether the output level from a pin is inverted or not. true: Pin output level is inverted. false: Pin output level is not inverted.
          enumeration PortDriveStrengthControl: {SLOW, FAST}, set at post-build, origin=Renesas_v1.0.0, default-value=SLOW  # This parameter selects the port pins output drive strength as high strength or low strength type. This functionality is also referred to fast (high strength) and slow (low strength) behavior of output buffer. SLOW: Lower drive strength (slow mode) is selected for port pin's output buffer. FAST: Higher drive strength (fast mode) is selected for port pin's output buffer.
          boolean PortUniversalCharacteristicCntrl: set at post-build, origin=Renesas_v1.0.0, default-value=false  # This parameter selects the port pins output drive strength as high or low type. The PortDriveStrengthControl must be enabled for this feature. | false: PortDriveStrengthControl parameter specifies the output driver strength of the port pin. true : Number of output buffer characteristics selection capability is expanded, the maximum of 4 characteristics selection is possible PUCCn PDSCn 0 0 Output characteristic selection 1 (400 Ohm buffer) 0 1 Output characteristic selection 2 (200 Ohm buffer) 1 0 Output characteristic selection 3 (100 Ohm buffer) 1 1 Output characteristic selection 4 (50 Ohm buffer)
          enumeration PortInputSelection: {TYPE1_SHMT1, TYPE2_SHMT4}, set at post-build, origin=Renesas_v1.0.0, default-value=TYPE1_SHMT1  # This setting specifies the input buffer characteristics. TYPE1_SHMT1: TYPE 1 buffer is selected. TYPE2_SHMT4: TYPE 2 buffer is selected.
        container PortPin8  # This container contains the configuration (parameters) for Port Pin 0.
          boolean PortPinDirectionChangeable: set at post-build, origin=Renesas_v1.0.0, default-value=false  # Parameter to indicate if the direction is changeable on a port pin during runtime. true: Port Pin direction changeable enabled. false: Port Pin direction changeable disabled.
          boolean PortPinDioAltModeChangeable: set at post-build, origin=Renesas_v1.0.0, default-value=false  # Parameter to indicate if the mode of a port pin is changeable between DIO and Alternate during runtime by API functions Port_SetToDioMode and Port_SetToAlternateMode. Including these APIs is controlled by PortSetToDioAltModeApi. true: Dio Alternate mode is changeable. false: Dio Alternate mode is not changeable.
          boolean PortPinModeChangeable: set at post-build, origin=Renesas_v1.0.0, default-value=false  # Parameter to indicate if the mode of a port pin is changeable during runtime by API function Port_SetPinMode. Including this API is controlled by PortSetPinModeApi. true: Port Pin mode is changeable. false: Port Pin mode is not changeable.
          enumeration PortPinLevelValue: {PORT_PIN_LEVEL_LOW, PORT_PIN_LEVEL_HIGH}, set at post-build, origin=Renesas_v1.0.0, default-value=PORT_PIN_LEVEL_LOW  # Parameter to indicate port pin level value for a port pin. PORT_PIN_LEVEL_LOW: Port pin Level is low. PORT_PIN_LEVEL_HIGH: Port pin Level is high.
          enumeration PortPinInitialMode: {GTMAT1O0_ALT1_OUT_SUPP_PFC_PMCSR, DIO_SUPP_PFC_PMCSR}, set at post-build, origin=Renesas_v1.0.0, default-value=DIO_SUPP_PFC_PMCSR  # Mode of the port pin for use with Port_Init() function. <Input name>_ALT<Alternative instance>_IN: Provides alternative instance for selected input. <Output name>_ALT<Alternative instance>_OUT: Provides alternative instance for selected output.
          enumeration PortPinDirection: {PORT_PIN_OUT, PORT_PIN_IN}, set at post-build, origin=Renesas_v1.0.0, default-value=PORT_PIN_IN  # The initial direction of the pin (IN or OUT). If the direction is not changeable, the value configured here is fixed. The direction must match the pin mode. PORT_PIN_IN: Port pin direction set as input. PORT_PIN_OUT: Port pin direction set as output.
          boolean PortInputBufferControl: set at post-build, origin=Renesas_v1.0.0, default-value=false  # This parameter is used as one of the factors to enable/disable port pins input buffer in DIO Mode (PMC=0). true: Port pin's input buffer is ready to be enabled in DIO Mode. false: Port pin's input buffer is disabled in DIO Mode.
          boolean PortBiDirectionControl: set at post-build, origin=Renesas_v1.0.0, default-value=false  # This parameter forces port pins input buffer and output buffer at the same time. If activated, the effect is valid independently from any other port settings. true: Activate forced Bi-directional IO buffer of the port pin. false: Deactivate forced Bi-directional IO buffer of the port pin.
          boolean PortIpControl: set at post-build, origin=Renesas_v1.0.0, default-value=false  # This parameter is used to enable/disable the direct IO control of port pins input buffer and output buffer. true: Enables the direct IO control of port pins input buffer and output buffer by the corresponding control signals of IP_ENI3(0) and IP_ENO3(0) from internal peripheral IPs. This register is valid only in Control Mode (PMC=1). false: Disables the direct IO control of port pins input buffer and output buffer.
          boolean PortPullUpOption: set at post-build, origin=Renesas_v1.0.0, default-value=false  # This register switches on or off the port pins pull-up resistor. true: Port pin's pull-up resistor is enabled. false: Port pin's pull-up resistor is disabled.
          boolean PortPullDownOption: set at post-build, origin=Renesas_v1.0.0, default-value=false  # This parameter switches on or off the port pins pull-down resistor. true: Port pin's pull-down resistor is enabled. false: Port pin's pull-down resistor is disabled.
          enumeration PortOpenDrainControl_Expansion: {PushPull, OpenDrain_N_Channel, OpenDrain_P_Channel}, set at post-build, origin=Renesas_v1.0.2, default-value=PushPull  # This parameter selects port pins output buffer function in combination of PODC and PODCE . | PushPull Specifies the PushPull type output circuit characteristics and updates both PODC and PODCE registers as 0 0 respectively. OpenDrain_N_Channel specifies the N-ch open drain type output circuit characteristics and updates the PODC and PODCE registers as 1 0 respectively. OpenDrain_P_Channel specifies the P-ch open drain type output circuit characteristics and updates the PODC and PODCE registers as 1 1 respectively.
          boolean PortOutputLevelInversion: set at post-build, origin=Renesas_v1.0.0, default-value=false  # This parameter specifies whether the output level from a pin is inverted or not. true: Pin output level is inverted. false: Pin output level is not inverted.
          enumeration PortDriveStrengthControl: {SLOW, FAST}, set at post-build, origin=Renesas_v1.0.0, default-value=SLOW  # This parameter selects the port pins output drive strength as high strength or low strength type. This functionality is also referred to fast (high strength) and slow (low strength) behavior of output buffer. SLOW: Lower drive strength (slow mode) is selected for port pin's output buffer. FAST: Higher drive strength (fast mode) is selected for port pin's output buffer.
          boolean PortUniversalCharacteristicCntrl: set at post-build, origin=Renesas_v1.0.0, default-value=false  # This parameter selects the port pins output drive strength as high or low type. The PortDriveStrengthControl must be enabled for this feature. | false: PortDriveStrengthControl parameter specifies the output driver strength of the port pin. true : Number of output buffer characteristics selection capability is expanded, the maximum of 4 characteristics selection is possible PUCCn PDSCn 0 0 Output characteristic selection 1 (400 Ohm buffer) 0 1 Output characteristic selection 2 (200 Ohm buffer) 1 0 Output characteristic selection 3 (100 Ohm buffer) 1 1 Output characteristic selection 4 (50 Ohm buffer)
          enumeration PortInputSelection: {TYPE1_SHMT1, TYPE2_SHMT4}, set at post-build, origin=Renesas_v1.0.0, default-value=TYPE1_SHMT1  # This setting specifies the input buffer characteristics. TYPE1_SHMT1: TYPE 1 buffer is selected. TYPE2_SHMT4: TYPE 2 buffer is selected.
      container PortGroupJtag0  # This container contains the configuration (parameters) for Jtag Port Group 0.
        container PortPin0  # This container contains the configuration (parameters) for Port Pin 0.
          boolean PortPinDirectionChangeable: set at post-build, origin=Renesas_v1.0.0, default-value=false  # Parameter to indicate if the direction is changeable on a port pin during runtime. true: Port Pin direction changeable enabled. false: Port Pin direction changeable disabled.
          boolean PortPinDioAltModeChangeable: set at post-build, origin=Renesas_v1.0.0, default-value=false  # Parameter to indicate if the mode of a port pin is changeable between DIO_SUPP_PFCE_PMCSR and Alternate during runtime by API functions Port_SetToDioMode and Port_SetToAlternateMode. Including these APIs is controlled by PortSetToDioAltModeApi. true: Dio Alternate mode is changeable. false: Dio Alternate mode is not changeable.
          boolean PortPinModeChangeable: set at post-build, origin=Renesas_v1.0.0, default-value=false  # Parameter to indicate if the mode of a port pin is changeable during runtime by API function Port_SetPinMode. Including this API is controlled by PortSetPinModeApi. true: Port Pin mode is changeable. false: Port Pin mode is not changeable.
          enumeration PortPinLevelValue: {PORT_PIN_LEVEL_LOW, PORT_PIN_LEVEL_HIGH}, set at post-build, origin=Renesas_v1.0.0, default-value=PORT_PIN_LEVEL_LOW  # Parameter to indicate port pin level value for a port pin. PORT_PIN_LEVEL_LOW: Port pin Level is low. PORT_PIN_LEVEL_HIGH: Port pin Level is high.
          enumeration PortPinInitialMode: {FLSCI3RXD_ALT3_IN_SUPP_JPFCE_JPMCSR, FLSCI3TXD_ALT3_OUT_SUPP_JPFCE_JPMCSR, DIO_SUPP_JPFCE_JPMCSR}, set at post-build, origin=Renesas_v1.0.0, default-value=DIO_SUPP_JPFCE_JPMCSR  # Mode of the port pin for use with Port_Init() function. <Input name>_ALT<Alternative instance>_IN: Provides alternative instance for selected input. <Output name>_ALT<Alternative instance>_OUT: Provides alternative instance for selected output.
          enumeration PortPinDirection: {PORT_PIN_OUT, PORT_PIN_IN}, set at post-build, origin=Renesas_v1.0.0, default-value=PORT_PIN_IN  # The initial direction of the pin (IN or OUT). If the direction is not changeable, the value configured here is fixed. The direction must match the pin mode. PORT_PIN_IN: Port pin direction set as input. PORT_PIN_OUT: Port pin direction set as output.
          boolean PortInputBufferControl: set at post-build, origin=Renesas_v1.0.0, default-value=false  # This parameter is used as one of the factors to enable/disable port pins input buffer in DIO_SUPP_PFCE_PMCSR Mode (PMC=0). true: Port pin's input buffer is ready to be enabled in DIO_SUPP_PFCE_PMCSR Mode. false: Port pin's input buffer is disabled in DIO_SUPP_PFCE_PMCSR Mode.
          boolean PortBiDirectionControl: set at post-build, origin=Renesas_v1.0.0, default-value=false  # This parameter forces port pins input buffer and output buffer at the same time. If activated, the effect is valid independently from any other port settings. true: Activate forced Bi-directional IO buffer of the port pin. false: Deactivate forced Bi-directional IO buffer of the port pin.
          boolean PortPullUpOption: set at post-build, origin=Renesas_v1.0.0, default-value=false  # This register switches on or off the port pins pull-up resistor. true: Port pin's pull-up resistor is enabled. false: Port pin's pull-up resistor is disabled.
          boolean PortPullDownOption: set at post-build, origin=Renesas_v1.0.0, default-value=false  # This parameter switches on or off the port pins pull-down resistor. true: Port pin's pull-down resistor is enabled. false: Port pin's pull-down resistor is disabled.
          enumeration PortOpenDrainControl_Expansion: {PushPull, OpenDrain_N_Channel, OpenDrain_P_Channel}, set at post-build, origin=Renesas_v1.0.2, default-value=PushPull  # This parameter selects port pins output buffer function in combination of PODC and PODCE . | PushPull Specifies the PushPull type output circuit characteristics and updates both PODC and PODCE registers as 0 0 respectively. OpenDrain_N_Channel specifies the N-ch open drain type output circuit characteristics and updates the PODC and PODCE registers as 1 0 respectively. OpenDrain_P_Channel specifies the P-ch open drain type output circuit characteristics and updates the PODC and PODCE registers as 1 1 respectively.
          boolean PortOutputLevelInversion: set at post-build, origin=Renesas_v1.0.0, default-value=false  # This parameter specifies whether the output level from a pin is inverted or not. true: Pin output level is inverted. false: Pin output level is not inverted.
          enumeration PortDriveStrengthControl: {SLOW, FAST}, set at post-build, origin=Renesas_v1.0.0, default-value=SLOW  # This parameter selects the port pins output drive strength as high strength or low strength type. This functionality is also referred to fast (high strength) and slow (low strength) behavior of output buffer. SLOW: Lower drive strength (slow mode) is selected for port pin's output buffer. FAST: Higher drive strength (fast mode) is selected for port pin's output buffer.
          boolean PortUniversalCharacteristicCntrl: set at post-build, origin=Renesas_v1.0.0, default-value=false  # This parameter selects the port pins output drive strength as high or low type. The PortDriveStrengthControl must be enabled for this feature. | false: PortDriveStrengthControl parameter specifies the output driver strength of the port pin. true : Number of output buffer characteristics selection capability is expanded, the maximum of 4 characteristics selection is possible PUCCn PDSCn 0 0 Output characteristic selection 1 (400 Ohm buffer) 0 1 Output characteristic selection 2 (200 Ohm buffer) 1 0 Output characteristic selection 3 (100 Ohm buffer) 1 1 Output characteristic selection 4 (50 Ohm buffer)
          enumeration PortInputSelection: {TYPE1_SHMT1, TYPE2_SHMT4}, set at post-build, origin=Renesas_v1.0.0, default-value=TYPE1_SHMT1  # This setting specifies the input buffer characteristics. TYPE1_SHMT1: TYPE 1 buffer is selected. TYPE2_SHMT4: TYPE 2 buffer is selected.
        container PortPin1  # This container contains the configuration (parameters) for Port Pin 1.
          boolean PortPinDirectionChangeable: set at post-build, origin=Renesas_v1.0.0, default-value=false  # Parameter to indicate if the direction is changeable on a port pin during runtime. true: Port Pin direction changeable enabled. false: Port Pin direction changeable disabled.
          boolean PortPinDioAltModeChangeable: set at post-build, origin=Renesas_v1.0.0, default-value=false  # Parameter to indicate if the mode of a port pin is changeable between DIO_SUPP_PFCE_PMCSR and Alternate during runtime by API functions Port_SetToDioMode and Port_SetToAlternateMode. Including these APIs is controlled by PortSetToDioAltModeApi. true: Dio Alternate mode is changeable. false: Dio Alternate mode is not changeable.
          boolean PortPinModeChangeable: set at post-build, origin=Renesas_v1.0.0, default-value=false  # Parameter to indicate if the mode of a port pin is changeable during runtime by API function Port_SetPinMode. Including this API is controlled by PortSetPinModeApi. true: Port Pin mode is changeable. false: Port Pin mode is not changeable.
          enumeration PortPinLevelValue: {PORT_PIN_LEVEL_LOW, PORT_PIN_LEVEL_HIGH}, set at post-build, origin=Renesas_v1.0.0, default-value=PORT_PIN_LEVEL_LOW  # Parameter to indicate port pin level value for a port pin. PORT_PIN_LEVEL_LOW: Port pin Level is low. PORT_PIN_LEVEL_HIGH: Port pin Level is high.
          enumeration PortPinInitialMode: {FLSCI3TXD_ALT3_OUT_SUPP_JPFCE_JPMCSR, DIO_SUPP_JPFCE_JPMCSR}, set at post-build, origin=Renesas_v1.0.0, default-value=DIO_SUPP_JPFCE_JPMCSR  # Mode of the port pin for use with Port_Init() function. <Input name>_ALT<Alternative instance>_IN: Provides alternative instance for selected input. <Output name>_ALT<Alternative instance>_OUT: Provides alternative instance for selected output.
          enumeration PortPinDirection: {PORT_PIN_OUT, PORT_PIN_IN}, set at post-build, origin=Renesas_v1.0.0, default-value=PORT_PIN_IN  # The initial direction of the pin (IN or OUT). If the direction is not changeable, the value configured here is fixed. The direction must match the pin mode. PORT_PIN_IN: Port pin direction set as input. PORT_PIN_OUT: Port pin direction set as output.
          boolean PortInputBufferControl: set at post-build, origin=Renesas_v1.0.0, default-value=false  # This parameter is used as one of the factors to enable/disable port pins input buffer in DIO_SUPP_PFCE_PMCSR Mode (PMC=0). true: Port pin's input buffer is ready to be enabled in DIO_SUPP_PFCE_PMCSR Mode. false: Port pin's input buffer is disabled in DIO_SUPP_PFCE_PMCSR Mode.
          boolean PortBiDirectionControl: set at post-build, origin=Renesas_v1.0.0, default-value=false  # This parameter forces port pins input buffer and output buffer at the same time. If activated, the effect is valid independently from any other port settings. true: Activate forced Bi-directional IO buffer of the port pin. false: Deactivate forced Bi-directional IO buffer of the port pin.
          boolean PortPullUpOption: set at post-build, origin=Renesas_v1.0.0, default-value=false  # This register switches on or off the port pins pull-up resistor. true: Port pin's pull-up resistor is enabled. false: Port pin's pull-up resistor is disabled.
          boolean PortPullDownOption: set at post-build, origin=Renesas_v1.0.0, default-value=false  # This parameter switches on or off the port pins pull-down resistor. true: Port pin's pull-down resistor is enabled. false: Port pin's pull-down resistor is disabled.
          enumeration PortOpenDrainControl_Expansion: {PushPull, OpenDrain_N_Channel, OpenDrain_P_Channel}, set at post-build, origin=Renesas_v1.0.2, default-value=PushPull  # This parameter selects port pins output buffer function in combination of PODC and PODCE . | PushPull Specifies the PushPull type output circuit characteristics and updates both PODC and PODCE registers as 0 0 respectively. OpenDrain_N_Channel specifies the N-ch open drain type output circuit characteristics and updates the PODC and PODCE registers as 1 0 respectively. OpenDrain_P_Channel specifies the P-ch open drain type output circuit characteristics and updates the PODC and PODCE registers as 1 1 respectively.
          boolean PortOutputLevelInversion: set at post-build, origin=Renesas_v1.0.0, default-value=false  # This parameter specifies whether the output level from a pin is inverted or not. true: Pin output level is inverted. false: Pin output level is not inverted.
          enumeration PortDriveStrengthControl: {SLOW, FAST}, set at post-build, origin=Renesas_v1.0.0, default-value=SLOW  # This parameter selects the port pins output drive strength as high strength or low strength type. This functionality is also referred to fast (high strength) and slow (low strength) behavior of output buffer. SLOW: Lower drive strength (slow mode) is selected for port pin's output buffer. FAST: Higher drive strength (fast mode) is selected for port pin's output buffer.
          boolean PortUniversalCharacteristicCntrl: set at post-build, origin=Renesas_v1.0.0, default-value=false  # This parameter selects the port pins output drive strength as high or low type. The PortDriveStrengthControl must be enabled for this feature. | false: PortDriveStrengthControl parameter specifies the output driver strength of the port pin. true : Number of output buffer characteristics selection capability is expanded, the maximum of 4 characteristics selection is possible PUCCn PDSCn 0 0 Output characteristic selection 1 (400 Ohm buffer) 0 1 Output characteristic selection 2 (200 Ohm buffer) 1 0 Output characteristic selection 3 (100 Ohm buffer) 1 1 Output characteristic selection 4 (50 Ohm buffer)
          enumeration PortInputSelection: {TYPE1_SHMT1, TYPE2_SHMT4}, set at post-build, origin=Renesas_v1.0.0, default-value=TYPE1_SHMT1  # This setting specifies the input buffer characteristics. TYPE1_SHMT1: TYPE 1 buffer is selected. TYPE2_SHMT4: TYPE 2 buffer is selected.
        container PortPin2  # This container contains the configuration (parameters) for Port Pin 2.
          boolean PortPinDirectionChangeable: set at post-build, origin=Renesas_v1.0.0, default-value=false  # Parameter to indicate if the direction is changeable on a port pin during runtime. true: Port Pin direction changeable enabled. false: Port Pin direction changeable disabled.
          boolean PortPinDioAltModeChangeable: set at post-build, origin=Renesas_v1.0.0, default-value=false  # Parameter to indicate if the mode of a port pin is changeable between DIO_SUPP_PFCE_PMCSR and Alternate during runtime by API functions Port_SetToDioMode and Port_SetToAlternateMode. Including these APIs is controlled by PortSetToDioAltModeApi. true: Dio Alternate mode is changeable. false: Dio Alternate mode is not changeable.
          boolean PortPinModeChangeable: set at post-build, origin=Renesas_v1.0.0, default-value=false  # Parameter to indicate if the mode of a port pin is changeable during runtime by API function Port_SetPinMode. Including this API is controlled by PortSetPinModeApi. true: Port Pin mode is changeable. false: Port Pin mode is not changeable.
          enumeration PortPinLevelValue: {PORT_PIN_LEVEL_LOW, PORT_PIN_LEVEL_HIGH}, set at post-build, origin=Renesas_v1.0.0, default-value=PORT_PIN_LEVEL_LOW  # Parameter to indicate port pin level value for a port pin. PORT_PIN_LEVEL_LOW: Port pin Level is low. PORT_PIN_LEVEL_HIGH: Port pin Level is high.
          enumeration PortPinInitialMode: {FLSCI3SCKI_ALT3_IN_SUPP_JPFCE_JPMCSR, DIO_SUPP_JPFCE_JPMCSR}, set at post-build, origin=Renesas_v1.0.0, default-value=DIO_SUPP_JPFCE_JPMCSR  # Mode of the port pin for use with Port_Init() function. <Input name>_ALT<Alternative instance>_IN: Provides alternative instance for selected input. <Output name>_ALT<Alternative instance>_OUT: Provides alternative instance for selected output.
          enumeration PortPinDirection: {PORT_PIN_OUT, PORT_PIN_IN}, set at post-build, origin=Renesas_v1.0.0, default-value=PORT_PIN_IN  # The initial direction of the pin (IN or OUT). If the direction is not changeable, the value configured here is fixed. The direction must match the pin mode. PORT_PIN_IN: Port pin direction set as input. PORT_PIN_OUT: Port pin direction set as output.
          boolean PortInputBufferControl: set at post-build, origin=Renesas_v1.0.0, default-value=false  # This parameter is used as one of the factors to enable/disable port pins input buffer in DIO_SUPP_PFCE_PMCSR Mode (PMC=0). true: Port pin's input buffer is ready to be enabled in DIO_SUPP_PFCE_PMCSR Mode. false: Port pin's input buffer is disabled in DIO_SUPP_PFCE_PMCSR Mode.
          boolean PortBiDirectionControl: set at post-build, origin=Renesas_v1.0.0, default-value=false  # This parameter forces port pins input buffer and output buffer at the same time. If activated, the effect is valid independently from any other port settings. true: Activate forced Bi-directional IO buffer of the port pin. false: Deactivate forced Bi-directional IO buffer of the port pin.
          boolean PortPullUpOption: set at post-build, origin=Renesas_v1.0.0, default-value=false  # This register switches on or off the port pins pull-up resistor. true: Port pin's pull-up resistor is enabled. false: Port pin's pull-up resistor is disabled.
          boolean PortPullDownOption: set at post-build, origin=Renesas_v1.0.0, default-value=false  # This parameter switches on or off the port pins pull-down resistor. true: Port pin's pull-down resistor is enabled. false: Port pin's pull-down resistor is disabled.
          enumeration PortOpenDrainControl_Expansion: {PushPull, OpenDrain_N_Channel, OpenDrain_P_Channel}, set at post-build, origin=Renesas_v1.0.2, default-value=PushPull  # This parameter selects port pins output buffer function in combination of PODC and PODCE . | PushPull Specifies the PushPull type output circuit characteristics and updates both PODC and PODCE registers as 0 0 respectively. OpenDrain_N_Channel specifies the N-ch open drain type output circuit characteristics and updates the PODC and PODCE registers as 1 0 respectively. OpenDrain_P_Channel specifies the P-ch open drain type output circuit characteristics and updates the PODC and PODCE registers as 1 1 respectively.
          boolean PortOutputLevelInversion: set at post-build, origin=Renesas_v1.0.0, default-value=false  # This parameter specifies whether the output level from a pin is inverted or not. true: Pin output level is inverted. false: Pin output level is not inverted.
          enumeration PortDriveStrengthControl: {SLOW, FAST}, set at post-build, origin=Renesas_v1.0.0, default-value=SLOW  # This parameter selects the port pins output drive strength as high strength or low strength type. This functionality is also referred to fast (high strength) and slow (low strength) behavior of output buffer. SLOW: Lower drive strength (slow mode) is selected for port pin's output buffer. FAST: Higher drive strength (fast mode) is selected for port pin's output buffer.
          boolean PortUniversalCharacteristicCntrl: set at post-build, origin=Renesas_v1.0.0, default-value=false  # This parameter selects the port pins output drive strength as high or low type. The PortDriveStrengthControl must be enabled for this feature. | false: PortDriveStrengthControl parameter specifies the output driver strength of the port pin. true : Number of output buffer characteristics selection capability is expanded, the maximum of 4 characteristics selection is possible PUCCn PDSCn 0 0 Output characteristic selection 1 (400 Ohm buffer) 0 1 Output characteristic selection 2 (200 Ohm buffer) 1 0 Output characteristic selection 3 (100 Ohm buffer) 1 1 Output characteristic selection 4 (50 Ohm buffer)
          enumeration PortInputSelection: {TYPE1_SHMT1, TYPE2_SHMT4}, set at post-build, origin=Renesas_v1.0.0, default-value=TYPE1_SHMT1  # This setting specifies the input buffer characteristics. TYPE1_SHMT1: TYPE 1 buffer is selected. TYPE2_SHMT4: TYPE 2 buffer is selected.
        container PortPin3  # This container contains the configuration (parameters) for Port Pin 3.
          boolean PortPinDirectionChangeable: set at post-build, origin=Renesas_v1.0.0, default-value=false  # Parameter to indicate if the direction is changeable on a port pin during runtime. true: Port Pin direction changeable enabled. false: Port Pin direction changeable disabled.
          boolean PortPinDioAltModeChangeable: set at post-build, origin=Renesas_v1.0.0, default-value=false  # Parameter to indicate if the mode of a port pin is changeable between DIO_SUPP_PFCE_PMCSR and Alternate during runtime by API functions Port_SetToDioMode and Port_SetToAlternateMode. Including these APIs is controlled by PortSetToDioAltModeApi. true: Dio Alternate mode is changeable. false: Dio Alternate mode is not changeable.
          boolean PortPinModeChangeable: set at post-build, origin=Renesas_v1.0.0, default-value=false  # Parameter to indicate if the mode of a port pin is changeable during runtime by API function Port_SetPinMode. Including this API is controlled by PortSetPinModeApi. true: Port Pin mode is changeable. false: Port Pin mode is not changeable.
          enumeration PortPinLevelValue: {PORT_PIN_LEVEL_LOW, PORT_PIN_LEVEL_HIGH}, set at post-build, origin=Renesas_v1.0.0, default-value=PORT_PIN_LEVEL_LOW  # Parameter to indicate port pin level value for a port pin. PORT_PIN_LEVEL_LOW: Port pin Level is low. PORT_PIN_LEVEL_HIGH: Port pin Level is high.
          enumeration PortPinInitialMode: {ALT_NOT_SUPPORTED}, set at post-build, origin=Renesas_v1.0.0, default-value=ALT_NOT_SUPPORTED  # Mode of the port pin for use with Port_Init() function. <Input name>_ALT<Alternative instance>_IN: Provides alternative instance for selected input. <Output name>_ALT<Alternative instance>_OUT: Provides alternative instance for selected output.
          enumeration PortPinDirection: {PORT_PIN_OUT, PORT_PIN_IN}, set at post-build, origin=Renesas_v1.0.0, default-value=PORT_PIN_IN  # The initial direction of the pin (IN or OUT). If the direction is not changeable, the value configured here is fixed. The direction must match the pin mode. PORT_PIN_IN: Port pin direction set as input. PORT_PIN_OUT: Port pin direction set as output.
          boolean PortInputBufferControl: set at post-build, origin=Renesas_v1.0.0, default-value=false  # This parameter is used as one of the factors to enable/disable port pins input buffer in DIO_SUPP_PFCE_PMCSR Mode (PMC=0). true: Port pin's input buffer is ready to be enabled in DIO_SUPP_PFCE_PMCSR Mode. false: Port pin's input buffer is disabled in DIO_SUPP_PFCE_PMCSR Mode.
          boolean PortBiDirectionControl: set at post-build, origin=Renesas_v1.0.0, default-value=false  # This parameter forces port pins input buffer and output buffer at the same time. If activated, the effect is valid independently from any other port settings. true: Activate forced Bi-directional IO buffer of the port pin. false: Deactivate forced Bi-directional IO buffer of the port pin.
          boolean PortPullUpOption: set at post-build, origin=Renesas_v1.0.0, default-value=false  # This register switches on or off the port pins pull-up resistor. true: Port pin's pull-up resistor is enabled. false: Port pin's pull-up resistor is disabled.
          boolean PortPullDownOption: set at post-build, origin=Renesas_v1.0.0, default-value=false  # This parameter switches on or off the port pins pull-down resistor. true: Port pin's pull-down resistor is enabled. false: Port pin's pull-down resistor is disabled.
          enumeration PortOpenDrainControl_Expansion: {PushPull, OpenDrain_N_Channel, OpenDrain_P_Channel}, set at post-build, origin=Renesas_v1.0.2, default-value=PushPull  # This parameter selects port pins output buffer function in combination of PODC and PODCE . | PushPull Specifies the PushPull type output circuit characteristics and updates both PODC and PODCE registers as 0 0 respectively. OpenDrain_N_Channel specifies the N-ch open drain type output circuit characteristics and updates the PODC and PODCE registers as 1 0 respectively. OpenDrain_P_Channel specifies the P-ch open drain type output circuit characteristics and updates the PODC and PODCE registers as 1 1 respectively.
          boolean PortOutputLevelInversion: set at post-build, origin=Renesas_v1.0.0, default-value=false  # This parameter specifies whether the output level from a pin is inverted or not. true: Pin output level is inverted. false: Pin output level is not inverted.
          enumeration PortDriveStrengthControl: {SLOW, FAST}, set at post-build, origin=Renesas_v1.0.0, default-value=SLOW  # This parameter selects the port pins output drive strength as high strength or low strength type. This functionality is also referred to fast (high strength) and slow (low strength) behavior of output buffer. SLOW: Lower drive strength (slow mode) is selected for port pin's output buffer. FAST: Higher drive strength (fast mode) is selected for port pin's output buffer.
          boolean PortUniversalCharacteristicCntrl: set at post-build, origin=Renesas_v1.0.0, default-value=false  # This parameter selects the port pins output drive strength as high or low type. The PortDriveStrengthControl must be enabled for this feature. | false: PortDriveStrengthControl parameter specifies the output driver strength of the port pin. true : Number of output buffer characteristics selection capability is expanded, the maximum of 4 characteristics selection is possible PUCCn PDSCn 0 0 Output characteristic selection 1 (400 Ohm buffer) 0 1 Output characteristic selection 2 (200 Ohm buffer) 1 0 Output characteristic selection 3 (100 Ohm buffer) 1 1 Output characteristic selection 4 (50 Ohm buffer)
          enumeration PortInputSelection: {TYPE1_SHMT1, TYPE2_SHMT4}, set at post-build, origin=Renesas_v1.0.0, default-value=TYPE1_SHMT1  # This setting specifies the input buffer characteristics. TYPE1_SHMT1: TYPE 1 buffer is selected. TYPE2_SHMT4: TYPE 2 buffer is selected.
        container PortPin4  # This container contains the configuration (parameters) for Port Pin 4.
          enumeration PortPinInitialMode: {ALT_NOT_SUPPORTED}, set at post-build, origin=Renesas_v1.0.0, default-value=ALT_NOT_SUPPORTED  # Mode of the port pin for use with Port_Init() function. <Input name>_ALT<Alternative instance>_IN: Provides alternative instance for selected input. <Output name>_ALT<Alternative instance>_OUT: Provides alternative instance for selected output.
          boolean PortInputBufferControl: set at post-build, origin=Renesas_v1.0.0, default-value=false  # This parameter is used as one of the factors to enable/disable port pins input buffer in DIO_SUPP_PFCE_PMCSR Mode (PMC=0). true: Port pin's input buffer is ready to be enabled in DIO_SUPP_PFCE_PMCSR Mode. false: Port pin's input buffer is disabled in DIO_SUPP_PFCE_PMCSR Mode.
        container PortPin5  # This container contains the configuration (parameters) for Port Pin 5.
          boolean PortPinDirectionChangeable: set at post-build, origin=Renesas_v1.0.0, default-value=false  # Parameter to indicate if the direction is changeable on a port pin during runtime. true: Port Pin direction changeable enabled. false: Port Pin direction changeable disabled.
          boolean PortPinDioAltModeChangeable: set at post-build, origin=Renesas_v1.0.0, default-value=false  # Parameter to indicate if the mode of a port pin is changeable between DIO_SUPP_PFCE_PMCSR and Alternate during runtime by API functions Port_SetToDioMode and Port_SetToAlternateMode. Including these APIs is controlled by PortSetToDioAltModeApi. true: Dio Alternate mode is changeable. false: Dio Alternate mode is not changeable.
          boolean PortPinModeChangeable: set at post-build, origin=Renesas_v1.0.0, default-value=false  # Parameter to indicate if the mode of a port pin is changeable during runtime by API function Port_SetPinMode. Including this API is controlled by PortSetPinModeApi. true: Port Pin mode is changeable. false: Port Pin mode is not changeable.
          enumeration PortPinLevelValue: {PORT_PIN_LEVEL_LOW, PORT_PIN_LEVEL_HIGH}, set at post-build, origin=Renesas_v1.0.0, default-value=PORT_PIN_LEVEL_LOW  # Parameter to indicate port pin level value for a port pin. PORT_PIN_LEVEL_LOW: Port pin Level is low. PORT_PIN_LEVEL_HIGH: Port pin Level is high.
          enumeration PortPinInitialMode: {ALT_NOT_SUPPORTED}, set at post-build, origin=Renesas_v1.0.0, default-value=ALT_NOT_SUPPORTED  # Mode of the port pin for use with Port_Init() function. <Input name>_ALT<Alternative instance>_IN: Provides alternative instance for selected input. <Output name>_ALT<Alternative instance>_OUT: Provides alternative instance for selected output.
          enumeration PortPinDirection: {PORT_PIN_OUT, PORT_PIN_IN}, set at post-build, origin=Renesas_v1.0.0, default-value=PORT_PIN_IN  # The initial direction of the pin (IN or OUT). If the direction is not changeable, the value configured here is fixed. The direction must match the pin mode. PORT_PIN_IN: Port pin direction set as input. PORT_PIN_OUT: Port pin direction set as output.
          boolean PortInputBufferControl: set at post-build, origin=Renesas_v1.0.0, default-value=false  # This parameter is used as one of the factors to enable/disable port pins input buffer in DIO_SUPP_PFCE_PMCSR Mode (PMC=0). true: Port pin's input buffer is ready to be enabled in DIO_SUPP_PFCE_PMCSR Mode. false: Port pin's input buffer is disabled in DIO_SUPP_PFCE_PMCSR Mode.
          boolean PortBiDirectionControl: set at post-build, origin=Renesas_v1.0.0, default-value=false  # This parameter forces port pins input buffer and output buffer at the same time. If activated, the effect is valid independently from any other port settings. true: Activate forced Bi-directional IO buffer of the port pin. false: Deactivate forced Bi-directional IO buffer of the port pin.
          boolean PortPullUpOption: set at post-build, origin=Renesas_v1.0.0, default-value=false  # This register switches on or off the port pins pull-up resistor. true: Port pin's pull-up resistor is enabled. false: Port pin's pull-up resistor is disabled.
          boolean PortPullDownOption: set at post-build, origin=Renesas_v1.0.0, default-value=false  # This parameter switches on or off the port pins pull-down resistor. true: Port pin's pull-down resistor is enabled. false: Port pin's pull-down resistor is disabled.
          enumeration PortOpenDrainControl_Expansion: {PushPull, OpenDrain_N_Channel, OpenDrain_P_Channel}, set at post-build, origin=Renesas_v1.0.2, default-value=PushPull  # This parameter selects port pins output buffer function in combination of PODC and PODCE . | PushPull Specifies the PushPull type output circuit characteristics and updates both PODC and PODCE registers as 0 0 respectively. OpenDrain_N_Channel specifies the N-ch open drain type output circuit characteristics and updates the PODC and PODCE registers as 1 0 respectively. OpenDrain_P_Channel specifies the P-ch open drain type output circuit characteristics and updates the PODC and PODCE registers as 1 1 respectively.
          boolean PortOutputLevelInversion: set at post-build, origin=Renesas_v1.0.0, default-value=false  # This parameter specifies whether the output level from a pin is inverted or not. true: Pin output level is inverted. false: Pin output level is not inverted.
          enumeration PortDriveStrengthControl: {SLOW, FAST}, set at post-build, origin=Renesas_v1.0.0, default-value=SLOW  # This parameter selects the port pins output drive strength as high strength or low strength type. This functionality is also referred to fast (high strength) and slow (low strength) behavior of output buffer. SLOW: Lower drive strength (slow mode) is selected for port pin's output buffer. FAST: Higher drive strength (fast mode) is selected for port pin's output buffer.
          boolean PortUniversalCharacteristicCntrl: set at post-build, origin=Renesas_v1.0.0, default-value=false  # This parameter selects the port pins output drive strength as high or low type. The PortDriveStrengthControl must be enabled for this feature. | false: PortDriveStrengthControl parameter specifies the output driver strength of the port pin. true : Number of output buffer characteristics selection capability is expanded, the maximum of 4 characteristics selection is possible PUCCn PDSCn 0 0 Output characteristic selection 1 (400 Ohm buffer) 0 1 Output characteristic selection 2 (200 Ohm buffer) 1 0 Output characteristic selection 3 (100 Ohm buffer) 1 1 Output characteristic selection 4 (50 Ohm buffer)
          enumeration PortInputSelection: {TYPE1_SHMT1, TYPE2_SHMT4}, set at post-build, origin=Renesas_v1.0.0, default-value=TYPE1_SHMT1  # This setting specifies the input buffer characteristics. TYPE1_SHMT1: TYPE 1 buffer is selected. TYPE2_SHMT4: TYPE 2 buffer is selected.
    container PortGeneral  # Module wide configuration parameters of the PORT driver.
      boolean PortDevErrorDetect: set at pre-compile, default-value=false  # Switches the Development Error Detection and Notification on or off. true: Development Error Detection and Notification is enabled. false: Development Error Detection and Notification is disabled.
      boolean PortSetPinDirectionApi: set at pre-compile, default-value=true  # Pre-processor switch to enable / disable the use of the function Port_SetPinDirection(). true: Enabled - Function Port_SetPinDirection() is available. false: Disabled - Function Port_SetPinDirection() is not available.
      boolean PortSetPinDefaultDirectionApi: set at pre-compile, origin=Renesas_v1.0.3, default-value=true  # Pre-processor switch to enable / disable the use of the function Port_SetPinDefaultDirection(). true: Enabled - Function Port_SetPinDefaultDirection() is available. false: Disabled - Function Port_SetPinDefaultDirection() is not available.
      boolean PortSetPinModeApi: set at pre-compile, default-value=true  # Pre-processor switch to enable / disable the use of the function Port_SetPinMode(). true: Enabled - Function Port_SetPinMode() is available. false: Disabled - Function Port_SetPinMode() is not available.
      boolean PortSetPinDefaultModeApi: set at pre-compile, origin=Renesas_v1.0.3, default-value=true  # Pre-processor switch to enable / disable the use of the function Port_SetPinDefaultMode(). true: Enabled - Function Port_SetPinDefaultMode() is available. false: Disabled - Function Port_SetPinDefaultMode() is not available.
      boolean PortVersionInfoApi: set at pre-compile, default-value=true  # Pre-processor switch to enable / disable the API to read out the modules version information. true: Version info API enabled. false: Version info API disabled.
      boolean PortVersionCheckExternalModules: set at pre-compile, origin=Renesas_v1.0.0, default-value=true  # Enable / disable AUTOSAR Version check for inter-module dependencies. true: AUTOSAR Version check for inter-module dependencies is enabled. false: AUTOSAR Version check for inter-module dependencies is disabled
      enumeration PortDeviceName: {R7F701373}, set at pre-compile, origin=Renesas_v1.0.0, default-value=R7F701373  # This parameter contains the supported device name.
      boolean PortCriticalSectionProtection: set at pre-compile, origin=Renesas_v1.0.0, default-value=true  # This parameter specifies if the PORT driver CPU load can be reduced by disabling the enter/exit critical section functionality by adding a precompiled configuration parameter to the PORT driver configuration. true: Enables the critical section functionality for the restricted area. false: Disables the critical section functionality for the restricted area.
      integer PortMaxMode: 4..4, set at pre-compile, origin=Renesas_v1.0.0, default-value=4  # This parameter indicates maximum Alternative modes present in a Port Module.
      boolean PortSetToDioAltModeApi: set at pre-compile, origin=Renesas_v1.0.0, default-value=false  # Pre-processor switch to enable / disable the use of the function Port_SetToDioMode() and Port_SetToAlternateMode(). true: Enabled - Function Port_SetToDioMode() and Port_SetToAlternateMode() is available. false: Disabled - Function Port_SetToDioMode() and Port_SetToAlternateMode() is not available.
      enumeration PortWriteVerify: {WV_DISABLE, WV_INIT_ONLY, WV_INIT_RUNTIME}, set at pre-compile, origin=Renesas_v1.0.2, default-value=WV_DISABLE  # This parameter enables selection and support of the register write-verify functionality of all Port registers. | WV_INIT_ONLY: Enables register write-verify functionality during initialize API. WV_INIT_RUNTIME: Enables register write-verify functionality for Init and all other APIs. WV_DISABLE: Disables register write-verify functionality of all Port registers.
      boolean PortUseWriteVerifyErrorInterface: set at pre-compile, origin=Renesas_v1.0.2, default-value=false  # This parameter specifies whether user can configure error notification interface instead of DEM error for Write-Verify functionality. | true: User can configure error notification interface via PortWriteVerifyErrorInterface parameter. false: Error notification for Write-Verify functionality shall be handled via DEM error.
      function name PortWriteVerifyErrorInterface [0..1]: set at post-build, origin=Renesas_v1.0.2, default-value=NULL, regular-expression=[a-zA-Z][a-zA-Z0-9_]*  # This parameter is used to configure the name of the error notification which shall be called with the ApiID and ErrorId when there is a Write Verify error.
    container PortDemEventParameterRefs  # Container for the references to DemEventParameter elements which shall be invoked using the API Dem_ReportErrorStatus API in case the corresponding error occurs. The EventId is taken from the referenced DemEventParameter's DemEventId value. The standardized errors are provided in the container and can be extended by vendor specific error references.
      symbolic name reference PORT_E_REG_WRITE_VERIFY [0..1]: set at pre-compile, origin=Renesas_v1.0.2, destination=DemEventParameter  # Reference to configured DEM event to report "Register write-verify failure".
