[part 2 of 4: package /Renesas/EcucDefs_Port]
AUTOSAR XML (schema 4-0-3)
# COPYRIGHT
# Copyright(c) 2016 - 2017 Renesas Electronics Corporation
package /Renesas/EcucDefs_Port  (continued)
  module definition Port: refined-module-def=Port, variants post-build  (continued)
    container PortConfigSet: multiple-configuration-container=true  (continued)
      container PortGroup2  # This container contains the configuration (parameters) for Port Group 0.
        container PortPin0  # This container contains the configuration (parameters) for Port Pin 0.
          boolean PortPinDirectionChangeable: set at post-build, origin=Renesas_v1.0.0, default-value=false  # Parameter to indicate if the direction is changeable on a port pin during runtime. true: Port Pin direction changeable enabled. false: Port Pin direction changeable disabled.
          boolean PortPinDioAltModeChangeable: set at post-build, origin=Renesas_v1.0.0, default-value=false  # Parameter to indicate if the mode of a port pin is changeable between DIO and Alternate during runtime by API functions Port_SetToDioMode and Port_SetToAlternateMode. Including these APIs is controlled by PortSetToDioAltModeApi. true: Dio Alternate mode is changeable. false: Dio Alternate mode is not changeable.
          boolean PortPinModeChangeable: set at post-build, origin=Renesas_v1.0.0, default-value=false  # Parameter to indicate if the mode of a port pin is changeable during runtime by API function Port_SetPinMode. Including this API is controlled by PortSetPinModeApi. true: Port Pin mode is changeable. false: Port Pin mode is not changeable.
          enumeration PortPinLevelValue: {PORT_PIN_LEVEL_LOW, PORT_PIN_LEVEL_HIGH}, set at post-build, origin=Renesas_v1.0.0, default-value=PORT_PIN_LEVEL_LOW  # Parameter to indicate port pin level value for a port pin. PORT_PIN_LEVEL_LOW: Port pin Level is low. PORT_PIN_LEVEL_HIGH: Port pin Level is high.
          enumeration PortPinInitialMode: {GTM0I1_ALT1_IN, GTMAT0O1N_ALT1_OUT, GTM0I0_ALT2_IN, CSIH1CSS0_ALT2_OUT, CSIH2SCI0_ALT3_IN, CSIH2SCO0_ALT3_OUT, HSURT0SCKI_ALT4_IN, HSURT0SCKO_ALT4_OUT, DIO}, set at post-build, origin=Renesas_v1.0.0, default-value=DIO  # Mode of the port pin for use with Port_Init() function. <Input name>_ALT<Alternative instance>_IN: Provides alternative instance for selected input. <Output name>_ALT<Alternative instance>_OUT: Provides alternative instance for selected output.
          enumeration PortPinDirection: {PORT_PIN_OUT, PORT_PIN_IN}, set at post-build, origin=Renesas_v1.0.0, default-value=PORT_PIN_IN  # The initial direction of the pin (IN or OUT). If the direction is not changeable, the value configured here is fixed. The direction must match the pin mode. PORT_PIN_IN: Port pin direction set as input. PORT_PIN_OUT: Port pin direction set as output.
          boolean PortInputBufferControl: set at post-build, origin=Renesas_v1.0.0, default-value=false  # This parameter is used as one of the factors to enable/disable port pins input buffer in DIO Mode (PMC=0). true: Port pin's input buffer is ready to be enabled in DIO Mode. false: Port pin's input buffer is disabled in DIO Mode.
          boolean PortBiDirectionControl: set at post-build, origin=Renesas_v1.0.0, default-value=false  # This parameter forces port pins input buffer and output buffer at the same time. If activated, the effect is valid independently from any other port settings. true: Activate forced Bi-directional IO buffer of the port pin. false: Deactivate forced Bi-directional IO buffer of the port pin.
          boolean PortIpControl: set at post-build, origin=Renesas_v1.0.0, default-value=false  # This parameter is used to enable/disable the direct IO control of port pins input buffer and output buffer. true: Enables the direct IO control of port pins input buffer and output buffer by the corresponding control signals of IP_ENI3(0) and IP_ENO3(0) from internal peripheral IPs. This register is valid only in Control Mode (PMC=1). false: Disables the direct IO control of port pins input buffer and output buffer.
          boolean PortPullUpOption: set at post-build, origin=Renesas_v1.0.0, default-value=false  # This register switches on or off the port pins pull-up resistor. true: Port pin's pull-up resistor is enabled. false: Port pin's pull-up resistor is disabled.
          boolean PortPullDownOption: set at post-build, origin=Renesas_v1.0.0, default-value=false  # This parameter switches on or off the port pins pull-down resistor. true: Port pin's pull-down resistor is enabled. false: Port pin's pull-down resistor is disabled.
          enumeration PortOpenDrainControl_Expansion: {PushPull, OpenDrain_N_Channel, OpenDrain_P_Channel}, set at post-build, origin=Renesas_v1.0.1, default-value=PushPull  # This parameter selects port pins output buffer function in combination of PODC and PODCE . | PushPull Specifies the PushPull type output circuit characteristics and updates both PODC and PODCE registers as 0 0 respectively. OpenDrain_N_Channel specifies the N-ch open drain type output circuit characteristics and updates the PODC and PODCE registers as 1 0 respectively. OpenDrain_P_Channel specifies the P-ch open drain type output circuit characteristics and updates the PODC and PODCE registers as 1 1 respectively.
          boolean PortOutputLevelInversion: set at post-build, origin=Renesas_v1.0.0, default-value=false  # This parameter specifies whether the output level from a pin is inverted or not.. true: Pin output level is inverted. false: Pin output level is not inverted.
          enumeration PortDriveStrengthControl: {SLOW, FAST}, set at post-build, origin=Renesas_v1.0.0, default-value=SLOW  # This parameter selects the port pins output drive strength as high strength or low strength type. This functionality is also referred to fast (high strength) and slow (low strength) behavior of output buffer. SLOW: Lower drive strength (slow mode) is selected for port pin's output buffer. FAST: Higher drive strength (fast mode) is selected for port pin's output buffer.
          boolean PortUniversalCharacteristicCntrl: set at post-build, origin=Renesas_v1.0.0, default-value=false  # This parameter selects the port pins output drive strength as high or low type. The PortDriveStrengthControl must be enabled for this feature. | false: PortDriveStrengthControl parameter specifies the output driver strength of the port pin. true : Number of output buffer characteristics selection capability is expanded, the maximum of 4 characteristics selection is possible PUCCn PDSCn 0 0 Output characteristic selection 1 (400 Ohm buffer) 0 1 Output characteristic selection 2 (200 Ohm buffer) 1 0 Output characteristic selection 3 (100 Ohm buffer) 1 1 Output characteristic selection 4 (50 Ohm buffer)
          enumeration PortInputSelection: {TYPE1_SHMT1, TYPE2_SHMT4}, set at post-build, origin=Renesas_v1.0.0, default-value=TYPE1_SHMT1  # This setting specifies the input buffer characteristics. TYPE1_SHMT1: TYPE 1 buffer is selected. TYPE2_SHMT4: TYPE 2 buffer is selected.
        container PortPin1  # This container contains the configuration (parameters) for Port Pin 0.
          boolean PortPinDirectionChangeable: set at post-build, origin=Renesas_v1.0.0, default-value=false  # Parameter to indicate if the direction is changeable on a port pin during runtime. true: Port Pin direction changeable enabled. false: Port Pin direction changeable disabled.
          boolean PortPinDioAltModeChangeable: set at post-build, origin=Renesas_v1.0.0, default-value=false  # Parameter to indicate if the mode of a port pin is changeable between DIO and Alternate during runtime by API functions Port_SetToDioMode and Port_SetToAlternateMode. Including these APIs is controlled by PortSetToDioAltModeApi. true: Dio Alternate mode is changeable. false: Dio Alternate mode is not changeable.
          boolean PortPinModeChangeable: set at post-build, origin=Renesas_v1.0.0, default-value=false  # Parameter to indicate if the mode of a port pin is changeable during runtime by API function Port_SetPinMode. Including this API is controlled by PortSetPinModeApi. true: Port Pin mode is changeable. false: Port Pin mode is not changeable.
          enumeration PortPinLevelValue: {PORT_PIN_LEVEL_LOW, PORT_PIN_LEVEL_HIGH}, set at post-build, origin=Renesas_v1.0.0, default-value=PORT_PIN_LEVEL_LOW  # Parameter to indicate port pin level value for a port pin. PORT_PIN_LEVEL_LOW: Port pin Level is low. PORT_PIN_LEVEL_HIGH: Port pin Level is high.
          enumeration PortPinInitialMode: {GTM1I0_ALT1_IN, GTMAT0O0_ALT1_OUT, CSIH1CSS2_ALT2_OUT, CSIH2DCS_ALT3_IN, CSIH2SO0_ALT3_OUT, HSURT0CSI_ALT4_IN, HSURT0CSO_ALT4_OUT, DIO}, set at post-build, origin=Renesas_v1.0.0, default-value=DIO  # Mode of the port pin for use with Port_Init() function. <Input name>_ALT<Alternative instance>_IN: Provides alternative instance for selected input. <Output name>_ALT<Alternative instance>_OUT: Provides alternative instance for selected output.
          enumeration PortPinDirection: {PORT_PIN_OUT, PORT_PIN_IN}, set at post-build, origin=Renesas_v1.0.0, default-value=PORT_PIN_IN  # The initial direction of the pin (IN or OUT). If the direction is not changeable, the value configured here is fixed. The direction must match the pin mode. PORT_PIN_IN: Port pin direction set as input. PORT_PIN_OUT: Port pin direction set as output.
          boolean PortInputBufferControl: set at post-build, origin=Renesas_v1.0.0, default-value=false  # This parameter is used as one of the factors to enable/disable port pins input buffer in DIO Mode (PMC=0). true: Port pin's input buffer is ready to be enabled in DIO Mode. false: Port pin's input buffer is disabled in DIO Mode.
          boolean PortBiDirectionControl: set at post-build, origin=Renesas_v1.0.0, default-value=false  # This parameter forces port pins input buffer and output buffer at the same time. If activated, the effect is valid independently from any other port settings. true: Activate forced Bi-directional IO buffer of the port pin. false: Deactivate forced Bi-directional IO buffer of the port pin.
          boolean PortIpControl: set at post-build, origin=Renesas_v1.0.0, default-value=false  # This parameter is used to enable/disable the direct IO control of port pins input buffer and output buffer. true: Enables the direct IO control of port pins input buffer and output buffer by the corresponding control signals of IP_ENI3(0) and IP_ENO3(0) from internal peripheral IPs. This register is valid only in Control Mode (PMC=1). false: Disables the direct IO control of port pins input buffer and output buffer.
          boolean PortPullUpOption: set at post-build, origin=Renesas_v1.0.0, default-value=false  # This register switches on or off the port pins pull-up resistor. true: Port pin's pull-up resistor is enabled. false: Port pin's pull-up resistor is disabled.
          boolean PortPullDownOption: set at post-build, origin=Renesas_v1.0.0, default-value=false  # This parameter switches on or off the port pins pull-down resistor. true: Port pin's pull-down resistor is enabled. false: Port pin's pull-down resistor is disabled.
          enumeration PortOpenDrainControl_Expansion: {PushPull, OpenDrain_N_Channel, OpenDrain_P_Channel}, set at post-build, origin=Renesas_v1.0.1, default-value=PushPull  # This parameter selects port pins output buffer function in combination of PODC and PODCE . | PushPull Specifies the PushPull type output circuit characteristics and updates both PODC and PODCE registers as 0 0 respectively. OpenDrain_N_Channel specifies the N-ch open drain type output circuit characteristics and updates the PODC and PODCE registers as 1 0 respectively. OpenDrain_P_Channel specifies the P-ch open drain type output circuit characteristics and updates the PODC and PODCE registers as 1 1 respectively.
          boolean PortOutputLevelInversion: set at post-build, origin=Renesas_v1.0.0, default-value=false  # This parameter specifies whether the output level from a pin is inverted or not.. true: Pin output level is inverted. false: Pin output level is not inverted.
          enumeration PortDriveStrengthControl: {SLOW, FAST}, set at post-build, origin=Renesas_v1.0.0, default-value=SLOW  # This parameter selects the port pins output drive strength as high strength or low strength type. This functionality is also referred to fast (high strength) and slow (low strength) behavior of output buffer. SLOW: Lower drive strength (slow mode) is selected for port pin's output buffer. FAST: Higher drive strength (fast mode) is selected for port pin's output buffer.
          boolean PortUniversalCharacteristicCntrl: set at post-build, origin=Renesas_v1.0.0, default-value=false  # This parameter selects the port pins output drive strength as high or low type. The PortDriveStrengthControl must be enabled for this feature. | false: PortDriveStrengthControl parameter specifies the output driver strength of the port pin. true : Number of output buffer characteristics selection capability is expanded, the maximum of 4 characteristics selection is possible PUCCn PDSCn 0 0 Output characteristic selection 1 (400 Ohm buffer) 0 1 Output characteristic selection 2 (200 Ohm buffer) 1 0 Output characteristic selection 3 (100 Ohm buffer) 1 1 Output characteristic selection 4 (50 Ohm buffer)
          enumeration PortInputSelection: {TYPE1_SHMT1, TYPE2_SHMT4}, set at post-build, origin=Renesas_v1.0.0, default-value=TYPE1_SHMT1  # This setting specifies the input buffer characteristics. TYPE1_SHMT1: TYPE 1 buffer is selected. TYPE2_SHMT4: TYPE 2 buffer is selected.
        container PortPin2  # This container contains the configuration (parameters) for Port Pin 0.
          boolean PortPinDirectionChangeable: set at post-build, origin=Renesas_v1.0.0, default-value=false  # Parameter to indicate if the direction is changeable on a port pin during runtime. true: Port Pin direction changeable enabled. false: Port Pin direction changeable disabled.
          boolean PortPinDioAltModeChangeable: set at post-build, origin=Renesas_v1.0.0, default-value=false  # Parameter to indicate if the mode of a port pin is changeable between DIO and Alternate during runtime by API functions Port_SetToDioMode and Port_SetToAlternateMode. Including these APIs is controlled by PortSetToDioAltModeApi. true: Dio Alternate mode is changeable. false: Dio Alternate mode is not changeable.
          boolean PortPinModeChangeable: set at post-build, origin=Renesas_v1.0.0, default-value=false  # Parameter to indicate if the mode of a port pin is changeable during runtime by API function Port_SetPinMode. Including this API is controlled by PortSetPinModeApi. true: Port Pin mode is changeable. false: Port Pin mode is not changeable.
          enumeration PortPinLevelValue: {PORT_PIN_LEVEL_LOW, PORT_PIN_LEVEL_HIGH}, set at post-build, origin=Renesas_v1.0.0, default-value=PORT_PIN_LEVEL_LOW  # Parameter to indicate port pin level value for a port pin. PORT_PIN_LEVEL_LOW: Port pin Level is low. PORT_PIN_LEVEL_HIGH: Port pin Level is high.
          enumeration PortPinInitialMode: {GTM0I2_ALT1_IN, GTMAT0O2N_ALT1_OUT, GTM0I4_ALT2_IN, CSIH2CSS1_ALT2_OUT, CSIH1SCI1_ALT3_IN, CSIH1SCO1_ALT3_OUT, HSURT0SDIR_ALT4_OUT, DIO}, set at post-build, origin=Renesas_v1.0.0, default-value=DIO  # Mode of the port pin for use with Port_Init() function. <Input name>_ALT<Alternative instance>_IN: Provides alternative instance for selected input. <Output name>_ALT<Alternative instance>_OUT: Provides alternative instance for selected output.
          enumeration PortPinDirection: {PORT_PIN_OUT, PORT_PIN_IN}, set at post-build, origin=Renesas_v1.0.0, default-value=PORT_PIN_IN  # The initial direction of the pin (IN or OUT). If the direction is not changeable, the value configured here is fixed. The direction must match the pin mode. PORT_PIN_IN: Port pin direction set as input. PORT_PIN_OUT: Port pin direction set as output.
          boolean PortInputBufferControl: set at post-build, origin=Renesas_v1.0.0, default-value=false  # This parameter is used as one of the factors to enable/disable port pins input buffer in DIO Mode (PMC=0). true: Port pin's input buffer is ready to be enabled in DIO Mode. false: Port pin's input buffer is disabled in DIO Mode.
          boolean PortBiDirectionControl: set at post-build, origin=Renesas_v1.0.0, default-value=false  # This parameter forces port pins input buffer and output buffer at the same time. If activated, the effect is valid independently from any other port settings. true: Activate forced Bi-directional IO buffer of the port pin. false: Deactivate forced Bi-directional IO buffer of the port pin.
          boolean PortIpControl: set at post-build, origin=Renesas_v1.0.0, default-value=false  # This parameter is used to enable/disable the direct IO control of port pins input buffer and output buffer. true: Enables the direct IO control of port pins input buffer and output buffer by the corresponding control signals of IP_ENI3(0) and IP_ENO3(0) from internal peripheral IPs. This register is valid only in Control Mode (PMC=1). false: Disables the direct IO control of port pins input buffer and output buffer.
          boolean PortPullUpOption: set at post-build, origin=Renesas_v1.0.0, default-value=false  # This register switches on or off the port pins pull-up resistor. true: Port pin's pull-up resistor is enabled. false: Port pin's pull-up resistor is disabled.
          boolean PortPullDownOption: set at post-build, origin=Renesas_v1.0.0, default-value=false  # This parameter switches on or off the port pins pull-down resistor. true: Port pin's pull-down resistor is enabled. false: Port pin's pull-down resistor is disabled.
          enumeration PortOpenDrainControl_Expansion: {PushPull, OpenDrain_N_Channel, OpenDrain_P_Channel}, set at post-build, origin=Renesas_v1.0.1, default-value=PushPull  # This parameter selects port pins output buffer function in combination of PODC and PODCE . | PushPull Specifies the PushPull type output circuit characteristics and updates both PODC and PODCE registers as 0 0 respectively. OpenDrain_N_Channel specifies the N-ch open drain type output circuit characteristics and updates the PODC and PODCE registers as 1 0 respectively. OpenDrain_P_Channel specifies the P-ch open drain type output circuit characteristics and updates the PODC and PODCE registers as 1 1 respectively.
          boolean PortOutputLevelInversion: set at post-build, origin=Renesas_v1.0.0, default-value=false  # This parameter specifies whether the output level from a pin is inverted or not.. true: Pin output level is inverted. false: Pin output level is not inverted.
          enumeration PortDriveStrengthControl: {SLOW, FAST}, set at post-build, origin=Renesas_v1.0.0, default-value=SLOW  # This parameter selects the port pins output drive strength as high strength or low strength type. This functionality is also referred to fast (high strength) and slow (low strength) behavior of output buffer. SLOW: Lower drive strength (slow mode) is selected for port pin's output buffer. FAST: Higher drive strength (fast mode) is selected for port pin's output buffer.
          boolean PortUniversalCharacteristicCntrl: set at post-build, origin=Renesas_v1.0.0, default-value=false  # This parameter selects the port pins output drive strength as high or low type. The PortDriveStrengthControl must be enabled for this feature. | false: PortDriveStrengthControl parameter specifies the output driver strength of the port pin. true : Number of output buffer characteristics selection capability is expanded, the maximum of 4 characteristics selection is possible PUCCn PDSCn 0 0 Output characteristic selection 1 (400 Ohm buffer) 0 1 Output characteristic selection 2 (200 Ohm buffer) 1 0 Output characteristic selection 3 (100 Ohm buffer) 1 1 Output characteristic selection 4 (50 Ohm buffer)
          enumeration PortInputSelection: {TYPE1_SHMT1, TYPE2_SHMT4}, set at post-build, origin=Renesas_v1.0.0, default-value=TYPE1_SHMT1  # This setting specifies the input buffer characteristics. TYPE1_SHMT1: TYPE 1 buffer is selected. TYPE2_SHMT4: TYPE 2 buffer is selected.
        container PortPin3  # This container contains the configuration (parameters) for Port Pin 0.
          boolean PortPinDirectionChangeable: set at post-build, origin=Renesas_v1.0.0, default-value=false  # Parameter to indicate if the direction is changeable on a port pin during runtime. true: Port Pin direction changeable enabled. false: Port Pin direction changeable disabled.
          boolean PortPinDioAltModeChangeable: set at post-build, origin=Renesas_v1.0.0, default-value=false  # Parameter to indicate if the mode of a port pin is changeable between DIO and Alternate during runtime by API functions Port_SetToDioMode and Port_SetToAlternateMode. Including these APIs is controlled by PortSetToDioAltModeApi. true: Dio Alternate mode is changeable. false: Dio Alternate mode is not changeable.
          boolean PortPinModeChangeable: set at post-build, origin=Renesas_v1.0.0, default-value=false  # Parameter to indicate if the mode of a port pin is changeable during runtime by API function Port_SetPinMode. Including this API is controlled by PortSetPinModeApi. true: Port Pin mode is changeable. false: Port Pin mode is not changeable.
          enumeration PortPinLevelValue: {PORT_PIN_LEVEL_LOW, PORT_PIN_LEVEL_HIGH}, set at post-build, origin=Renesas_v1.0.0, default-value=PORT_PIN_LEVEL_LOW  # Parameter to indicate port pin level value for a port pin. PORT_PIN_LEVEL_LOW: Port pin Level is low. PORT_PIN_LEVEL_HIGH: Port pin Level is high.
          enumeration PortPinInitialMode: {GTM1I1_ALT1_IN, GTMAT0O1_ALT1_OUT, GTM0I5_ALT2_IN, GTMAT0O5_ALT2_OUT, CSIH2SI0_ALT3_IN, CSIH0CSS0_ALT3_OUT, HSURT1SDIO0I_ALT4_IN, HSURT1SDIO0O_ALT4_OUT, DIO}, set at post-build, origin=Renesas_v1.0.0, default-value=DIO  # Mode of the port pin for use with Port_Init() function. <Input name>_ALT<Alternative instance>_IN: Provides alternative instance for selected input. <Output name>_ALT<Alternative instance>_OUT: Provides alternative instance for selected output.
          enumeration PortPinDirection: {PORT_PIN_OUT, PORT_PIN_IN}, set at post-build, origin=Renesas_v1.0.0, default-value=PORT_PIN_IN  # The initial direction of the pin (IN or OUT). If the direction is not changeable, the value configured here is fixed. The direction must match the pin mode. PORT_PIN_IN: Port pin direction set as input. PORT_PIN_OUT: Port pin direction set as output.
          boolean PortInputBufferControl: set at post-build, origin=Renesas_v1.0.0, default-value=false  # This parameter is used as one of the factors to enable/disable port pins input buffer in DIO Mode (PMC=0). true: Port pin's input buffer is ready to be enabled in DIO Mode. false: Port pin's input buffer is disabled in DIO Mode.
          boolean PortBiDirectionControl: set at post-build, origin=Renesas_v1.0.0, default-value=false  # This parameter forces port pins input buffer and output buffer at the same time. If activated, the effect is valid independently from any other port settings. true: Activate forced Bi-directional IO buffer of the port pin. false: Deactivate forced Bi-directional IO buffer of the port pin.
          boolean PortIpControl: set at post-build, origin=Renesas_v1.0.0, default-value=false  # This parameter is used to enable/disable the direct IO control of port pins input buffer and output buffer. true: Enables the direct IO control of port pins input buffer and output buffer by the corresponding control signals of IP_ENI3(0) and IP_ENO3(0) from internal peripheral IPs. This register is valid only in Control Mode (PMC=1). false: Disables the direct IO control of port pins input buffer and output buffer.
          boolean PortPullUpOption: set at post-build, origin=Renesas_v1.0.0, default-value=false  # This register switches on or off the port pins pull-up resistor. true: Port pin's pull-up resistor is enabled. false: Port pin's pull-up resistor is disabled.
          boolean PortPullDownOption: set at post-build, origin=Renesas_v1.0.0, default-value=false  # This parameter switches on or off the port pins pull-down resistor. true: Port pin's pull-down resistor is enabled. false: Port pin's pull-down resistor is disabled.
          enumeration PortOpenDrainControl_Expansion: {PushPull, OpenDrain_N_Channel, OpenDrain_P_Channel}, set at post-build, origin=Renesas_v1.0.1, default-value=PushPull  # This parameter selects port pins output buffer function in combination of PODC and PODCE . | PushPull Specifies the PushPull type output circuit characteristics and updates both PODC and PODCE registers as 0 0 respectively. OpenDrain_N_Channel specifies the N-ch open drain type output circuit characteristics and updates the PODC and PODCE registers as 1 0 respectively. OpenDrain_P_Channel specifies the P-ch open drain type output circuit characteristics and updates the PODC and PODCE registers as 1 1 respectively.
          boolean PortOutputLevelInversion: set at post-build, origin=Renesas_v1.0.0, default-value=false  # This parameter specifies whether the output level from a pin is inverted or not.. true: Pin output level is inverted. false: Pin output level is not inverted.
          enumeration PortDriveStrengthControl: {SLOW, FAST}, set at post-build, origin=Renesas_v1.0.0, default-value=SLOW  # This parameter selects the port pins output drive strength as high strength or low strength type. This functionality is also referred to fast (high strength) and slow (low strength) behavior of output buffer. SLOW: Lower drive strength (slow mode) is selected for port pin's output buffer. FAST: Higher drive strength (fast mode) is selected for port pin's output buffer.
          boolean PortUniversalCharacteristicCntrl: set at post-build, origin=Renesas_v1.0.0, default-value=false  # This parameter selects the port pins output drive strength as high or low type. The PortDriveStrengthControl must be enabled for this feature. | false: PortDriveStrengthControl parameter specifies the output driver strength of the port pin. true : Number of output buffer characteristics selection capability is expanded, the maximum of 4 characteristics selection is possible PUCCn PDSCn 0 0 Output characteristic selection 1 (400 Ohm buffer) 0 1 Output characteristic selection 2 (200 Ohm buffer) 1 0 Output characteristic selection 3 (100 Ohm buffer) 1 1 Output characteristic selection 4 (50 Ohm buffer)
          enumeration PortInputSelection: {TYPE1_SHMT1, TYPE2_SHMT4}, set at post-build, origin=Renesas_v1.0.0, default-value=TYPE1_SHMT1  # This setting specifies the input buffer characteristics. TYPE1_SHMT1: TYPE 1 buffer is selected. TYPE2_SHMT4: TYPE 2 buffer is selected.
        container PortPin4  # This container contains the configuration (parameters) for Port Pin 0.
          boolean PortPinDirectionChangeable: set at post-build, origin=Renesas_v1.0.0, default-value=false  # Parameter to indicate if the direction is changeable on a port pin during runtime. true: Port Pin direction changeable enabled. false: Port Pin direction changeable disabled.
          boolean PortPinDioAltModeChangeable: set at post-build, origin=Renesas_v1.0.0, default-value=false  # Parameter to indicate if the mode of a port pin is changeable between DIO and Alternate during runtime by API functions Port_SetToDioMode and Port_SetToAlternateMode. Including these APIs is controlled by PortSetToDioAltModeApi. true: Dio Alternate mode is changeable. false: Dio Alternate mode is not changeable.
          boolean PortPinModeChangeable: set at post-build, origin=Renesas_v1.0.0, default-value=false  # Parameter to indicate if the mode of a port pin is changeable during runtime by API function Port_SetPinMode. Including this API is controlled by PortSetPinModeApi. true: Port Pin mode is changeable. false: Port Pin mode is not changeable.
          enumeration PortPinLevelValue: {PORT_PIN_LEVEL_LOW, PORT_PIN_LEVEL_HIGH}, set at post-build, origin=Renesas_v1.0.0, default-value=PORT_PIN_LEVEL_LOW  # Parameter to indicate port pin level value for a port pin. PORT_PIN_LEVEL_LOW: Port pin Level is low. PORT_PIN_LEVEL_HIGH: Port pin Level is high.
          enumeration PortPinInitialMode: {GTM0I3_ALT1_IN, GTMAT0O3_ALT1_OUT, ESO0Z_ALT2_IN, CSIH2CSS1_ALT2_OUT, RLIN31RX_ALT3_IN, SENT0SPCO_ALT3_OUT, HSURT1SDIO1I_ALT4_IN, HSURT1SDIO1O_ALT4_OUT, DIO}, set at post-build, origin=Renesas_v1.0.0, default-value=DIO  # Mode of the port pin for use with Port_Init() function. <Input name>_ALT<Alternative instance>_IN: Provides alternative instance for selected input. <Output name>_ALT<Alternative instance>_OUT: Provides alternative instance for selected output.
          enumeration PortPinDirection: {PORT_PIN_OUT, PORT_PIN_IN}, set at post-build, origin=Renesas_v1.0.0, default-value=PORT_PIN_IN  # The initial direction of the pin (IN or OUT). If the direction is not changeable, the value configured here is fixed. The direction must match the pin mode. PORT_PIN_IN: Port pin direction set as input. PORT_PIN_OUT: Port pin direction set as output.
          boolean PortInputBufferControl: set at post-build, origin=Renesas_v1.0.0, default-value=false  # This parameter is used as one of the factors to enable/disable port pins input buffer in DIO Mode (PMC=0). true: Port pin's input buffer is ready to be enabled in DIO Mode. false: Port pin's input buffer is disabled in DIO Mode.
          boolean PortBiDirectionControl: set at post-build, origin=Renesas_v1.0.0, default-value=false  # This parameter forces port pins input buffer and output buffer at the same time. If activated, the effect is valid independently from any other port settings. true: Activate forced Bi-directional IO buffer of the port pin. false: Deactivate forced Bi-directional IO buffer of the port pin.
          boolean PortIpControl: set at post-build, origin=Renesas_v1.0.0, default-value=false  # This parameter is used to enable/disable the direct IO control of port pins input buffer and output buffer. true: Enables the direct IO control of port pins input buffer and output buffer by the corresponding control signals of IP_ENI3(0) and IP_ENO3(0) from internal peripheral IPs. This register is valid only in Control Mode (PMC=1). false: Disables the direct IO control of port pins input buffer and output buffer.
          boolean PortPullUpOption: set at post-build, origin=Renesas_v1.0.0, default-value=false  # This register switches on or off the port pins pull-up resistor. true: Port pin's pull-up resistor is enabled. false: Port pin's pull-up resistor is disabled.
          boolean PortPullDownOption: set at post-build, origin=Renesas_v1.0.0, default-value=false  # This parameter switches on or off the port pins pull-down resistor. true: Port pin's pull-down resistor is enabled. false: Port pin's pull-down resistor is disabled.
          enumeration PortOpenDrainControl_Expansion: {PushPull, OpenDrain_N_Channel, OpenDrain_P_Channel}, set at post-build, origin=Renesas_v1.0.1, default-value=PushPull  # This parameter selects port pins output buffer function in combination of PODC and PODCE . | PushPull Specifies the PushPull type output circuit characteristics and updates both PODC and PODCE registers as 0 0 respectively. OpenDrain_N_Channel specifies the N-ch open drain type output circuit characteristics and updates the PODC and PODCE registers as 1 0 respectively. OpenDrain_P_Channel specifies the P-ch open drain type output circuit characteristics and updates the PODC and PODCE registers as 1 1 respectively.
          boolean PortOutputLevelInversion: set at post-build, origin=Renesas_v1.0.0, default-value=false  # This parameter specifies whether the output level from a pin is inverted or not.. true: Pin output level is inverted. false: Pin output level is not inverted.
          enumeration PortDriveStrengthControl: {SLOW, FAST}, set at post-build, origin=Renesas_v1.0.0, default-value=SLOW  # This parameter selects the port pins output drive strength as high strength or low strength type. This functionality is also referred to fast (high strength) and slow (low strength) behavior of output buffer. SLOW: Lower drive strength (slow mode) is selected for port pin's output buffer. FAST: Higher drive strength (fast mode) is selected for port pin's output buffer.
          boolean PortUniversalCharacteristicCntrl: set at post-build, origin=Renesas_v1.0.0, default-value=false  # This parameter selects the port pins output drive strength as high or low type. The PortDriveStrengthControl must be enabled for this feature. | false: PortDriveStrengthControl parameter specifies the output driver strength of the port pin. true : Number of output buffer characteristics selection capability is expanded, the maximum of 4 characteristics selection is possible PUCCn PDSCn 0 0 Output characteristic selection 1 (400 Ohm buffer) 0 1 Output characteristic selection 2 (200 Ohm buffer) 1 0 Output characteristic selection 3 (100 Ohm buffer) 1 1 Output characteristic selection 4 (50 Ohm buffer)
          enumeration PortInputSelection: {TYPE1_SHMT1, TYPE2_SHMT4}, set at post-build, origin=Renesas_v1.0.0, default-value=TYPE1_SHMT1  # This setting specifies the input buffer characteristics. TYPE1_SHMT1: TYPE 1 buffer is selected. TYPE2_SHMT4: TYPE 2 buffer is selected.
        container PortPin5  # This container contains the configuration (parameters) for Port Pin 0.
          boolean PortPinDirectionChangeable: set at post-build, origin=Renesas_v1.0.0, default-value=false  # Parameter to indicate if the direction is changeable on a port pin during runtime. true: Port Pin direction changeable enabled. false: Port Pin direction changeable disabled.
          boolean PortPinDioAltModeChangeable: set at post-build, origin=Renesas_v1.0.0, default-value=false  # Parameter to indicate if the mode of a port pin is changeable between DIO and Alternate during runtime by API functions Port_SetToDioMode and Port_SetToAlternateMode. Including these APIs is controlled by PortSetToDioAltModeApi. true: Dio Alternate mode is changeable. false: Dio Alternate mode is not changeable.
          boolean PortPinModeChangeable: set at post-build, origin=Renesas_v1.0.0, default-value=false  # Parameter to indicate if the mode of a port pin is changeable during runtime by API function Port_SetPinMode. Including this API is controlled by PortSetPinModeApi. true: Port Pin mode is changeable. false: Port Pin mode is not changeable.
          enumeration PortPinLevelValue: {PORT_PIN_LEVEL_LOW, PORT_PIN_LEVEL_HIGH}, set at post-build, origin=Renesas_v1.0.0, default-value=PORT_PIN_LEVEL_LOW  # Parameter to indicate port pin level value for a port pin. PORT_PIN_LEVEL_LOW: Port pin Level is low. PORT_PIN_LEVEL_HIGH: Port pin Level is high.
          enumeration PortPinInitialMode: {GTM0I6_ALT1_IN, GTMAT0O2_ALT1_OUT, CSIH2CSS2_ALT2_OUT, RLIN31TX_ALT3_OUT, HSURT1SDIO2I_ALT4_IN, HSURT1SDIO2O_ALT4_OUT, DIO}, set at post-build, origin=Renesas_v1.0.0, default-value=DIO  # Mode of the port pin for use with Port_Init() function. <Input name>_ALT<Alternative instance>_IN: Provides alternative instance for selected input. <Output name>_ALT<Alternative instance>_OUT: Provides alternative instance for selected output.
          enumeration PortPinDirection: {PORT_PIN_OUT, PORT_PIN_IN}, set at post-build, origin=Renesas_v1.0.0, default-value=PORT_PIN_IN  # The initial direction of the pin (IN or OUT). If the direction is not changeable, the value configured here is fixed. The direction must match the pin mode. PORT_PIN_IN: Port pin direction set as input. PORT_PIN_OUT: Port pin direction set as output.
          boolean PortInputBufferControl: set at post-build, origin=Renesas_v1.0.0, default-value=false  # This parameter is used as one of the factors to enable/disable port pins input buffer in DIO Mode (PMC=0). true: Port pin's input buffer is ready to be enabled in DIO Mode. false: Port pin's input buffer is disabled in DIO Mode.
          boolean PortBiDirectionControl: set at post-build, origin=Renesas_v1.0.0, default-value=false  # This parameter forces port pins input buffer and output buffer at the same time. If activated, the effect is valid independently from any other port settings. true: Activate forced Bi-directional IO buffer of the port pin. false: Deactivate forced Bi-directional IO buffer of the port pin.
          boolean PortIpControl: set at post-build, origin=Renesas_v1.0.0, default-value=false  # This parameter is used to enable/disable the direct IO control of port pins input buffer and output buffer. true: Enables the direct IO control of port pins input buffer and output buffer by the corresponding control signals of IP_ENI3(0) and IP_ENO3(0) from internal peripheral IPs. This register is valid only in Control Mode (PMC=1). false: Disables the direct IO control of port pins input buffer and output buffer.
          boolean PortPullUpOption: set at post-build, origin=Renesas_v1.0.0, default-value=false  # This register switches on or off the port pins pull-up resistor. true: Port pin's pull-up resistor is enabled. false: Port pin's pull-up resistor is disabled.
          boolean PortPullDownOption: set at post-build, origin=Renesas_v1.0.0, default-value=false  # This parameter switches on or off the port pins pull-down resistor. true: Port pin's pull-down resistor is enabled. false: Port pin's pull-down resistor is disabled.
          enumeration PortOpenDrainControl_Expansion: {PushPull, OpenDrain_N_Channel, OpenDrain_P_Channel}, set at post-build, origin=Renesas_v1.0.1, default-value=PushPull  # This parameter selects port pins output buffer function in combination of PODC and PODCE . | PushPull Specifies the PushPull type output circuit characteristics and updates both PODC and PODCE registers as 0 0 respectively. OpenDrain_N_Channel specifies the N-ch open drain type output circuit characteristics and updates the PODC and PODCE registers as 1 0 respectively. OpenDrain_P_Channel specifies the P-ch open drain type output circuit characteristics and updates the PODC and PODCE registers as 1 1 respectively.
          boolean PortOutputLevelInversion: set at post-build, origin=Renesas_v1.0.0, default-value=false  # This parameter specifies whether the output level from a pin is inverted or not.. true: Pin output level is inverted. false: Pin output level is not inverted.
          enumeration PortDriveStrengthControl: {SLOW, FAST}, set at post-build, origin=Renesas_v1.0.0, default-value=SLOW  # This parameter selects the port pins output drive strength as high strength or low strength type. This functionality is also referred to fast (high strength) and slow (low strength) behavior of output buffer. SLOW: Lower drive strength (slow mode) is selected for port pin's output buffer. FAST: Higher drive strength (fast mode) is selected for port pin's output buffer.
          boolean PortUniversalCharacteristicCntrl: set at post-build, origin=Renesas_v1.0.0, default-value=false  # This parameter selects the port pins output drive strength as high or low type. The PortDriveStrengthControl must be enabled for this feature. | false: PortDriveStrengthControl parameter specifies the output driver strength of the port pin. true : Number of output buffer characteristics selection capability is expanded, the maximum of 4 characteristics selection is possible PUCCn PDSCn 0 0 Output characteristic selection 1 (400 Ohm buffer) 0 1 Output characteristic selection 2 (200 Ohm buffer) 1 0 Output characteristic selection 3 (100 Ohm buffer) 1 1 Output characteristic selection 4 (50 Ohm buffer)
          enumeration PortInputSelection: {TYPE1_SHMT1, TYPE2_SHMT4}, set at post-build, origin=Renesas_v1.0.0, default-value=TYPE1_SHMT1  # This setting specifies the input buffer characteristics. TYPE1_SHMT1: TYPE 1 buffer is selected. TYPE2_SHMT4: TYPE 2 buffer is selected.
        container PortPin6  # This container contains the configuration (parameters) for Port Pin 0.
          boolean PortPinDirectionChangeable: set at post-build, origin=Renesas_v1.0.0, default-value=false  # Parameter to indicate if the direction is changeable on a port pin during runtime. true: Port Pin direction changeable enabled. false: Port Pin direction changeable disabled.
          boolean PortPinDioAltModeChangeable: set at post-build, origin=Renesas_v1.0.0, default-value=false  # Parameter to indicate if the mode of a port pin is changeable between DIO and Alternate during runtime by API functions Port_SetToDioMode and Port_SetToAlternateMode. Including these APIs is controlled by PortSetToDioAltModeApi. true: Dio Alternate mode is changeable. false: Dio Alternate mode is not changeable.
          boolean PortPinModeChangeable: set at post-build, origin=Renesas_v1.0.0, default-value=false  # Parameter to indicate if the mode of a port pin is changeable during runtime by API function Port_SetPinMode. Including this API is controlled by PortSetPinModeApi. true: Port Pin mode is changeable. false: Port Pin mode is not changeable.
          enumeration PortPinLevelValue: {PORT_PIN_LEVEL_LOW, PORT_PIN_LEVEL_HIGH}, set at post-build, origin=Renesas_v1.0.0, default-value=PORT_PIN_LEVEL_LOW  # Parameter to indicate port pin level value for a port pin. PORT_PIN_LEVEL_LOW: Port pin Level is low. PORT_PIN_LEVEL_HIGH: Port pin Level is high.
          enumeration PortPinInitialMode: {GTM1I6_ALT1_IN, GTMAT0O2_ALT1_OUT, RLIN30RX_ALT2_IN, CSIH2CSS3_ALT2_OUT, MTTCAN0RX_ALT3_IN, CSIH1CSS1_ALT3_OUT, HSURT1SDIO3I_ALT4_IN, HSURT1SDIO3O_ALT4_OUT, DIO}, set at post-build, origin=Renesas_v1.0.0, default-value=DIO  # Mode of the port pin for use with Port_Init() function. <Input name>_ALT<Alternative instance>_IN: Provides alternative instance for selected input. <Output name>_ALT<Alternative instance>_OUT: Provides alternative instance for selected output.
          enumeration PortPinDirection: {PORT_PIN_OUT, PORT_PIN_IN}, set at post-build, origin=Renesas_v1.0.0, default-value=PORT_PIN_IN  # The initial direction of the pin (IN or OUT). If the direction is not changeable, the value configured here is fixed. The direction must match the pin mode. PORT_PIN_IN: Port pin direction set as input. PORT_PIN_OUT: Port pin direction set as output.
          boolean PortInputBufferControl: set at post-build, origin=Renesas_v1.0.0, default-value=false  # This parameter is used as one of the factors to enable/disable port pins input buffer in DIO Mode (PMC=0). true: Port pin's input buffer is ready to be enabled in DIO Mode. false: Port pin's input buffer is disabled in DIO Mode.
          boolean PortBiDirectionControl: set at post-build, origin=Renesas_v1.0.0, default-value=false  # This parameter forces port pins input buffer and output buffer at the same time. If activated, the effect is valid independently from any other port settings. true: Activate forced Bi-directional IO buffer of the port pin. false: Deactivate forced Bi-directional IO buffer of the port pin.
          boolean PortIpControl: set at post-build, origin=Renesas_v1.0.0, default-value=false  # This parameter is used to enable/disable the direct IO control of port pins input buffer and output buffer. true: Enables the direct IO control of port pins input buffer and output buffer by the corresponding control signals of IP_ENI3(0) and IP_ENO3(0) from internal peripheral IPs. This register is valid only in Control Mode (PMC=1). false: Disables the direct IO control of port pins input buffer and output buffer.
          boolean PortPullUpOption: set at post-build, origin=Renesas_v1.0.0, default-value=false  # This register switches on or off the port pins pull-up resistor. true: Port pin's pull-up resistor is enabled. false: Port pin's pull-up resistor is disabled.
          boolean PortPullDownOption: set at post-build, origin=Renesas_v1.0.0, default-value=false  # This parameter switches on or off the port pins pull-down resistor. true: Port pin's pull-down resistor is enabled. false: Port pin's pull-down resistor is disabled.
          enumeration PortOpenDrainControl_Expansion: {PushPull, OpenDrain_N_Channel, OpenDrain_P_Channel}, set at post-build, origin=Renesas_v1.0.1, default-value=PushPull  # This parameter selects port pins output buffer function in combination of PODC and PODCE . | PushPull Specifies the PushPull type output circuit characteristics and updates both PODC and PODCE registers as 0 0 respectively. OpenDrain_N_Channel specifies the N-ch open drain type output circuit characteristics and updates the PODC and PODCE registers as 1 0 respectively. OpenDrain_P_Channel specifies the P-ch open drain type output circuit characteristics and updates the PODC and PODCE registers as 1 1 respectively.
          boolean PortOutputLevelInversion: set at post-build, origin=Renesas_v1.0.0, default-value=false  # This parameter specifies whether the output level from a pin is inverted or not.. true: Pin output level is inverted. false: Pin output level is not inverted.
          enumeration PortDriveStrengthControl: {SLOW, FAST}, set at post-build, origin=Renesas_v1.0.0, default-value=SLOW  # This parameter selects the port pins output drive strength as high strength or low strength type. This functionality is also referred to fast (high strength) and slow (low strength) behavior of output buffer. SLOW: Lower drive strength (slow mode) is selected for port pin's output buffer. FAST: Higher drive strength (fast mode) is selected for port pin's output buffer.
          boolean PortUniversalCharacteristicCntrl: set at post-build, origin=Renesas_v1.0.0, default-value=false  # This parameter selects the port pins output drive strength as high or low type. The PortDriveStrengthControl must be enabled for this feature. | false: PortDriveStrengthControl parameter specifies the output driver strength of the port pin. true : Number of output buffer characteristics selection capability is expanded, the maximum of 4 characteristics selection is possible PUCCn PDSCn 0 0 Output characteristic selection 1 (400 Ohm buffer) 0 1 Output characteristic selection 2 (200 Ohm buffer) 1 0 Output characteristic selection 3 (100 Ohm buffer) 1 1 Output characteristic selection 4 (50 Ohm buffer)
          enumeration PortInputSelection: {TYPE1_SHMT1, TYPE2_SHMT4}, set at post-build, origin=Renesas_v1.0.0, default-value=TYPE1_SHMT1  # This setting specifies the input buffer characteristics. TYPE1_SHMT1: TYPE 1 buffer is selected. TYPE2_SHMT4: TYPE 2 buffer is selected.
        container PortPin7  # This container contains the configuration (parameters) for Port Pin 0.
          boolean PortPinDirectionChangeable: set at post-build, origin=Renesas_v1.0.0, default-value=false  # Parameter to indicate if the direction is changeable on a port pin during runtime. true: Port Pin direction changeable enabled. false: Port Pin direction changeable disabled.
          boolean PortPinDioAltModeChangeable: set at post-build, origin=Renesas_v1.0.0, default-value=false  # Parameter to indicate if the mode of a port pin is changeable between DIO and Alternate during runtime by API functions Port_SetToDioMode and Port_SetToAlternateMode. Including these APIs is controlled by PortSetToDioAltModeApi. true: Dio Alternate mode is changeable. false: Dio Alternate mode is not changeable.
          boolean PortPinModeChangeable: set at post-build, origin=Renesas_v1.0.0, default-value=false  # Parameter to indicate if the mode of a port pin is changeable during runtime by API function Port_SetPinMode. Including this API is controlled by PortSetPinModeApi. true: Port Pin mode is changeable. false: Port Pin mode is not changeable.
          enumeration PortPinLevelValue: {PORT_PIN_LEVEL_LOW, PORT_PIN_LEVEL_HIGH}, set at post-build, origin=Renesas_v1.0.0, default-value=PORT_PIN_LEVEL_LOW  # Parameter to indicate port pin level value for a port pin. PORT_PIN_LEVEL_LOW: Port pin Level is low. PORT_PIN_LEVEL_HIGH: Port pin Level is high.
          enumeration PortPinInitialMode: {GTM1I2_ALT1_IN, RLIN30TX_ALT1_OUT, INTP5_ALT2_IN, CSIH0CSS2_ALT2_OUT, MTTCAN0TX_ALT3_OUT, HSURT1SCKI_ALT4_IN, HSURT1SCKO_ALT4_OUT, DIO}, set at post-build, origin=Renesas_v1.0.0, default-value=DIO  # Mode of the port pin for use with Port_Init() function. <Input name>_ALT<Alternative instance>_IN: Provides alternative instance for selected input. <Output name>_ALT<Alternative instance>_OUT: Provides alternative instance for selected output.
          enumeration PortPinDirection: {PORT_PIN_OUT, PORT_PIN_IN}, set at post-build, origin=Renesas_v1.0.0, default-value=PORT_PIN_IN  # The initial direction of the pin (IN or OUT). If the direction is not changeable, the value configured here is fixed. The direction must match the pin mode. PORT_PIN_IN: Port pin direction set as input. PORT_PIN_OUT: Port pin direction set as output.
          boolean PortInputBufferControl: set at post-build, origin=Renesas_v1.0.0, default-value=false  # This parameter is used as one of the factors to enable/disable port pins input buffer in DIO Mode (PMC=0). true: Port pin's input buffer is ready to be enabled in DIO Mode. false: Port pin's input buffer is disabled in DIO Mode.
          boolean PortBiDirectionControl: set at post-build, origin=Renesas_v1.0.0, default-value=false  # This parameter forces port pins input buffer and output buffer at the same time. If activated, the effect is valid independently from any other port settings. true: Activate forced Bi-directional IO buffer of the port pin. false: Deactivate forced Bi-directional IO buffer of the port pin.
          boolean PortIpControl: set at post-build, origin=Renesas_v1.0.0, default-value=false  # This parameter is used to enable/disable the direct IO control of port pins input buffer and output buffer. true: Enables the direct IO control of port pins input buffer and output buffer by the corresponding control signals of IP_ENI3(0) and IP_ENO3(0) from internal peripheral IPs. This register is valid only in Control Mode (PMC=1). false: Disables the direct IO control of port pins input buffer and output buffer.
          boolean PortPullUpOption: set at post-build, origin=Renesas_v1.0.0, default-value=false  # This register switches on or off the port pins pull-up resistor. true: Port pin's pull-up resistor is enabled. false: Port pin's pull-up resistor is disabled.
          boolean PortPullDownOption: set at post-build, origin=Renesas_v1.0.0, default-value=false  # This parameter switches on or off the port pins pull-down resistor. true: Port pin's pull-down resistor is enabled. false: Port pin's pull-down resistor is disabled.
          enumeration PortOpenDrainControl_Expansion: {PushPull, OpenDrain_N_Channel, OpenDrain_P_Channel}, set at post-build, origin=Renesas_v1.0.1, default-value=PushPull  # This parameter selects port pins output buffer function in combination of PODC and PODCE . | PushPull Specifies the PushPull type output circuit characteristics and updates both PODC and PODCE registers as 0 0 respectively. OpenDrain_N_Channel specifies the N-ch open drain type output circuit characteristics and updates the PODC and PODCE registers as 1 0 respectively. OpenDrain_P_Channel specifies the P-ch open drain type output circuit characteristics and updates the PODC and PODCE registers as 1 1 respectively.
          boolean PortOutputLevelInversion: set at post-build, origin=Renesas_v1.0.0, default-value=false  # This parameter specifies whether the output level from a pin is inverted or not.. true: Pin output level is inverted. false: Pin output level is not inverted.
          enumeration PortDriveStrengthControl: {SLOW, FAST}, set at post-build, origin=Renesas_v1.0.0, default-value=SLOW  # This parameter selects the port pins output drive strength as high strength or low strength type. This functionality is also referred to fast (high strength) and slow (low strength) behavior of output buffer. SLOW: Lower drive strength (slow mode) is selected for port pin's output buffer. FAST: Higher drive strength (fast mode) is selected for port pin's output buffer.
          boolean PortUniversalCharacteristicCntrl: set at post-build, origin=Renesas_v1.0.0, default-value=false  # This parameter selects the port pins output drive strength as high or low type. The PortDriveStrengthControl must be enabled for this feature. | false: PortDriveStrengthControl parameter specifies the output driver strength of the port pin. true : Number of output buffer characteristics selection capability is expanded, the maximum of 4 characteristics selection is possible PUCCn PDSCn 0 0 Output characteristic selection 1 (400 Ohm buffer) 0 1 Output characteristic selection 2 (200 Ohm buffer) 1 0 Output characteristic selection 3 (100 Ohm buffer) 1 1 Output characteristic selection 4 (50 Ohm buffer)
          enumeration PortInputSelection: {TYPE1_SHMT1, TYPE2_SHMT4}, set at post-build, origin=Renesas_v1.0.0, default-value=TYPE1_SHMT1  # This setting specifies the input buffer characteristics. TYPE1_SHMT1: TYPE 1 buffer is selected. TYPE2_SHMT4: TYPE 2 buffer is selected.
        container PortPin8  # This container contains the configuration (parameters) for Port Pin 0.
          boolean PortPinDirectionChangeable: set at post-build, origin=Renesas_v1.0.0, default-value=false  # Parameter to indicate if the direction is changeable on a port pin during runtime. true: Port Pin direction changeable enabled. false: Port Pin direction changeable disabled.
          boolean PortPinDioAltModeChangeable: set at post-build, origin=Renesas_v1.0.0, default-value=false  # Parameter to indicate if the mode of a port pin is changeable between DIO and Alternate during runtime by API functions Port_SetToDioMode and Port_SetToAlternateMode. Including these APIs is controlled by PortSetToDioAltModeApi. true: Dio Alternate mode is changeable. false: Dio Alternate mode is not changeable.
          boolean PortPinModeChangeable: set at post-build, origin=Renesas_v1.0.0, default-value=false  # Parameter to indicate if the mode of a port pin is changeable during runtime by API function Port_SetPinMode. Including this API is controlled by PortSetPinModeApi. true: Port Pin mode is changeable. false: Port Pin mode is not changeable.
          enumeration PortPinLevelValue: {PORT_PIN_LEVEL_LOW, PORT_PIN_LEVEL_HIGH}, set at post-build, origin=Renesas_v1.0.0, default-value=PORT_PIN_LEVEL_LOW  # Parameter to indicate port pin level value for a port pin. PORT_PIN_LEVEL_LOW: Port pin Level is low. PORT_PIN_LEVEL_HIGH: Port pin Level is high.
          enumeration PortPinInitialMode: {GTM1I1_ALT1_IN, GTMAT0O1N_ALT1_OUT, CSIH0CSS3_ALT2_OUT, EXTCLK0O_ALT3_OUT, HSURT1CSI_ALT4_IN, HSURT1CSO_ALT4_OUT, DIO}, set at post-build, origin=Renesas_v1.0.0, default-value=DIO  # Mode of the port pin for use with Port_Init() function. <Input name>_ALT<Alternative instance>_IN: Provides alternative instance for selected input. <Output name>_ALT<Alternative instance>_OUT: Provides alternative instance for selected output.
          enumeration PortPinDirection: {PORT_PIN_OUT, PORT_PIN_IN}, set at post-build, origin=Renesas_v1.0.0, default-value=PORT_PIN_IN  # The initial direction of the pin (IN or OUT). If the direction is not changeable, the value configured here is fixed. The direction must match the pin mode. PORT_PIN_IN: Port pin direction set as input. PORT_PIN_OUT: Port pin direction set as output.
          boolean PortInputBufferControl: set at post-build, origin=Renesas_v1.0.0, default-value=false  # This parameter is used as one of the factors to enable/disable port pins input buffer in DIO Mode (PMC=0). true: Port pin's input buffer is ready to be enabled in DIO Mode. false: Port pin's input buffer is disabled in DIO Mode.
          boolean PortBiDirectionControl: set at post-build, origin=Renesas_v1.0.0, default-value=false  # This parameter forces port pins input buffer and output buffer at the same time. If activated, the effect is valid independently from any other port settings. true: Activate forced Bi-directional IO buffer of the port pin. false: Deactivate forced Bi-directional IO buffer of the port pin.
          boolean PortIpControl: set at post-build, origin=Renesas_v1.0.0, default-value=false  # This parameter is used to enable/disable the direct IO control of port pins input buffer and output buffer. true: Enables the direct IO control of port pins input buffer and output buffer by the corresponding control signals of IP_ENI3(0) and IP_ENO3(0) from internal peripheral IPs. This register is valid only in Control Mode (PMC=1). false: Disables the direct IO control of port pins input buffer and output buffer.
          boolean PortPullUpOption: set at post-build, origin=Renesas_v1.0.0, default-value=false  # This register switches on or off the port pins pull-up resistor. true: Port pin's pull-up resistor is enabled. false: Port pin's pull-up resistor is disabled.
          boolean PortPullDownOption: set at post-build, origin=Renesas_v1.0.0, default-value=false  # This parameter switches on or off the port pins pull-down resistor. true: Port pin's pull-down resistor is enabled. false: Port pin's pull-down resistor is disabled.
          enumeration PortOpenDrainControl_Expansion: {PushPull, OpenDrain_N_Channel, OpenDrain_P_Channel}, set at post-build, origin=Renesas_v1.0.1, default-value=PushPull  # This parameter selects port pins output buffer function in combination of PODC and PODCE . | PushPull Specifies the PushPull type output circuit characteristics and updates both PODC and PODCE registers as 0 0 respectively. OpenDrain_N_Channel specifies the N-ch open drain type output circuit characteristics and updates the PODC and PODCE registers as 1 0 respectively. OpenDrain_P_Channel specifies the P-ch open drain type output circuit characteristics and updates the PODC and PODCE registers as 1 1 respectively.
          boolean PortOutputLevelInversion: set at post-build, origin=Renesas_v1.0.0, default-value=false  # This parameter specifies whether the output level from a pin is inverted or not.. true: Pin output level is inverted. false: Pin output level is not inverted.
          enumeration PortDriveStrengthControl: {SLOW, FAST}, set at post-build, origin=Renesas_v1.0.0, default-value=SLOW  # This parameter selects the port pins output drive strength as high strength or low strength type. This functionality is also referred to fast (high strength) and slow (low strength) behavior of output buffer. SLOW: Lower drive strength (slow mode) is selected for port pin's output buffer. FAST: Higher drive strength (fast mode) is selected for port pin's output buffer.
          boolean PortUniversalCharacteristicCntrl: set at post-build, origin=Renesas_v1.0.0, default-value=false  # This parameter selects the port pins output drive strength as high or low type. The PortDriveStrengthControl must be enabled for this feature. | false: PortDriveStrengthControl parameter specifies the output driver strength of the port pin. true : Number of output buffer characteristics selection capability is expanded, the maximum of 4 characteristics selection is possible PUCCn PDSCn 0 0 Output characteristic selection 1 (400 Ohm buffer) 0 1 Output characteristic selection 2 (200 Ohm buffer) 1 0 Output characteristic selection 3 (100 Ohm buffer) 1 1 Output characteristic selection 4 (50 Ohm buffer)
          enumeration PortInputSelection: {TYPE1_SHMT1, TYPE2_SHMT4}, set at post-build, origin=Renesas_v1.0.0, default-value=TYPE1_SHMT1  # This setting specifies the input buffer characteristics. TYPE1_SHMT1: TYPE 1 buffer is selected. TYPE2_SHMT4: TYPE 2 buffer is selected.
        container PortPin9  # This container contains the configuration (parameters) for Port Pin 0.
          boolean PortPinDirectionChangeable: set at post-build, origin=Renesas_v1.0.0, default-value=false  # Parameter to indicate if the direction is changeable on a port pin during runtime. true: Port Pin direction changeable enabled. false: Port Pin direction changeable disabled.
          boolean PortPinDioAltModeChangeable: set at post-build, origin=Renesas_v1.0.0, default-value=false  # Parameter to indicate if the mode of a port pin is changeable between DIO and Alternate during runtime by API functions Port_SetToDioMode and Port_SetToAlternateMode. Including these APIs is controlled by PortSetToDioAltModeApi. true: Dio Alternate mode is changeable. false: Dio Alternate mode is not changeable.
          boolean PortPinModeChangeable: set at post-build, origin=Renesas_v1.0.0, default-value=false  # Parameter to indicate if the mode of a port pin is changeable during runtime by API function Port_SetPinMode. Including this API is controlled by PortSetPinModeApi. true: Port Pin mode is changeable. false: Port Pin mode is not changeable.
          enumeration PortPinLevelValue: {PORT_PIN_LEVEL_LOW, PORT_PIN_LEVEL_HIGH}, set at post-build, origin=Renesas_v1.0.0, default-value=PORT_PIN_LEVEL_LOW  # Parameter to indicate port pin level value for a port pin. PORT_PIN_LEVEL_LOW: Port pin Level is low. PORT_PIN_LEVEL_HIGH: Port pin Level is high.
          enumeration PortPinInitialMode: {GTM1I4_ALT1_IN, GTMAT0O1N_ALT1_OUT, CSIH0CSS4_ALT2_OUT, RLIN30RX_ALT3_IN, HSURT1SDIR_ALT4_OUT, DIO}, set at post-build, origin=Renesas_v1.0.0, default-value=DIO  # Mode of the port pin for use with Port_Init() function. <Input name>_ALT<Alternative instance>_IN: Provides alternative instance for selected input. <Output name>_ALT<Alternative instance>_OUT: Provides alternative instance for selected output.
          enumeration PortPinDirection: {PORT_PIN_OUT, PORT_PIN_IN}, set at post-build, origin=Renesas_v1.0.0, default-value=PORT_PIN_IN  # The initial direction of the pin (IN or OUT). If the direction is not changeable, the value configured here is fixed. The direction must match the pin mode. PORT_PIN_IN: Port pin direction set as input. PORT_PIN_OUT: Port pin direction set as output.
          boolean PortInputBufferControl: set at post-build, origin=Renesas_v1.0.0, default-value=false  # This parameter is used as one of the factors to enable/disable port pins input buffer in DIO Mode (PMC=0). true: Port pin's input buffer is ready to be enabled in DIO Mode. false: Port pin's input buffer is disabled in DIO Mode.
          boolean PortBiDirectionControl: set at post-build, origin=Renesas_v1.0.0, default-value=false  # This parameter forces port pins input buffer and output buffer at the same time. If activated, the effect is valid independently from any other port settings. true: Activate forced Bi-directional IO buffer of the port pin. false: Deactivate forced Bi-directional IO buffer of the port pin.
          boolean PortIpControl: set at post-build, origin=Renesas_v1.0.0, default-value=false  # This parameter is used to enable/disable the direct IO control of port pins input buffer and output buffer. true: Enables the direct IO control of port pins input buffer and output buffer by the corresponding control signals of IP_ENI3(0) and IP_ENO3(0) from internal peripheral IPs. This register is valid only in Control Mode (PMC=1). false: Disables the direct IO control of port pins input buffer and output buffer.
          boolean PortPullUpOption: set at post-build, origin=Renesas_v1.0.0, default-value=false  # This register switches on or off the port pins pull-up resistor. true: Port pin's pull-up resistor is enabled. false: Port pin's pull-up resistor is disabled.
          boolean PortPullDownOption: set at post-build, origin=Renesas_v1.0.0, default-value=false  # This parameter switches on or off the port pins pull-down resistor. true: Port pin's pull-down resistor is enabled. false: Port pin's pull-down resistor is disabled.
          enumeration PortOpenDrainControl_Expansion: {PushPull, OpenDrain_N_Channel, OpenDrain_P_Channel}, set at post-build, origin=Renesas_v1.0.1, default-value=PushPull  # This parameter selects port pins output buffer function in combination of PODC and PODCE . | PushPull Specifies the PushPull type output circuit characteristics and updates both PODC and PODCE registers as 0 0 respectively. OpenDrain_N_Channel specifies the N-ch open drain type output circuit characteristics and updates the PODC and PODCE registers as 1 0 respectively. OpenDrain_P_Channel specifies the P-ch open drain type output circuit characteristics and updates the PODC and PODCE registers as 1 1 respectively.
          boolean PortOutputLevelInversion: set at post-build, origin=Renesas_v1.0.0, default-value=false  # This parameter specifies whether the output level from a pin is inverted or not.. true: Pin output level is inverted. false: Pin output level is not inverted.
          enumeration PortDriveStrengthControl: {SLOW, FAST}, set at post-build, origin=Renesas_v1.0.0, default-value=SLOW  # This parameter selects the port pins output drive strength as high strength or low strength type. This functionality is also referred to fast (high strength) and slow (low strength) behavior of output buffer. SLOW: Lower drive strength (slow mode) is selected for port pin's output buffer. FAST: Higher drive strength (fast mode) is selected for port pin's output buffer.
          boolean PortUniversalCharacteristicCntrl: set at post-build, origin=Renesas_v1.0.0, default-value=false  # This parameter selects the port pins output drive strength as high or low type. The PortDriveStrengthControl must be enabled for this feature. | false: PortDriveStrengthControl parameter specifies the output driver strength of the port pin. true : Number of output buffer characteristics selection capability is expanded, the maximum of 4 characteristics selection is possible PUCCn PDSCn 0 0 Output characteristic selection 1 (400 Ohm buffer) 0 1 Output characteristic selection 2 (200 Ohm buffer) 1 0 Output characteristic selection 3 (100 Ohm buffer) 1 1 Output characteristic selection 4 (50 Ohm buffer)
          enumeration PortInputSelection: {TYPE1_SHMT1, TYPE2_SHMT4}, set at post-build, origin=Renesas_v1.0.0, default-value=TYPE1_SHMT1  # This setting specifies the input buffer characteristics. TYPE1_SHMT1: TYPE 1 buffer is selected. TYPE2_SHMT4: TYPE 2 buffer is selected..
        container PortPin10  # This container contains the configuration (parameters) for Port Pin 0.
          boolean PortPinDirectionChangeable: set at post-build, origin=Renesas_v1.0.0, default-value=false  # Parameter to indicate if the direction is changeable on a port pin during runtime. true: Port Pin direction changeable enabled. false: Port Pin direction changeable disabled.
          boolean PortPinDioAltModeChangeable: set at post-build, origin=Renesas_v1.0.0, default-value=false  # Parameter to indicate if the mode of a port pin is changeable between DIO and Alternate during runtime by API functions Port_SetToDioMode and Port_SetToAlternateMode. Including these APIs is controlled by PortSetToDioAltModeApi. true: Dio Alternate mode is changeable. false: Dio Alternate mode is not changeable.
          boolean PortPinModeChangeable: set at post-build, origin=Renesas_v1.0.0, default-value=false  # Parameter to indicate if the mode of a port pin is changeable during runtime by API function Port_SetPinMode. Including this API is controlled by PortSetPinModeApi. true: Port Pin mode is changeable. false: Port Pin mode is not changeable.
          enumeration PortPinLevelValue: {PORT_PIN_LEVEL_LOW, PORT_PIN_LEVEL_HIGH}, set at post-build, origin=Renesas_v1.0.0, default-value=PORT_PIN_LEVEL_LOW  # Parameter to indicate port pin level value for a port pin. PORT_PIN_LEVEL_LOW: Port pin Level is low. PORT_PIN_LEVEL_HIGH: Port pin Level is high.
          enumeration PortPinInitialMode: {GTM1I7_ALT1_IN, GTMAT1O3_ALT1_OUT, CSIH2RYI_ALT2_IN, CSIH2RYO_ALT2_OUT, RLIN30TX_ALT3_OUT, CSIH3CSS3_ALT4_OUT, DIO}, set at post-build, origin=Renesas_v1.0.0, default-value=DIO  # Mode of the port pin for use with Port_Init() function. <Input name>_ALT<Alternative instance>_IN: Provides alternative instance for selected input. <Output name>_ALT<Alternative instance>_OUT: Provides alternative instance for selected output.
          enumeration PortPinDirection: {PORT_PIN_OUT, PORT_PIN_IN}, set at post-build, origin=Renesas_v1.0.0, default-value=PORT_PIN_IN  # The initial direction of the pin (IN or OUT). If the direction is not changeable, the value configured here is fixed. The direction must match the pin mode. PORT_PIN_IN: Port pin direction set as input. PORT_PIN_OUT: Port pin direction set as output.
          boolean PortInputBufferControl: set at post-build, origin=Renesas_v1.0.0, default-value=false  # This parameter is used as one of the factors to enable/disable port pins input buffer in DIO Mode (PMC=0). true: Port pin's input buffer is ready to be enabled in DIO Mode. false: Port pin's input buffer is disabled in DIO Mode.
          boolean PortBiDirectionControl: set at post-build, origin=Renesas_v1.0.0, default-value=false  # This parameter forces port pins input buffer and output buffer at the same time. If activated, the effect is valid independently from any other port settings. true: Activate forced Bi-directional IO buffer of the port pin. false: Deactivate forced Bi-directional IO buffer of the port pin.
          boolean PortIpControl: set at post-build, origin=Renesas_v1.0.0, default-value=false  # This parameter is used to enable/disable the direct IO control of port pins input buffer and output buffer. true: Enables the direct IO control of port pins input buffer and output buffer by the corresponding control signals of IP_ENI3(0) and IP_ENO3(0) from internal peripheral IPs. This register is valid only in Control Mode (PMC=1). false: Disables the direct IO control of port pins input buffer and output buffer.
          boolean PortPullUpOption: set at post-build, origin=Renesas_v1.0.0, default-value=false  # This register switches on or off the port pins pull-up resistor. true: Port pin's pull-up resistor is enabled. false: Port pin's pull-up resistor is disabled.
          boolean PortPullDownOption: set at post-build, origin=Renesas_v1.0.0, default-value=false  # This parameter switches on or off the port pins pull-down resistor. true: Port pin's pull-down resistor is enabled. false: Port pin's pull-down resistor is disabled.
          enumeration PortOpenDrainControl_Expansion: {PushPull, OpenDrain_N_Channel, OpenDrain_P_Channel}, set at post-build, origin=Renesas_v1.0.1, default-value=PushPull  # This parameter selects port pins output buffer function in combination of PODC and PODCE . | PushPull Specifies the PushPull type output circuit characteristics and updates both PODC and PODCE registers as 0 0 respectively. OpenDrain_N_Channel specifies the N-ch open drain type output circuit characteristics and updates the PODC and PODCE registers as 1 0 respectively. OpenDrain_P_Channel specifies the P-ch open drain type output circuit characteristics and updates the PODC and PODCE registers as 1 1 respectively.
          boolean PortOutputLevelInversion: set at post-build, origin=Renesas_v1.0.0, default-value=false  # This parameter specifies whether the output level from a pin is inverted or not.. true: Pin output level is inverted. false: Pin output level is not inverted.
          enumeration PortDriveStrengthControl: {SLOW, FAST}, set at post-build, origin=Renesas_v1.0.0, default-value=SLOW  # This parameter selects the port pins output drive strength as high strength or low strength type. This functionality is also referred to fast (high strength) and slow (low strength) behavior of output buffer. SLOW: Lower drive strength (slow mode) is selected for port pin's output buffer. FAST: Higher drive strength (fast mode) is selected for port pin's output buffer.
          boolean PortUniversalCharacteristicCntrl: set at post-build, origin=Renesas_v1.0.0, default-value=false  # This parameter selects the port pins output drive strength as high or low type. The PortDriveStrengthControl must be enabled for this feature. | false: PortDriveStrengthControl parameter specifies the output driver strength of the port pin. true : Number of output buffer characteristics selection capability is expanded, the maximum of 4 characteristics selection is possible PUCCn PDSCn 0 0 Output characteristic selection 1 (400 Ohm buffer) 0 1 Output characteristic selection 2 (200 Ohm buffer) 1 0 Output characteristic selection 3 (100 Ohm buffer) 1 1 Output characteristic selection 4 (50 Ohm buffer)
          enumeration PortInputSelection: {TYPE1_SHMT1, TYPE2_SHMT4}, set at post-build, origin=Renesas_v1.0.0, default-value=TYPE1_SHMT1  # This setting specifies the input buffer characteristics. TYPE1_SHMT1: TYPE 1 buffer is selected. TYPE2_SHMT4: TYPE 2 buffer is selected.
        container PortPin11  # This container contains the configuration (parameters) for Port Pin 0.
          boolean PortPinDirectionChangeable: set at post-build, origin=Renesas_v1.0.0, default-value=false  # Parameter to indicate if the direction is changeable on a port pin during runtime. true: Port Pin direction changeable enabled. false: Port Pin direction changeable disabled.
          boolean PortPinDioAltModeChangeable: set at post-build, origin=Renesas_v1.0.0, default-value=false  # Parameter to indicate if the mode of a port pin is changeable between DIO and Alternate during runtime by API functions Port_SetToDioMode and Port_SetToAlternateMode. Including these APIs is controlled by PortSetToDioAltModeApi. true: Dio Alternate mode is changeable. false: Dio Alternate mode is not changeable.
          boolean PortPinModeChangeable: set at post-build, origin=Renesas_v1.0.0, default-value=false  # Parameter to indicate if the mode of a port pin is changeable during runtime by API function Port_SetPinMode. Including this API is controlled by PortSetPinModeApi. true: Port Pin mode is changeable. false: Port Pin mode is not changeable.
          enumeration PortPinLevelValue: {PORT_PIN_LEVEL_LOW, PORT_PIN_LEVEL_HIGH}, set at post-build, origin=Renesas_v1.0.0, default-value=PORT_PIN_LEVEL_LOW  # Parameter to indicate port pin level value for a port pin. PORT_PIN_LEVEL_LOW: Port pin Level is low. PORT_PIN_LEVEL_HIGH: Port pin Level is high.
          enumeration PortPinInitialMode: {GTM1I4_ALT1_IN, GTMAT1O3_ALT1_OUT, CSIH2CSS4_ALT2_OUT, CSIH0SI1_ALT3_IN, DIO}, set at post-build, origin=Renesas_v1.0.0, default-value=DIO  # Mode of the port pin for use with Port_Init() function. <Input name>_ALT<Alternative instance>_IN: Provides alternative instance for selected input. <Output name>_ALT<Alternative instance>_OUT: Provides alternative instance for selected output.
          enumeration PortPinDirection: {PORT_PIN_OUT, PORT_PIN_IN}, set at post-build, origin=Renesas_v1.0.0, default-value=PORT_PIN_IN  # The initial direction of the pin (IN or OUT). If the direction is not changeable, the value configured here is fixed. The direction must match the pin mode. PORT_PIN_IN: Port pin direction set as input. PORT_PIN_OUT: Port pin direction set as output.
          boolean PortInputBufferControl: set at post-build, origin=Renesas_v1.0.0, default-value=false  # This parameter is used as one of the factors to enable/disable port pins input buffer in DIO Mode (PMC=0). true: Port pin's input buffer is ready to be enabled in DIO Mode. false: Port pin's input buffer is disabled in DIO Mode.
          boolean PortBiDirectionControl: set at post-build, origin=Renesas_v1.0.0, default-value=false  # This parameter forces port pins input buffer and output buffer at the same time. If activated, the effect is valid independently from any other port settings. true: Activate forced Bi-directional IO buffer of the port pin. false: Deactivate forced Bi-directional IO buffer of the port pin.
          boolean PortIpControl: set at post-build, origin=Renesas_v1.0.0, default-value=false  # This parameter is used to enable/disable the direct IO control of port pins input buffer and output buffer. true: Enables the direct IO control of port pins input buffer and output buffer by the corresponding control signals of IP_ENI3(0) and IP_ENO3(0) from internal peripheral IPs. This register is valid only in Control Mode (PMC=1). false: Disables the direct IO control of port pins input buffer and output buffer.
          boolean PortPullUpOption: set at post-build, origin=Renesas_v1.0.0, default-value=false  # This register switches on or off the port pins pull-up resistor. true: Port pin's pull-up resistor is enabled. false: Port pin's pull-up resistor is disabled.
          boolean PortPullDownOption: set at post-build, origin=Renesas_v1.0.0, default-value=false  # This parameter switches on or off the port pins pull-down resistor. true: Port pin's pull-down resistor is enabled. false: Port pin's pull-down resistor is disabled.
          enumeration PortOpenDrainControl_Expansion: {PushPull, OpenDrain_N_Channel, OpenDrain_P_Channel}, set at post-build, origin=Renesas_v1.0.1, default-value=PushPull  # This parameter selects port pins output buffer function in combination of PODC and PODCE . | PushPull Specifies the PushPull type output circuit characteristics and updates both PODC and PODCE registers as 0 0 respectively. OpenDrain_N_Channel specifies the N-ch open drain type output circuit characteristics and updates the PODC and PODCE registers as 1 0 respectively. OpenDrain_P_Channel specifies the P-ch open drain type output circuit characteristics and updates the PODC and PODCE registers as 1 1 respectively.
          boolean PortOutputLevelInversion: set at post-build, origin=Renesas_v1.0.0, default-value=false  # This parameter specifies whether the output level from a pin is inverted or not.. true: Pin output level is inverted. false: Pin output level is not inverted.
          enumeration PortDriveStrengthControl: {SLOW, FAST}, set at post-build, origin=Renesas_v1.0.0, default-value=SLOW  # This parameter selects the port pins output drive strength as high strength or low strength type. This functionality is also referred to fast (high strength) and slow (low strength) behavior of output buffer. SLOW: Lower drive strength (slow mode) is selected for port pin's output buffer. FAST: Higher drive strength (fast mode) is selected for port pin's output buffer.
          boolean PortUniversalCharacteristicCntrl: set at post-build, origin=Renesas_v1.0.0, default-value=false  # This parameter selects the port pins output drive strength as high or low type. The PortDriveStrengthControl must be enabled for this feature. | false: PortDriveStrengthControl parameter specifies the output driver strength of the port pin. true : Number of output buffer characteristics selection capability is expanded, the maximum of 4 characteristics selection is possible PUCCn PDSCn 0 0 Output characteristic selection 1 (400 Ohm buffer) 0 1 Output characteristic selection 2 (200 Ohm buffer) 1 0 Output characteristic selection 3 (100 Ohm buffer) 1 1 Output characteristic selection 4 (50 Ohm buffer)
          enumeration PortInputSelection: {TYPE1_SHMT1, TYPE2_SHMT4}, set at post-build, origin=Renesas_v1.0.0, default-value=TYPE1_SHMT1  # This setting specifies the input buffer characteristics. TYPE1_SHMT1: TYPE 1 buffer is selected. TYPE2_SHMT4: TYPE 2 buffer is selected.
        container PortPin12  # This container contains the configuration (parameters) for Port Pin 0.
          boolean PortPinDirectionChangeable: set at post-build, origin=Renesas_v1.0.0, default-value=false  # Parameter to indicate if the direction is changeable on a port pin during runtime. true: Port Pin direction changeable enabled. false: Port Pin direction changeable disabled.
          boolean PortPinDioAltModeChangeable: set at post-build, origin=Renesas_v1.0.0, default-value=false  # Parameter to indicate if the mode of a port pin is changeable between DIO and Alternate during runtime by API functions Port_SetToDioMode and Port_SetToAlternateMode. Including these APIs is controlled by PortSetToDioAltModeApi. true: Dio Alternate mode is changeable. false: Dio Alternate mode is not changeable.
          boolean PortPinModeChangeable: set at post-build, origin=Renesas_v1.0.0, default-value=false  # Parameter to indicate if the mode of a port pin is changeable during runtime by API function Port_SetPinMode. Including this API is controlled by PortSetPinModeApi. true: Port Pin mode is changeable. false: Port Pin mode is not changeable.
          enumeration PortPinLevelValue: {PORT_PIN_LEVEL_LOW, PORT_PIN_LEVEL_HIGH}, set at post-build, origin=Renesas_v1.0.0, default-value=PORT_PIN_LEVEL_LOW  # Parameter to indicate port pin level value for a port pin. PORT_PIN_LEVEL_LOW: Port pin Level is low. PORT_PIN_LEVEL_HIGH: Port pin Level is high.
          enumeration PortPinInitialMode: {GTM0I4_ALT1_IN, GTMAT1O3N_ALT1_OUT, CSIH2CSS5_ALT2_OUT, CSIH0SCI1_ALT3_IN, CSIH0SCO1_ALT3_OUT, DIO}, set at post-build, origin=Renesas_v1.0.0, default-value=DIO  # Mode of the port pin for use with Port_Init() function. <Input name>_ALT<Alternative instance>_IN: Provides alternative instance for selected input. <Output name>_ALT<Alternative instance>_OUT: Provides alternative instance for selected output.
          enumeration PortPinDirection: {PORT_PIN_OUT, PORT_PIN_IN}, set at post-build, origin=Renesas_v1.0.0, default-value=PORT_PIN_IN  # The initial direction of the pin (IN or OUT). If the direction is not changeable, the value configured here is fixed. The direction must match the pin mode. PORT_PIN_IN: Port pin direction set as input. PORT_PIN_OUT: Port pin direction set as output.
          boolean PortInputBufferControl: set at post-build, origin=Renesas_v1.0.0, default-value=false  # This parameter is used as one of the factors to enable/disable port pins input buffer in DIO Mode (PMC=0). true: Port pin's input buffer is ready to be enabled in DIO Mode. false: Port pin's input buffer is disabled in DIO Mode.
          boolean PortBiDirectionControl: set at post-build, origin=Renesas_v1.0.0, default-value=false  # This parameter forces port pins input buffer and output buffer at the same time. If activated, the effect is valid independently from any other port settings. true: Activate forced Bi-directional IO buffer of the port pin. false: Deactivate forced Bi-directional IO buffer of the port pin.
          boolean PortIpControl: set at post-build, origin=Renesas_v1.0.0, default-value=false  # This parameter is used to enable/disable the direct IO control of port pins input buffer and output buffer. true: Enables the direct IO control of port pins input buffer and output buffer by the corresponding control signals of IP_ENI3(0) and IP_ENO3(0) from internal peripheral IPs. This register is valid only in Control Mode (PMC=1). false: Disables the direct IO control of port pins input buffer and output buffer.
          boolean PortPullUpOption: set at post-build, origin=Renesas_v1.0.0, default-value=false  # This register switches on or off the port pins pull-up resistor. true: Port pin's pull-up resistor is enabled. false: Port pin's pull-up resistor is disabled.
          boolean PortPullDownOption: set at post-build, origin=Renesas_v1.0.0, default-value=false  # This parameter switches on or off the port pins pull-down resistor. true: Port pin's pull-down resistor is enabled. false: Port pin's pull-down resistor is disabled.
          enumeration PortOpenDrainControl_Expansion: {PushPull, OpenDrain_N_Channel, OpenDrain_P_Channel}, set at post-build, origin=Renesas_v1.0.1, default-value=PushPull  # This parameter selects port pins output buffer function in combination of PODC and PODCE . | PushPull Specifies the PushPull type output circuit characteristics and updates both PODC and PODCE registers as 0 0 respectively. OpenDrain_N_Channel specifies the N-ch open drain type output circuit characteristics and updates the PODC and PODCE registers as 1 0 respectively. OpenDrain_P_Channel specifies the P-ch open drain type output circuit characteristics and updates the PODC and PODCE registers as 1 1 respectively.
          boolean PortOutputLevelInversion: set at post-build, origin=Renesas_v1.0.0, default-value=false  # This parameter specifies whether the output level from a pin is inverted or not.. true: Pin output level is inverted. false: Pin output level is not inverted.
          enumeration PortDriveStrengthControl: {SLOW, FAST}, set at post-build, origin=Renesas_v1.0.0, default-value=SLOW  # This parameter selects the port pins output drive strength as high strength or low strength type. This functionality is also referred to fast (high strength) and slow (low strength) behavior of output buffer. SLOW: Lower drive strength (slow mode) is selected for port pin's output buffer. FAST: Higher drive strength (fast mode) is selected for port pin's output buffer.
          boolean PortUniversalCharacteristicCntrl: set at post-build, origin=Renesas_v1.0.0, default-value=false  # This parameter selects the port pins output drive strength as high or low type. The PortDriveStrengthControl must be enabled for this feature. | false: PortDriveStrengthControl parameter specifies the output driver strength of the port pin. true : Number of output buffer characteristics selection capability is expanded, the maximum of 4 characteristics selection is possible PUCCn PDSCn 0 0 Output characteristic selection 1 (400 Ohm buffer) 0 1 Output characteristic selection 2 (200 Ohm buffer) 1 0 Output characteristic selection 3 (100 Ohm buffer) 1 1 Output characteristic selection 4 (50 Ohm buffer)
          enumeration PortInputSelection: {TYPE1_SHMT1, TYPE2_SHMT4}, set at post-build, origin=Renesas_v1.0.0, default-value=TYPE1_SHMT1  # This setting specifies the input buffer characteristics. TYPE1_SHMT1: TYPE 1 buffer is selected. TYPE2_SHMT4: TYPE 2 buffer is selected.
        container PortPin13  # This container contains the configuration (parameters) for Port Pin 0.
          boolean PortPinDirectionChangeable: set at post-build, origin=Renesas_v1.0.0, default-value=false  # Parameter to indicate if the direction is changeable on a port pin during runtime. true: Port Pin direction changeable enabled. false: Port Pin direction changeable disabled.
          boolean PortPinDioAltModeChangeable: set at post-build, origin=Renesas_v1.0.0, default-value=false  # Parameter to indicate if the mode of a port pin is changeable between DIO and Alternate during runtime by API functions Port_SetToDioMode and Port_SetToAlternateMode. Including these APIs is controlled by PortSetToDioAltModeApi. true: Dio Alternate mode is changeable. false: Dio Alternate mode is not changeable.
          boolean PortPinModeChangeable: set at post-build, origin=Renesas_v1.0.0, default-value=false  # Parameter to indicate if the mode of a port pin is changeable during runtime by API function Port_SetPinMode. Including this API is controlled by PortSetPinModeApi. true: Port Pin mode is changeable. false: Port Pin mode is not changeable.
          enumeration PortPinLevelValue: {PORT_PIN_LEVEL_LOW, PORT_PIN_LEVEL_HIGH}, set at post-build, origin=Renesas_v1.0.0, default-value=PORT_PIN_LEVEL_LOW  # Parameter to indicate port pin level value for a port pin. PORT_PIN_LEVEL_LOW: Port pin Level is low. PORT_PIN_LEVEL_HIGH: Port pin Level is high.
          enumeration PortPinInitialMode: {GTM1I2_ALT1_IN, GTMAT1O1_ALT1_OUT, CSIH2CSS6_ALT2_OUT, CSIH0DCS_ALT3_IN, CSIH0SO1_ALT3_OUT, DIO}, set at post-build, origin=Renesas_v1.0.0, default-value=DIO  # Mode of the port pin for use with Port_Init() function. <Input name>_ALT<Alternative instance>_IN: Provides alternative instance for selected input. <Output name>_ALT<Alternative instance>_OUT: Provides alternative instance for selected output.
          enumeration PortPinDirection: {PORT_PIN_OUT, PORT_PIN_IN}, set at post-build, origin=Renesas_v1.0.0, default-value=PORT_PIN_IN  # The initial direction of the pin (IN or OUT). If the direction is not changeable, the value configured here is fixed. The direction must match the pin mode. PORT_PIN_IN: Port pin direction set as input. PORT_PIN_OUT: Port pin direction set as output.
          boolean PortInputBufferControl: set at post-build, origin=Renesas_v1.0.0, default-value=false  # This parameter is used as one of the factors to enable/disable port pins input buffer in DIO Mode (PMC=0). true: Port pin's input buffer is ready to be enabled in DIO Mode. false: Port pin's input buffer is disabled in DIO Mode.
          boolean PortBiDirectionControl: set at post-build, origin=Renesas_v1.0.0, default-value=false  # This parameter forces port pins input buffer and output buffer at the same time. If activated, the effect is valid independently from any other port settings. true: Activate forced Bi-directional IO buffer of the port pin. false: Deactivate forced Bi-directional IO buffer of the port pin.
          boolean PortIpControl: set at post-build, origin=Renesas_v1.0.0, default-value=false  # This parameter is used to enable/disable the direct IO control of port pins input buffer and output buffer. true: Enables the direct IO control of port pins input buffer and output buffer by the corresponding control signals of IP_ENI3(0) and IP_ENO3(0) from internal peripheral IPs. This register is valid only in Control Mode (PMC=1). false: Disables the direct IO control of port pins input buffer and output buffer.
          boolean PortPullUpOption: set at post-build, origin=Renesas_v1.0.0, default-value=false  # This register switches on or off the port pins pull-up resistor. true: Port pin's pull-up resistor is enabled. false: Port pin's pull-up resistor is disabled.
          boolean PortPullDownOption: set at post-build, origin=Renesas_v1.0.0, default-value=false  # This parameter switches on or off the port pins pull-down resistor. true: Port pin's pull-down resistor is enabled. false: Port pin's pull-down resistor is disabled.
          enumeration PortOpenDrainControl_Expansion: {PushPull, OpenDrain_N_Channel, OpenDrain_P_Channel}, set at post-build, origin=Renesas_v1.0.1, default-value=PushPull  # This parameter selects port pins output buffer function in combination of PODC and PODCE . | PushPull Specifies the PushPull type output circuit characteristics and updates both PODC and PODCE registers as 0 0 respectively. OpenDrain_N_Channel specifies the N-ch open drain type output circuit characteristics and updates the PODC and PODCE registers as 1 0 respectively. OpenDrain_P_Channel specifies the P-ch open drain type output circuit characteristics and updates the PODC and PODCE registers as 1 1 respectively.
          boolean PortOutputLevelInversion: set at post-build, origin=Renesas_v1.0.0, default-value=false  # This parameter specifies whether the output level from a pin is inverted or not.. true: Pin output level is inverted. false: Pin output level is not inverted.
          enumeration PortDriveStrengthControl: {SLOW, FAST}, set at post-build, origin=Renesas_v1.0.0, default-value=SLOW  # This parameter selects the port pins output drive strength as high strength or low strength type. This functionality is also referred to fast (high strength) and slow (low strength) behavior of output buffer. SLOW: Lower drive strength (slow mode) is selected for port pin's output buffer. FAST: Higher drive strength (fast mode) is selected for port pin's output buffer.
          boolean PortUniversalCharacteristicCntrl: set at post-build, origin=Renesas_v1.0.0, default-value=false  # This parameter selects the port pins output drive strength as high or low type. The PortDriveStrengthControl must be enabled for this feature. | false: PortDriveStrengthControl parameter specifies the output driver strength of the port pin. true : Number of output buffer characteristics selection capability is expanded, the maximum of 4 characteristics selection is possible PUCCn PDSCn 0 0 Output characteristic selection 1 (400 Ohm buffer) 0 1 Output characteristic selection 2 (200 Ohm buffer) 1 0 Output characteristic selection 3 (100 Ohm buffer) 1 1 Output characteristic selection 4 (50 Ohm buffer)
          enumeration PortInputSelection: {TYPE1_SHMT1, TYPE2_SHMT4}, set at post-build, origin=Renesas_v1.0.0, default-value=TYPE1_SHMT1  # This setting specifies the input buffer characteristics. TYPE1_SHMT1: TYPE 1 buffer is selected. TYPE2_SHMT4: TYPE 2 buffer is selected.
        container PortPin14  # This container contains the configuration (parameters) for Port Pin 0.
          boolean PortPinDirectionChangeable: set at post-build, origin=Renesas_v1.0.0, default-value=false  # Parameter to indicate if the direction is changeable on a port pin during runtime. true: Port Pin direction changeable enabled. false: Port Pin direction changeable disabled.
          boolean PortPinDioAltModeChangeable: set at post-build, origin=Renesas_v1.0.0, default-value=false  # Parameter to indicate if the mode of a port pin is changeable between DIO and Alternate during runtime by API functions Port_SetToDioMode and Port_SetToAlternateMode. Including these APIs is controlled by PortSetToDioAltModeApi. true: Dio Alternate mode is changeable. false: Dio Alternate mode is not changeable.
          boolean PortPinModeChangeable: set at post-build, origin=Renesas_v1.0.0, default-value=false  # Parameter to indicate if the mode of a port pin is changeable during runtime by API function Port_SetPinMode. Including this API is controlled by PortSetPinModeApi. true: Port Pin mode is changeable. false: Port Pin mode is not changeable.
          enumeration PortPinLevelValue: {PORT_PIN_LEVEL_LOW, PORT_PIN_LEVEL_HIGH}, set at post-build, origin=Renesas_v1.0.0, default-value=PORT_PIN_LEVEL_LOW  # Parameter to indicate port pin level value for a port pin. PORT_PIN_LEVEL_LOW: Port pin Level is low. PORT_PIN_LEVEL_HIGH: Port pin Level is high.
          enumeration PortPinInitialMode: {GTM1I4_ALT1_IN, GTMAT1O3N_ALT1_OUT, CSIH2CSS7_ALT2_OUT, CSIH0CSS0_ALT3_OUT, CSIH0CSS7_ALT4_OUT, DIO}, set at post-build, origin=Renesas_v1.0.0, default-value=DIO  # Mode of the port pin for use with Port_Init() function. <Input name>_ALT<Alternative instance>_IN: Provides alternative instance for selected input. <Output name>_ALT<Alternative instance>_OUT: Provides alternative instance for selected output.
          enumeration PortPinDirection: {PORT_PIN_OUT, PORT_PIN_IN}, set at post-build, origin=Renesas_v1.0.0, default-value=PORT_PIN_IN  # The initial direction of the pin (IN or OUT). If the direction is not changeable, the value configured here is fixed. The direction must match the pin mode. PORT_PIN_IN: Port pin direction set as input. PORT_PIN_OUT: Port pin direction set as output.
          boolean PortInputBufferControl: set at post-build, origin=Renesas_v1.0.0, default-value=false  # This parameter is used as one of the factors to enable/disable port pins input buffer in DIO Mode (PMC=0). true: Port pin's input buffer is ready to be enabled in DIO Mode. false: Port pin's input buffer is disabled in DIO Mode.
          boolean PortBiDirectionControl: set at post-build, origin=Renesas_v1.0.0, default-value=false  # This parameter forces port pins input buffer and output buffer at the same time. If activated, the effect is valid independently from any other port settings. true: Activate forced Bi-directional IO buffer of the port pin. false: Deactivate forced Bi-directional IO buffer of the port pin.
          boolean PortIpControl: set at post-build, origin=Renesas_v1.0.0, default-value=false  # This parameter is used to enable/disable the direct IO control of port pins input buffer and output buffer. true: Enables the direct IO control of port pins input buffer and output buffer by the corresponding control signals of IP_ENI3(0) and IP_ENO3(0) from internal peripheral IPs. This register is valid only in Control Mode (PMC=1). false: Disables the direct IO control of port pins input buffer and output buffer.
          boolean PortPullUpOption: set at post-build, origin=Renesas_v1.0.0, default-value=false  # This register switches on or off the port pins pull-up resistor. true: Port pin's pull-up resistor is enabled. false: Port pin's pull-up resistor is disabled.
          boolean PortPullDownOption: set at post-build, origin=Renesas_v1.0.0, default-value=false  # This parameter switches on or off the port pins pull-down resistor. true: Port pin's pull-down resistor is enabled. false: Port pin's pull-down resistor is disabled.
          enumeration PortOpenDrainControl_Expansion: {PushPull, OpenDrain_N_Channel, OpenDrain_P_Channel}, set at post-build, origin=Renesas_v1.0.1, default-value=PushPull  # This parameter selects port pins output buffer function in combination of PODC and PODCE . | PushPull Specifies the PushPull type output circuit characteristics and updates both PODC and PODCE registers as 0 0 respectively. OpenDrain_N_Channel specifies the N-ch open drain type output circuit characteristics and updates the PODC and PODCE registers as 1 0 respectively. OpenDrain_P_Channel specifies the P-ch open drain type output circuit characteristics and updates the PODC and PODCE registers as 1 1 respectively.
          boolean PortOutputLevelInversion: set at post-build, origin=Renesas_v1.0.0, default-value=false  # This parameter specifies whether the output level from a pin is inverted or not.. true: Pin output level is inverted. false: Pin output level is not inverted.
          enumeration PortDriveStrengthControl: {SLOW, FAST}, set at post-build, origin=Renesas_v1.0.0, default-value=SLOW  # This parameter selects the port pins output drive strength as high strength or low strength type. This functionality is also referred to fast (high strength) and slow (low strength) behavior of output buffer. SLOW: Lower drive strength (slow mode) is selected for port pin's output buffer. FAST: Higher drive strength (fast mode) is selected for port pin's output buffer.
          boolean PortUniversalCharacteristicCntrl: set at post-build, origin=Renesas_v1.0.0, default-value=false  # This parameter selects the port pins output drive strength as high or low type. The PortDriveStrengthControl must be enabled for this feature. | false: PortDriveStrengthControl parameter specifies the output driver strength of the port pin. true : Number of output buffer characteristics selection capability is expanded, the maximum of 4 characteristics selection is possible PUCCn PDSCn 0 0 Output characteristic selection 1 (400 Ohm buffer) 0 1 Output characteristic selection 2 (200 Ohm buffer) 1 0 Output characteristic selection 3 (100 Ohm buffer) 1 1 Output characteristic selection 4 (50 Ohm buffer)
          enumeration PortInputSelection: {TYPE1_SHMT1, TYPE2_SHMT4}, set at post-build, origin=Renesas_v1.0.0, default-value=TYPE1_SHMT1  # This setting specifies the input buffer characteristics. TYPE1_SHMT1: TYPE 1 buffer is selected. TYPE2_SHMT4: TYPE 2 buffer is selected.
        container PortPin15  # This container contains the configuration (parameters) for Port Pin 0.
          boolean PortPinDirectionChangeable: set at post-build, origin=Renesas_v1.0.0, default-value=false  # Parameter to indicate if the direction is changeable on a port pin during runtime. true: Port Pin direction changeable enabled. false: Port Pin direction changeable disabled.
          boolean PortPinDioAltModeChangeable: set at post-build, origin=Renesas_v1.0.0, default-value=false  # Parameter to indicate if the mode of a port pin is changeable between DIO and Alternate during runtime by API functions Port_SetToDioMode and Port_SetToAlternateMode. Including these APIs is controlled by PortSetToDioAltModeApi. true: Dio Alternate mode is changeable. false: Dio Alternate mode is not changeable.
          boolean PortPinModeChangeable: set at post-build, origin=Renesas_v1.0.0, default-value=false  # Parameter to indicate if the mode of a port pin is changeable during runtime by API function Port_SetPinMode. Including this API is controlled by PortSetPinModeApi. true: Port Pin mode is changeable. false: Port Pin mode is not changeable.
          enumeration PortPinLevelValue: {PORT_PIN_LEVEL_LOW, PORT_PIN_LEVEL_HIGH}, set at post-build, origin=Renesas_v1.0.0, default-value=PORT_PIN_LEVEL_LOW  # Parameter to indicate port pin level value for a port pin. PORT_PIN_LEVEL_LOW: Port pin Level is low. PORT_PIN_LEVEL_HIGH: Port pin Level is high.
          enumeration PortPinInitialMode: {GTM1I7_ALT1_IN, GTMAT0O3_ALT1_OUT, EXTCLK0O_ALT2_OUT, DIO}, set at post-build, origin=Renesas_v1.0.0, default-value=DIO  # Mode of the port pin for use with Port_Init() function. <Input name>_ALT<Alternative instance>_IN: Provides alternative instance for selected input. <Output name>_ALT<Alternative instance>_OUT: Provides alternative instance for selected output.
          enumeration PortPinDirection: {PORT_PIN_OUT, PORT_PIN_IN}, set at post-build, origin=Renesas_v1.0.0, default-value=PORT_PIN_IN  # The initial direction of the pin (IN or OUT). If the direction is not changeable, the value configured here is fixed. The direction must match the pin mode. PORT_PIN_IN: Port pin direction set as input. PORT_PIN_OUT: Port pin direction set as output.
          boolean PortInputBufferControl: set at post-build, origin=Renesas_v1.0.0, default-value=false  # This parameter is used as one of the factors to enable/disable port pins input buffer in DIO Mode (PMC=0). true: Port pin's input buffer is ready to be enabled in DIO Mode. false: Port pin's input buffer is disabled in DIO Mode.
          boolean PortBiDirectionControl: set at post-build, origin=Renesas_v1.0.0, default-value=false  # This parameter forces port pins input buffer and output buffer at the same time. If activated, the effect is valid independently from any other port settings. true: Activate forced Bi-directional IO buffer of the port pin. false: Deactivate forced Bi-directional IO buffer of the port pin.
          boolean PortIpControl: set at post-build, origin=Renesas_v1.0.0, default-value=false  # This parameter is used to enable/disable the direct IO control of port pins input buffer and output buffer. true: Enables the direct IO control of port pins input buffer and output buffer by the corresponding control signals of IP_ENI3(0) and IP_ENO3(0) from internal peripheral IPs. This register is valid only in Control Mode (PMC=1). false: Disables the direct IO control of port pins input buffer and output buffer.
          boolean PortPullUpOption: set at post-build, origin=Renesas_v1.0.0, default-value=false  # This register switches on or off the port pins pull-up resistor. true: Port pin's pull-up resistor is enabled. false: Port pin's pull-up resistor is disabled.
          boolean PortPullDownOption: set at post-build, origin=Renesas_v1.0.0, default-value=false  # This parameter switches on or off the port pins pull-down resistor. true: Port pin's pull-down resistor is enabled. false: Port pin's pull-down resistor is disabled.
          enumeration PortOpenDrainControl_Expansion: {PushPull, OpenDrain_N_Channel, OpenDrain_P_Channel}, set at post-build, origin=Renesas_v1.0.1, default-value=PushPull  # This parameter selects port pins output buffer function in combination of PODC and PODCE . | PushPull Specifies the PushPull type output circuit characteristics and updates both PODC and PODCE registers as 0 0 respectively. OpenDrain_N_Channel specifies the N-ch open drain type output circuit characteristics and updates the PODC and PODCE registers as 1 0 respectively. OpenDrain_P_Channel specifies the P-ch open drain type output circuit characteristics and updates the PODC and PODCE registers as 1 1 respectively.
          boolean PortOutputLevelInversion: set at post-build, origin=Renesas_v1.0.0, default-value=false  # This parameter specifies whether the output level from a pin is inverted or not.. true: Pin output level is inverted. false: Pin output level is not inverted.
          enumeration PortDriveStrengthControl: {SLOW, FAST}, set at post-build, origin=Renesas_v1.0.0, default-value=SLOW  # This parameter selects the port pins output drive strength as high strength or low strength type. This functionality is also referred to fast (high strength) and slow (low strength) behavior of output buffer. SLOW: Lower drive strength (slow mode) is selected for port pin's output buffer. FAST: Higher drive strength (fast mode) is selected for port pin's output buffer.
          boolean PortUniversalCharacteristicCntrl: set at post-build, origin=Renesas_v1.0.0, default-value=false  # This parameter selects the port pins output drive strength as high or low type. The PortDriveStrengthControl must be enabled for this feature. | false: PortDriveStrengthControl parameter specifies the output driver strength of the port pin. true : Number of output buffer characteristics selection capability is expanded, the maximum of 4 characteristics selection is possible PUCCn PDSCn 0 0 Output characteristic selection 1 (400 Ohm buffer) 0 1 Output characteristic selection 2 (200 Ohm buffer) 1 0 Output characteristic selection 3 (100 Ohm buffer) 1 1 Output characteristic selection 4 (50 Ohm buffer)
          enumeration PortInputSelection: {TYPE1_SHMT1, TYPE2_SHMT4}, set at post-build, origin=Renesas_v1.0.0, default-value=TYPE1_SHMT1  # This setting specifies the input buffer characteristics. TYPE1_SHMT1: TYPE 1 buffer is selected. TYPE2_SHMT4: TYPE 2 buffer is selected.
