AUTOSAR XML (schema 4-0-3)
standard types defined: boolean, float32, uint16, boolean_CompuMethod, boolean_DataConstr, float32_DataConstr, uint16_DataConstr, float64_DataConstr, sint16_DataConstr, sint32_DataConstr, sint8_DataConstr, uint32_DataConstr, uint8_DataConstr, float64, sint16, sint32, sint8, uint32, uint8
package /Nexteer/DataTypes
  25 x impl type:
    Ary1D_u0p16_10: category=ARRAY, sw-calibration-access=READ-ONLY, type-emitter=RTE
      element Element: array-size=10, array-size-semantics=FIXED-SIZE, implementation-data-type=u0p16
    Ary1D_u11p5_6: category=ARRAY, sw-calibration-access=READ-ONLY, type-emitter=RTE
      element Element: array-size=6, array-size-semantics=FIXED-SIZE, implementation-data-type=u11p5
    Ary1D_u12p4_2: category=ARRAY, sw-calibration-access=READ-ONLY, type-emitter=RTE
      element Element: array-size=2, array-size-semantics=FIXED-SIZE, implementation-data-type=u12p4
    Ary1D_u13p3_6: category=ARRAY, sw-calibration-access=READ-ONLY, type-emitter=RTE
      element Element: array-size=6, array-size-semantics=FIXED-SIZE, implementation-data-type=u13p3
    Ary1D_u1p15_12: category=ARRAY, sw-calibration-access=READ-ONLY, type-emitter=RTE
      element Element: array-size=12, array-size-semantics=FIXED-SIZE, implementation-data-type=u1p15
    Ary1D_u1p15_2: category=ARRAY, sw-calibration-access=READ-ONLY, type-emitter=RTE
      element Element: array-size=2, array-size-semantics=FIXED-SIZE, implementation-data-type=u1p15
    Ary1D_u1p15_5: category=ARRAY, sw-calibration-access=READ-ONLY, type-emitter=RTE
      element Element: array-size=5, array-size-semantics=FIXED-SIZE, implementation-data-type=u1p15
    Ary1D_u2p14_12: category=ARRAY, sw-calibration-access=READ-ONLY, type-emitter=RTE
      element Element: array-size=12, array-size-semantics=FIXED-SIZE, implementation-data-type=u2p14
    Ary1D_u4p12_10: category=ARRAY, sw-calibration-access=READ-ONLY, type-emitter=RTE
      element Element: array-size=10, array-size-semantics=FIXED-SIZE, implementation-data-type=u4p12
    Ary1D_u4p12_2: category=ARRAY, sw-calibration-access=READ-ONLY, type-emitter=RTE
      element Element: array-size=2, array-size-semantics=FIXED-SIZE, implementation-data-type=u4p12
    Ary1D_u4p12_5: category=ARRAY, sw-calibration-access=READ-ONLY, type-emitter=RTE
      element Element: array-size=5, array-size-semantics=FIXED-SIZE, implementation-data-type=u4p12
    Ary1D_u7p9_12: category=ARRAY, sw-calibration-access=READ-ONLY, type-emitter=RTE
      element Element: array-size=12, array-size-semantics=FIXED-SIZE, implementation-data-type=u7p9
    Ary1D_u9p7_12: category=ARRAY, sw-calibration-access=READ-ONLY, type-emitter=RTE
      element Element: array-size=12, array-size-semantics=FIXED-SIZE, implementation-data-type=u9p7
    FilLpRec1: category=STRUCTURE, sw-calibration-access=READ-ONLY, type-emitter=NxtrFil
      element FilSt: implementation-data-type=ImplementationDataTypes/float32
      element FilGain: implementation-data-type=ImplementationDataTypes/float32
      symbol props FilLpRec1
    FilNotchGainRec1: category=STRUCTURE, sw-calibration-access=READ-ONLY, type-emitter=RTE
      5 x element, all with category=TYPE_REFERENCE, implementation-data-type=ImplementationDataTypes/float32:
        FilGainB{0..2}
        FilGainA1
        FilGainA2
    FilNotchStRec1: category=STRUCTURE, sw-calibration-access=READ-ONLY, type-emitter=RTE
      element FilSt1: implementation-data-type=ImplementationDataTypes/float32
      element FilSt2: implementation-data-type=ImplementationDataTypes/float32
    u0p16: implementation-data-type=ImplementationDataTypes/uint16, type-emitter=RTE
    u11p5: implementation-data-type=ImplementationDataTypes/uint16, type-emitter=RTE
    u12p4: implementation-data-type=ImplementationDataTypes/uint16, type-emitter=RTE
    u13p3: implementation-data-type=ImplementationDataTypes/uint16, type-emitter=RTE
    u1p15: implementation-data-type=ImplementationDataTypes/uint16, type-emitter=RTE
    u2p14: implementation-data-type=ImplementationDataTypes/uint16, type-emitter=RTE
    u4p12: implementation-data-type=ImplementationDataTypes/uint16, type-emitter=RTE
    u7p9: implementation-data-type=ImplementationDataTypes/uint16, type-emitter=RTE
    u9p7: implementation-data-type=ImplementationDataTypes/uint16, type-emitter=RTE
