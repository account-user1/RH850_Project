AUTOSAR XML (schema 4-2-2)
package /DaVinci/PKG_ECU
  ecu instance EPS
package /ECUCompositionTypes
  composition sw component type ECU_Composition
    component CDD_ChkPtAppl10: type=CDD_ChkPtAppl10
package /EndToEndProtections
  end to end protection set EndToEndConnections
package /Systems
  system EPS: category=SYSTEM_EXTRACT
    system mapping EPS_MPPNG
    root-software-compositions:
      root sw composition prototype ECU_Composition: software-composition=ECU_Composition
