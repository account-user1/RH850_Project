AUTOSAR XML (schema 4-0-3)
package /ComponentTypes
  parameter sw component type CalRegn01Rt01
    provide port TEstimnMagAmbMplr: parameter-provide-com-spec{init-value=[0.01, 0.01, 0.01], parameter=Ary1D}, provided-interface=Ary1D_f32_3_CalPortIf1
