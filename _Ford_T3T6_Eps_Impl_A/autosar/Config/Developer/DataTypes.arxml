[part 1 of 2: packages /DataDictionary/ComponentTypes/DataTypeMappingSets to /Nexteer/DataTypeMappingSets]
AUTOSAR XML (schema 4-0-3)
standard types defined: boolean, uint16, uint32, uint8, float32_DataConstr, sint16_DataConstr, sint32_DataConstr, sint8_DataConstr, uint16_DataConstr, uint32_DataConstr, uint8_DataConstr, float32, sint16, sint32, sint8, Boolean
package /DataDictionary/ComponentTypes/DataTypeMappingSets
  data type mapping set Cals
    data-type-maps:
      application-data-type=AssiPahSumHysCmpLimDataType, implementation-data-type=float32
      application-data-type=AssiSumLimNtc0x0C4FailStepDataType, implementation-data-type=uint16
      application-data-type=AssiSumLimNtc0x0C4PassStepDataType, implementation-data-type=uint16
      application-data-type=AssiSumLimPullCmpLimDataType, implementation-data-type=float32
      application-data-type=BattVltgCorrlnAllwdVltgDifDataType, implementation-data-type=float32
      application-data-type=BattVltgCorrlnNtc0x03C0x0440x04CFailStepDataType, implementation-data-type=uint16
      application-data-type=BattVltgCorrlnNtc0x03C0x0440x04CPassStepDataType, implementation-data-type=uint16
      application-data-type=BattVltgSwdMaxDataType, implementation-data-type=float32
      application-data-type=CmnMfgSrvCal0RelNrDataType, implementation-data-type=uint32
      application-data-type=CurrMeasArbnDaxQaxScagFacDataType, implementation-data-type=float32
      application-data-type=CurrMeasArbnMaxStallCntrDataType, implementation-data-type=uint8
      application-data-type=CurrMeasCorrlnErrNstepDataType, implementation-data-type=uint16
      application-data-type=CurrMeasCorrlnErrPstepDataType, implementation-data-type=uint16
      application-data-type=CurrMeasCorrlnMaxErrCurrDataType, implementation-data-type=float32
      application-data-type=CurrMeasCorrlnMaxStallCntrDataType, implementation-data-type=uint8
      application-data-type=CurrMeasEolFixdPwmPerdDataType, implementation-data-type=uint32
      application-data-type=CurrMeasEolGainMaxDataType, implementation-data-type=float32
      application-data-type=CurrMeasEolGainMinDataType, implementation-data-type=float32
      application-data-type=CurrMeasEolGainNrOfSampleDataType, implementation-data-type=uint16
      application-data-type=CurrMeasEolGainNumerDataType, implementation-data-type=float32
      application-data-type=CurrMeasEolMaxMotVelDataType, implementation-data-type=float32
      application-data-type=CurrMeasEolOffsHiBrdgVltgMinDataType, implementation-data-type=uint32
      application-data-type=CurrMeasEolOffsHiCmuOffsDataType, implementation-data-type=uint32
      application-data-type=CurrMeasEolOffsLoCmuOffsDataType, implementation-data-type=uint32
      application-data-type=CurrMeasEolOffsMaxDataType, implementation-data-type=float32
      application-data-type=CurrMeasEolOffsMinDataType, implementation-data-type=float32
      application-data-type=CurrMeasEolOffsNrOfSampleDataType, implementation-data-type=uint16
      application-data-type=CurrMeasEolTranCntrThdDataType, implementation-data-type=uint8
      application-data-type=CurrMeasMinRqrdPhaOnTiDataType, implementation-data-type=uint32
      application-data-type=CurrMeasMotAgCompuDlyDataType, implementation-data-type=uint32
      application-data-type=CurrMeasMotCurrAdcVlyEnadMaxDataType, implementation-data-type=float32
      application-data-type=CurrMeasMotCurrAdcVlyEnadMinDataType, implementation-data-type=float32
      application-data-type=CurrMeasMotCurrAdcVlyWrmIninMaxDataType, implementation-data-type=float32
      application-data-type=CurrMeasMotCurrAdcVlyWrmIninMinDataType, implementation-data-type=float32
      application-data-type=CurrMeasNtc0x05DFailStepDataType, implementation-data-type=uint16
      application-data-type=CurrMeasNtc0x05DPassStepDataType, implementation-data-type=uint16
      application-data-type=CurrMeasNtc0x06DFailStepDataType, implementation-data-type=uint16
      application-data-type=CurrMeasNtc0x06DPassStepDataType, implementation-data-type=uint16
      application-data-type=CurrMeasNtc0x1ECFailStepDataType, implementation-data-type=uint16
      application-data-type=CurrMeasNtc0x1ECPassStepDataType, implementation-data-type=uint16
      application-data-type=CurrMeasNtc0x1EDFailStepDataType, implementation-data-type=uint16
      application-data-type=CurrMeasNtc0x1EDPassStepDataType, implementation-data-type=uint16
      application-data-type=DampgHydBasCoeff{1..4}DataType, implementation-data-type=float32
      application-data-type=DampgHydOutpLimDataType, implementation-data-type=float32
      application-data-type=DampgMotVelLpFilFrqDataType, implementation-data-type=float32
      application-data-type=DampgQuad13MplrDataType, implementation-data-type=float32
      application-data-type=DampgQuad24MplrDataType, implementation-data-type=float32
      application-data-type=DampgQuadHwTqBacklshDataType, implementation-data-type=float32
      application-data-type=DampgQuadHwTqLpFilFrqDataType, implementation-data-type=float32
      application-data-type=DampgQuadMotVelBacklshDataType, implementation-data-type=float32
      application-data-type=DampgQuadMotVelLpFilFrqDataType, implementation-data-type=float32
      application-data-type=DampgQuadScaLpFilFrqDataType, implementation-data-type=float32
      application-data-type=EcuTMeasDftTDataType, implementation-data-type=float32
      application-data-type=EcuTMeasFilTauDataType, implementation-data-type=float32
      application-data-type=EcuTMeasNtc0x045FailStepDataType, implementation-data-type=uint16
      application-data-type=EcuTMeasNtc0x045PassStepDataType, implementation-data-type=uint16
      application-data-type=EcuTMeasRngDiagcMaxDataType, implementation-data-type=float32
      application-data-type=EcuTMeasRngDiagcMinDataType, implementation-data-type=float32
      application-data-type=EcuTMeasScagDataType, implementation-data-type=float32
      application-data-type=EcuTMeasScagOffsDataType, implementation-data-type=float32
      application-data-type=GateDrvCtrlNtcNr0x050FailStepDataType, implementation-data-type=uint16
      application-data-type=GateDrvCtrlNtcNr0x060FailStepDataType, implementation-data-type=uint16
      application-data-type=GateDrvCtrlUnit0Cfg{2..4}WrValDataType, implementation-data-type=uint16
      application-data-type=GateDrvCtrlUnit0Cfg7WrValDataType, implementation-data-type=uint16
      application-data-type=GateDrvCtrlUnit1Cfg{2..4}WrValDataType, implementation-data-type=uint16
      application-data-type=GateDrvCtrlUnit1Cfg7WrValDataType, implementation-data-type=uint16
      application-data-type=HwAg0MeasNtc0x093FailStepDataType, implementation-data-type=uint16
      application-data-type=HwAg0MeasNtc0x093PassStepDataType, implementation-data-type=uint16
      application-data-type=HwAg0MeasNtc0x094FailStepDataType, implementation-data-type=uint16
      application-data-type=HwAg0MeasNtc0x094PassStepDataType, implementation-data-type=uint16
      application-data-type=HwAg0MeasNtc0x095FailStepDataType, implementation-data-type=uint16
      application-data-type=HwAg0MeasNtc0x095PassStepDataType, implementation-data-type=uint16
      application-data-type=HwAg0MeasVrnrErrThdDataType, implementation-data-type=uint8
      application-data-type=HwAg1MeasNtc0x097FailStepDataType, implementation-data-type=uint16
      application-data-type=HwAg1MeasNtc0x097PassStepDataType, implementation-data-type=uint16
      application-data-type=HwAg1MeasNtc0x098FailStepDataType, implementation-data-type=uint16
      application-data-type=HwAg1MeasNtc0x098PassStepDataType, implementation-data-type=uint16
      application-data-type=HwAg1MeasNtc0x099FailStepDataType, implementation-data-type=uint16
      application-data-type=HwAg1MeasNtc0x099PassStepDataType, implementation-data-type=uint16
      application-data-type=HwAg1MeasVrnrErrThdDataType, implementation-data-type=uint8
      application-data-type=HwTq0MeasNtc0x073FailStepDataType, implementation-data-type=uint16
      application-data-type=HwTq0MeasNtc0x073PassStepDataType, implementation-data-type=uint16
      application-data-type=HwTqArbnMaxStallTqADataType, implementation-data-type=uint8
      application-data-type=HwTqArbnMaxStallTqBDataType, implementation-data-type=uint8
      application-data-type=HwTqArbnMaxStallTqCDataType, implementation-data-type=uint8
      application-data-type=HwTqArbnMaxStallTqDDataType, implementation-data-type=uint8
      application-data-type=MotCtrlPrmEstimnFetRNomDataType, implementation-data-type=float32
      application-data-type=MotCtrlPrmEstimnFetThermCoeffDataType, implementation-data-type=float32
      application-data-type=MotCtrlPrmEstimnMagThermCoeffDataType, implementation-data-type=float32
      application-data-type=MotCtrlPrmEstimnMotBackEmfConHiLimDataType, implementation-data-type=float32
      application-data-type=MotCtrlPrmEstimnMotBackEmfConLoLimDataType, implementation-data-type=float32
      application-data-type=MotCtrlPrmEstimnMotBackEmfConNomDataType, implementation-data-type=float32
      application-data-type=MotCtrlPrmEstimnMotInduDaxHiLimDataType, implementation-data-type=float32
      application-data-type=MotCtrlPrmEstimnMotInduDaxLoLimDataType, implementation-data-type=float32
      application-data-type=MotCtrlPrmEstimnMotInduDaxNomDataType, implementation-data-type=float32
      application-data-type=MotCtrlPrmEstimnMotInduQaxHiLimDataType, implementation-data-type=float32
      application-data-type=MotCtrlPrmEstimnMotInduQaxLoLimDataType, implementation-data-type=float32
      application-data-type=MotCtrlPrmEstimnMotInduQaxNomDataType, implementation-data-type=float32
      application-data-type=MotCtrlPrmEstimnMotRHiLimDataType, implementation-data-type=float32
      application-data-type=MotCtrlPrmEstimnMotRLoLimDataType, implementation-data-type=float32
      application-data-type=MotCtrlPrmEstimnMotRNomDataType, implementation-data-type=float32
      application-data-type=MotCtrlPrmEstimnMotWidgThermCoeffDataType, implementation-data-type=float32
      application-data-type=MotCtrlPrmEstimnTNomDataType, implementation-data-type=float32
      application-data-type=MotCurrRegCfgCtrlrDynGainVehSpdCutOffDataType, implementation-data-type=float32
      application-data-type=MotCurrRegCfgCurrLoopSecOrderTrfFcnEnaDataType, implementation-data-type=uint8
      application-data-type=MotCurrRegCfgIntgrlGainSampleTiDataType, implementation-data-type=float32
      application-data-type=MotCurrRegCfgMotAgCompuDlyDataType, implementation-data-type=float32
      application-data-type=MotCurrRegCfgMotDampgRatDaxDataType, implementation-data-type=float32
      application-data-type=MotCurrRegCfgMotDampgRatQaxDataType, implementation-data-type=float32
      application-data-type=MotCurrRegCfgMotRVirtDaxDataType, implementation-data-type=float32
      application-data-type=MotCurrRegCfgMotRVirtQaxDataType, implementation-data-type=float32
      application-data-type=MotCurrRegCfgMotVelFilFrqDataType, implementation-data-type=float32
      application-data-type=MotCurrRegVltgLimrCurrLoaScarSlewRateDataType, implementation-data-type=float32
      application-data-type=MotCurrRegVltgLimrDaxAntiWdupCoeffDataType, implementation-data-type=float32
      application-data-type=MotCurrRegVltgLimrIvtrLoaScarSlewRateDataType, implementation-data-type=float32
      application-data-type=MotCurrRegVltgLimrQaxAntiWdupCoeffDataType, implementation-data-type=float32
      application-data-type=MotCurrRegVltgLimrQaxAntiWdupScagDiDataType, implementation-data-type=uint8
      application-data-type=MotQuadDetnMotDirHysInstsDataType, implementation-data-type=DataTypes/s18p13
      application-data-type=MotRefMdlCurrDaxBoostGainDataType, implementation-data-type=float32
      application-data-type=MotRefMdlCurrIterTolDataType, implementation-data-type=float32
      application-data-type=MotRefMdlFbCtrlDiDataType, implementation-data-type=uint8
      application-data-type=MotRefMdlIvtrDeadTiBrdgVltgScaDataType, implementation-data-type=float32
      application-data-type=MotRefMdlMinCurrIterLimDataType, implementation-data-type=uint8
      application-data-type=MotRefMdlMotCurrDaxMaxScaDataType, implementation-data-type=float32
      application-data-type=MotRefMdlMotVelLpFilFrqDataType, implementation-data-type=float32
      application-data-type=MotRefMdlMotVltgDerivtvTiConDataType, implementation-data-type=float32
      application-data-type=MotRefMdlRefLocnIterLimDataType, implementation-data-type=uint8
      application-data-type=MotRefMdlTqIterLimDataType, implementation-data-type=uint8
      application-data-type=MotRefMdlTqIterTolDataType, implementation-data-type=float32
      application-data-type=MotRefMdlVltgModDynCmpEnaDataType, implementation-data-type=uint8
      application-data-type=MotRefMdlVltgOvrRThdScaDataType, implementation-data-type=float32
      application-data-type=PwrDiscnctNtc0x042FailStepDataType, implementation-data-type=uint16
      application-data-type=PwrDiscnctNtc0x042PassStepDataType, implementation-data-type=uint16
      application-data-type=PwrDiscnctNtc0x04AFailStepDataType, implementation-data-type=uint16
      application-data-type=PwrDiscnctNtc0x04APassStepDataType, implementation-data-type=uint16
      application-data-type=PwrDiscnctOpenThdDataType, implementation-data-type=float32
      application-data-type=RtnHwAuthySlewDataType, implementation-data-type=float32
      application-data-type=RtnOffsRngDataType, implementation-data-type=float32
      application-data-type=RtnOffsSlewDataType, implementation-data-type=float32
      application-data-type=SinVltgGennDitherLpfCoeffDataType, implementation-data-type=float32
      application-data-type=SysGlbPrmMotPoleCntDataType, implementation-data-type=uint8
      application-data-type=SysGlbPrmSysKineRatDataType, implementation-data-type=float32
      application-data-type=SysGlbPrmSysTqRatDataType, implementation-data-type=float32
      application-data-type=SysGlbPrmTorsBarStfnDataType, implementation-data-type=float32
      application-data-type=TSG31CfgAndUseAdcStrtOfCnvn2OffsDataType, implementation-data-type=uint32
      application-data-type=TSG31CfgAndUseAdcStrtOfCnvnMotCtrlPeakOffsDataType, implementation-data-type=uint32
      application-data-type=TSG31CfgAndUseAdcStrtOfCnvnMotCtrlVlyOffsDataType, implementation-data-type=uint32
      application-data-type=TSG31CfgAndUseMtrAg0SPIStartDataType, implementation-data-type=uint32
      application-data-type=TSG31CfgAndUsePwmDbndDataType, implementation-data-type=uint32
      application-data-type=VehSigCdngDftLatADataType, implementation-data-type=float32
      application-data-type=VehSigCdngDftLgtADataType, implementation-data-type=float32
      application-data-type=VehSigCdngDftVehSpdDataType, implementation-data-type=float32
      application-data-type=VehSigCdngDftYawRateDataType, implementation-data-type=float32
      application-data-type=VehSigCdngLatADifThdDataType, implementation-data-type=float32
      application-data-type=VehSigCdngLatAFilFrqDataType, implementation-data-type=float32
      application-data-type=VehSigCdngLatASlewRateDataType, implementation-data-type=float32
      application-data-type=VehSigCdngLtgADifThdDataType, implementation-data-type=float32
      application-data-type=VehSigCdngLtgASlewRateDataType, implementation-data-type=float32
      application-data-type=VehSigCdngVehSpdDifThdDataType, implementation-data-type=float32
      application-data-type=VehSigCdngVehSpdSlewRateDataType, implementation-data-type=float32
      application-data-type=VehSigCdngVehYawSlewRateDataType, implementation-data-type=float32
      application-data-type=VehSigCdngYawRateDifThdDataType, implementation-data-type=float32
package /DataDictionary/DataTypes
  169 x app type, all with category=VALUE, sw-calibration-access=READ-ONLY:
    AssiPahSumHysCmpLimDataType: range phys 0..0.3, unit=MotNwtMtr
    AssiSumLimNtc0x0C4FailStepDataType: range phys 0..65535, unit=Cnt
    AssiSumLimNtc0x0C4PassStepDataType: range phys 0..65535, unit=Cnt
    AssiSumLimPullCmpLimDataType: range phys 0..8.8, unit=MotNwtMtr
    BattVltgCorrlnAllwdVltgDifDataType: range phys 0..1, unit=Volt
    BattVltgCorrlnNtc0x03C0x0440x04CFailStepDataType: range phys 0..65535, unit=Cnt
    BattVltgCorrlnNtc0x03C0x0440x04CPassStepDataType: range phys 0..65535, unit=Cnt
    BattVltgSwdMaxDataType: range phys 6..26.5, unit=Volt
    CmnMfgSrvCal0RelNrDataType: range phys 0..4294967295, unit=Cnt
    CurrMeasArbnDaxQaxScagFacDataType: range phys 0.5..1, unit=Uls
    CurrMeasArbnMaxStallCntrDataType: range phys 0..255, unit=Cnt
    CurrMeasCorrlnErrNstepDataType: range phys 0..65535, unit=Cnt
    CurrMeasCorrlnErrPstepDataType: range phys 0..65535, unit=Cnt
    CurrMeasCorrlnMaxErrCurrDataType: range phys 0..50, unit=Ampr
    CurrMeasCorrlnMaxStallCntrDataType: range phys 0..255, unit=Cnt
    CurrMeasEolFixdPwmPerdDataType: range phys 55555..71429, unit=NanoSec
    CurrMeasEolGainMaxDataType: range phys 70..76, unit=AmprPerVolt
    CurrMeasEolGainMinDataType: range phys 56..60, unit=AmprPerVolt
    CurrMeasEolGainNrOfSampleDataType: range phys 1..1000, unit=Cnt
    CurrMeasEolGainNumerDataType: range phys 10..100, unit=Ampr
    CurrMeasEolMaxMotVelDataType: range phys 0..1350, unit=MotRadPerSec
    CurrMeasEolOffsHiBrdgVltgMinDataType: range phys 233330..1325008, unit=VoltNanoSec
    CurrMeasEolOffsHiCmuOffsDataType: range phys 0..71429, unit=NanoSec
    CurrMeasEolOffsLoCmuOffsDataType: range phys 0..71429, unit=NanoSec
    CurrMeasEolOffsMaxDataType: range phys 2.8..3, unit=Volt
    CurrMeasEolOffsMinDataType: range phys 2..2.3, unit=Volt
    CurrMeasEolOffsNrOfSampleDataType: range phys 1..10000, unit=Cnt
    CurrMeasEolTranCntrThdDataType: range phys 0..255, unit=Cnt
    CurrMeasMinRqrdPhaOnTiDataType: range phys 6666..8572, unit=NanoSec
    CurrMeasMotAgCompuDlyDataType: range phys 0..30000, unit=NanoSec
    CurrMeasMotCurrAdcVlyEnadMaxDataType: range phys 2.5..4.8, unit=Volt
    CurrMeasMotCurrAdcVlyEnadMinDataType: range phys 0.3..2.5, unit=Volt
    CurrMeasMotCurrAdcVlyWrmIninMaxDataType: range phys 2.5..3, unit=Volt
    CurrMeasMotCurrAdcVlyWrmIninMinDataType: range phys 2..2.5, unit=Volt
    CurrMeasNtc0x05DFailStepDataType: range phys 0..65535, unit=Cnt
    CurrMeasNtc0x05DPassStepDataType: range phys 0..65535, unit=Cnt
    CurrMeasNtc0x06DFailStepDataType: range phys 0..65535, unit=Cnt
    CurrMeasNtc0x06DPassStepDataType: range phys 0..65535, unit=Cnt
    CurrMeasNtc0x1ECFailStepDataType: range phys 0..65535, unit=Cnt
    CurrMeasNtc0x1ECPassStepDataType: range phys 0..65535, unit=Cnt
    CurrMeasNtc0x1EDFailStepDataType: range phys 0..65535, unit=Cnt
    CurrMeasNtc0x1EDPassStepDataType: range phys 0..65535, unit=Cnt
    DampgHydBasCoeff{1..4}DataType: range phys 0..0.1, unit=MotNwtMtrPerMotRadPerSec
    DampgHydOutpLimDataType: range phys -8.8..8.8, unit=MotNwtMtr
    DampgMotVelLpFilFrqDataType: range phys 5..100, unit=Hz
    DampgQuad13MplrDataType: range phys 0..2, unit=Uls
    DampgQuad24MplrDataType: range phys 0..2, unit=Uls
    DampgQuadHwTqBacklshDataType: range phys 0..10, unit=HwNwtMtr
    DampgQuadHwTqLpFilFrqDataType: range phys 5..31.25, unit=Hz
    DampgQuadMotVelBacklshDataType: range phys 0..128, unit=MotRadPerSec
    DampgQuadMotVelLpFilFrqDataType: range phys 5..31.25, unit=Hz
    DampgQuadScaLpFilFrqDataType: range phys 0.0039..100, unit=Hz
    EcuTMeasDftTDataType: range phys -50..150, unit=DegCgrd
    EcuTMeasFilTauDataType: range phys 0.1..10, unit=Hz
    EcuTMeasNtc0x045FailStepDataType: range phys 0..65535, unit=Cnt
    EcuTMeasNtc0x045PassStepDataType: range phys 0..65535, unit=Cnt
    EcuTMeasRngDiagcMaxDataType: range phys -50..200, unit=DegCgrd
    EcuTMeasRngDiagcMinDataType: range phys -50..200, unit=DegCgrd
    EcuTMeasScagDataType: range phys 0..200, unit=DegCgrdPerVolt
    EcuTMeasScagOffsDataType: range phys -100..150, unit=DegCgrd
    GateDrvCtrlNtcNr0x050FailStepDataType: range phys 0..65535, unit=Cnt
    GateDrvCtrlNtcNr0x060FailStepDataType: range phys 0..65535, unit=Cnt
    GateDrvCtrlUnit0Cfg{2..4}WrValDataType: range phys 0..65535, unit=Cnt
    GateDrvCtrlUnit0Cfg7WrValDataType: range phys 0..65535, unit=Cnt
    GateDrvCtrlUnit1Cfg{2..4}WrValDataType: range phys 0..65535, unit=Cnt
    GateDrvCtrlUnit1Cfg7WrValDataType: range phys 0..65535, unit=Cnt
    HwAg0MeasNtc0x093FailStepDataType: range phys 0..65535, unit=Cnt
    HwAg0MeasNtc0x093PassStepDataType: range phys 0..65535, unit=Cnt
    HwAg0MeasNtc0x094FailStepDataType: range phys 0..65535, unit=Cnt
    HwAg0MeasNtc0x094PassStepDataType: range phys 0..65535, unit=Cnt
    HwAg0MeasNtc0x095FailStepDataType: range phys 0..65535, unit=Cnt
    HwAg0MeasNtc0x095PassStepDataType: range phys 0..65535, unit=Cnt
    HwAg0MeasVrnrErrThdDataType: range phys 0..20, unit=Cnt
    HwAg1MeasNtc0x097FailStepDataType: range phys 0..65535, unit=Cnt
    HwAg1MeasNtc0x097PassStepDataType: range phys 0..65535, unit=Cnt
    HwAg1MeasNtc0x098FailStepDataType: range phys 0..65535, unit=Cnt
    HwAg1MeasNtc0x098PassStepDataType: range phys 0..65535, unit=Cnt
    HwAg1MeasNtc0x099FailStepDataType: range phys 0..65535, unit=Cnt
    HwAg1MeasNtc0x099PassStepDataType: range phys 0..65535, unit=Cnt
    HwAg1MeasVrnrErrThdDataType: range phys 0..20, unit=Cnt
    HwTq0MeasNtc0x073FailStepDataType: range phys 0..65535, unit=Cnt
    HwTq0MeasNtc0x073PassStepDataType: range phys 0..65535, unit=Cnt
    HwTqArbnMaxStallTqADataType: range phys 0..255, unit=Cnt
    HwTqArbnMaxStallTqBDataType: range phys 0..255, unit=Cnt
    HwTqArbnMaxStallTqCDataType: range phys 0..255, unit=Cnt
    HwTqArbnMaxStallTqDDataType: range phys 0..255, unit=Cnt
    MotCtrlPrmEstimnFetRNomDataType: range phys 0..0.1, unit=Ohm
    MotCtrlPrmEstimnFetThermCoeffDataType: range phys 0..0.006, unit=OhmPerDegCgrd
    MotCtrlPrmEstimnMagThermCoeffDataType: range phys -0.0015..0, unit=VoltPerMotRadPerSecPerDegCgrd
    MotCtrlPrmEstimnMotBackEmfConHiLimDataType: range phys 0.025..0.075, unit=VoltPerMotRadPerSec
    MotCtrlPrmEstimnMotBackEmfConLoLimDataType: range phys 0.025..0.075, unit=VoltPerMotRadPerSec
    MotCtrlPrmEstimnMotBackEmfConNomDataType: range phys 0.025..0.075, unit=VoltPerMotRadPerSec
    MotCtrlPrmEstimnMotInduDaxHiLimDataType: range phys 3e-05..0.00041, unit=Henry
    MotCtrlPrmEstimnMotInduDaxLoLimDataType: range phys 3e-05..0.00041, unit=Henry
    MotCtrlPrmEstimnMotInduDaxNomDataType: range phys 3e-05..0.00041, unit=Henry
    MotCtrlPrmEstimnMotInduQaxHiLimDataType: range phys 3e-05..0.00041, unit=Henry
    MotCtrlPrmEstimnMotInduQaxLoLimDataType: range phys 3e-05..0.00041, unit=Henry
    MotCtrlPrmEstimnMotInduQaxNomDataType: range phys 3e-05..0.00041, unit=Henry
    MotCtrlPrmEstimnMotRHiLimDataType: range phys 0.005..0.12565, unit=Ohm
    MotCtrlPrmEstimnMotRLoLimDataType: range phys 0.005..0.12565, unit=Ohm
    MotCtrlPrmEstimnMotRNomDataType: range phys 0.005..0.12565, unit=Ohm
    MotCtrlPrmEstimnMotWidgThermCoeffDataType: range phys 0..0.0045, unit=OhmPerDegCgrd
    MotCtrlPrmEstimnTNomDataType: range phys -40..150, unit=DegCgrd
    MotCurrRegCfgCtrlrDynGainVehSpdCutOffDataType: range phys 0..255, unit=Kph
    MotCurrRegCfgCurrLoopSecOrderTrfFcnEnaDataType: range phys 0..1, unit=Cnt
    MotCurrRegCfgIntgrlGainSampleTiDataType: range phys 9.1e-05..0.000143, unit=Sec
    MotCurrRegCfgMotAgCompuDlyDataType: range phys 0..0.0002, unit=Sec
    MotCurrRegCfgMotDampgRatDaxDataType: range phys 0..20, unit=Uls
    MotCurrRegCfgMotDampgRatQaxDataType: range phys 0..20, unit=Uls
    MotCurrRegCfgMotRVirtDaxDataType: range phys 0..0.2, unit=Ohm
    MotCurrRegCfgMotRVirtQaxDataType: range phys 0..0.2, unit=Ohm
    MotCurrRegCfgMotVelFilFrqDataType: range phys 1..200, unit=Hz
    MotCurrRegVltgLimrCurrLoaScarSlewRateDataType: range phys 0..1000, unit=UlsPerSec
    MotCurrRegVltgLimrDaxAntiWdupCoeffDataType: range phys -25..25, unit=Uls
    MotCurrRegVltgLimrIvtrLoaScarSlewRateDataType: range phys 0..1000, unit=UlsPerSec
    MotCurrRegVltgLimrQaxAntiWdupCoeffDataType: range phys -25..25, unit=Uls
    MotCurrRegVltgLimrQaxAntiWdupScagDiDataType: range phys 0..1, unit=Cnt
    MotQuadDetnMotDirHysInstsDataType: range phys 0..6.25, unit=MotDeg
    MotRefMdlCurrDaxBoostGainDataType: range phys 0..1, unit=Uls
    MotRefMdlCurrIterTolDataType: range phys 0.01..20, unit=Ampr
    MotRefMdlFbCtrlDiDataType: range phys 0..1, unit=Cnt
    MotRefMdlIvtrDeadTiBrdgVltgScaDataType: range phys 0.98..1, unit=Uls
    MotRefMdlMinCurrIterLimDataType: range phys 1..5, unit=Cnt
    MotRefMdlMotCurrDaxMaxScaDataType: range phys 1..2, unit=Uls
    MotRefMdlMotVelLpFilFrqDataType: range phys 1..200, unit=Hz
    MotRefMdlMotVltgDerivtvTiConDataType: range phys 0..0.05, unit=Sec
    MotRefMdlRefLocnIterLimDataType: range phys 1..20, unit=Cnt
    MotRefMdlTqIterLimDataType: range phys 1..5, unit=Cnt
    MotRefMdlTqIterTolDataType: range phys 0.001..0.1, unit=MotRad
    MotRefMdlVltgModDynCmpEnaDataType: range phys 0..1, unit=Cnt
    MotRefMdlVltgOvrRThdScaDataType: range phys 0..1, unit=Uls
    PwrDiscnctNtc0x042FailStepDataType: range phys 0..65535, unit=Cnt
    PwrDiscnctNtc0x042PassStepDataType: range phys 0..65535, unit=Cnt
    PwrDiscnctNtc0x04AFailStepDataType: range phys 0..65535, unit=Cnt
    PwrDiscnctNtc0x04APassStepDataType: range phys 0..65535, unit=Cnt
    PwrDiscnctOpenThdDataType: range phys 0..26.5, unit=Volt
    RtnHwAuthySlewDataType: range phys 0.1..10, unit=UlsPerSec
    RtnOffsRngDataType: range phys 0..20, unit=HwDeg
    RtnOffsSlewDataType: range phys 0..0.5, unit=HwDegPerSec
    SinVltgGennDitherLpfCoeffDataType: range phys 0..1, unit=Uls
    SysGlbPrmMotPoleCntDataType: range phys 2..12, unit=Cnt
    SysGlbPrmSysKineRatDataType: range phys 10..40, unit=MotDegPerHwDeg
    SysGlbPrmSysTqRatDataType: range phys 10..40, unit=HwNwtMtrPerMotNwtMtr
    SysGlbPrmTorsBarStfnDataType: range phys 0.5..10, unit=HwNwtMtrPerHwDeg
    TSG31CfgAndUseAdcStrtOfCnvn2OffsDataType: range phys 0..25000, unit=NanoSec
    TSG31CfgAndUseAdcStrtOfCnvnMotCtrlPeakOffsDataType: range phys 0..25000, unit=NanoSec
    TSG31CfgAndUseAdcStrtOfCnvnMotCtrlVlyOffsDataType: range phys 0..25000, unit=NanoSec
    TSG31CfgAndUseMtrAg0SPIStartDataType: range phys 0..71429, unit=NanoSec
    TSG31CfgAndUsePwmDbndDataType: range phys 1..1000, unit=NanoSec
    VehSigCdngDftLatADataType: range phys -10..10, unit=MtrPerSecSqd
    VehSigCdngDftLgtADataType: range phys -50..50, unit=KphPerSec
    VehSigCdngDftVehSpdDataType: range phys 0..511, unit=Kph
    VehSigCdngDftYawRateDataType: range phys -120..120, unit=VehDegPerSec
    VehSigCdngLatADifThdDataType: range phys 0.1..10, unit=MtrPerSecSqd
    VehSigCdngLatAFilFrqDataType: range phys 1..100, unit=Hz
    VehSigCdngLatASlewRateDataType: range phys 0.1..400, unit=MtrPerSecSqd
    VehSigCdngLtgADifThdDataType: range phys 0.1..10, unit=KphPerSec
    VehSigCdngLtgASlewRateDataType: range phys 0.1..500, unit=KphPerSecSqd
    VehSigCdngVehSpdDifThdDataType: range phys 0.1..511, unit=Kph
    VehSigCdngVehSpdSlewRateDataType: range phys 1..50, unit=KphPerSec
    VehSigCdngVehYawSlewRateDataType: range phys 1..1200, unit=VehDegPerSecSqd
    VehSigCdngYawRateDifThdDataType: range phys 0.1..120, unit=VehDegPerSec
  impl type s18p13: compu {raw=phys*8192 for phys >0..<255; unit FixdPt}, implementation-data-type=sint32, type-emitter=RTE
package /DataDictionary/Units
  35 x unit, all with factor-si-to-unit=1, offset-si-to-unit=0:
    Ampr: display-name=Ampr
    AmprPerVolt: display-name=AmprPerVolt
    Cnt: display-name=Cnt
    DegCgrd: display-name=DegCgrd
    DegCgrdPerVolt: display-name=DegCgrdPerVolt
    FixdPt: display-name=FixdPt
    Henry: display-name=Henry
    HwDeg: display-name=HwDeg
    HwDegPerSec: display-name=HwDegPerSec
    HwNwtMtr: display-name=HwNwtMtr
    HwNwtMtrPerHwDeg: display-name=HwNwtMtrPerHwDeg
    HwNwtMtrPerMotNwtMtr: display-name=HwNwtMtrPerMotNwtMtr
    Hz: display-name=Hz
    Kph: display-name=Kph
    KphPerSec: display-name=KphPerSec
    KphPerSecSqd: display-name=KphPerSecSqd
    MotDeg: display-name=MotDeg
    MotDegPerHwDeg: display-name=MotDegPerHwDeg
    MotNwtMtr: display-name=MotNwtMtr
    MotNwtMtrPerMotRadPerSec: display-name=MotNwtMtrPerMotRadPerSec
    MotRad: display-name=MotRad
    MotRadPerSec: display-name=MotRadPerSec
    MtrPerSecSqd: display-name=MtrPerSecSqd
    NanoSec: display-name=NanoSec
    Ohm: display-name=Ohm
    OhmPerDegCgrd: display-name=OhmPerDegCgrd
    Sec: display-name=Sec
    Uls: display-name=Uls
    UlsPerSec: display-name=UlsPerSec
    VehDegPerSec: display-name=VehDegPerSec
    VehDegPerSecSqd: display-name=VehDegPerSecSqd
    Volt: display-name=Volt
    VoltNanoSec: display-name=VoltNanoSec
    VoltPerMotRadPerSec: display-name=VoltPerMotRadPerSec
    VoltPerMotRadPerSecPerDegCgrd: display-name=VoltPerMotRadPerSecPerDegCgrd
package /DataType
  base type uint8_6_iso_8859_1: category=FIXED_LENGTH, base-type-size=48, base-type-encoding=ISO-8859-1
  base type uint8_8_iso_8859_1: category=FIXED_LENGTH, base-type-size=64, base-type-encoding=ISO-8859-1
package /DataType/Semantics
  compu method CM_TrlrSnsId_No_Actl: phys=raw for raw 0..281474976710650, 4294967294=Cx0000FFFFFFFE_NoDataExists_FFFFFFFFFFFE, 4294967295=Cx0000FFFFFFFF_Faulty_FFFFFFFFFFFF; unit unitless
  compu method CM_VehicleGGCCData: phys=raw for raw 0..18446744073709551615; unit mixed
package /DataType/Unit
  29 x unit, all with factor-si-to-unit=1, offset-si-to-unit=0:
    U_1Ym: display-name=1/m
    U_1Ymeter: display-name=1/meter
    U_Amps: display-name=Amps
    U_deg: display-name=deg
    U_degrees: display-name=degrees
    U_Degrees: display-name=Degrees
    U_Degrees_C: display-name=Degrees C
    U_degreesYsecond: display-name=degrees/second
    U_degYs: display-name=deg/s
    U_km: display-name=km
    U_kmYh: display-name=km/h
    U_kph: display-name=kph
    U_meter: display-name=meter
    U_metersYsec: display-name=meters/sec
    U_mixed: display-name=mixed
    U_mrad: display-name=mrad
    U_mYsX2: display-name=m/s^2
    U_Nm: display-name=Nm
    U_p: display-name=%
    U_radians: display-name=radians
    U_radiansYsecond: display-name=radians/second
    U_radYs: display-name=rad/s
    U_rpm: display-name=rpm
    U_second: display-name=second
    U_SED: display-name=SED
    U_volt: display-name=volt
    U_Volts: display-name=Volts
    unitless: display-name=unitless
    Unitless: display-name=Unitless
package /DataTypes
  4 x impl type, all with type-emitter=RTE:
    Ary1D_u16_16: category=ARRAY, sw-calibration-access=READ-ONLY
      element Element: array-size=16, array-size-semantics=FIXED-SIZE, implementation-data-type=uint16
    Ary1D_u8_20: category=ARRAY, sw-calibration-access=READ-ONLY
      element Element: array-size=20, array-size-semantics=FIXED-SIZE, implementation-data-type=uint8
    Ary1D_u8_8: category=ARRAY, sw-calibration-access=READ-ONLY
      element Element: array-size=8, array-size-semantics=FIXED-SIZE, implementation-data-type=uint8
    FordArbnCmd1: compu-method=FordArbnCmd1, implementation-data-type=uint8
package /Ford/DataTypes
  168 x impl type, all with sw-calibration-access=READ-ONLY:
    Ford_AbsActv_B_Actl: category=VALUE, base-type=boolean, compu {phys=raw for raw 0..1, 0=Cx0_No, 1=Cx1_Yes; unit SED}
    Ford_ApaSys_D_Stat: category=VALUE, base-type=uint8, compu {phys=raw for raw 0..7, 0=Cx0_Null, 1=Cx1_Off, 2=Cx2_On, 3=Cx3_Overspeed, 4=Cx4_ApaCancelled, 5=Cx5_NotAccessible, 6=Cx6_Finished, 7=Cx7_Faulty; unit SED}, range raw 0..7
    Ford_ApedPos_Pc_ActlArb: category=VALUE, base-type=uint16, compu {phys=raw*0.1 for raw 0..1022; unit %}, range raw 0..1023
    Ford_ApedPosPcActl_D_Qf: category=VALUE, base-type=uint8, compu {phys=raw for raw 0..3, 0=Cx0_Faulty, 1=Cx1_No_Data_Exists, 2=Cx2_Not_Within_Specifications, 3=Cx3_OK; unit SED}, range raw 0..3
    Ford_BattULo_U_Actl: category=VALUE, base-type=uint8, compu {255=CxFF_Fault, phys=raw*0.0625 for raw 0..255; unit volt} "Source signal range: [0,254]"
    Ford_BpedDrvAppl_D_Actl: category=VALUE, base-type=uint8, compu {phys=raw for raw 0..3, 0=Cx0_Not_Allowed, 1=Cx1_Driver_Not_Braking, 2=Cx2_Driver_Braking, 3=Cx3_Not_Allowed; unit SED}, range raw 0..3
    Ford_BPedDrvAppl_D_QF: category=VALUE, base-type=uint8, compu {phys=raw for raw 0..3, 0=Cx0_Faulty, 1=Cx1_No_Data_Exists, 2=Cx2_Not_Within_Specifications, 3=Cx3_OK; unit SED}, range raw 0..3
    Ford_BrkTot_Tq_Actl: category=VALUE, base-type=uint16, compu {8190=Cx1FFE_Unknown, 8191=Cx1FFF_Fault, phys=raw*4 for raw 0..8191; unit Nm} "Source signal range: [0,8189]", range raw 0..8191
    Ford_CmbbBrkDis_B_Actl: category=VALUE, base-type=boolean, compu {phys=raw for raw 0..1, 0=Cx0_No, 1=Cx1_Yes; unit SED}
    Ford_CmbbDeny_B_ActlBrk: category=VALUE, base-type=boolean, compu {phys=raw for raw 0..1, 0=Cx0_No, 1=Cx1_Yes; unit SED}
    Ford_CmbbObjClass_D_Stat: category=VALUE, base-type=uint8, compu {phys=raw for raw 0..15, 0=Cx0_Undetermined, 1=Cx1_Vehicle, 2=Cx2_Motorcycle, 3=Cx3_Truck, 4=Cx4_Pedestrian, 5=Cx5_Bicycle, 6=Cx6_Unclassified_Vehicle, 7=Cx7_NotUsed_1, 8=Cx8_NotUsed_2, 9=Cx9_NotUsed_3, 10=CxA_NotUsed_4, 11=CxB_NotUsed_5, 12=CxC_NotUsed_6, 13=CxD_NotUsed_7, 14=CxE_NotUsed_8, 15=CxF_NotUsed_9; unit SED}, range raw 0..15
    Ford_CmbbObjColl_T_Actl: category=VALUE, base-type=uint8, compu {126=Cx7E_NoDataExists, 127=Cx7F_Faulty, phys=raw*0.05 for raw 0..127; unit second} "Source signal range: [0,125]", range raw 0..127
    Ford_CmbbObjConfdnc_D_Stat: category=VALUE, base-type=uint8, compu {phys=raw for raw 0..3, 0=Cx0_NotDetermined, 1=Cx1_Low, 2=Cx2_Medium, 3=Cx3_High; unit SED}, range raw 0..3
    Ford_CmbbObjDistLat_L_Actl: category=VALUE, base-type=uint16, compu {510=Cx1FE_NoDataExists, 511=Cx1FF_Faulty, phys=raw*0.1-25.5 for raw 0..511; unit meter} "Source signal range: [0,509]", range raw 0..511
    Ford_CmbbObjDistLong_L_Actl: category=VALUE, base-type=uint16, compu {1022=Cx3FE_NoDataExists, 1023=Cx3FF_Faulty, phys=raw*0.1 for raw 0..1023; unit meter} "Source signal range: [0,1021]", range raw 0..1023
    Ford_CmbbObjRelLat_V_Actl: category=VALUE, base-type=uint16, compu {510=Cx1FE_NoDataExists, 511=Cx1FF_Faulty, phys=raw*0.1-25.5 for raw 0..511; unit meters/sec} "Source signal range: [0,509]", range raw 0..511
    Ford_CmbbObjRelLong_V_Actl: category=VALUE, base-type=uint16, compu {1022=Cx3FE_NoDataExists, 1023=Cx3FF_Faulty, phys=raw*0.1-102.1 for raw 0..1023; unit meters/sec} "Source signal range: [0,1021]", range raw 0..1023
    Ford_DeliveryIdle: category=VALUE, base-type=uint16
    Ford_DeliveryNumber: category=VALUE, base-type=uint8
    Ford_DeliverySipNumber: category=VALUE, base-type=uint32, range raw 0..16777215
    Ford_DeliverySubProjectNumber: category=VALUE, base-type=uint32
    Ford_DrvSte_D_Stat:
      category=VALUE
      base-type=uint8
      compu {phys=raw for raw 0..15, 0=Cx0_DSR_Deactivated, 1=Cx1_DSR_Request_Not_Applicable, 2=Cx2_EPAS_Comm_Disturbed, 3=Cx3_DSR_in_Normal_Idle_Mode, 4=Cx4_Ignition_Off, 5=Cx5_Request_Active, 6=Cx6_NotUsed1, 7=Cx7_NotUsed2, 8=Cx8_NotUsed3, 9=Cx9_NotUsed4, 10=CxA_NotUsed5, 11=CxB_NotUsed6, 12=CxC_NotUsed7, 13=CxD_NotUsed8, 14=CxE_NotUsed9, 15=CxF_NotUsed10; unit SED}
      range raw 0..15
    Ford_DrvSte_Tq_Actl: category=VALUE, base-type=uint8, compu {254=CxFE_Unknown, 255=CxFF_Invalid, phys=raw*0.0625-8 for raw 0..255; unit Nm} "Source signal range: [0,253]"
    Ford_DrvSte_Tq_Rq: category=VALUE, base-type=uint8, compu {254=CxFE_Unknown, 255=CxFF_Invalid, phys=raw*0.0625-8 for raw 0..255; unit Nm} "Source signal range: [0,253]"
    Ford_DrvSteActv_B_Stat: category=VALUE, base-type=boolean, compu {phys=raw for raw 0..1, 0=Cx0_Inactive, 1=Cx1_Active; unit SED}
    Ford_ElPw_D_Stat: category=VALUE, base-type=uint8, compu {phys=raw for raw 0..7, 0=Cx0_Not_Supported, 1=Cx1_Supported, 2=Cx2_Not_Supported_Imminent, 3=Cx3_LV_Event_In_Progress, 4=Cx4_Fault_Limited, 5=Cx5_NotUsed_1, 6=Cx6_NotUsed_2, 7=Cx7_NotUsed_3; unit SED}, range raw 0..7
    Ford_ElPw_D_StatStrtStop:
      category=VALUE
      base-type=uint8
      compu {phys=raw for raw 0..15, 0=Cx0_Not_Supported, 1=Cx1_Supported_All, 2=Cx2_Not_Supported_Imminent, 3=Cx3_LV_Event_in_Progress, 4=Cx4_Fault_Limited, 5=Cx5_Limited_Support, 6=Cx6_Supported_Level_1, 7=Cx7_Supported_Level_2, 8=Cx8_Supported_Level_3, 9=Cx9_Supported_Level_4, 10=CxA_NotUsed1, 11=CxB_NotUsed2, 12=CxC_NotUsed3, 13=CxD_NotUsed4, 14=CxE_NotUsed5, 15=CxF_NotUsed6; unit SED}
      range raw 0..15
    Ford_EngAout_N_Actl: category=VALUE, base-type=uint16, compu {phys=raw*2 for raw 0..8191; unit rpm}, range raw 0..8191
    Ford_EPAS_Failure: category=VALUE, base-type=uint8, compu {phys=raw for raw 0..3, 0=Cx0_EPAS_OK_NO_MESSAGE, 1=Cx1_POWER_STRG_ASSIST_FAULT, 2=Cx2_SERVICE_POWER_STEERING, 3=Cx3_SERVICE_POWER_STEERING_NOW; unit SED}, range raw 0..3
    Ford_EPASExtAngleStatReq: category=VALUE, base-type=boolean, compu {phys=raw for raw 0..1, 0=Cx0_NoRequest, 1=Cx1_Request; unit SED}
    Ford_EsaEnbl_D2_Rq: category=VALUE, base-type=uint8, compu {phys=raw for raw 0..3, 0=Cx0_Disabled, 1=Cx1_Pending, 2=Cx2_Enabled, 3=Cx3_NotConfigured; unit SED}, range raw 0..3
    Ford_EsaOn_B_Rq: category=VALUE, base-type=boolean, compu {phys=raw for raw 0..1, 0=Cx0_Off, 1=Cx1_On; unit SED}
    Ford_EsaOn_B_Stat: category=VALUE, base-type=boolean, compu {phys=raw for raw 0..1, 0=Cx0_Off, 1=Cx1_On; unit SED}
    Ford_ExtSteeringAngleReq2: category=VALUE, base-type=uint16, compu {32766=Cx7FFE_Unknown, 32767=Cx7FFF_Invalid, phys=raw*0.1-1000 for raw 0..32767; unit Degrees} "Source signal range: [0,32765]", range raw 0..32767
    Ford_FileVersionDay: category=VALUE, base-type=uint8
    Ford_FileVersionMonth: category=VALUE, base-type=uint8
    Ford_FileVersionNumber: category=VALUE, base-type=uint8
    Ford_FileVersionYear: category=VALUE, base-type=uint8
    Ford_GearLvrPos_D_Actl: category=VALUE, base-type=uint8, compu {phys=raw for raw 0..15, 0=Cx0_Park, 1=Cx1_Reverse, 2=Cx2_Neutral, 3=Cx3_Drive, 4=Cx4_Sport_DriveSport, 5=Cx5_Low, 6=Cx6_first, 7=Cx7_second, 8=Cx8_third, 9=Cx9_fourth, 10=CxA_fifth, 11=CxB_sixth, 12=CxC_Undefined_Treat_as_Fault, 13=CxD_Undefined_Treat_as_Fault (Undefined_Treat_as__Fault), 14=CxE_Unknown_Position, 15=CxF_Fault; unit SED}, range raw 0..15
    Ford_GearPos_D_Actl: category=VALUE, base-type=uint8, compu {phys=raw for raw 0..15, 0=Cx0_Neutral, 1=Cx1_First, 2=Cx2_Second, 3=Cx3_Third, 4=Cx4_Fourth, 5=Cx5_Fifth, 6=Cx6_Sixth, 7=Cx7_Seventh, 8=Cx8_Eighth, 9=Cx9_Ninth, 10=CxA_Tenth, 11=CxB_Undefined_3, 12=CxC_Undefined_4, 13=CxD_Undefined_5, 14=CxE_Reverse, 15=CxF_Unknown; unit SED}, range raw 0..15
    Ford_GearRvrse_D_Actl: category=VALUE, base-type=uint8, compu {phys=raw for raw 0..7, 0=Cx0_Inactive_not_confirmed, 1=Cx1_Inactive_confirmed, 2=Cx2_Active_not_confirmed, 3=Cx3_Active_confirmed, 4=Cx4_NotUsed_1, 5=Cx5_NotUsed_2, 6=Cx6_NotUsed_3, 7=Cx7_Fault; unit SED}, range raw 0..7
    Ford_HandsOffCnfm_B_Rq: category=VALUE, base-type=boolean, compu {phys=raw for raw 0..1, 0=Cx0_Inactive, 1=Cx1_Active; unit SED}
    Ford_HitchToTrlrAxle_L_Calc: category=VALUE, base-type=uint16, compu {phys=raw*0.0254 for raw 0..511; unit meter}, range raw 0..511
    Ford_HitchToVehAxle_L_Calc: category=VALUE, base-type=uint8, compu {255=CxFF_Faulty, phys=raw*0.0127-0.508 for raw 0..255; unit meter} "Source signal range: [0,254]"
    Ford_Ignition_Status: category=VALUE, base-type=uint8, compu {phys=raw for raw 0..15, 0=Cx0_Unknown, 1=Cx1_Off, 2=Cx2_Accessory, 4=Cx4_Run, 8=Cx8_Start, 15=CxF_Invalid; unit SED}, range raw 0..15
    Ford_LaActAvail_D_Actl: category=VALUE, base-type=uint8, compu {phys=raw for raw 0..3, 0=Cx0_LCA_LKA_LDW_Suppress, 1=Cx1_LCA_LKA_Suppress_LDW_Avail, 2=Cx2_LCA_LKA_Avail_LDW_Suppress, 3=Cx3_LKA_LCA_LDW_Avail; unit SED}, range raw 0..3
    Ford_LaActDeny_B_Actl: category=VALUE, base-type=boolean, compu {phys=raw for raw 0..1, 0=Cx0_LA_Not_Denied, 1=Cx1_LA_Denied; unit SED}
    Ford_LaCurvature_No_Calc: category=VALUE, base-type=uint16, compu {4095=CxFFF_Fault, phys=raw*5e-06-0.01024 for raw 0..4095; unit 1/m} "Source signal range: [0,4094]", range raw 0..4095
    Ford_LaHandsOff_B_Actl: category=VALUE, base-type=boolean, compu {phys=raw for raw 0..1, 0=Cx0_Hands_On, 1=Cx1_Hands_Off; unit SED}
    Ford_LaRampType_B_Req: category=VALUE, base-type=boolean, compu {phys=raw for raw 0..1, 0=Cx0_Smooth, 1=Cx1_Quick; unit SED}
    Ford_LaRefAng_No_Req: category=VALUE, base-type=uint16, compu {4095=CxFFF_Fault, phys=raw*0.05-102.4 for raw 0..4095; unit mrad} "Source signal range: [0,4094]", range raw 0..4095
    Ford_LatCtl_D_Rq: category=VALUE, base-type=uint8, compu {phys=raw for raw 0..7, 0=Cx0_NoLateralControl, 1=Cx1_ContinuousPathFollowing, 2=Cx2_InterventionLeft, 3=Cx3_InterventionRight, 4=Cx4_NotUsed1, 5=Cx5_NotUsed2, 6=Cx6_NotUsed3, 7=Cx7_NotUsed4; unit SED}, range raw 0..7
    Ford_LatCtlCurv_No_Actl: category=VALUE, base-type=uint16, compu {phys=raw*2e-05-0.02 for raw 0..2047; unit 1/meter}, range raw 0..2047
    Ford_LatCtlCurv_NoRate_Actl: category=VALUE, base-type=uint16, compu {phys=raw/4000000-0.001024 for raw 0..8191; unit 1/meter}, range raw 0..8191
    Ford_LatCtlLim_D_Stat: category=VALUE, base-type=uint8, compu {phys=raw for raw 0..3, 0=Cx0_LimitNotReached, 1=Cx1_LimitClose, 2=Cx2_LimitReached, 3=Cx3_LimitWithDriverActive; unit SED}, range raw 0..3
    Ford_LatCtlPath_An_Actl: category=VALUE, base-type=uint16, compu {phys=raw*0.0005-0.5 for raw 0..2046; unit radians}, range raw 0..2047
    Ford_LatCtlPathOffst_L_Actl: category=VALUE, base-type=uint16, compu {phys=raw*0.01-5.12 for raw 0..1023; unit meter}, range raw 0..1023
    Ford_LatCtlPrecision_D_Rq: category=VALUE, base-type=uint8, compu {phys=raw for raw 0..3, 0=Cx0_Comfortable, 1=Cx1_Precise, 2=Cx2_NotUsed1, 3=Cx3_NotUsed2; unit SED}, range raw 0..3
    Ford_LatCtlRampType_D_Rq: category=VALUE, base-type=uint8, compu {phys=raw for raw 0..3, 0=Cx0_Slow, 1=Cx1_Medium, 2=Cx2_Fast, 3=Cx3_Immediately; unit SED}, range raw 0..3
    Ford_LatCtlRng_L_Max: category=VALUE, base-type=uint8, compu {phys=raw*2 for raw 0..63; unit meter}, range raw 0..63
    Ford_LatCtlSte_D_Stat: category=VALUE, base-type=uint8, compu {phys=raw for raw 0..7, 0=Cx0_Unavailable, 1=Cx1_Available, 2=Cx2_ContLatControlInProgress, 3=Cx3_RampOut, 4=Cx4_Denied, 5=Cx5_NotUsed1, 6=Cx6_NotUsed2, 7=Cx7_NotUsed3; unit SED}, range raw 0..7
    Ford_LdwActvIntns_D_Req: category=VALUE, base-type=uint8, compu {phys=raw for raw 0..3, 0=Cx0_None, 1=Cx1_Low, 2=Cx2_Medium, 3=Cx3_High; unit SED}, range raw 0..3
    Ford_LdwActvStats_D_Req: category=VALUE, base-type=uint8, compu {phys=raw for raw 0..7, 0=Cx0_LDW_Idle, 1=Cx1_Not_Used1, 2=Cx2_LDW_Warning_Left, 3=Cx3_LDW_Suppress_Left, 4=Cx4_LDW_Warning_Right, 5=Cx5_LDW_Suppress_Right, 6=Cx6_Not_Used2, 7=Cx7_LDW_Suppress_Right_Left; unit SED}, range raw 0..7
    Ford_LifeCycMde_D_Actl: category=VALUE, base-type=uint8, compu {phys=raw for raw 0..15, 0=Cx0_Normal, 1=Cx1_Factory, 2=Cx2_NotUsed, 3=Cx3_Transport; unit SED}, range raw 0..15
    Ford_LkaActvStats_D2_Req: category=VALUE, base-type=uint8, compu {phys=raw for raw 0..7, 0=Cx0_LkaNoInterv, 1=Cx1_LkaIncrIntervLeft, 2=Cx2_LkaStandIntervLeft, 3=Cx3_LkaSupprLeft, 4=Cx4_LkaStandIntervRight, 5=Cx5_LkaSupprRight, 6=Cx6_LkaIncrIntervRight, 7=Cx7_NotUsed; unit SED}, range raw 0..7
    Ford_LkaDrvOvrrd_D_Rq: category=VALUE, base-type=uint8, compu {phys=raw for raw 0..3, 0=Cx0_Level_0, 1=Cx1_Level_1, 2=Cx2_Level_2, 3=Cx3_Level_3; unit SED}, range raw 0..3
    Ford_LsmcBrk_Tq_Rq: category=VALUE, base-type=uint16, compu {phys=raw*4 for raw 0..8191; unit Nm}, range raw 0..8191
    Ford_LsmcBrkDecel_D_Stat: category=VALUE, base-type=uint8, compu {phys=raw for raw 0..7, 0=Cx0_Off, 1=Cx1_On, 2=Cx2_FaultExt, 3=Cx3_FaultDegraded, 4=Cx4_Denied, 5=Cx5_NotUsed_1, 6=Cx6_NotUsed_2, 7=Cx7_NotUsed_3; unit SED}, range raw 0..7
    Ford_LsmcBrkDecelEnbl_D_Rq: category=VALUE, base-type=uint8, compu {phys=raw for raw 0..3, 0=Cx0_Off, 1=Cx1_On, 2=Cx2_NotUsed1, 3=Cx3_NotUsed2; unit SED}, range raw 0..3
    Ford_OdometerMasterValue: category=VALUE, base-type=uint32, compu {phys=raw for raw 0..16777215, 16777215=CxFFFFFF_Invalid; unit km} "Source signal range: [0,16777214]", range raw 0..16777215
    Ford_Outside_Air_Temp_Stat: category=VALUE, base-type=uint8, compu {254=CxFE_Unknown, 255=CxFF_Invalid, phys=raw*0.5-40 for raw 0..255; unit Degrees C} "Source signal range: [0,253]"
    Ford_PrplWhlTot2_Tq_Actl: category=VALUE, base-type=uint16, compu {65534=CxFFFE_NoDataExists, 65535=CxFFFF_Fault, phys=raw*4-131072 for raw 0..65535; unit Nm} "Source signal range: [0,65533]"
    Ford_PwPckTq_D_Stat: category=VALUE, base-type=uint8, compu {phys=raw for raw 0..3, 0=Cx0_PwPckOff_TqNotAvailable, 1=Cx1_PwPckOn_TqNotAvailable, 2=Cx2_StartInPrgrss_TqNotAvail, 3=Cx3_PwPckOn_TqAvailable; unit SED}, range raw 0..3
    Ford_SAPPAngleControlStat1: category=VALUE, base-type=uint8, compu {phys=raw for raw 0..3, 0=Cx0_Closed, 1=Cx1_Open, 2=Cx2_Active, 3=Cx3_Fault; unit SED}, range raw 0..3
    Ford_SAPPAngleControlStat2: category=VALUE, base-type=boolean, compu {phys=raw for raw 0..1, 0=Cx0_NoRel_ExtSteeringAngleReqx, 1=Cx1_Rel_ExtSteeringAngleReqx; unit SED}
    Ford_SAPPAngleControlStat3: category=VALUE, base-type=boolean, compu {phys=raw for raw 0..1, 0=Cx0_ExternalSigContentOKforEAC, 1=Cx1_EARactiveNoReverseEngage; unit SED}
    Ford_SAPPAngleControlStat4: category=VALUE, base-type=boolean, compu {phys=raw for raw 0..1, 0=Cx0_ExternalSigContentOKforEAC, 1=Cx1_SpeedLimitExceededEAROn; unit SED}
    Ford_SAPPAngleControlStat5: category=VALUE, base-type=boolean, compu {phys=raw for raw 0..1, 0=Cx0_ExternalSigContentOKforEAC, 1=Cx1_StrgColTorqueExceed_EAROn; unit SED}
    Ford_SAPPAngleControlStat6: category=VALUE, base-type=boolean, compu {phys=raw for raw 0..1, 0=Cx0_RequestedAngleCanBeReached, 1=Cx1_RequestedAngleNotReached; unit SED}
    Ford_SelDrvMdeChassis2_D_Rq:
      category=VALUE
      base-type=uint8
      compu {phys=raw for raw 0..31, 0=Cx00_NormalMode, 1=Cx01_NormalAdaptiveMode, 2=Cx02_EconomyMode, 3=Cx03_SportMode, 4=Cx04_SportAdaptiveMode, 5=Cx05_ComfortMode, 6=Cx06_ComfortAdaptiveMode, 7=Cx07_LowMuMode, 8=Cx08_MudAndRutsMode, 9=Cx09_SandMode, 10=Cx0A_RockCrawlMode, 11=Cx0B_TowHaulMode, 12=Cx0C_HighSpeedDesertMode, 13=Cx0D_TrackMode, 14=Cx0E_RoughRoadMode, 15=Cx0F_NotUsed2, 16=Cx10_NotUsed3, 17=Cx11_NotUsed4, 18=Cx12_NotUsed5, 19=Cx13_NotUsed6, 20=Cx14_NotUsed7, 21=Cx15_NotUsed8, 22=Cx16_NotUsed9, 23=Cx17_NotUsed10, 24=Cx18_NotUsed11, 25=Cx19_NotUsed12, 26=Cx1A_NotUsed13, 27=Cx1B_NotUsed14, 28=Cx1C_NotUsed15, 29=Cx1D_NotUsed16, 30=Cx1E_NotUsed17, 31=Cx1F_Faulty; unit SED}
      range raw 0..31
    Ford_SelDrvMdeSte_D_Stat: category=VALUE, base-type=uint8, compu {phys=raw for raw 0..3, 0=Cx0_NotAvailable, 1=Cx1_Available, 2=Cx2_TemporarilyNotAvailable, 3=Cx3_Faulty; unit SED}, range raw 0..3
    Ford_StabCtlBrkActv_B_Actl: category=VALUE, base-type=boolean, compu {phys=raw for raw 0..1, 0=Cx0_No, 1=Cx1_Yes; unit SED}
    Ford_SteeringColumnTorque: category=VALUE, base-type=uint8, compu {254=CxFE_Unknown, 255=CxFF_Invalid, phys=raw*0.0625-8 for raw 0..255; unit Nm} "Source signal range: [0,253]"
    Ford_SteMdule_D_Stat: category=VALUE, base-type=uint8, compu {phys=raw for raw 0..7, 0=Cx0_EPAS_Initialization, 1=Cx1_Normal_Op_Limited_Assist, 2=Cx2_Normal_Op_Full_Assist, 3=Cx3_EPAS_Shutdown, 4=Cx4_System_Failure, 5=Cx5_EPAS_Failure2, 6=Cx6_EPAS_Failure3, 7=Cx7_NotUsed; unit SED}, range raw 0..7
    Ford_SteMdule_I_Est: category=VALUE, base-type=uint16, compu {4095=CxFFF_Invalid, phys=raw*0.05-64 for raw 0..4095; unit Amps} "Source signal range: [0,4094]", range raw 0..4095
    Ford_SteMdule_U_Meas: category=VALUE, base-type=uint8, compu {255=CxFF_Invalid, phys=raw*0.05+6 for raw 0..255; unit Volts} "Source signal range: [0,254]"
    Ford_StePinAn_No_Cnt: category=VALUE, base-type=uint8, compu {phys=raw for raw 0..15; unit unitless}, range raw 0..15
    Ford_StePinAn_No_Cs: category=VALUE, base-type=uint8, compu {phys=raw for raw 0..255; unit Unitless}
    Ford_StePinComp_An_Est: category=VALUE, base-type=uint16, compu {phys=raw*0.1-1600 for raw 0..32766; unit degrees}, range raw 0..32767
    Ford_StePinCompAnEst_D_Qf: category=VALUE, base-type=uint8, compu {phys=raw for raw 0..3, 0=Cx0_Faulty, 1=Cx1_No_Data_Exists, 2=Cx2_Degraded, 3=Cx3_OK; unit SED}, range raw 0..3
    Ford_StePinOffst_An_Est: category=VALUE, base-type=uint16, compu {65534=CxFFFE_NoDataExists, 65535=CxFFFF_Faulty, phys=raw*0.1-3200 for raw 0..65535; unit degrees} "Source signal range: [0,65533]"
    Ford_StePinOffst_D_Stat: category=VALUE, base-type=uint8, compu {phys=raw for raw 0..3, 0=Cx0_OffsetNotCalculated, 1=Cx1_StoredOffset, 2=Cx2_CoarseOffset, 3=Cx3_FineOffset; unit SED}, range raw 0..3
    Ford_StePinOffst_No_Cnt: category=VALUE, base-type=uint8, compu {phys=raw for raw 0..15; unit unitless}, range raw 0..15
    Ford_StePinOffst_No_Cs: category=VALUE, base-type=uint8, compu {phys=raw for raw 0..255; unit Unitless}
    Ford_StePinRelInit_An_Sns: category=VALUE, base-type=uint16, compu {65534=CxFFFE_NoDataExists, 65535=CxFFFF_Faulty, phys=raw*0.1-3200 for raw 0..65535; unit degrees} "Source signal range: [0,65533]"
    Ford_StePw_B_Rq: category=VALUE, base-type=boolean, compu {phys=raw for raw 0..1, 0=Cx0_No, 1=Cx1_Yes; unit SED}
    Ford_SteWhlRelCalib_An_Sns: category=VALUE, base-type=uint16, compu {32766=Cx7FFE_NoDataExists, 32767=Cx7FFF_Fault, phys=raw*0.1-1600 for raw 0..32767; unit deg} "Source signal range: [0,32765]", range raw 0..32767
    Ford_TjaHandsOnCnfdnc_B_Est: category=VALUE, base-type=boolean, compu {phys=raw for raw 0..1, 0=Cx0_Low_Confidence, 1=Cx1_High_Confidence; unit SED}
    Ford_TrlrAid_An3_Actl: category=VALUE, base-type=uint16, compu {2047=Cx7FF_Faulty, phys=raw*0.125-90 for raw 0..2047; unit degrees} "Source signal range: [0,2046]", range raw 0..2047
    Ford_TrlrAid_AnRate2_Actl: category=VALUE, base-type=uint16, compu {1023=Cx3FF_Faulty, phys=raw*0.125-50 for raw 0..1023; unit degrees/second} "Source signal range: [0,1022]", range raw 0..1023
    Ford_TrlrAid_D2_Stat:
      category=VALUE
      base-type=uint8
      compu {phys=raw for raw 0..15, 0=Cx0_NotTracking, 1=Cx1_Initializing, 2=Cx2_DriveStraighRequested, 3=Cx3_TurnRequested, 4=Cx4_TrackingLowConfidence, 5=Cx5_TrackingMediumConfidence, 6=Cx6_TrackingHighConfidence, 7=Cx7_TrackingUnknownConfidence, 8=Cx8_TrackingLost, 9=Cx9_IncorrectLighting, 10=CxA_DirtyCamera, 11=CxB_NotUsed_1, 12=CxC_NotUsed_2, 13=CxD_NotUsed_3, 14=CxE_NotUsed_4, 15=CxF_Faulty; unit SED}
      range raw 0..15
    Ford_TrlrAidCancl_B_Rq: category=VALUE, base-type=boolean, compu {phys=raw for raw 0..1, 0=Cx0_Null, 1=Cx1_Cancel; unit SED}
    Ford_TrlrAidCtl_U_RqDrv: category=VALUE, base-type=uint16, compu {4094=CxFFE_NoDataExists, 4095=CxFFF_Faulty, phys=raw/800 for raw 0..4095; unit volt} "Source signal range: [0,4093]", range raw 0..4095
    Ford_TrlrAidEnbl_D2_Rq: category=VALUE, base-type=uint8, compu {phys=raw for raw 0..7, 0=Cx0_Inactive, 1=Cx1_ActivateTba, 2=Cx2_ActivateTrg, 3=Cx3_Deactivate, 4=Cx4_NotUsed_1, 5=Cx5_NotUsed_2, 6=Cx6_NotUsed_3, 7=Cx7_NotUsed_4; unit SED}, range raw 0..7
    Ford_TrlrAidEnbl_D2_Stat: category=VALUE, base-type=uint8, compu {phys=raw for raw 0..7, 0=Cx0_Inactive, 1=Cx1_TbaActive, 2=Cx2_TbaSetup, 3=Cx3_TbaOffTrgSetup, 4=Cx4_TbaOffTrgActive, 5=Cx5_TbaActiveExpertAvail, 6=Cx6_TbaActiveExpertActive, 7=Cx7_NotUsed_1; unit SED}, range raw 0..7
    Ford_TrlrAidMde_D_Rq: category=VALUE, base-type=uint8, compu {phys=raw for raw 0..3, 0=Cx0_NoRequest, 1=Cx1_Mode_1, 2=Cx2_Mode_2, 3=Cx3_Mode_3; unit SED}, range raw 0..3
    Ford_TrlrAidMsgTxt_D2_Rq:
      category=VALUE
      base-type=uint8
      compu {phys=raw for raw 0..63, 0=Cx00_NoMessage, 1=Cx01_Message1, 2=Cx02_Message2, 3=Cx03_Message3, 4=Cx04_Message4, 5=Cx05_Message5, 6=Cx06_Message6, 7=Cx07_Message7, 8=Cx08_Message8, 9=Cx09_Message9, 10=Cx0A_Message10, 11=Cx0B_Message11, 12=Cx0C_Message12, 13=Cx0D_Message13, 14=Cx0E_Message14, 15=Cx0F_Message15, 16=Cx10_Message16, 17=Cx11_Message17, 18=Cx12_Message18, 19=Cx13_Message19, 20=Cx14_Message20, 21=Cx15_Message21, 22=Cx16_Message22, 23=Cx17_Message23, 24=Cx18_Message24, 25=Cx19_Message25, 26=Cx1A_Message26, 27=Cx1B_Message27, 28=Cx1C_Message28, 29=Cx1D_Message29, 30=Cx1E_Message30, 31=Cx1F_Message31, 35=Cx23_Message35, 40=Cx28_Message40, 45=Cx2D_Message45, 50=Cx32_Message50, 55=Cx37_Message55, 60=Cx3C_Message60, 61=Cx3D_Message61, 62=Cx3E_Message62, 63=Cx3F_Message63; unit SED}
      range raw 0..63
    Ford_TrlrAidSetup_D2_Rq: category=VALUE, base-type=uint8, compu {phys=raw for raw 0..15, 0=Cx0_Inactive, 1=Cx1_BeginSetup, 2=Cx2_EndSetup, 3=Cx3_ConfirmSetup, 4=Cx4_StickerNotCircled, 5=Cx5_ReturnToSetup, 6=Cx6_CompleteSetup, 7=Cx7_NotUsed_1, 8=Cx8_NotUsed_2, 9=Cx9_NotUsed_3, 10=CxA_NotUsed_4, 11=CxB_NotUsed_5, 12=CxC_NotUsed_6, 13=CxD_NotUsed_7, 14=CxE_NotUsed_8, 15=CxF_NotUsed_9; unit SED}, range raw 0..15
    Ford_TrlrAidSetup_D2_Stat: category=VALUE, base-type=uint8, compu {phys=raw for raw 0..7, 0=Cx0_Null, 1=Cx1_TbaActive, 2=Cx2_SetupPrepForAcquisition, 3=Cx3_SetupStartAcquisition, 4=Cx4_TbaTadMonitor, 5=Cx5_SetupAcquisitionSuccess, 6=Cx6_NotUsed_1, 7=Cx7_NotUsed_2; unit SED}, range raw 0..7
    Ford_TrlrAidSwtch_D_RqDrv: category=VALUE, base-type=uint8, compu {phys=raw for raw 0..3, 0=Cx0_Not_Pressed, 1=Cx1_Pressed, 2=Cx2_NotUsed, 3=Cx3_Faulty; unit SED}, range raw 0..3
    Ford_TrlrAidTrgtId_No_Actl: category=VALUE, base-type=uint8, compu {phys=raw for raw 0..31; unit unitless}, range raw 0..31
    Ford_TrlrAidTrgtId_No_Rq: category=VALUE, base-type=uint8, compu {phys=raw for raw 0..31; unit unitless}, range raw 0..31
    Ford_TrlrAidTrlrId_No_Rq: category=VALUE, base-type=uint8, compu {phys=raw for raw 0..15; unit unitless}, range raw 0..15
    Ford_TrlrAn_An_MxCalc: category=VALUE, base-type=uint8, compu {phys=raw for raw 0..127; unit degrees}, range raw 0..127
    Ford_TrlrAn_An_TrgtCalc: category=VALUE, base-type=uint8, compu {phys=raw-128 for raw 0..255; unit degrees}
    Ford_TrlrAn_An_WarnCalc: category=VALUE, base-type=uint8, compu {phys=raw for raw 0..31; unit degrees}, range raw 0..31
    Ford_TrlrAnOffst_An2_Calc: category=VALUE, base-type=uint8, compu {phys=raw*0.5-64 for raw 0..255; unit degrees}
    Ford_TrlrAnOffstDir_D_Mem: category=VALUE, base-type=uint8, compu {phys=raw for raw 0..3, 0=Cx0_Null, 1=Cx1_Left_or_Center, 2=Cx2_Right, 3=Cx3_NotUSed; unit SED}, range raw 0..3
    Ford_TrlrAxleToBmpr_L_Actl: category=VALUE, base-type=uint16, compu {phys=raw*0.0254 for raw 0..511; unit meter}, range raw 0..511
    Ford_TrlrBrkActCnnct_B_Actl: category=VALUE, base-type=boolean, compu {phys=raw for raw 0..1, 0=Cx0_No, 1=Cx1_Yes; unit SED}
    Ford_TrlrHitchLamp_D_Rqst: category=VALUE, base-type=boolean, compu {phys=raw for raw 0..1, 0=Cx0_Off, 1=Cx1_On; unit SED}
    Ford_TrlrHitchYaw_An_Actl: category=VALUE, base-type=uint16, compu {4094=CxFFE_NoDataExists, 4095=CxFFF_Faulty, phys=raw*0.1-90 for raw 0..4095; unit degrees} "Source signal range: [0,4093]", range raw 0..4095
    Ford_TrlrHitchYaw_D_Stat:
      category=VALUE
      base-type=uint8
      compu {phys=raw for raw 0..15, 0=Cx0_NoConnectionWithYrsu, 1=Cx1_TadNotWithinSpecification, 2=Cx2_TadTrlrDataOutOfRange, 3=Cx3_InitInputs, 4=Cx4_InitNoTadAngle, 5=Cx5_LowConfdAngleMem, 6=Cx6_HiConfdAngleMem, 7=Cx7_LowConfdLrndAngle, 8=Cx8_HiConfdLrndAngle, 9=Cx9_FaultyYrsu, 10=CxA_FaultyYrsuConnection, 11=CxB_NotUsed_1, 12=CxC_NotUsed_2, 13=CxD_NotUsed_3, 14=CxE_NotUsed_4, 15=CxF_Faulty; unit SED}
      range raw 0..15
    Ford_TrlrHitYaw_AnRate_Actl: category=VALUE, base-type=uint16, compu {4094=CxFFE_NoDataExists, 4095=CxFFF_Fault, phys=raw*0.1-50 for raw 0..4095; unit degrees/second} "Source signal range: [0,4093]", range raw 0..4095
    Ford_TrlrId_No_Actl: category=VALUE, base-type=uint8, compu {phys=raw for raw 0..15; unit unitless}, range raw 0..15
    Ford_TrlrIdType_D_Stat: category=VALUE, base-type=uint8, compu {phys=raw for raw 0..3, 0=Cx0_Null, 1=Cx1_Conventional, 2=Cx2_FifthWheel, 3=Cx3_Gooseneck; unit SED}, range raw 0..3
    Ford_TrlrLampCnnct_B_Actl: category=VALUE, base-type=boolean, compu {phys=raw for raw 0..1, 0=Cx0_No, 1=Cx1_Yes; unit SED}
    Ford_TrlrRvrse_D_Stat: category=VALUE, base-type=uint8, compu {phys=raw for raw 0..3, 0=Cx0_Off, 1=Cx1_On, 2=Cx2_TrailerReverseGuidanceLite, 3=Cx3_Faulty; unit SED}, range raw 0..3
    Ford_TrlrRvrseCancl_B_Rq: category=VALUE, base-type=boolean, compu {phys=raw for raw 0..1, 0=Cx0_Null, 1=Cx1_Cancel; unit SED}
    Ford_TrlrRvrseEnbl_D2_Stat: category=VALUE, base-type=uint8, compu {phys=raw for raw 0..7, 0=Cx0_Inactive, 1=Cx1_TbaActive, 2=Cx2_TbaSetup, 3=Cx3_TbaOffTrgSetup, 4=Cx4_TbaOffTrgActive, 5=Cx5_TbaActiveExpertAvail, 6=Cx6_TbaActiveExpertActive, 7=Cx7_NotUsed; unit SED}, range raw 0..7
    Ford_TrlrRvrseMsgTxt_D2_Rq:
      category=VALUE
      base-type=uint8
      compu {phys=raw for raw 0..63, 0=Cx00_NoMessage, 1=Cx01_Message1, 2=Cx02_Message2, 3=Cx03_Message3, 4=Cx04_Message4, 5=Cx05_Message5, 6=Cx06_Message6, 7=Cx07_Message7, 8=Cx08_Message8, 9=Cx09_Message9, 10=Cx0A_Message10, 11=Cx0B_Message11, 12=Cx0C_Message12, 13=Cx0D_Message13, 14=Cx0E_Message14, 15=Cx0F_Message15, 16=Cx10_Message16, 17=Cx11_Message17, 18=Cx12_Message18, 19=Cx13_Message19, 20=Cx14_Message20, 21=Cx15_Message21, 22=Cx16_Message22, 23=Cx17_Message23, 24=Cx18_Message24, 25=Cx19_Message25, 26=Cx1A_Message26, 27=Cx1B_Message27, 28=Cx1C_Message28, 29=Cx1D_Message29, 30=Cx1E_Message30, 31=Cx1F_Message31; unit SED}
      range raw 0..63
    Ford_TrlrSnsId_No_Actl: category=ARRAY
      element Element: array-size=6, array-size-semantics=FIXED-SIZE, implementation-data-type=uint8
    Ford_TrlrTrgtAcquire_D_Stat: category=VALUE, base-type=uint8, compu {phys=raw for raw 0..7, 0=Cx0_Null, 1=Cx1_TargetAcquired, 2=Cx2_TargetNotAcquired, 3=Cx3_Processing, 4=Cx4_RVCforTBA_Activated, 5=Cx5_NotUsed_1, 6=Cx6_NotUsed_2, 7=Cx7_Faulty; unit SED}, range raw 0..7
    Ford_TrlrYaw_W_Actl: category=VALUE, base-type=uint16, compu {65534=CxFFFE_NoDataExists, 65535=CxFFFF_Faulty, phys=raw*0.0002-6.5 for raw 0..65535; unit radians/second} "Source signal range: [0,65533]"
    Ford_TrlrYawWActl_D_Qf: category=VALUE, base-type=uint8, compu {phys=raw for raw 0..3, 0=Cx0_Faulty, 1=Cx1_No_Data_Exists, 2=Cx2_Not_Within_Specifications, 3=Cx3_OK; unit SED}, range raw 0..3
    Ford_TrnRng_D_Rq: category=VALUE, base-type=uint8, compu {phys=raw for raw 0..15, 0=Cx0_Park, 1=Cx1_Reverse, 2=Cx2_Neutral, 3=Cx3_Drive, 4=Cx4_Sport_DriveSport_Mposition, 5=Cx5_Low, 6=Cx6_Range1_M1_L1, 7=Cx7_Range2_M2_L2, 8=Cx8_Range3_M3_L3, 9=Cx9_Range4, 10=CxA_Range5, 11=CxB_Range6, 12=CxC_NotUsed_1, 13=CxD_NotUsed_2, 14=CxE_Unknown_Position, 15=CxF_Fault; unit SED}, range raw 0..15
    Ford_TurnLghtSwtch_D_Stat: category=VALUE, base-type=uint8, compu {phys=raw for raw 0..3, 0=Cx0_Off, 1=Cx1_Left, 2=Cx2_Right, 3=Cx3_Unused_Treat_As_Off; unit SED}, range raw 0..3
    Ford_Veh_V_ActlBrk: category=VALUE, base-type=uint16, compu {phys=raw*0.01 for raw 0..65535; unit kph}
    Ford_Veh_V_ActlEng: category=VALUE, base-type=uint16, compu {phys=raw*0.01 for raw 0..65535; unit kph}
    Ford_Veh_V_RqMxTrlrAid: category=VALUE, base-type=uint8, compu {phys=raw*0.1 for raw 0..255; unit km/h}
    Ford_VehicleGGCCData: category=ARRAY
      element Element: array-size=8, array-size-semantics=FIXED-SIZE, implementation-data-type=uint8
    Ford_VehLatComp_A_Actl: category=VALUE, base-type=uint16, compu {1022=Cx3FE_NoDataExists, 1023=Cx3FF_Fault, phys=raw*0.035-17.9 for raw 0..1023; unit m/s^2} "Source signal range: [0,1021]", range raw 0..1023
    Ford_VehLongComp_A_Actl: category=VALUE, base-type=uint16, compu {1022=Cx3FE_NoDataExists, 1023=Cx3FF_Fault, phys=raw*0.035-17.9 for raw 0..1023; unit m/s^2} "Source signal range: [0,1021]", range raw 0..1023
    Ford_VehOverGnd_V_Est: category=VALUE, base-type=uint16, compu {65534=CxFFFE_Unknown, 65535=CxFFFF_Invalid, phys=raw*0.01 for raw 0..65535; unit kph} "Source signal range: [0,65533]"
    Ford_VehVActlBrk_D_Qf: category=VALUE, base-type=uint8, compu {phys=raw for raw 0..3, 0=Cx0_Faulty, 1=Cx1_No_Data_Exists, 2=Cx2_Not_Within_Specifications, 3=Cx3_OK; unit SED}, range raw 0..3
    Ford_VehVActlBrk_No_Cnt: category=VALUE, base-type=uint8, compu {phys=raw for raw 0..15; unit Unitless}, range raw 0..15
    Ford_VehVActlBrk_No_Cs: category=VALUE, base-type=uint8, compu {phys=raw for raw 0..255; unit Unitless}
    Ford_VehVActlEng_D_Qf: category=VALUE, base-type=uint8, compu {phys=raw for raw 0..3, 0=Cx0_Faulty, 1=Cx1_No_Data_Exists, 2=Cx2_Not_Within_Specifications, 3=Cx3_OK; unit SED}, range raw 0..3
    Ford_VehVActlEng_No_Cnt: category=VALUE, base-type=uint8, compu {phys=raw for raw 0..15; unit Unitless}, range raw 0..15
    Ford_VehVActlEng_No_Cs: category=VALUE, base-type=uint8, compu {phys=raw for raw 0..255; unit Unitless}
    Ford_VehVertComp_A_Actl: category=VALUE, base-type=uint16, compu {1022=Cx3FE_NoDataExists, 1023=Cx3FF_Fault, phys=raw*0.035-17.9 for raw 0..1023; unit m/s^2} "Source signal range: [0,1021]", range raw 0..1023
    Ford_VehVTrlrAid_B_Avail: category=VALUE, base-type=boolean, compu {phys=raw for raw 0..1, 0=Cx0_No, 1=Cx1_Yes; unit SED}
    Ford_VehVTrlrAid_B_Rq: category=VALUE, base-type=boolean, compu {phys=raw for raw 0..1, 0=Cx0_NoRequest, 1=Cx1_Request; unit SED}
    Ford_VehYaw_W_Actl: category=VALUE, base-type=uint16, compu {65534=CxFFFE_NoDataExists, 65535=CxFFFF_Faulty, phys=raw*0.0002-6.5 for raw 0..65535; unit rad/s} "Source signal range: [0,65533]"
    Ford_VehYawComp_W_Actl: category=VALUE, base-type=uint16, compu {4094=CxFFE_NoDataExists, 4095=CxFFF_Fault, phys=raw*0.03663-75 for raw 0..4095; unit deg/s} "Source signal range: [0,4093]", range raw 0..4095
    Ford_WhlDirFl_D_Actl: category=VALUE, base-type=uint8, compu {phys=raw for raw 0..3, 0=Cx0_Forward, 1=Cx1_Backward, 2=Cx2_Unknown, 3=Cx3_Failed; unit SED}, range raw 0..3
    Ford_WhlDirFr_D_Actl: category=VALUE, base-type=uint8, compu {phys=raw for raw 0..3, 0=Cx0_Forward, 1=Cx1_Backward, 2=Cx2_Unknown, 3=Cx3_Failed; unit SED}, range raw 0..3
    Ford_WhlDirRl_D_Actl: category=VALUE, base-type=uint8, compu {phys=raw for raw 0..3, 0=Cx0_Forward, 1=Cx1_Backward, 2=Cx2_Unknown, 3=Cx3_Failed; unit SED}, range raw 0..3
    Ford_WhlDirRr_D_Actl: category=VALUE, base-type=uint8, compu {phys=raw for raw 0..3, 0=Cx0_Forward, 1=Cx1_Backward, 2=Cx2_Unknown, 3=Cx3_Failed; unit SED}, range raw 0..3
    Ford_WhlFl_W_Meas: category=VALUE, base-type=uint16, compu {32766=Cx7FFE_Unknown, 32767=Cx7FFF_Fault, phys=raw*0.01 for raw 0..32767; unit rad/s} "Source signal range: [0,32765]", range raw 0..32767
    Ford_WhlFr_W_Meas: category=VALUE, base-type=uint16, compu {32766=Cx7FFE_Unknown, 32767=Cx7FFF_Fault, phys=raw*0.01 for raw 0..32767; unit rad/s} "Source signal range: [0,32765]", range raw 0..32767
    Ford_WhlRl_W_Meas: category=VALUE, base-type=uint16, compu {32766=Cx7FFE_Unknown, 32767=Cx7FFF_Fault, phys=raw*0.01 for raw 0..32767; unit rad/s} "Source signal range: [0,32765]", range raw 0..32767
    Ford_WhlRotatFl_No_Cnt: category=VALUE, base-type=uint8, compu {phys=raw for raw 0..255; unit Unitless}
    Ford_WhlRotatFr_No_Cnt: category=VALUE, base-type=uint8, compu {phys=raw for raw 0..255; unit Unitless}
    Ford_WhlRotatRl_No_Cnt: category=VALUE, base-type=uint8, compu {phys=raw for raw 0..255; unit Unitless}
    Ford_WhlRotatRr_No_Cnt: category=VALUE, base-type=uint8, compu {phys=raw for raw 0..255; unit Unitless}
    Ford_WhlRr_W_Meas: category=VALUE, base-type=uint16, compu {32766=Cx7FFE_Unknown, 32767=Cx7FFF_Fault, phys=raw*0.01 for raw 0..32767; unit rad/s} "Source signal range: [0,32765]", range raw 0..32767
    Ford_YawStabilityIndex: category=VALUE, base-type=uint16, compu {510=Cx1FE_NoDataExists, 511=Cx1FF_Fault, phys=raw-256 for raw 0..511; unit %}, range raw 0..511
package /Nexteer/ComponentTypes/DataTypeMappingSets
  data type mapping set Cals
package /Nexteer/DataTypeMappingSets
  data type mapping set Nexteer
    data-type-maps:
      application-data-type=A{1..5}, implementation-data-type=float32
      application-data-type=Ag1, implementation-data-type=float32
      application-data-type=Ag{10..17}, implementation-data-type=float32
      application-data-type=Ag18, implementation-data-type=u12p4
      application-data-type=Ag19, implementation-data-type=float32
      application-data-type=Ag2, implementation-data-type=float32
      application-data-type=Ag3, implementation-data-type=float32
      application-data-type=Ag4, implementation-data-type=s2p13
      application-data-type=Ag5, implementation-data-type=u0p16
      application-data-type=Ag6, implementation-data-type=DataTypes/s18p13
      application-data-type=Ag7, implementation-data-type=DataTypes/s18p13
      application-data-type=Ag8, implementation-data-type=s15p16
      application-data-type=Ag9, implementation-data-type=u0p16
      application-data-type=AgAry1D1, implementation-data-type=Ary1D_s2p13_1024
      application-data-type=AgAry1D2, implementation-data-type=Ary1D_u0p16_8
      application-data-type=AgAry1D3, implementation-data-type=Ary1D_s2p13_1025
      application-data-type=AgAry1D4, implementation-data-type=Ary1D_f32_8
      application-data-type=AgAry1D5, implementation-data-type=Ary1D_u12p4_16
      application-data-type=AgAry2D1, implementation-data-type=Ary2D_u12p4_9_16
      application-data-type=Cnt1, implementation-data-type=uint8
      application-data-type=Cnt10, implementation-data-type=uint16
      application-data-type=Cnt11, implementation-data-type=uint16
      application-data-type=Cnt{12..14}, implementation-data-type=uint8
      application-data-type=Cnt15, implementation-data-type=uint32
      application-data-type=Cnt16, implementation-data-type=uint16
      application-data-type=Cnt17, implementation-data-type=uint32
      application-data-type=Cnt18, implementation-data-type=uint8
      application-data-type=Cnt19, implementation-data-type=uint8
      application-data-type=Cnt2, implementation-data-type=sint8
      application-data-type=Cnt20, implementation-data-type=sint16
      application-data-type=Cnt21, implementation-data-type=uint8
      application-data-type=Cnt22, implementation-data-type=uint8
      application-data-type=Cnt23, implementation-data-type=u16p0
      application-data-type=Cnt24, implementation-data-type=uint8
      application-data-type=Cnt25, implementation-data-type=uint8
      application-data-type=Cnt26, implementation-data-type=u16p0
      application-data-type=Cnt{27..29}, implementation-data-type=uint8
      application-data-type=Cnt3, implementation-data-type=uint16
      application-data-type=Cnt30, implementation-data-type=uint8
      application-data-type=Cnt31, implementation-data-type=uint16
      application-data-type=Cnt32, implementation-data-type=float32
      application-data-type=Cnt33, implementation-data-type=uint8
      application-data-type=Cnt34, implementation-data-type=float32
      application-data-type=Cnt35, implementation-data-type=sint16
      application-data-type=Cnt4, implementation-data-type=uint16
      application-data-type=Cnt5, implementation-data-type=uint16
      application-data-type=Cnt6, implementation-data-type=uint8
      application-data-type=Cnt7, implementation-data-type=uint8
      application-data-type=Cnt8, implementation-data-type=uint32
      application-data-type=Cnt9, implementation-data-type=uint16
      application-data-type=CntAry1D1, implementation-data-type=Ary1D_u16p0_2
      application-data-type=CntAry1D2, implementation-data-type=Ary1D_u32_8
      application-data-type=CntAry1D3, implementation-data-type=Ary1D_u16_257
      application-data-type=CntAry1D4, implementation-data-type=Ary1D_u16p0_2
      application-data-type=CntAry1D5, implementation-data-type=Ary1D_u8_22
      application-data-type=CntAry1D6, implementation-data-type=Ary1D_s16_22
      application-data-type=Curr{1..7}, implementation-data-type=float32
      application-data-type=Curr8, implementation-data-type=u9p7
      application-data-type=Curr9, implementation-data-type=float32
      application-data-type=CurrAry1D1, implementation-data-type=Ary1D_u9p7_16
      application-data-type=CurrAry1D2, implementation-data-type=Ary1D_u9p7_6
      application-data-type=CurrAry1D3, implementation-data-type=Ary1D_u9p7_7
      application-data-type=CurrSqd1, implementation-data-type=float32
      application-data-type=Frq1, implementation-data-type=float32
      application-data-type=Frq10, implementation-data-type=float32
      application-data-type=Frq2, implementation-data-type=float32
      application-data-type=Frq3, implementation-data-type=u10p6
      application-data-type=Frq4, implementation-data-type=u10p6
      application-data-type=Frq5, implementation-data-type=u9p7
      application-data-type=Frq6, implementation-data-type=u9p7
      application-data-type=Frq{7..9}, implementation-data-type=float32
      application-data-type=FrqAry1D1, implementation-data-type=Ary1D_u10p6_4
      application-data-type=FrqAry1D2, implementation-data-type=Ary1D_u10p6_4
      application-data-type=FrqAry1D3, implementation-data-type=Ary1D_u9p7_4
      application-data-type=FrqAry1D4, implementation-data-type=Ary1D_u9p7_4
      application-data-type=Gain{1..8}, implementation-data-type=float32
      application-data-type=HwAgOffsRecAppl1, implementation-data-type=HwAgOffsRec1
      application-data-type=Indu1, implementation-data-type=float32
      application-data-type=Indu2, implementation-data-type=float32
      application-data-type=Logl1, implementation-data-type=boolean
      application-data-type=MotCon1, implementation-data-type=float32
      application-data-type=MotPrmNomEolRecAppl2, implementation-data-type=MotPrmNomEolRec2
      application-data-type=MotPrmNomEolRecAppl3, implementation-data-type=MotPrmNomEolRec3
      application-data-type=R{1..8}, implementation-data-type=float32
      application-data-type=Rate1, implementation-data-type=float32
      application-data-type=Rate10, implementation-data-type=float32
      application-data-type=Rate{2..9}, implementation-data-type=float32
      application-data-type=Spd1, implementation-data-type=float32
      application-data-type=Spd2, implementation-data-type=u9p7
      application-data-type=Spd3, implementation-data-type=float32
      application-data-type=Spd4, implementation-data-type=float32
      application-data-type=SpdAry1D1, implementation-data-type=Ary1D_u9p7_12
      application-data-type=SpdAry1D2, implementation-data-type=Ary1D_u9p7_9
      application-data-type=T{1..5}, implementation-data-type=float32
      application-data-type=T6, implementation-data-type=s11p4
      application-data-type=T7, implementation-data-type=s8p7
      application-data-type=T8, implementation-data-type=float32
      application-data-type=TAry1D1, implementation-data-type=Ary1D_s11p4_14
      application-data-type=TAry1D2, implementation-data-type=Ary1D_s8p7_14
      application-data-type=Ti1, implementation-data-type=uint32
      application-data-type=Ti{10..12}, implementation-data-type=float32
      application-data-type=Ti{2..6}, implementation-data-type=uint32
      application-data-type=Ti7, implementation-data-type=float32
      application-data-type=Ti8, implementation-data-type=float32
      application-data-type=Ti9, implementation-data-type=uint32
      application-data-type=Tq1, implementation-data-type=float32
      application-data-type=Tq10, implementation-data-type=float32
      application-data-type=Tq11, implementation-data-type=s4p11
      application-data-type=Tq12, implementation-data-type=u5p11
      application-data-type=Tq13, implementation-data-type=u4p12
      application-data-type=Tq14, implementation-data-type=u5p11
      application-data-type=Tq{15..19}, implementation-data-type=float32
      application-data-type=Tq2, implementation-data-type=float32
      application-data-type=Tq3, implementation-data-type=float32
      application-data-type=Tq4, implementation-data-type=u5p11
      application-data-type=Tq5, implementation-data-type=s4p11
      application-data-type=Tq6, implementation-data-type=u8p8
      application-data-type=Tq7, implementation-data-type=u5p11
      application-data-type=Tq8, implementation-data-type=float32
      application-data-type=Tq9, implementation-data-type=float32
      application-data-type=TqAry1D1, implementation-data-type=Ary1D_s4p11_20
      application-data-type=TqAry1D10, implementation-data-type=Ary1D_u4p12_12
      application-data-type=TqAry1D11, implementation-data-type=Ary1D_u5p11_13
      application-data-type=TqAry1D2, implementation-data-type=Ary1D_u8p8_20
      application-data-type=TqAry1D3, implementation-data-type=Ary1D_u5p11_5
      application-data-type=TqAry1D4, implementation-data-type=Ary1D_s4p11_20
      application-data-type=TqAry1D5, implementation-data-type=Ary1D_u5p11_5
      application-data-type=TqAry1D6, implementation-data-type=Ary1D_u4p12_11
      application-data-type=TqAry1D7, implementation-data-type=Ary1D_u5p11_16
      application-data-type=TqAry1D8, implementation-data-type=Ary1D_u8p8_8
      application-data-type=TqAry1D9, implementation-data-type=Ary1D_u8p8_2
      application-data-type=TqAry2D1, implementation-data-type=Ary2D_s4p11_12_20
      application-data-type=TqAry2D2, implementation-data-type=Ary2D_u8p8_12_20
      application-data-type=TqAry2D3, implementation-data-type=Ary2D_u5p11_12_5
      application-data-type=TqAry2D4, implementation-data-type=Ary2D_s4p11_12_20
      application-data-type=TqAry2D5, implementation-data-type=Ary2D_u5p11_12_5
      application-data-type=TqAry2D6, implementation-data-type=Ary2D_u5p11_9_16
      application-data-type=TqAry2D7, implementation-data-type=Ary2D_u8p8_9_8
      application-data-type=TqAry2D8, implementation-data-type=Ary2D_u5p11_12_13
      application-data-type=Uls1, implementation-data-type=float32
      application-data-type=Uls10, implementation-data-type=float32
      application-data-type=Uls11, implementation-data-type=u2p14
      application-data-type=Uls{12..14}, implementation-data-type=float32
      application-data-type=Uls15, implementation-data-type=u1p15
      application-data-type=Uls16, implementation-data-type=float32
      application-data-type=Uls17, implementation-data-type=u8p8
      application-data-type=Uls18, implementation-data-type=u9p7
      application-data-type=Uls19, implementation-data-type=u8p8
      application-data-type=Uls2, implementation-data-type=float32
      application-data-type=Uls20, implementation-data-type=u4p12
      application-data-type=Uls21, implementation-data-type=float32
      application-data-type=Uls22, implementation-data-type=float32
      application-data-type=Uls23, implementation-data-type=u8p8
      application-data-type=Uls24, implementation-data-type=uint8
      application-data-type=Uls3, implementation-data-type=sint8
      application-data-type=Uls4, implementation-data-type=u2p14
      application-data-type=Uls{5..9}, implementation-data-type=float32
      application-data-type=UlsAry1D1, implementation-data-type=Ary1D_u2p14_5
      application-data-type=UlsAry1D10, implementation-data-type=Ary1D_u8p8_4
      application-data-type=UlsAry1D11, implementation-data-type=Ary1D_u8p8_14
      application-data-type=UlsAry1D12, implementation-data-type=Ary1D_u1p15_2
      application-data-type=UlsAry1D13, implementation-data-type=Ary1D_u4p12_12
      application-data-type=UlsAry1D14, implementation-data-type=Ary1D_u4p12_14
      application-data-type=UlsAry1D15, implementation-data-type=Ary1D_u8p8_14
      application-data-type=UlsAry1D2, implementation-data-type=Ary1D_u2p14_2
      application-data-type=UlsAry1D3, implementation-data-type=Ary1D_u2p14_16
      application-data-type=UlsAry1D4, implementation-data-type=Ary1D_u2p14_6
      application-data-type=UlsAry1D5, implementation-data-type=Ary1D_u1p15_11
      application-data-type=UlsAry1D6, implementation-data-type=Ary1D_f32_8
      application-data-type=UlsAry1D7, implementation-data-type=Ary1D_u8p8_4
      application-data-type=UlsAry1D8, implementation-data-type=Ary1D_u9p7_4
      application-data-type=UlsAry1D9, implementation-data-type=Ary1D_u8p8_8
      application-data-type=UlsAry2D1, implementation-data-type=Ary2D_u2p14_12_5
      application-data-type=UlsAry2D2, implementation-data-type=Ary2D_u2p14_7_6
      application-data-type=UlsAry2D3, implementation-data-type=Ary2D_u8p8_9_8
      application-data-type=UlsAry2D4, implementation-data-type=Ary2D_u8p8_9_4
      application-data-type=Vel{1..3}, implementation-data-type=float32
      application-data-type=Vel4, implementation-data-type=u11p5
      application-data-type=Vel5, implementation-data-type=float32
      application-data-type=Vel6, implementation-data-type=u7p9
      application-data-type=Vel7, implementation-data-type=u12p4
      application-data-type=Vel8, implementation-data-type=float32
      application-data-type=Vel9, implementation-data-type=float32
      application-data-type=VelAry1D1, implementation-data-type=Ary1D_u11p5_4
      application-data-type=VelAry1D2, implementation-data-type=Ary1D_u11p5_11
      application-data-type=VelAry1D3, implementation-data-type=Ary1D_u11p5_10
      application-data-type=VelAry1D4, implementation-data-type=Ary1D_u7p9_4
      application-data-type=VelAry1D5, implementation-data-type=Ary1D_u12p4_13
      application-data-type=VelAry2D1, implementation-data-type=Ary2D_u7p9_8_4
      application-data-type=VelAry2D2, implementation-data-type=Ary2D_u7p9_9_4
      application-data-type=VelAry2D3, implementation-data-type=Ary2D_u12p4_12_13
      application-data-type=Volt1, implementation-data-type=float32
      application-data-type=Volt{10..17}, implementation-data-type=float32
      application-data-type=Volt18, implementation-data-type=u3p13
      application-data-type=Volt{2..9}, implementation-data-type=float32
      application-data-type=VoltAry1D1, implementation-data-type=Ary1D_u3p13_10
      application-data-type=VoltGain1, implementation-data-type=float32
      application-data-type=VoltTi1, implementation-data-type=uint32
      application-data-type=VoltTi2, implementation-data-type=uint32
