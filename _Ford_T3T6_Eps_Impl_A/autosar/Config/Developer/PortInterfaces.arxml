AUTOSAR XML (schema 4-0-3)
package /Ford/PortInterfaces
  176 x sender receiver interface:
    Ford_AbsActv_B_Actl: invalidation-policy{data-element=Ford_AbsActv_B_Actl, handle-invalid=DONT-INVALIDATE}
      data Ford_AbsActv_B_Actl: sw-calibration-access=READ-ONLY, type=Ford_AbsActv_B_Actl
    Ford_ApaSys_D_Stat: invalidation-policy{data-element=Ford_ApaSys_D_Stat, handle-invalid=DONT-INVALIDATE}
      data Ford_ApaSys_D_Stat: sw-calibration-access=READ-ONLY, type=Ford_ApaSys_D_Stat
    Ford_ApedPos_Pc_ActlArb: invalidation-policy{data-element=Ford_ApedPos_Pc_ActlArb, handle-invalid=DONT-INVALIDATE}
      data Ford_ApedPos_Pc_ActlArb: sw-calibration-access=READ-ONLY, type=Ford_ApedPos_Pc_ActlArb
    Ford_ApedPosPcActl_D_Qf: invalidation-policy{data-element=Ford_ApedPosPcActl_D_Qf, handle-invalid=DONT-INVALIDATE}
      data Ford_ApedPosPcActl_D_Qf: sw-calibration-access=READ-ONLY, type=Ford_ApedPosPcActl_D_Qf
    Ford_BattULo_U_Actl: invalidation-policy{data-element=Ford_BattULo_U_Actl, handle-invalid=DONT-INVALIDATE}
      data Ford_BattULo_U_Actl: sw-calibration-access=READ-ONLY, type=Ford_BattULo_U_Actl
    Ford_BpedDrvAppl_D_Actl: invalidation-policy{data-element=Ford_BpedDrvAppl_D_Actl, handle-invalid=DONT-INVALIDATE}
      data Ford_BpedDrvAppl_D_Actl: sw-calibration-access=READ-ONLY, type=Ford_BpedDrvAppl_D_Actl
    Ford_BPedDrvAppl_D_QF: invalidation-policy{data-element=Ford_BPedDrvAppl_D_QF, handle-invalid=DONT-INVALIDATE}
      data Ford_BPedDrvAppl_D_QF: sw-calibration-access=READ-ONLY, type=Ford_BPedDrvAppl_D_QF
    Ford_BrkTot_Tq_Actl: invalidation-policy{data-element=Ford_BrkTot_Tq_Actl, handle-invalid=DONT-INVALIDATE}
      data Ford_BrkTot_Tq_Actl: sw-calibration-access=READ-ONLY, type=Ford_BrkTot_Tq_Actl
    Ford_CmbbBrkDis_B_Actl: invalidation-policy{data-element=Ford_CmbbBrkDis_B_Actl, handle-invalid=DONT-INVALIDATE}
      data Ford_CmbbBrkDis_B_Actl: sw-calibration-access=READ-ONLY, type=Ford_CmbbBrkDis_B_Actl
    Ford_CmbbDeny_B_ActlBrk: invalidation-policy{data-element=Ford_CmbbDeny_B_ActlBrk, handle-invalid=DONT-INVALIDATE}
      data Ford_CmbbDeny_B_ActlBrk: sw-calibration-access=READ-ONLY, type=Ford_CmbbDeny_B_ActlBrk
    Ford_CmbbObjClass_D_Stat: invalidation-policy{data-element=Ford_CmbbObjClass_D_Stat, handle-invalid=DONT-INVALIDATE}
      data Ford_CmbbObjClass_D_Stat: sw-calibration-access=READ-ONLY, type=Ford_CmbbObjClass_D_Stat
    Ford_CmbbObjColl_T_Actl: invalidation-policy{data-element=Ford_CmbbObjColl_T_Actl, handle-invalid=DONT-INVALIDATE}
      data Ford_CmbbObjColl_T_Actl: sw-calibration-access=READ-ONLY, type=Ford_CmbbObjColl_T_Actl
    Ford_CmbbObjConfdnc_D_Stat: invalidation-policy{data-element=Ford_CmbbObjConfdnc_D_Stat, handle-invalid=DONT-INVALIDATE}
      data Ford_CmbbObjConfdnc_D_Stat: sw-calibration-access=READ-ONLY, type=Ford_CmbbObjConfdnc_D_Stat
    Ford_CmbbObjDistLat_L_Actl: invalidation-policy{data-element=Ford_CmbbObjDistLat_L_Actl, handle-invalid=DONT-INVALIDATE}
      data Ford_CmbbObjDistLat_L_Actl: sw-calibration-access=READ-ONLY, type=Ford_CmbbObjDistLat_L_Actl
    Ford_CmbbObjDistLong_L_Actl: invalidation-policy{data-element=Ford_CmbbObjDistLong_L_Actl, handle-invalid=DONT-INVALIDATE}
      data Ford_CmbbObjDistLong_L_Actl: sw-calibration-access=READ-ONLY, type=Ford_CmbbObjDistLong_L_Actl
    Ford_CmbbObjRelLat_V_Actl: invalidation-policy{data-element=Ford_CmbbObjRelLat_V_Actl, handle-invalid=DONT-INVALIDATE}
      data Ford_CmbbObjRelLat_V_Actl: sw-calibration-access=READ-ONLY, type=Ford_CmbbObjRelLat_V_Actl
    Ford_CmbbObjRelLong_V_Actl: invalidation-policy{data-element=Ford_CmbbObjRelLong_V_Actl, handle-invalid=DONT-INVALIDATE}
      data Ford_CmbbObjRelLong_V_Actl: sw-calibration-access=READ-ONLY, type=Ford_CmbbObjRelLong_V_Actl
    Ford_DeliveryIdle: invalidation-policy{data-element=Ford_DeliveryIdle, handle-invalid=DONT-INVALIDATE}
      data Ford_DeliveryIdle: sw-calibration-access=READ-ONLY, type=Ford_DeliveryIdle
    Ford_DeliveryNumber: invalidation-policy{data-element=Ford_DeliveryNumber, handle-invalid=DONT-INVALIDATE}
      data Ford_DeliveryNumber: sw-calibration-access=READ-ONLY, type=Ford_DeliveryNumber
    Ford_DeliverySipNumber: invalidation-policy{data-element=Ford_DeliverySipNumber, handle-invalid=DONT-INVALIDATE}
      data Ford_DeliverySipNumber: sw-calibration-access=READ-ONLY, type=Ford_DeliverySipNumber
    Ford_DeliverySubProjectNumber: invalidation-policy{data-element=Ford_DeliverySubProjectNumber, handle-invalid=DONT-INVALIDATE}
      data Ford_DeliverySubProjectNumber: sw-calibration-access=READ-ONLY, type=Ford_DeliverySubProjectNumber
    Ford_DrvSte_D_Stat: invalidation-policy{data-element=Ford_DrvSte_D_Stat, handle-invalid=DONT-INVALIDATE}
      data Ford_DrvSte_D_Stat: sw-calibration-access=READ-ONLY, type=Ford_DrvSte_D_Stat
    Ford_DrvSte_Tq_Actl: invalidation-policy{data-element=Ford_DrvSte_Tq_Actl, handle-invalid=DONT-INVALIDATE}
      data Ford_DrvSte_Tq_Actl: sw-calibration-access=READ-ONLY, type=Ford_DrvSte_Tq_Actl
    Ford_DrvSte_Tq_Rq: invalidation-policy{data-element=Ford_DrvSte_Tq_Rq, handle-invalid=DONT-INVALIDATE}
      data Ford_DrvSte_Tq_Rq: sw-calibration-access=READ-ONLY, type=Ford_DrvSte_Tq_Rq
    Ford_DrvSteActv_B_Stat: invalidation-policy{data-element=Ford_DrvSteActv_B_Stat, handle-invalid=DONT-INVALIDATE}
      data Ford_DrvSteActv_B_Stat: sw-calibration-access=READ-ONLY, type=Ford_DrvSteActv_B_Stat
    Ford_ElPw_D_Stat: invalidation-policy{data-element=Ford_ElPw_D_Stat, handle-invalid=DONT-INVALIDATE}
      data Ford_ElPw_D_Stat: sw-calibration-access=READ-ONLY, type=Ford_ElPw_D_Stat
    Ford_ElPw_D_StatStrtStop: invalidation-policy{data-element=Ford_ElPw_D_StatStrtStop, handle-invalid=DONT-INVALIDATE}
      data Ford_ElPw_D_StatStrtStop: sw-calibration-access=READ-ONLY, type=Ford_ElPw_D_StatStrtStop
    Ford_EngAout_N_Actl: invalidation-policy{data-element=Ford_EngAout_N_Actl, handle-invalid=DONT-INVALIDATE}
      data Ford_EngAout_N_Actl: sw-calibration-access=READ-ONLY, type=Ford_EngAout_N_Actl
    Ford_EPAS_Failure: invalidation-policy{data-element=Ford_EPAS_Failure, handle-invalid=DONT-INVALIDATE}
      data Ford_EPAS_Failure: sw-calibration-access=READ-ONLY, type=Ford_EPAS_Failure
    Ford_EPASExtAngleStatReq: invalidation-policy{data-element=Ford_EPASExtAngleStatReq, handle-invalid=DONT-INVALIDATE}
      data Ford_EPASExtAngleStatReq: sw-calibration-access=READ-ONLY, type=Ford_EPASExtAngleStatReq
    Ford_EsaEnbl_D2_Rq: invalidation-policy{data-element=Ford_EsaEnbl_D2_Rq, handle-invalid=DONT-INVALIDATE}
      data Ford_EsaEnbl_D2_Rq: sw-calibration-access=READ-ONLY, type=Ford_EsaEnbl_D2_Rq
    Ford_EsaOn_B_Rq: invalidation-policy{data-element=Ford_EsaOn_B_Rq, handle-invalid=DONT-INVALIDATE}
      data Ford_EsaOn_B_Rq: sw-calibration-access=READ-ONLY, type=Ford_EsaOn_B_Rq
    Ford_EsaOn_B_Stat: invalidation-policy{data-element=Ford_EsaOn_B_Stat, handle-invalid=DONT-INVALIDATE}
      data Ford_EsaOn_B_Stat: sw-calibration-access=READ-ONLY, type=Ford_EsaOn_B_Stat
    Ford_ExtSteeringAngleReq2: invalidation-policy{data-element=Ford_ExtSteeringAngleReq2, handle-invalid=DONT-INVALIDATE}
      data Ford_ExtSteeringAngleReq2: sw-calibration-access=READ-ONLY, type=Ford_ExtSteeringAngleReq2
    Ford_FileVersionDay: invalidation-policy{data-element=Ford_FileVersionDay, handle-invalid=DONT-INVALIDATE}
      data Ford_FileVersionDay: sw-calibration-access=READ-ONLY, type=Ford_FileVersionDay
    Ford_FileVersionMonth: invalidation-policy{data-element=Ford_FileVersionMonth, handle-invalid=DONT-INVALIDATE}
      data Ford_FileVersionMonth: sw-calibration-access=READ-ONLY, type=Ford_FileVersionMonth
    Ford_FileVersionNumber: invalidation-policy{data-element=Ford_FileVersionNumber, handle-invalid=DONT-INVALIDATE}
      data Ford_FileVersionNumber: sw-calibration-access=READ-ONLY, type=Ford_FileVersionNumber
    Ford_FileVersionYear: invalidation-policy{data-element=Ford_FileVersionYear, handle-invalid=DONT-INVALIDATE}
      data Ford_FileVersionYear: sw-calibration-access=READ-ONLY, type=Ford_FileVersionYear
    Ford_GearLvrPos_D_Actl: invalidation-policy{data-element=Ford_GearLvrPos_D_Actl, handle-invalid=DONT-INVALIDATE}
      data Ford_GearLvrPos_D_Actl: sw-calibration-access=READ-ONLY, type=Ford_GearLvrPos_D_Actl
    Ford_GearPos_D_Actl: invalidation-policy{data-element=Ford_GearPos_D_Actl, handle-invalid=DONT-INVALIDATE}
      data Ford_GearPos_D_Actl: sw-calibration-access=READ-ONLY, type=Ford_GearPos_D_Actl
    Ford_GearRvrse_D_Actl: invalidation-policy{data-element=Ford_GearRvrse_D_Actl, handle-invalid=DONT-INVALIDATE}
      data Ford_GearRvrse_D_Actl: sw-calibration-access=READ-ONLY, type=Ford_GearRvrse_D_Actl
    Ford_HandsOffCnfm_B_Rq: invalidation-policy{data-element=Ford_HandsOffCnfm_B_Rq, handle-invalid=DONT-INVALIDATE}
      data Ford_HandsOffCnfm_B_Rq: sw-calibration-access=READ-ONLY, type=Ford_HandsOffCnfm_B_Rq
    Ford_HitchToTrlrAxle_L_Calc: invalidation-policy{data-element=Ford_HitchToTrlrAxle_L_Calc, handle-invalid=DONT-INVALIDATE}
      data Ford_HitchToTrlrAxle_L_Calc: sw-calibration-access=READ-ONLY, type=Ford_HitchToTrlrAxle_L_Calc
    Ford_HitchToVehAxle_L_Calc: invalidation-policy{data-element=Ford_HitchToVehAxle_L_Calc, handle-invalid=DONT-INVALIDATE}
      data Ford_HitchToVehAxle_L_Calc: sw-calibration-access=READ-ONLY, type=Ford_HitchToVehAxle_L_Calc
    Ford_Ignition_Status: invalidation-policy{data-element=Ford_Ignition_Status, handle-invalid=DONT-INVALIDATE}
      data Ford_Ignition_Status: sw-calibration-access=READ-ONLY, type=Ford_Ignition_Status
    Ford_LaActAvail_D_Actl: invalidation-policy{data-element=Ford_LaActAvail_D_Actl/Ford_LaActAvail_D_Actl, handle-invalid=DONT-INVALIDATE}
      data Ford_LaActAvail_D_Actl: sw-calibration-access=READ-ONLY, type=Ford_LaActAvail_D_Actl
    Ford_LaActAvail_D_Actl_PortIf1: invalidation-policy{data-element=Ford_LaActAvail_D_Actl_PortIf1/Ford_LaActAvail_D_Actl, handle-invalid=DONT-INVALIDATE}
      data Ford_LaActAvail_D_Actl: sw-calibration-access=READ-ONLY, type=Ford_LaActAvail_D_Actl
    Ford_LaActDeny_B_Actl: invalidation-policy{data-element=Ford_LaActDeny_B_Actl/Ford_LaActDeny_B_Actl, handle-invalid=DONT-INVALIDATE}
      data Ford_LaActDeny_B_Actl: sw-calibration-access=READ-ONLY, type=Ford_LaActDeny_B_Actl
    Ford_LaActDeny_B_Actl_PortIf1: invalidation-policy{data-element=Ford_LaActDeny_B_Actl_PortIf1/Ford_LaActDeny_B_Actl, handle-invalid=DONT-INVALIDATE}
      data Ford_LaActDeny_B_Actl: sw-calibration-access=READ-ONLY, type=Ford_LaActDeny_B_Actl
    Ford_LaCurvature_No_Calc: invalidation-policy{data-element=Ford_LaCurvature_No_Calc, handle-invalid=DONT-INVALIDATE}
      data Ford_LaCurvature_No_Calc: sw-calibration-access=READ-ONLY, type=Ford_LaCurvature_No_Calc
    Ford_LaHandsOff_B_Actl: invalidation-policy{data-element=Ford_LaHandsOff_B_Actl/Ford_LaHandsOff_B_Actl, handle-invalid=DONT-INVALIDATE}
      data Ford_LaHandsOff_B_Actl: sw-calibration-access=READ-ONLY, type=Ford_LaHandsOff_B_Actl
    Ford_LaHandsOff_B_Actl_PortIf1: invalidation-policy{data-element=Ford_LaHandsOff_B_Actl_PortIf1/Ford_LaHandsOff_B_Actl, handle-invalid=DONT-INVALIDATE}
      data Ford_LaHandsOff_B_Actl: sw-calibration-access=READ-ONLY, type=Ford_LaHandsOff_B_Actl
    Ford_LaRampType_B_Req: invalidation-policy{data-element=Ford_LaRampType_B_Req, handle-invalid=DONT-INVALIDATE}
      data Ford_LaRampType_B_Req: sw-calibration-access=READ-ONLY, type=Ford_LaRampType_B_Req
    Ford_LaRefAng_No_Req: invalidation-policy{data-element=Ford_LaRefAng_No_Req, handle-invalid=DONT-INVALIDATE}
      data Ford_LaRefAng_No_Req: sw-calibration-access=READ-ONLY, type=Ford_LaRefAng_No_Req
    Ford_LatCtl_D_Rq: invalidation-policy{data-element=Ford_LatCtl_D_Rq, handle-invalid=DONT-INVALIDATE}
      data Ford_LatCtl_D_Rq: sw-calibration-access=READ-ONLY, type=Ford_LatCtl_D_Rq
    Ford_LatCtlCurv_No_Actl: invalidation-policy{data-element=Ford_LatCtlCurv_No_Actl, handle-invalid=DONT-INVALIDATE}
      data Ford_LatCtlCurv_No_Actl: sw-calibration-access=READ-ONLY, type=Ford_LatCtlCurv_No_Actl
    Ford_LatCtlCurv_NoRate_Actl: invalidation-policy{data-element=Ford_LatCtlCurv_NoRate_Actl, handle-invalid=DONT-INVALIDATE}
      data Ford_LatCtlCurv_NoRate_Actl: sw-calibration-access=READ-ONLY, type=Ford_LatCtlCurv_NoRate_Actl
    Ford_LatCtlLim_D_Stat: invalidation-policy{data-element=Ford_LatCtlLim_D_Stat, handle-invalid=DONT-INVALIDATE}
      data Ford_LatCtlLim_D_Stat: sw-calibration-access=READ-ONLY, type=Ford_LatCtlLim_D_Stat
    Ford_LatCtlPath_An_Actl: invalidation-policy{data-element=Ford_LatCtlPath_An_Actl, handle-invalid=DONT-INVALIDATE}
      data Ford_LatCtlPath_An_Actl: sw-calibration-access=READ-ONLY, type=Ford_LatCtlPath_An_Actl
    Ford_LatCtlPathOffst_L_Actl: invalidation-policy{data-element=Ford_LatCtlPathOffst_L_Actl, handle-invalid=DONT-INVALIDATE}
      data Ford_LatCtlPathOffst_L_Actl: sw-calibration-access=READ-ONLY, type=Ford_LatCtlPathOffst_L_Actl
    Ford_LatCtlPrecision_D_Rq: invalidation-policy{data-element=Ford_LatCtlPrecision_D_Rq, handle-invalid=DONT-INVALIDATE}
      data Ford_LatCtlPrecision_D_Rq: sw-calibration-access=READ-ONLY, type=Ford_LatCtlPrecision_D_Rq
    Ford_LatCtlRampType_D_Rq: invalidation-policy{data-element=Ford_LatCtlRampType_D_Rq, handle-invalid=DONT-INVALIDATE}
      data Ford_LatCtlRampType_D_Rq: sw-calibration-access=READ-ONLY, type=Ford_LatCtlRampType_D_Rq
    Ford_LatCtlRng_L_Max: invalidation-policy{data-element=Ford_LatCtlRng_L_Max, handle-invalid=DONT-INVALIDATE}
      data Ford_LatCtlRng_L_Max: sw-calibration-access=READ-ONLY, type=Ford_LatCtlRng_L_Max
    Ford_LatCtlSte_D_Stat: invalidation-policy{data-element=Ford_LatCtlSte_D_Stat, handle-invalid=DONT-INVALIDATE}
      data Ford_LatCtlSte_D_Stat: sw-calibration-access=READ-ONLY, type=Ford_LatCtlSte_D_Stat
    Ford_LdwActvIntns_D_Req: invalidation-policy{data-element=Ford_LdwActvIntns_D_Req, handle-invalid=DONT-INVALIDATE}
      data Ford_LdwActvIntns_D_Req: sw-calibration-access=READ-ONLY, type=Ford_LdwActvIntns_D_Req
    Ford_LdwActvStats_D_Req: invalidation-policy{data-element=Ford_LdwActvStats_D_Req, handle-invalid=DONT-INVALIDATE}
      data Ford_LdwActvStats_D_Req: sw-calibration-access=READ-ONLY, type=Ford_LdwActvStats_D_Req
    Ford_LifeCycMde_D_Actl: invalidation-policy{data-element=Ford_LifeCycMde_D_Actl, handle-invalid=DONT-INVALIDATE}
      data Ford_LifeCycMde_D_Actl: sw-calibration-access=READ-ONLY, type=Ford_LifeCycMde_D_Actl
    Ford_LkaActvStats_D2_Req: invalidation-policy{data-element=Ford_LkaActvStats_D2_Req, handle-invalid=DONT-INVALIDATE}
      data Ford_LkaActvStats_D2_Req: sw-calibration-access=READ-ONLY, type=Ford_LkaActvStats_D2_Req
    Ford_LkaDrvOvrrd_D_Rq: invalidation-policy{data-element=Ford_LkaDrvOvrrd_D_Rq, handle-invalid=DONT-INVALIDATE}
      data Ford_LkaDrvOvrrd_D_Rq: sw-calibration-access=READ-ONLY, type=Ford_LkaDrvOvrrd_D_Rq
    Ford_LsmcBrk_Tq_Rq: invalidation-policy{data-element=Ford_LsmcBrk_Tq_Rq/Ford_LsmcBrk_Tq_Rq, handle-invalid=DONT-INVALIDATE}
      data Ford_LsmcBrk_Tq_Rq: sw-calibration-access=READ-ONLY, type=Ford_LsmcBrk_Tq_Rq
    Ford_LsmcBrk_Tq_Rq_PortIf1: invalidation-policy{data-element=Ford_LsmcBrk_Tq_Rq_PortIf1/Ford_LsmcBrk_Tq_Rq, handle-invalid=DONT-INVALIDATE}
      data Ford_LsmcBrk_Tq_Rq: sw-calibration-access=READ-ONLY, type=Ford_LsmcBrk_Tq_Rq
    Ford_LsmcBrkDecel_D_Stat: invalidation-policy{data-element=Ford_LsmcBrkDecel_D_Stat, handle-invalid=DONT-INVALIDATE}
      data Ford_LsmcBrkDecel_D_Stat: sw-calibration-access=READ-ONLY, type=Ford_LsmcBrkDecel_D_Stat
    Ford_LsmcBrkDecelEnbl_D_Rq: invalidation-policy{data-element=Ford_LsmcBrkDecelEnbl_D_Rq/Ford_LsmcBrkDecelEnbl_D_Rq, handle-invalid=DONT-INVALIDATE}
      data Ford_LsmcBrkDecelEnbl_D_Rq: sw-calibration-access=READ-ONLY, type=Ford_LsmcBrkDecelEnbl_D_Rq
    Ford_LsmcBrkDecelEnbl_D_Rq_PortIf1: invalidation-policy{data-element=Ford_LsmcBrkDecelEnbl_D_Rq_PortIf1/Ford_LsmcBrkDecelEnbl_D_Rq, handle-invalid=DONT-INVALIDATE}
      data Ford_LsmcBrkDecelEnbl_D_Rq: sw-calibration-access=READ-ONLY, type=Ford_LsmcBrkDecelEnbl_D_Rq
    Ford_OdometerMasterValue: invalidation-policy{data-element=Ford_OdometerMasterValue, handle-invalid=DONT-INVALIDATE}
      data Ford_OdometerMasterValue: sw-calibration-access=READ-ONLY, type=Ford_OdometerMasterValue
    Ford_Outside_Air_Temp_Stat: invalidation-policy{data-element=Ford_Outside_Air_Temp_Stat, handle-invalid=DONT-INVALIDATE}
      data Ford_Outside_Air_Temp_Stat: sw-calibration-access=READ-ONLY, type=Ford_Outside_Air_Temp_Stat
    Ford_PrplWhlTot2_Tq_Actl: invalidation-policy{data-element=Ford_PrplWhlTot2_Tq_Actl, handle-invalid=DONT-INVALIDATE}
      data Ford_PrplWhlTot2_Tq_Actl: sw-calibration-access=READ-ONLY, type=Ford_PrplWhlTot2_Tq_Actl
    Ford_PwPckTq_D_Stat: invalidation-policy{data-element=Ford_PwPckTq_D_Stat, handle-invalid=DONT-INVALIDATE}
      data Ford_PwPckTq_D_Stat: sw-calibration-access=READ-ONLY, type=Ford_PwPckTq_D_Stat
    Ford_SAPPAngleControlStat1: invalidation-policy{data-element=Ford_SAPPAngleControlStat1, handle-invalid=DONT-INVALIDATE}
      data Ford_SAPPAngleControlStat1: sw-calibration-access=READ-ONLY, type=Ford_SAPPAngleControlStat1
    Ford_SAPPAngleControlStat2: invalidation-policy{data-element=Ford_SAPPAngleControlStat2, handle-invalid=DONT-INVALIDATE}
      data Ford_SAPPAngleControlStat2: sw-calibration-access=READ-ONLY, type=Ford_SAPPAngleControlStat2
    Ford_SAPPAngleControlStat3: invalidation-policy{data-element=Ford_SAPPAngleControlStat3, handle-invalid=DONT-INVALIDATE}
      data Ford_SAPPAngleControlStat3: sw-calibration-access=READ-ONLY, type=Ford_SAPPAngleControlStat3
    Ford_SAPPAngleControlStat4: invalidation-policy{data-element=Ford_SAPPAngleControlStat4, handle-invalid=DONT-INVALIDATE}
      data Ford_SAPPAngleControlStat4: sw-calibration-access=READ-ONLY, type=Ford_SAPPAngleControlStat4
    Ford_SAPPAngleControlStat5: invalidation-policy{data-element=Ford_SAPPAngleControlStat5, handle-invalid=DONT-INVALIDATE}
      data Ford_SAPPAngleControlStat5: sw-calibration-access=READ-ONLY, type=Ford_SAPPAngleControlStat5
    Ford_SAPPAngleControlStat6: invalidation-policy{data-element=Ford_SAPPAngleControlStat6, handle-invalid=DONT-INVALIDATE}
      data Ford_SAPPAngleControlStat6: sw-calibration-access=READ-ONLY, type=Ford_SAPPAngleControlStat6
    Ford_SelDrvMdeChassis2_D_Rq: invalidation-policy{data-element=Ford_SelDrvMdeChassis2_D_Rq, handle-invalid=DONT-INVALIDATE}
      data Ford_SelDrvMdeChassis2_D_Rq: sw-calibration-access=READ-ONLY, type=Ford_SelDrvMdeChassis2_D_Rq
    Ford_SelDrvMdeSte_D_Stat: invalidation-policy{data-element=Ford_SelDrvMdeSte_D_Stat, handle-invalid=DONT-INVALIDATE}
      data Ford_SelDrvMdeSte_D_Stat: sw-calibration-access=READ-ONLY, type=Ford_SelDrvMdeSte_D_Stat
    Ford_StabCtlBrkActv_B_Actl: invalidation-policy{data-element=Ford_StabCtlBrkActv_B_Actl, handle-invalid=DONT-INVALIDATE}
      data Ford_StabCtlBrkActv_B_Actl: sw-calibration-access=READ-ONLY, type=Ford_StabCtlBrkActv_B_Actl
    Ford_SteeringColumnTorque: invalidation-policy{data-element=Ford_SteeringColumnTorque, handle-invalid=DONT-INVALIDATE}
      data Ford_SteeringColumnTorque: sw-calibration-access=READ-ONLY, type=Ford_SteeringColumnTorque
    Ford_SteMdule_D_Stat: invalidation-policy{data-element=Ford_SteMdule_D_Stat, handle-invalid=DONT-INVALIDATE}
      data Ford_SteMdule_D_Stat: sw-calibration-access=READ-ONLY, type=Ford_SteMdule_D_Stat
    Ford_SteMdule_I_Est: invalidation-policy{data-element=Ford_SteMdule_I_Est, handle-invalid=DONT-INVALIDATE}
      data Ford_SteMdule_I_Est: sw-calibration-access=READ-ONLY, type=Ford_SteMdule_I_Est
    Ford_SteMdule_U_Meas: invalidation-policy{data-element=Ford_SteMdule_U_Meas, handle-invalid=DONT-INVALIDATE}
      data Ford_SteMdule_U_Meas: sw-calibration-access=READ-ONLY, type=Ford_SteMdule_U_Meas
    Ford_StePinAn_No_Cnt: invalidation-policy{data-element=Ford_StePinAn_No_Cnt, handle-invalid=DONT-INVALIDATE}
      data Ford_StePinAn_No_Cnt: sw-calibration-access=READ-ONLY, type=Ford_StePinAn_No_Cnt
    Ford_StePinAn_No_Cs: invalidation-policy{data-element=Ford_StePinAn_No_Cs, handle-invalid=DONT-INVALIDATE}
      data Ford_StePinAn_No_Cs: sw-calibration-access=READ-ONLY, type=Ford_StePinAn_No_Cs
    Ford_StePinComp_An_Est: invalidation-policy{data-element=Ford_StePinComp_An_Est, handle-invalid=DONT-INVALIDATE}
      data Ford_StePinComp_An_Est: sw-calibration-access=READ-ONLY, type=Ford_StePinComp_An_Est
    Ford_StePinCompAnEst_D_Qf: invalidation-policy{data-element=Ford_StePinCompAnEst_D_Qf, handle-invalid=DONT-INVALIDATE}
      data Ford_StePinCompAnEst_D_Qf: sw-calibration-access=READ-ONLY, type=Ford_StePinCompAnEst_D_Qf
    Ford_StePinOffst_An_Est: invalidation-policy{data-element=Ford_StePinOffst_An_Est, handle-invalid=DONT-INVALIDATE}
      data Ford_StePinOffst_An_Est: sw-calibration-access=READ-ONLY, type=Ford_StePinOffst_An_Est
    Ford_StePinOffst_D_Stat: invalidation-policy{data-element=Ford_StePinOffst_D_Stat, handle-invalid=DONT-INVALIDATE}
      data Ford_StePinOffst_D_Stat: sw-calibration-access=READ-ONLY, type=Ford_StePinOffst_D_Stat
    Ford_StePinOffst_No_Cnt: invalidation-policy{data-element=Ford_StePinOffst_No_Cnt, handle-invalid=DONT-INVALIDATE}
      data Ford_StePinOffst_No_Cnt: sw-calibration-access=READ-ONLY, type=Ford_StePinOffst_No_Cnt
    Ford_StePinOffst_No_Cs: invalidation-policy{data-element=Ford_StePinOffst_No_Cs, handle-invalid=DONT-INVALIDATE}
      data Ford_StePinOffst_No_Cs: sw-calibration-access=READ-ONLY, type=Ford_StePinOffst_No_Cs
    Ford_StePinRelInit_An_Sns: invalidation-policy{data-element=Ford_StePinRelInit_An_Sns, handle-invalid=DONT-INVALIDATE}
      data Ford_StePinRelInit_An_Sns: sw-calibration-access=READ-ONLY, type=Ford_StePinRelInit_An_Sns
    Ford_StePw_B_Rq: invalidation-policy{data-element=Ford_StePw_B_Rq, handle-invalid=DONT-INVALIDATE}
      data Ford_StePw_B_Rq: sw-calibration-access=READ-ONLY, type=Ford_StePw_B_Rq
    Ford_SteWhlRelCalib_An_Sns: invalidation-policy{data-element=Ford_SteWhlRelCalib_An_Sns, handle-invalid=DONT-INVALIDATE}
      data Ford_SteWhlRelCalib_An_Sns: sw-calibration-access=READ-ONLY, type=Ford_SteWhlRelCalib_An_Sns
    Ford_TjaHandsOnCnfdnc_B_Est: invalidation-policy{data-element=Ford_TjaHandsOnCnfdnc_B_Est/Ford_TjaHandsOnCnfdnc_B_Est, handle-invalid=DONT-INVALIDATE}
      data Ford_TjaHandsOnCnfdnc_B_Est: sw-calibration-access=READ-ONLY, type=Ford_TjaHandsOnCnfdnc_B_Est
    Ford_TjaHandsOnCnfdnc_B_Est_PortIf1: invalidation-policy{data-element=Ford_TjaHandsOnCnfdnc_B_Est_PortIf1/Ford_TjaHandsOnCnfdnc_B_Est, handle-invalid=DONT-INVALIDATE}
      data Ford_TjaHandsOnCnfdnc_B_Est: sw-calibration-access=READ-ONLY, type=Ford_TjaHandsOnCnfdnc_B_Est
    Ford_TrlrAid_An3_Actl: invalidation-policy{data-element=Ford_TrlrAid_An3_Actl, handle-invalid=DONT-INVALIDATE}
      data Ford_TrlrAid_An3_Actl: sw-calibration-access=READ-ONLY, type=Ford_TrlrAid_An3_Actl
    Ford_TrlrAid_AnRate2_Actl: invalidation-policy{data-element=Ford_TrlrAid_AnRate2_Actl, handle-invalid=DONT-INVALIDATE}
      data Ford_TrlrAid_AnRate2_Actl: sw-calibration-access=READ-ONLY, type=Ford_TrlrAid_AnRate2_Actl
    Ford_TrlrAid_D2_Stat: invalidation-policy{data-element=Ford_TrlrAid_D2_Stat, handle-invalid=DONT-INVALIDATE}
      data Ford_TrlrAid_D2_Stat: sw-calibration-access=READ-ONLY, type=Ford_TrlrAid_D2_Stat
    Ford_TrlrAidCancl_B_Rq: invalidation-policy{data-element=Ford_TrlrAidCancl_B_Rq, handle-invalid=DONT-INVALIDATE}
      data Ford_TrlrAidCancl_B_Rq: sw-calibration-access=READ-ONLY, type=Ford_TrlrAidCancl_B_Rq
    Ford_TrlrAidCtl_U_RqDrv: invalidation-policy{data-element=Ford_TrlrAidCtl_U_RqDrv, handle-invalid=DONT-INVALIDATE}
      data Ford_TrlrAidCtl_U_RqDrv: sw-calibration-access=READ-ONLY, type=Ford_TrlrAidCtl_U_RqDrv
    Ford_TrlrAidEnbl_D2_Rq: invalidation-policy{data-element=Ford_TrlrAidEnbl_D2_Rq, handle-invalid=DONT-INVALIDATE}
      data Ford_TrlrAidEnbl_D2_Rq: sw-calibration-access=READ-ONLY, type=Ford_TrlrAidEnbl_D2_Rq
    Ford_TrlrAidEnbl_D2_Stat: invalidation-policy{data-element=Ford_TrlrAidEnbl_D2_Stat, handle-invalid=DONT-INVALIDATE}
      data Ford_TrlrAidEnbl_D2_Stat: sw-calibration-access=READ-ONLY, type=Ford_TrlrAidEnbl_D2_Stat
    Ford_TrlrAidMde_D_Rq: invalidation-policy{data-element=Ford_TrlrAidMde_D_Rq, handle-invalid=DONT-INVALIDATE}
      data Ford_TrlrAidMde_D_Rq: sw-calibration-access=READ-ONLY, type=Ford_TrlrAidMde_D_Rq
    Ford_TrlrAidMsgTxt_D2_Rq: invalidation-policy{data-element=Ford_TrlrAidMsgTxt_D2_Rq, handle-invalid=DONT-INVALIDATE}
      data Ford_TrlrAidMsgTxt_D2_Rq: sw-calibration-access=READ-ONLY, type=Ford_TrlrAidMsgTxt_D2_Rq
    Ford_TrlrAidSetup_D2_Rq: invalidation-policy{data-element=Ford_TrlrAidSetup_D2_Rq, handle-invalid=DONT-INVALIDATE}
      data Ford_TrlrAidSetup_D2_Rq: sw-calibration-access=READ-ONLY, type=Ford_TrlrAidSetup_D2_Rq
    Ford_TrlrAidSetup_D2_Stat: invalidation-policy{data-element=Ford_TrlrAidSetup_D2_Stat, handle-invalid=DONT-INVALIDATE}
      data Ford_TrlrAidSetup_D2_Stat: sw-calibration-access=READ-ONLY, type=Ford_TrlrAidSetup_D2_Stat
    Ford_TrlrAidSwtch_D_RqDrv: invalidation-policy{data-element=Ford_TrlrAidSwtch_D_RqDrv, handle-invalid=DONT-INVALIDATE}
      data Ford_TrlrAidSwtch_D_RqDrv: sw-calibration-access=READ-ONLY, type=Ford_TrlrAidSwtch_D_RqDrv
    Ford_TrlrAidTrgtId_No_Actl: invalidation-policy{data-element=Ford_TrlrAidTrgtId_No_Actl, handle-invalid=DONT-INVALIDATE}
      data Ford_TrlrAidTrgtId_No_Actl: sw-calibration-access=READ-ONLY, type=Ford_TrlrAidTrgtId_No_Actl
    Ford_TrlrAidTrgtId_No_Rq: invalidation-policy{data-element=Ford_TrlrAidTrgtId_No_Rq, handle-invalid=DONT-INVALIDATE}
      data Ford_TrlrAidTrgtId_No_Rq: sw-calibration-access=READ-ONLY, type=Ford_TrlrAidTrgtId_No_Rq
    Ford_TrlrAidTrlrId_No_Rq: invalidation-policy{data-element=Ford_TrlrAidTrlrId_No_Rq, handle-invalid=DONT-INVALIDATE}
      data Ford_TrlrAidTrlrId_No_Rq: sw-calibration-access=READ-ONLY, type=Ford_TrlrAidTrlrId_No_Rq
    Ford_TrlrAn_An_MxCalc: invalidation-policy{data-element=Ford_TrlrAn_An_MxCalc, handle-invalid=DONT-INVALIDATE}
      data Ford_TrlrAn_An_MxCalc: sw-calibration-access=READ-ONLY, type=Ford_TrlrAn_An_MxCalc
    Ford_TrlrAn_An_TrgtCalc: invalidation-policy{data-element=Ford_TrlrAn_An_TrgtCalc/Ford_TrlrAn_An_TrgtCalc, handle-invalid=DONT-INVALIDATE}
      data Ford_TrlrAn_An_TrgtCalc: sw-calibration-access=READ-ONLY, type=Ford_TrlrAn_An_TrgtCalc
    Ford_TrlrAn_An_TrgtCalc_PortIf1: invalidation-policy{data-element=Ford_TrlrAn_An_TrgtCalc_PortIf1/Ford_TrlrAn_An_TrgtCalc, handle-invalid=DONT-INVALIDATE}
      data Ford_TrlrAn_An_TrgtCalc: sw-calibration-access=READ-ONLY, type=Ford_TrlrAn_An_TrgtCalc
    Ford_TrlrAn_An_WarnCalc: invalidation-policy{data-element=Ford_TrlrAn_An_WarnCalc, handle-invalid=DONT-INVALIDATE}
      data Ford_TrlrAn_An_WarnCalc: sw-calibration-access=READ-ONLY, type=Ford_TrlrAn_An_WarnCalc
    Ford_TrlrAnOffst_An2_Calc: invalidation-policy{data-element=Ford_TrlrAnOffst_An2_Calc, handle-invalid=DONT-INVALIDATE}
      data Ford_TrlrAnOffst_An2_Calc: sw-calibration-access=READ-ONLY, type=Ford_TrlrAnOffst_An2_Calc
    Ford_TrlrAnOffstDir_D_Mem: invalidation-policy{data-element=Ford_TrlrAnOffstDir_D_Mem, handle-invalid=DONT-INVALIDATE}
      data Ford_TrlrAnOffstDir_D_Mem: sw-calibration-access=READ-ONLY, type=Ford_TrlrAnOffstDir_D_Mem
    Ford_TrlrAxleToBmpr_L_Actl: invalidation-policy{data-element=Ford_TrlrAxleToBmpr_L_Actl, handle-invalid=DONT-INVALIDATE}
      data Ford_TrlrAxleToBmpr_L_Actl: sw-calibration-access=READ-ONLY, type=Ford_TrlrAxleToBmpr_L_Actl
    Ford_TrlrBrkActCnnct_B_Actl: invalidation-policy{data-element=Ford_TrlrBrkActCnnct_B_Actl, handle-invalid=DONT-INVALIDATE}
      data Ford_TrlrBrkActCnnct_B_Actl: sw-calibration-access=READ-ONLY, type=Ford_TrlrBrkActCnnct_B_Actl
    Ford_TrlrHitchLamp_D_Rqst: invalidation-policy{data-element=Ford_TrlrHitchLamp_D_Rqst, handle-invalid=DONT-INVALIDATE}
      data Ford_TrlrHitchLamp_D_Rqst: sw-calibration-access=READ-ONLY, type=Ford_TrlrHitchLamp_D_Rqst
    Ford_TrlrHitchYaw_An_Actl: invalidation-policy{data-element=Ford_TrlrHitchYaw_An_Actl, handle-invalid=DONT-INVALIDATE}
      data Ford_TrlrHitchYaw_An_Actl: sw-calibration-access=READ-ONLY, type=Ford_TrlrHitchYaw_An_Actl
    Ford_TrlrHitchYaw_D_Stat: invalidation-policy{data-element=Ford_TrlrHitchYaw_D_Stat, handle-invalid=DONT-INVALIDATE}
      data Ford_TrlrHitchYaw_D_Stat: sw-calibration-access=READ-ONLY, type=Ford_TrlrHitchYaw_D_Stat
    Ford_TrlrHitYaw_AnRate_Actl: invalidation-policy{data-element=Ford_TrlrHitYaw_AnRate_Actl, handle-invalid=DONT-INVALIDATE}
      data Ford_TrlrHitYaw_AnRate_Actl: sw-calibration-access=READ-ONLY, type=Ford_TrlrHitYaw_AnRate_Actl
    Ford_TrlrId_No_Actl: invalidation-policy{data-element=Ford_TrlrId_No_Actl, handle-invalid=DONT-INVALIDATE}
      data Ford_TrlrId_No_Actl: sw-calibration-access=READ-ONLY, type=Ford_TrlrId_No_Actl
    Ford_TrlrIdType_D_Stat: invalidation-policy{data-element=Ford_TrlrIdType_D_Stat, handle-invalid=DONT-INVALIDATE}
      data Ford_TrlrIdType_D_Stat: sw-calibration-access=READ-ONLY, type=Ford_TrlrIdType_D_Stat
    Ford_TrlrLampCnnct_B_Actl: invalidation-policy{data-element=Ford_TrlrLampCnnct_B_Actl, handle-invalid=DONT-INVALIDATE}
      data Ford_TrlrLampCnnct_B_Actl: sw-calibration-access=READ-ONLY, type=Ford_TrlrLampCnnct_B_Actl
    Ford_TrlrRvrse_D_Stat: invalidation-policy{data-element=Ford_TrlrRvrse_D_Stat, handle-invalid=DONT-INVALIDATE}
      data Ford_TrlrRvrse_D_Stat: sw-calibration-access=READ-ONLY, type=Ford_TrlrRvrse_D_Stat
    Ford_TrlrRvrseCancl_B_Rq: invalidation-policy{data-element=Ford_TrlrRvrseCancl_B_Rq, handle-invalid=DONT-INVALIDATE}
      data Ford_TrlrRvrseCancl_B_Rq: sw-calibration-access=READ-ONLY, type=Ford_TrlrRvrseCancl_B_Rq
    Ford_TrlrRvrseEnbl_D2_Stat: invalidation-policy{data-element=Ford_TrlrRvrseEnbl_D2_Stat, handle-invalid=DONT-INVALIDATE}
      data Ford_TrlrRvrseEnbl_D2_Stat: sw-calibration-access=READ-ONLY, type=Ford_TrlrRvrseEnbl_D2_Stat
    Ford_TrlrRvrseMsgTxt_D2_Rq: invalidation-policy{data-element=Ford_TrlrRvrseMsgTxt_D2_Rq, handle-invalid=DONT-INVALIDATE}
      data Ford_TrlrRvrseMsgTxt_D2_Rq: sw-calibration-access=READ-ONLY, type=Ford_TrlrRvrseMsgTxt_D2_Rq
    Ford_TrlrSnsId_No_Actl: invalidation-policy{data-element=Ford_TrlrSnsId_No_Actl, handle-invalid=DONT-INVALIDATE}
      data Ford_TrlrSnsId_No_Actl: sw-calibration-access=READ-ONLY, type=Ford_TrlrSnsId_No_Actl
    Ford_TrlrTrgtAcquire_D_Stat: invalidation-policy{data-element=Ford_TrlrTrgtAcquire_D_Stat, handle-invalid=DONT-INVALIDATE}
      data Ford_TrlrTrgtAcquire_D_Stat: sw-calibration-access=READ-ONLY, type=Ford_TrlrTrgtAcquire_D_Stat
    Ford_TrlrYaw_W_Actl: invalidation-policy{data-element=Ford_TrlrYaw_W_Actl, handle-invalid=DONT-INVALIDATE}
      data Ford_TrlrYaw_W_Actl: sw-calibration-access=READ-ONLY, type=Ford_TrlrYaw_W_Actl
    Ford_TrlrYawWActl_D_Qf: invalidation-policy{data-element=Ford_TrlrYawWActl_D_Qf, handle-invalid=DONT-INVALIDATE}
      data Ford_TrlrYawWActl_D_Qf: sw-calibration-access=READ-ONLY, type=Ford_TrlrYawWActl_D_Qf
    Ford_TrnRng_D_Rq: invalidation-policy{data-element=Ford_TrnRng_D_Rq, handle-invalid=DONT-INVALIDATE}
      data Ford_TrnRng_D_Rq: sw-calibration-access=READ-ONLY, type=Ford_TrnRng_D_Rq
    Ford_TurnLghtSwtch_D_Stat: invalidation-policy{data-element=Ford_TurnLghtSwtch_D_Stat, handle-invalid=DONT-INVALIDATE}
      data Ford_TurnLghtSwtch_D_Stat: sw-calibration-access=READ-ONLY, type=Ford_TurnLghtSwtch_D_Stat
    Ford_Veh_V_ActlBrk: invalidation-policy{data-element=Ford_Veh_V_ActlBrk, handle-invalid=DONT-INVALIDATE}
      data Ford_Veh_V_ActlBrk: sw-calibration-access=READ-ONLY, type=Ford_Veh_V_ActlBrk
    Ford_Veh_V_ActlEng: invalidation-policy{data-element=Ford_Veh_V_ActlEng, handle-invalid=DONT-INVALIDATE}
      data Ford_Veh_V_ActlEng: sw-calibration-access=READ-ONLY, type=Ford_Veh_V_ActlEng
    Ford_Veh_V_RqMxTrlrAid: invalidation-policy{data-element=Ford_Veh_V_RqMxTrlrAid, handle-invalid=DONT-INVALIDATE}
      data Ford_Veh_V_RqMxTrlrAid: sw-calibration-access=READ-ONLY, type=Ford_Veh_V_RqMxTrlrAid
    Ford_VehicleGGCCData: invalidation-policy{data-element=Ford_VehicleGGCCData, handle-invalid=DONT-INVALIDATE}
      data Ford_VehicleGGCCData: sw-calibration-access=READ-ONLY, type=Ford_VehicleGGCCData
    Ford_VehLatComp_A_Actl: invalidation-policy{data-element=Ford_VehLatComp_A_Actl, handle-invalid=DONT-INVALIDATE}
      data Ford_VehLatComp_A_Actl: sw-calibration-access=READ-ONLY, type=Ford_VehLatComp_A_Actl
    Ford_VehLongComp_A_Actl: invalidation-policy{data-element=Ford_VehLongComp_A_Actl, handle-invalid=DONT-INVALIDATE}
      data Ford_VehLongComp_A_Actl: sw-calibration-access=READ-ONLY, type=Ford_VehLongComp_A_Actl
    Ford_VehOverGnd_V_Est: invalidation-policy{data-element=Ford_VehOverGnd_V_Est, handle-invalid=DONT-INVALIDATE}
      data Ford_VehOverGnd_V_Est: sw-calibration-access=READ-ONLY, type=Ford_VehOverGnd_V_Est
    Ford_VehVActlBrk_D_Qf: invalidation-policy{data-element=Ford_VehVActlBrk_D_Qf, handle-invalid=DONT-INVALIDATE}
      data Ford_VehVActlBrk_D_Qf: sw-calibration-access=READ-ONLY, type=Ford_VehVActlBrk_D_Qf
    Ford_VehVActlBrk_No_Cnt: invalidation-policy{data-element=Ford_VehVActlBrk_No_Cnt, handle-invalid=DONT-INVALIDATE}
      data Ford_VehVActlBrk_No_Cnt: sw-calibration-access=READ-ONLY, type=Ford_VehVActlBrk_No_Cnt
    Ford_VehVActlBrk_No_Cs: invalidation-policy{data-element=Ford_VehVActlBrk_No_Cs, handle-invalid=DONT-INVALIDATE}
      data Ford_VehVActlBrk_No_Cs: sw-calibration-access=READ-ONLY, type=Ford_VehVActlBrk_No_Cs
    Ford_VehVActlEng_D_Qf: invalidation-policy{data-element=Ford_VehVActlEng_D_Qf, handle-invalid=DONT-INVALIDATE}
      data Ford_VehVActlEng_D_Qf: sw-calibration-access=READ-ONLY, type=Ford_VehVActlEng_D_Qf
    Ford_VehVActlEng_No_Cnt: invalidation-policy{data-element=Ford_VehVActlEng_No_Cnt, handle-invalid=DONT-INVALIDATE}
      data Ford_VehVActlEng_No_Cnt: sw-calibration-access=READ-ONLY, type=Ford_VehVActlEng_No_Cnt
    Ford_VehVActlEng_No_Cs: invalidation-policy{data-element=Ford_VehVActlEng_No_Cs, handle-invalid=DONT-INVALIDATE}
      data Ford_VehVActlEng_No_Cs: sw-calibration-access=READ-ONLY, type=Ford_VehVActlEng_No_Cs
    Ford_VehVertComp_A_Actl: invalidation-policy{data-element=Ford_VehVertComp_A_Actl, handle-invalid=DONT-INVALIDATE}
      data Ford_VehVertComp_A_Actl: sw-calibration-access=READ-ONLY, type=Ford_VehVertComp_A_Actl
    Ford_VehVTrlrAid_B_Avail: invalidation-policy{data-element=Ford_VehVTrlrAid_B_Avail, handle-invalid=DONT-INVALIDATE}
      data Ford_VehVTrlrAid_B_Avail: sw-calibration-access=READ-ONLY, type=Ford_VehVTrlrAid_B_Avail
    Ford_VehVTrlrAid_B_Rq: invalidation-policy{data-element=Ford_VehVTrlrAid_B_Rq, handle-invalid=DONT-INVALIDATE}
      data Ford_VehVTrlrAid_B_Rq: sw-calibration-access=READ-ONLY, type=Ford_VehVTrlrAid_B_Rq
    Ford_VehYaw_W_Actl: invalidation-policy{data-element=Ford_VehYaw_W_Actl, handle-invalid=DONT-INVALIDATE}
      data Ford_VehYaw_W_Actl: sw-calibration-access=READ-ONLY, type=Ford_VehYaw_W_Actl
    Ford_VehYawComp_W_Actl: invalidation-policy{data-element=Ford_VehYawComp_W_Actl, handle-invalid=DONT-INVALIDATE}
      data Ford_VehYawComp_W_Actl: sw-calibration-access=READ-ONLY, type=Ford_VehYawComp_W_Actl
    Ford_WhlDirFl_D_Actl: invalidation-policy{data-element=Ford_WhlDirFl_D_Actl, handle-invalid=DONT-INVALIDATE}
      data Ford_WhlDirFl_D_Actl: sw-calibration-access=READ-ONLY, type=Ford_WhlDirFl_D_Actl
    Ford_WhlDirFr_D_Actl: invalidation-policy{data-element=Ford_WhlDirFr_D_Actl, handle-invalid=DONT-INVALIDATE}
      data Ford_WhlDirFr_D_Actl: sw-calibration-access=READ-ONLY, type=Ford_WhlDirFr_D_Actl
    Ford_WhlDirRl_D_Actl: invalidation-policy{data-element=Ford_WhlDirRl_D_Actl, handle-invalid=DONT-INVALIDATE}
      data Ford_WhlDirRl_D_Actl: sw-calibration-access=READ-ONLY, type=Ford_WhlDirRl_D_Actl
    Ford_WhlDirRr_D_Actl: invalidation-policy{data-element=Ford_WhlDirRr_D_Actl, handle-invalid=DONT-INVALIDATE}
      data Ford_WhlDirRr_D_Actl: sw-calibration-access=READ-ONLY, type=Ford_WhlDirRr_D_Actl
    Ford_WhlFl_W_Meas: invalidation-policy{data-element=Ford_WhlFl_W_Meas, handle-invalid=DONT-INVALIDATE}
      data Ford_WhlFl_W_Meas: sw-calibration-access=READ-ONLY, type=Ford_WhlFl_W_Meas
    Ford_WhlFr_W_Meas: invalidation-policy{data-element=Ford_WhlFr_W_Meas, handle-invalid=DONT-INVALIDATE}
      data Ford_WhlFr_W_Meas: sw-calibration-access=READ-ONLY, type=Ford_WhlFr_W_Meas
    Ford_WhlRl_W_Meas: invalidation-policy{data-element=Ford_WhlRl_W_Meas, handle-invalid=DONT-INVALIDATE}
      data Ford_WhlRl_W_Meas: sw-calibration-access=READ-ONLY, type=Ford_WhlRl_W_Meas
    Ford_WhlRotatFl_No_Cnt: invalidation-policy{data-element=Ford_WhlRotatFl_No_Cnt, handle-invalid=DONT-INVALIDATE}
      data Ford_WhlRotatFl_No_Cnt: sw-calibration-access=READ-ONLY, type=Ford_WhlRotatFl_No_Cnt
    Ford_WhlRotatFr_No_Cnt: invalidation-policy{data-element=Ford_WhlRotatFr_No_Cnt, handle-invalid=DONT-INVALIDATE}
      data Ford_WhlRotatFr_No_Cnt: sw-calibration-access=READ-ONLY, type=Ford_WhlRotatFr_No_Cnt
    Ford_WhlRotatRl_No_Cnt: invalidation-policy{data-element=Ford_WhlRotatRl_No_Cnt, handle-invalid=DONT-INVALIDATE}
      data Ford_WhlRotatRl_No_Cnt: sw-calibration-access=READ-ONLY, type=Ford_WhlRotatRl_No_Cnt
    Ford_WhlRotatRr_No_Cnt: invalidation-policy{data-element=Ford_WhlRotatRr_No_Cnt, handle-invalid=DONT-INVALIDATE}
      data Ford_WhlRotatRr_No_Cnt: sw-calibration-access=READ-ONLY, type=Ford_WhlRotatRr_No_Cnt
    Ford_WhlRr_W_Meas: invalidation-policy{data-element=Ford_WhlRr_W_Meas, handle-invalid=DONT-INVALIDATE}
      data Ford_WhlRr_W_Meas: sw-calibration-access=READ-ONLY, type=Ford_WhlRr_W_Meas
    Ford_YawStabilityIndex: invalidation-policy{data-element=Ford_YawStabilityIndex, handle-invalid=DONT-INVALIDATE}
      data Ford_YawStabilityIndex: sw-calibration-access=READ-ONLY, type=Ford_YawStabilityIndex
    FordEpsSysSt1_PortIf1: invalidation-policy{data-element=FordEpsSysSt1_PortIf1/Val, handle-invalid=DONT-INVALIDATE}
      data Val: sw-calibration-access=READ-ONLY, type=FordEpsSysSt1
package /Nexteer/Calibrations
  183 x parameter interface:
    Ag4
      parameter data prototype Val: sw-calibration-access=READ-WRITE, type=Ag13
    AgAry1D2
      parameter data prototype Ary1D: sw-calibration-access=READ-WRITE, type=AgAry1D4
    Ar1D_u2p14_5_calPortIf1
      parameter data prototype Ary1D: sw-calibration-access=READ-WRITE, type=Ary1D_u2p14_5
    Ary1D_boolean_4_CalPortIf1
      parameter data prototype Ary1D: sw-calibration-access=READ-WRITE, type=Ary1D_boolean_4
    Ary1D_f32_2_CalPortIf1
      parameter data prototype Ary1D: sw-calibration-access=READ-WRITE, type=Ary1D_f32_2
    Ary1D_f32_3_CalPortIf1
      parameter data prototype Ary1D: sw-calibration-access=READ-WRITE, type=Ary1D_f32_3
    Ary1D_f32_4_CalPortIf1
      parameter data prototype Ary1D: sw-calibration-access=READ-WRITE, type=Ary1D_f32_4
    Ary1D_f32_5_CalPortIf1
      parameter data prototype Ary1D: sw-calibration-access=READ-WRITE, type=Ary1D_f32_5
    Ary1D_f32_8_CalPortIf1
      parameter data prototype Ary1D: sw-calibration-access=READ-WRITE, type=Ary1D_f32_8
    Ary1D_logl_13_CalPortIf1
      parameter data prototype Ary1D: sw-calibration-access=READ-WRITE, type=Ary1D_logl_13
    Ary1D_logl_3_CalPortIf1
      parameter data prototype Ary1D: sw-calibration-access=READ-WRITE, type=Ary1D_logl_3
    Ary1D_logl_4_CalPortIf1
      parameter data prototype Ary1D: sw-calibration-access=READ-WRITE, type=Ary1D_logl_4
    Ary1D_s11p4_11_CalPortIf1
      parameter data prototype Ary1D: sw-calibration-access=READ-WRITE, type=Ary1D_s11p4_11
    Ary1D_s11p4_14_CalPortIf1
      parameter data prototype Ary1D: sw-calibration-access=READ-WRITE, type=Ary1D_s11p4_14
    Ary1D_s11p4_5_CalPortIf1
      parameter data prototype Ary1D: sw-calibration-access=READ-WRITE, type=Ary1D_s11p4_5
    Ary1D_s14p1_8_CalPortIf1
      parameter data prototype Ary1D: sw-calibration-access=READ-WRITE, type=Ary1D_s14p1_8
    Ary1D_s15p0_4_CalPortIf1
      parameter data prototype Ary1D: sw-calibration-access=READ-WRITE, type=Ary1D_s15p0_4
    Ary1D_s15p0_5_CalPortIf1
      parameter data prototype Ary1D: sw-calibration-access=READ-WRITE, type=Ary1D_s15p0_5
    Ary1D_s16_22_CalPortIf1
      parameter data prototype Ary1D: sw-calibration-access=READ-WRITE, type=Ary1D_s16_22
    Ary1D_s16_8_CalPortIf1
      parameter data prototype Ary1D: sw-calibration-access=READ-WRITE, type=Ary1D_s16_8
    Ary1D_s4p11_12_CalPort1f
      parameter data prototype Ary1D: sw-calibration-access=READ-WRITE, type=Ary1D_s4p11_12
    Ary1D_s4p11_12_CalPortIf1
      parameter data prototype Ary1D: sw-calibration-access=READ-WRITE, type=Ary1D_s4p11_12
    Ary1D_s4p11_4_CalPortIf1
      parameter data prototype Ary1D: sw-calibration-access=READ-WRITE, type=Ary1D_s4p11_4
    Ary1D_s5p10_8_CalPortIf1
      parameter data prototype Val: sw-calibration-access=READ-WRITE, type=Ary1D_s5p10_8
    Ary1D_s8p7_12_CalPortIf1
      parameter data prototype Ary1D: sw-calibration-access=READ-WRITE, type=Ary1D_s8p7_12
    Ary1D_s8p7_14_CalPortIf1
      parameter data prototype Ary1D: sw-calibration-access=READ-WRITE, type=Ary1D_s8p7_14
    Ary1D_u08_22_CalPortIf1
      parameter data prototype Ary1D: sw-calibration-access=READ-WRITE, type=Ary1D_u08_22
    Ary1D_u08_48_CalPortIf1
      parameter data prototype Ary1D: sw-calibration-access=READ-WRITE, type=Ary1D_u08_48
    Ary1D_u08_6_CalPortIf1
      parameter data prototype Ary1D: sw-calibration-access=READ-WRITE, type=Ary1D_u08_6
    Ary1D_u0p16_10_CalPortIf1
      parameter data prototype Ary1D: sw-calibration-access=READ-WRITE, type=Ary1D_u0p16_10
    Ary1D_u10p6_10_CalPortIf1
      parameter data prototype Ary1D: sw-calibration-access=READ-WRITE, type=Ary1D_u10p6_10
    Ary1D_u10p6_2_CalPortIf1
      parameter data prototype Ary1D: sw-calibration-access=READ-WRITE, type=Ary1D_u10p6_2
    Ary1D_u10p6_4_CalPortIf1
      parameter data prototype Ary1D: sw-calibration-access=READ-WRITE, type=Ary1D_u10p6_4
    Ary1D_u10p6_5_CalPortIf1
      parameter data prototype Ary1D: sw-calibration-access=READ-WRITE, type=Ary1D_u10p6_5
    Ary1D_u10p6_8_CalPortIf1
      parameter data prototype Ary1D: sw-calibration-access=READ-WRITE, type=Ary1D_u10p6_8
    Ary1D_u11p5_10_CalPortIf1
      parameter data prototype Ary1D: sw-calibration-access=READ-WRITE, type=Ary1D_u11p5_10
    Ary1D_u11p5_12_CalPortIf1
      parameter data prototype Ary1D: sw-calibration-access=READ-WRITE, type=Ary1D_u11p5_12
    Ary1D_u11p5_4_CalPortIf1
      parameter data prototype Ary1D: sw-calibration-access=READ-WRITE, type=Ary1D_u11p5_4
    Ary1D_u11p5_6_CalPortIf1
      parameter data prototype Ary1D: sw-calibration-access=READ-WRITE, type=Ary1D_u11p5_6
    Ary1D_u11p5_8_CalPortIf1
      parameter data prototype Ary1D: sw-calibration-access=READ-WRITE, type=Ary1D_u11p5_8
    Ary1D_u12p4_12_CalPortIf1
      parameter data prototype Ary1D: sw-calibration-access=READ-WRITE, type=Ary1D_u12p4_12
    Ary1D_u12p4_2_CalPortIf1
      parameter data prototype Ary1D: sw-calibration-access=READ-WRITE, type=Ary1D_u12p4_2
    Ary1D_u13p3_2_CalPortIf1
      parameter data prototype Ary1D: sw-calibration-access=READ-WRITE, type=Ary1D_u13p3_2
    Ary1D_u13p3_6_CalPortIf1
      parameter data prototype Ary1D: sw-calibration-access=READ-WRITE, type=Ary1D_u13p3_6
    Ary1D_u13p3_8_CalPortIf1
      parameter data prototype Ary1D: sw-calibration-access=READ-WRITE, type=Ary1D_u13p3_8
    Ary1D_u15p1_12_CalPortIf1
      parameter data prototype Ary1D: sw-calibration-access=READ-WRITE, type=Ary1D_u15p1_12
    Ary1D_u16_32_CalPortIf1
      parameter data prototype Ary1D: sw-calibration-access=READ-WRITE, type=Ary1D_u16_32
    Ary1D_u16_512_CalPortIf1
      parameter data prototype Ary1D: sw-calibration-access=READ-WRITE, type=Ary1D_u16_512
    Ary1D_u16_6_CalPortIf1
      parameter data prototype Ary1D: sw-calibration-access=READ-WRITE, type=Ary1D_u16_6
    Ary1D_u16_8_CalPortIf1
      parameter data prototype Ary1D: sw-calibration-access=READ-WRITE, type=Ary1D_u16_8
    Ary1D_u16p0_2_CalPortIf1
      parameter data prototype Ary1D: sw-calibration-access=READ-WRITE, type=Ary1D_u16p0_2
    Ary1D_u16p0_20_CalPortIf1
      parameter data prototype Ary1D: sw-calibration-access=READ-WRITE, type=Ary1D_u16p0_20
    Ary1D_u16p0_6_CalPortIf1
      parameter data prototype Ary1D: sw-calibration-access=READ-WRITE, type=Ary1D_u16p0_6
    Ary1D_u16p0_8_CalPortIf1
      parameter data prototype Ary1D: sw-calibration-access=READ-WRITE, type=Ary1D_u16p0_8
    Ary1D_u1p15_11_CalPortIf1
      parameter data prototype Ary1D: sw-calibration-access=READ-WRITE, type=Ary1D_u1p15_11
    Ary1D_u1p15_12_CalPortIf1
      parameter data prototype Ary1D: sw-calibration-access=READ-WRITE, type=Ary1D_u1p15_12
    Ary1D_u1p15_2_CalPortIf1
      parameter data prototype Ary1D: sw-calibration-access=READ-WRITE, type=Ary1D_u1p15_2
    Ary1D_u1p15_5_CalPortIf1
      parameter data prototype Ary1D: sw-calibration-access=READ-WRITE, type=Ary1D_u1p15_5
    Ary1D_u1p15_6_CalPortIf1
      parameter data prototype Ary1D: sw-calibration-access=READ-WRITE, type=Ary1D_u1p15_6
    Ary1D_u2p14_10_CalPortIf1
      parameter data prototype Ary1D: sw-calibration-access=READ-WRITE, type=Ary1D_u2p14_10
    Ary1D_u2p14_12_CalPortIf1
      parameter data prototype Ary1D: sw-calibration-access=READ-WRITE, type=Ary1D_u2p14_12
    Ary1D_u2p14_16_CalPortIf1
      parameter data prototype Ary1D: sw-calibration-access=READ-WRITE, type=Ary1D_u2p14_16
    Ary1D_u2p14_2_CalPortIf1
      parameter data prototype Ary1D: sw-calibration-access=READ-WRITE, type=Ary1D_u2p14_2
    Ary1D_u2p14_4_CalPortIf1
      parameter data prototype Ary1D: sw-calibration-access=READ-WRITE, type=Ary1D_u2p14_4
    Ary1D_u2p14_5_CalPortIf1
      parameter data prototype Ary1D: sw-calibration-access=READ-WRITE, type=Ary1D_u2p14_5
    Ary1D_u2p14_6_CalPortIf1
      parameter data prototype Ary1D: sw-calibration-access=READ-WRITE, type=Ary1D_u2p14_6
    Ary1D_u3p13_10_CalPortIf1
      parameter data prototype Ary1D: sw-calibration-access=READ-WRITE, type=Ary1D_u3p13_10
    Ary1D_u3p13_5_CalPortIf1
      parameter data prototype Ary1D: sw-calibration-access=READ-WRITE, type=Ary1D_u3p13_5
    Ary1D_u4p12_10_CalPortIf1
      parameter data prototype Ary1D: sw-calibration-access=READ-WRITE, type=Ary1D_u4p12_10
    Ary1D_u4p12_11_CalPortIf1
      parameter data prototype Ary1D: sw-calibration-access=READ-WRITE, type=Ary1D_u4p12_11
    Ary1D_u4p12_12_CalPortIf1
      parameter data prototype Ary1D: sw-calibration-access=READ-WRITE, type=Ary1D_u4p12_12
    Ary1D_u4p12_14_CalPortIf1
      parameter data prototype Ary1D: sw-calibration-access=READ-WRITE, type=Ary1D_u4p12_14
    Ary1D_u4p12_2_CalPortIf1
      parameter data prototype Ary1D: sw-calibration-access=READ-WRITE, type=Ary1D_u4p12_2
    Ary1D_u4p12_5_CalPortIf1
      parameter data prototype Ary1D: sw-calibration-access=READ-WRITE, type=Ary1D_u4p12_5
    Ary1D_u4p12_6_CalPortIf1
      parameter data prototype Ary1D: sw-calibration-access=READ-WRITE, type=Ary1D_u4p12_6
    Ary1D_u4p12_8_CalPortIf1
      parameter data prototype Ary1D: sw-calibration-access=READ-WRITE, type=Ary1D_u4p12_8
    Ary1D_u5p11_10_CalPortIf1
      parameter data prototype Ary1D: sw-calibration-access=READ-WRITE, type=Ary1D_u5p11_10
    Ary1D_u5p11_14_CalPortIf1
      parameter data prototype Ary1D: sw-calibration-access=READ-WRITE, type=Ary1D_u5p11_14
    Ary1D_u5p11_5_CalPortIf1
      parameter data prototype Ary1D: sw-calibration-access=READ-WRITE, type=Ary1D_u5p11_5
    Ary1D_u5p11_6_CalPortIf1
      parameter data prototype Ary1D: sw-calibration-access=READ-WRITE, type=Ary1D_u5p11_6
    Ary1D_u5p11_8_CalPortIf1
      parameter data prototype Ary1D: sw-calibration-access=READ-WRITE, type=Ary1D_u5p11_8
    Ary1D_u6p10_10_CalPortIf1
      parameter data prototype Ary1D: sw-calibration-access=READ-WRITE, type=Ary1D_u6p10_10
    Ary1D_u6p10_6_CalPortIf1
      parameter data prototype Ary1D: sw-calibration-access=READ-WRITE, type=Ary1D_u6p10_6
    Ary1D_u7p9_12_CalPortIf1
      parameter data prototype Ary1D: sw-calibration-access=READ-WRITE, type=Ary1D_u7p9_12
    Ary1D_u8_48_CalPortIf1
      parameter data prototype Ary1D: sw-calibration-access=READ-WRITE, type=Ary1D_u8_48
    Ary1D_u8_6_CalPortIf1
      parameter data prototype Ary1D: sw-calibration-access=READ-WRITE, type=Ary1D_u8_6
    Ary1D_u8p8_10_CalPortIf1
      parameter data prototype Ary1D: sw-calibration-access=READ-WRITE, type=Ary1D_u8p8_10
    Ary1D_u8p8_12_CalPortIf1
      parameter data prototype Ary1D: sw-calibration-access=READ-WRITE, type=Ary1D_u8p8_12
    Ary1D_u8p8_14_CalPortIf1
      parameter data prototype Ary1D: sw-calibration-access=READ-WRITE, type=Ary1D_u8p8_14
    Ary1D_u8p8_2_CalPortIf1
      parameter data prototype Ary1D: sw-calibration-access=READ-WRITE, type=Ary1D_u8p8_2
    Ary1D_u8p8_4_CalPortIf1
      parameter data prototype Ary1D: sw-calibration-access=READ-WRITE, type=Ary1D_u8p8_4
    Ary1D_u8p8_6_CalPortIf1
      parameter data prototype Ary1D: sw-calibration-access=READ-WRITE, type=Ary1D_u8p8_6
    Ary1D_u8p8_8_CalPortIf1
      parameter data prototype Ary1D: sw-calibration-access=READ-WRITE, type=Ary1D_u8p8_8
    Ary1D_u9p7_10_CalPortIf1
      parameter data prototype Ary1D: sw-calibration-access=READ-WRITE, type=Ary1D_u9p7_10
    Ary1D_u9p7_12_CalPortIf1
      parameter data prototype Ary1D: sw-calibration-access=READ-WRITE, type=Ary1D_u9p7_12
    Ary1D_u9p7_16_CalPortIf1
      parameter data prototype Ary1D: sw-calibration-access=READ-WRITE, type=Ary1D_u9p7_16
    Ary1D_u9p7_2_CalPortIf1
      parameter data prototype Ary1D: sw-calibration-access=READ-WRITE, type=Ary1D_u9p7_2
    Ary1D_u9p7_4_CalPortIf1
      parameter data prototype Ary1D: sw-calibration-access=READ-WRITE, type=Ary1D_u9p7_4
    Ary1D_u9p7_5_CalPortIf1
      parameter data prototype Ary1D: sw-calibration-access=READ-WRITE, type=Ary1D_u9p7_5
    Ary1D_u9p7_6_CalPortIf1
      parameter data prototype Ary1D: sw-calibration-access=READ-WRITE, type=Ary1D_u9p7_6
    Ary1D_u9p7_7_CalPortIf1
      parameter data prototype Ary1D: sw-calibration-access=READ-WRITE, type=Ary1D_u9p7_7
    Ary1D_u9p7_8_CalPortIf1
      parameter data prototype Ary1D: sw-calibration-access=READ-WRITE, type=Ary1D_u9p7_8
    Ary1D_u9p7_9_CalPortIf1
      parameter data prototype Ary1D: sw-calibration-access=READ-WRITE, type=Ary1D_u9p7_9
    Ary2D_f32_4_2_CalPortIf1
      parameter data prototype Ary2D: sw-calibration-access=READ-WRITE, type=Ary2D_f32_4_2
    Ary2D_f32_5_4_CalPortIf1
      parameter data prototype Ary2D: sw-calibration-access=READ-WRITE, type=Ary2D_f32_5_4
    Ary2D_f32_5_5_CalPortIf1
      parameter data prototype Ary2D: sw-calibration-access=READ-WRITE, type=Ary2D_f32_5_5
    Ary2D_f32_8_4_CalPortIf1
      parameter data prototype Ary2D: sw-calibration-access=READ-WRITE, type=Ary2D_f32_8_4
    Ary2D_s16_8_9_CalPortIf1
      parameter data prototype Ary2D: sw-calibration-access=READ-WRITE, type=Ary2D_s16_8_9
    Ary2D_s16p0_8_9_CalPortIf1
      parameter data prototype Ary2D: sw-calibration-access=READ-WRITE, type=Ary2D_s16p0_8_9
    Ary2D_s1p14_10_12_CalPortIf1
      parameter data prototype Ary2D: sw-calibration-access=READ-WRITE, type=Ary2D_s1p14_10_12
    Ary2D_s4p11_12_20_CalPortIf1
      parameter data prototype Ary2D: sw-calibration-access=READ-WRITE, type=Ary2D_s4p11_12_20
    Ary2D_s4p11_8_11_CalPortIf1
      parameter data prototype Ary2D: sw-calibration-access=READ-WRITE, type=Ary2D_s4p11_8_11
    Ary2D_s7p8_4_5_CalPortIf1
      parameter data prototype Ary2D: sw-calibration-access=READ-WRITE, type=Ary2D_s7p8_4_5
    Ary2D_u0p16_20_8_CalPortIf1
      parameter data prototype Ary2D: sw-calibration-access=READ-WRITE, type=Ary2D_u0p16_20_8
    Ary2D_u0p16_4_2_CalPortIf1
      parameter data prototype Ary2D: sw-calibration-access=READ-WRITE, type=Ary2D_u0p16_4_2
    Ary2D_u12p4_12_13_CalPortIf1
      parameter data prototype Ary2D: sw-calibration-access=READ-WRITE, type=Ary2D_u12p4_12_13
    Ary2D_u12p4_4_2_CalPortIf1
      parameter data prototype Ary2D: sw-calibration-access=READ-WRITE, type=Ary2D_u12p4_4_2
    Ary2D_u12p4_5_4_CalPortIf1
      parameter data prototype Ary2D: sw-calibration-access=READ-WRITE, type=Ary2D_u12p4_5_4
    Ary2D_u12p4_9_16_CalPortIf1
      parameter data prototype Ary2D: sw-calibration-access=READ-WRITE, type=Ary2D_u12p4_9_16
    Ary2D_u16_8_3_CalPortIf1
      parameter data prototype Ary2D: sw-calibration-access=READ-WRITE, type=Ary2D_u16_8_3
    Ary2D_u16p0_2_8_CalPortIf1
      parameter data prototype Ary2D: sw-calibration-access=READ-WRITE, type=Ary2D_u16p0_2_8
    Ary2D_u1p15_12_5_CalPortIf1
      parameter data prototype Ary2D: sw-calibration-access=READ-WRITE, type=Ary2D_u1p15_12_5
    Ary2D_u1p15_5_4_CalPortIf1
      parameter data prototype Ary2D: sw-calibration-access=READ-WRITE, type=Ary2D_u1p15_5_4
    Ary2D_u1p15_8_4_CalPortIf1
      parameter data prototype Ary2D: sw-calibration-access=READ-WRITE, type=Ary2D_u1p15_8_4
    Ary2D_u2p14_12_5_CalPortIf1
      parameter data prototype Ary2D: sw-calibration-access=READ-WRITE, type=Ary2D_u2p14_12_5
    Ary2D_u2p14_6_5_CalPortIf1
      parameter data prototype Ary2D: sw-calibration-access=READ-WRITE, type=Ary2D_u2p14_6_5
    Ary2D_u2p14_6_7_CalPortIf1
      parameter data prototype Ary2D: sw-calibration-access=READ-WRITE, type=Ary2D_u2p14_6_7
    Ary2D_u2p14_6_7_PortIf1
      parameter data prototype Ary2D: sw-calibration-access=READ-WRITE, type=Ary2D_u2p14_6_7
    Ary2D_u3p13_12_13_CalPortIf1
      parameter data prototype Ary2D: sw-calibration-access=READ-WRITE, type=Ary2D_u3p13_12_13
    Ary2D_u3p13_20_8_CalPortIf1
      parameter data prototype Ary2D: sw-calibration-access=READ-WRITE, type=Ary2D_u3p13_20_8
    Ary2D_u4p12_12_5_CalPortIf1
      parameter data prototype Ary2D: sw-calibration-access=READ-WRITE, type=Ary2D_u4p12_12_5
    Ary2D_u4p12_12_8_CalPortIf1
      parameter data prototype Ary2D: sw-calibration-access=READ-WRITE, type=Ary2D_u4p12_12_8
    Ary2D_u5p11_12_13_CalPortIf1
      parameter data prototype Ary2D: sw-calibration-access=READ-WRITE, type=Ary2D_u5p11_12_13
    Ary2D_u5p11_12_5_CalPortIf1
      parameter data prototype Ary2D: sw-calibration-access=READ-WRITE, type=Ary2D_u5p11_12_5
    Ary2D_u5p11_9_16_CalPortIf1
      parameter data prototype Ary2D: sw-calibration-access=READ-WRITE, type=Ary2D_u5p11_9_16
    Ary2D_u7p9_9_4_CalPortIf1
      parameter data prototype Ary2D: sw-calibration-access=READ-WRITE, type=Ary2D_u7p9_9_4
    Ary2D_u8p8_12_20_CalPortIf1
      parameter data prototype Ary2D: sw-calibration-access=READ-WRITE, type=Ary2D_u8p8_12_20
    Ary2D_u8p8_6_5_CalPortIf1
      parameter data prototype Ary2D: sw-calibration-access=READ-WRITE, type=Ary2D_u8p8_6_5
    Ary2D_u8p8_9_4_CalPortIf1
      parameter data prototype Ary2D: sw-calibration-access=READ-WRITE, type=Ary2D_u8p8_9_4
    Ary2D_u8p8_9_8_CalPortIf1
      parameter data prototype Ary2D: sw-calibration-access=READ-WRITE, type=Ary2D_u8p8_9_8
    Ary2D_u9p7_2_5_CalPortIf1
      parameter data prototype Ary2D: sw-calibration-access=READ-WRITE, type=Ary2D_u9p7_2_5
    Ary2D_u9p7_2_8_CalPortIf1
      parameter data prototype Ary2D: sw-calibration-access=READ-WRITE, type=Ary2D_u9p7_2_8
    boolean_CalPortIf1
      parameter data prototype Logl: sw-calibration-access=READ-WRITE, type=boolean
    Cnt6
      parameter data prototype Val: sw-calibration-access=READ-WRITE, type=Cnt14
    Cnt7
      parameter data prototype Val: sw-calibration-access=READ-WRITE, type=Cnt28
    Cnt8
      parameter data prototype Val: sw-calibration-access=READ-WRITE, type=Cnt29
    Curr3
      parameter data prototype Val: sw-calibration-access=READ-WRITE, type=Curr9
    CurrAry1D1
      parameter data prototype Ary1D: sw-calibration-access=READ-WRITE, type=CurrAry1D1
    CurrAry1D2
      parameter data prototype Ary1D: sw-calibration-access=READ-WRITE, type=CurrAry1D2
    CurrAry1D3
      parameter data prototype Ary1D: sw-calibration-access=READ-WRITE, type=CurrAry1D3
    FilNotchGainRec1_CalPortIf1
      parameter data prototype Rec: sw-calibration-access=READ-WRITE, type=FilNotchGainRec1
    float32_CalPortIf1
      parameter data prototype Val: sw-calibration-access=READ-WRITE, type=float32
    Frq2
      parameter data prototype Val: sw-calibration-access=READ-WRITE, type=Frq2
    Gain4
      parameter data prototype Val: sw-calibration-access=READ-WRITE, type=Gain5
    Gain5
      parameter data prototype Val: sw-calibration-access=READ-WRITE, type=Gain6
    Gain6
      parameter data prototype Val: sw-calibration-access=READ-WRITE, type=Gain7
    Indu1
      parameter data prototype Val: sw-calibration-access=READ-WRITE, type=Indu1
    Logl1
      parameter data prototype Logl: sw-calibration-access=READ-WRITE, type=Logl1
    MotCon1
      parameter data prototype Val: sw-calibration-access=READ-WRITE, type=MotCon1
    R1
      parameter data prototype Val: sw-calibration-access=READ-WRITE, type=R1
    R2
      parameter data prototype Val: sw-calibration-access=READ-WRITE, type=R6
    R3
      parameter data prototype Val: sw-calibration-access=READ-WRITE, type=R8
    Rate1
      parameter data prototype Val: sw-calibration-access=READ-WRITE, type=Rate3
    s18p13_CalPortIf1
      parameter data prototype Val: sw-calibration-access=READ-WRITE, type=s18p13
    T4
      parameter data prototype Val: sw-calibration-access=READ-WRITE, type=T5
    Ti9
      parameter data prototype Val: sw-calibration-access=READ-WRITE, type=Ti12
    TqAry1D1
      parameter data prototype Ary1D: sw-calibration-access=READ-WRITE, type=TqAry1D6
    u0p16_CalPortIf1
      parameter data prototype Val: sw-calibration-access=READ-WRITE, type=u0p16
    u16p0_CalPortIf1
      parameter data prototype Val: sw-calibration-access=READ-WRITE, type=u16p0
    u2p14_CalPortIf1
      parameter data prototype Val: sw-calibration-access=READ-WRITE, type=u2p14
    u8p8_CalPortIf1
      parameter data prototype Val: sw-calibration-access=READ-WRITE, type=u8p8
    u9p7_CalPortIf1
      parameter data prototype Val: sw-calibration-access=READ-WRITE, type=u9p7
    uint16_CalPortIf1
      parameter data prototype Val: sw-calibration-access=READ-WRITE, type=uint16
    uint32_CalPortIf1
      parameter data prototype Val: sw-calibration-access=READ-WRITE, type=uint32
    uint8_CalPortIf1
      parameter data prototype Val: sw-calibration-access=READ-WRITE, type=uint8
    Uls2
      parameter data prototype Val: sw-calibration-access=READ-WRITE, type=Uls7
    Uls3
      parameter data prototype Val: sw-calibration-access=READ-WRITE, type=Uls9
    Uls4
      parameter data prototype Val: sw-calibration-access=READ-WRITE, type=Uls2
    Uls6
      parameter data prototype Val: sw-calibration-access=READ-WRITE, type=Uls14
    UlsAry1D2
      parameter data prototype Ary1D: sw-calibration-access=READ-WRITE, type=UlsAry1D3
    UlsAry1D3
      parameter data prototype Ary1D: sw-calibration-access=READ-WRITE, type=UlsAry1D5
    VelAry1D3
      parameter data prototype Ary1D: sw-calibration-access=READ-WRITE, type=VelAry1D3
    VoltAry1D1
      parameter data prototype Ary1D: sw-calibration-access=READ-WRITE, type=VoltAry1D1
package /Nexteer/PortInterfaces
  232 x client server interface:
    ActvTunStsReq_PortIf1
      operation Oper
        5 x arg, all with type=uint8, direction=INOUT, server-argument-impl-policy=USE-ARGUMENT-TYPE:
          ActvRtIdx_Arg
          ActvIninIdx_Arg
          CalChgAllwd_Arg
          ActvGroup_Arg
          CalCopyCmpl_Arg
    Adc1CfgAndUseAdc1EnaCnvn_PortIf1
      operation Oper
    Adcf1EnaCnvn_PortIf1
      operation Oper
    Calc16BitCrc_u08_PortIf1
      operation Oper: possible-error=Calc16BitCrc_u08_PortIf1/E_NOT_OK
        5 x arg, all with server-argument-impl-policy=USE-ARGUMENT-TYPE:
          DataPtr_Arg: type=uint8, direction=INOUT
          Len_Arg: type=uint32, direction=IN
          StrtVal_Arg: type=uint16, direction=IN
          FirstCall_Arg: type=boolean, direction=IN
          CalcCrcRes_Arg: type=uint16, direction=OUT
      error E_NOT_OK: error-code=1
    Calc16BitCrc_u16_PortIf1
      operation Oper: possible-error=Calc16BitCrc_u16_PortIf1/E_NOT_OK
        5 x arg, all with server-argument-impl-policy=USE-ARGUMENT-TYPE:
          DataPtr_Arg: type=uint16, direction=INOUT
          Len_Arg: type=uint32, direction=IN
          StrtVal_Arg: type=uint16, direction=IN
          FirstCall_Arg: type=boolean, direction=IN
          CalcCrcRes_Arg: type=uint16, direction=OUT
      error E_NOT_OK: error-code=1
    Calc32BitCrc_u08_PortIf1
      operation Oper: possible-error=Calc32BitCrc_u08_PortIf1/E_NOT_OK
        5 x arg, all with server-argument-impl-policy=USE-ARGUMENT-TYPE:
          DataPtr_Arg: type=uint8, direction=INOUT
          Len_Arg: type=uint32, direction=IN
          StrtVal_Arg: type=uint32, direction=IN
          FirstCall_Arg: type=boolean, direction=IN
          CalcCrcRes_Arg: type=uint32, direction=OUT
      error E_NOT_OK: error-code=1
    Calc32BitCrc_u16_PortIf1
      operation Oper: possible-error=Calc32BitCrc_u16_PortIf1/E_NOT_OK
        5 x arg, all with server-argument-impl-policy=USE-ARGUMENT-TYPE:
          DataPtr_Arg: type=uint16, direction=INOUT
          Len_Arg: type=uint32, direction=IN
          StrtVal_Arg: type=uint32, direction=IN
          FirstCall_Arg: type=boolean, direction=IN
          CalcCrcRes_Arg: type=uint32, direction=OUT
      error E_NOT_OK: error-code=1
    Calc32BitCrc_u32_PortIf1
      operation Oper: possible-error=Calc32BitCrc_u32_PortIf1/E_NOT_OK
        5 x arg, all with server-argument-impl-policy=USE-ARGUMENT-TYPE:
          DataPtr_Arg: type=uint32, direction=INOUT
          Len_Arg: type=uint32, direction=IN
          StrtVal_Arg: type=uint32, direction=IN
          FirstCall_Arg: type=boolean, direction=IN
          CalcCrcRes_Arg: type=uint32, direction=OUT
      error E_NOT_OK: error-code=1
    Calc8BitCrc_PortIf1
      operation Oper: possible-error=Calc8BitCrc_PortIf1/E_NOT_OK
        5 x arg, all with server-argument-impl-policy=USE-ARGUMENT-TYPE:
          DataPtr_Arg: type=uint8, direction=INOUT
          Len_Arg: type=uint32, direction=IN
          StrtVal_Arg: type=uint8, direction=IN
          FirstCall_Arg: type=boolean, direction=IN
          CalcCrcRes_Arg: type=uint8, direction=OUT
      error E_NOT_OK: error-code=1
    ChkForStrtUpTest_PortIf1
      operation Oper
        arg ExecStrtUpTest_Arg: type=boolean, direction=OUT, server-argument-impl-policy=USE-ARGUMENT-TYPE
    ClrAllDiagc_PortIf1
      operation Oper
    ClrErrInjReg_PortIf1
      operation Oper
    ClrFricLrngOperMod_PortIf1
      operation Oper
    ClrHwAgTrimVal_PortIf1
      operation Oper
    ClrLtchCntrData_PortIf1
      operation Oper
    ClrSnpshtData_PortIf1
      operation Oper
    CnvSnpshtData_f32_PortIf1
      operation Oper
        arg SnpshtDataCnvd_Arg: type=uint32, direction=OUT, server-argument-impl-policy=USE-ARGUMENT-TYPE
        arg SnpshtData_Arg: type=float32, direction=IN, server-argument-impl-policy=USE-ARGUMENT-TYPE
    CnvSnpshtData_logl_PortIf1
      operation Oper
        arg SnpshtDataCnvd_Arg: type=uint32, direction=OUT, server-argument-impl-policy=USE-ARGUMENT-TYPE
        arg SnpshtData_Arg: type=boolean, direction=IN, server-argument-impl-policy=USE-ARGUMENT-TYPE
    CnvSnpshtData_s08_PortIf1
      operation Oper
        arg SnpshtDataCnvd_Arg: type=uint32, direction=OUT, server-argument-impl-policy=USE-ARGUMENT-TYPE
        arg SnpshtData_Arg: type=sint8, direction=IN, server-argument-impl-policy=USE-ARGUMENT-TYPE
    CnvSnpshtData_s16_PortIf1
      operation Oper
        arg SnpshtDataCnvd_Arg: type=uint32, direction=OUT, server-argument-impl-policy=USE-ARGUMENT-TYPE
        arg SnpshtData_Arg: type=sint16, direction=IN, server-argument-impl-policy=USE-ARGUMENT-TYPE
    CnvSnpshtData_s32_PortIf1
      operation Oper
        arg SnpshtDataCnvd_Arg: type=uint32, direction=OUT, server-argument-impl-policy=USE-ARGUMENT-TYPE
        arg SnpshtData_Arg: type=sint32, direction=IN, server-argument-impl-policy=USE-ARGUMENT-TYPE
    CnvSnpshtData_u08_PortIf1
      operation Oper
        arg SnpshtDataCnvd_Arg: type=uint32, direction=OUT, server-argument-impl-policy=USE-ARGUMENT-TYPE
        arg SnpshtData_Arg: type=uint8, direction=IN, server-argument-impl-policy=USE-ARGUMENT-TYPE
    CnvSnpshtData_u16_PortIf1
      operation Oper
        arg SnpshtDataCnvd_Arg: type=uint32, direction=OUT, server-argument-impl-policy=USE-ARGUMENT-TYPE
        arg SnpshtData_Arg: type=uint16, direction=IN, server-argument-impl-policy=USE-ARGUMENT-TYPE
    CopyCalPageReq_PortIf1
      operation Oper: possible-error=CopyCalPageReq_PortIf1/E_NOT_OK
        arg Seg_Arg: type=uint8, direction=IN, server-argument-impl-policy=USE-ARGUMENT-TYPE
      error E_NOT_OK: error-code=1
    CtrlErrOut_PortIf1
      operation Oper
        arg PinSt_Arg: type=boolean, direction=IN, server-argument-impl-policy=USE-ARGUMENT-TYPE
        arg TrigReg_Arg: type=TrigReg1, direction=IN, server-argument-impl-policy=USE-ARGUMENT-TYPE
    CurrMeasEolGainReq_PortIf1
      operation Oper
    CurrMeasEolGainStReq_PortIf1
      operation Oper
        arg CurrMeasEolGainSt_Arg: type=uint8, direction=OUT, server-argument-impl-policy=USE-ARGUMENT-TYPE
    CurrMeasEolOffsReq_PortIf1
      operation Oper
    CurrMeasEolOffsStReq_PortIf1
      operation Oper
        arg CurrMeasEolOffsSt_Arg: type=uint8, direction=OUT, server-argument-impl-policy=USE-ARGUMENT-TYPE
    CurrMeasGainReadReq_PortIf1
      operation Oper
        6 x arg, all with type=float32, direction=OUT, server-argument-impl-policy=USE-ARGUMENT-TYPE:
          CurrMeasMotCurrGainA_Arg
          CurrMeasMotCurrGainB_Arg
          CurrMeasMotCurrGainC_Arg
          CurrMeasMotCurrGainD_Arg
          CurrMeasMotCurrGainE_Arg
          CurrMeasMotCurrGainF_Arg
    CurrMeasGainReadReqSngIvtr_PortIf1
      operation Oper
        arg CurrMeasMotCurrGainA_Arg: type=float32, direction=OUT, server-argument-impl-policy=USE-ARGUMENT-TYPE
        arg CurrMeasMotCurrGainB_Arg: type=float32, direction=OUT, server-argument-impl-policy=USE-ARGUMENT-TYPE
        arg CurrMeasMotCurrGainC_Arg: type=float32, direction=OUT, server-argument-impl-policy=USE-ARGUMENT-TYPE
    CurrMeasGainWrReq_PortIf2
      operation Oper
        7 x arg, all with server-argument-impl-policy=USE-ARGUMENT-TYPE:
          CurrMeasMotCurrGainA_Arg: type=float32, direction=IN
          CurrMeasMotCurrGainB_Arg: type=float32, direction=IN
          CurrMeasMotCurrGainC_Arg: type=float32, direction=IN
          CurrMeasMotCurrGainD_Arg: type=float32, direction=IN
          CurrMeasMotCurrGainE_Arg: type=float32, direction=IN
          CurrMeasMotCurrGainF_Arg: type=float32, direction=IN
          CurrMeasGainWrReqSts_Arg: type=uint8, direction=OUT
    CurrMeasGainWrReqSngIvtr_PortIf1
      operation Oper
        4 x arg, all with server-argument-impl-policy=USE-ARGUMENT-TYPE:
          CurrMeasMotCurrGainA_Arg: type=float32, direction=IN
          CurrMeasMotCurrGainB_Arg: type=float32, direction=IN
          CurrMeasMotCurrGainC_Arg: type=float32, direction=IN
          CurrMeasGainWrReqSts_Arg: type=uint8, direction=OUT
    CurrMeasOffsReadReq_PortIf2
      operation Oper
        13 x arg, all with type=float32, direction=OUT, server-argument-impl-policy=USE-ARGUMENT-TYPE:
          CurrMeasEolOffsHiBrdgVltg_Arg
          CurrMeasMotCurrOffsDifA_Arg
          CurrMeasMotCurrOffsDifB_Arg
          CurrMeasMotCurrOffsDifC_Arg
          CurrMeasMotCurrOffsDifD_Arg
          CurrMeasMotCurrOffsDifE_Arg
          CurrMeasMotCurrOffsDifF_Arg
          CurrMeasMotCurrOffsLoAvrgA_Arg
          CurrMeasMotCurrOffsLoAvrgB_Arg
          CurrMeasMotCurrOffsLoAvrgC_Arg
          CurrMeasMotCurrOffsLoAvrgD_Arg
          CurrMeasMotCurrOffsLoAvrgE_Arg
          CurrMeasMotCurrOffsLoAvrgF_Arg
    CurrMeasOffsReadReqSngIvtr_PortIf1
      operation Oper
        7 x arg, all with type=float32, direction=OUT, server-argument-impl-policy=USE-ARGUMENT-TYPE:
          CurrMeasEolOffsHiBrdgVltg_Arg
          CurrMeasMotCurrOffsDifA_Arg
          CurrMeasMotCurrOffsDifB_Arg
          CurrMeasMotCurrOffsDifC_Arg
          CurrMeasMotCurrOffsLoAvrgA_Arg
          CurrMeasMotCurrOffsLoAvrgB_Arg
          CurrMeasMotCurrOffsLoAvrgC_Arg
    CurrMeasOffsWrReq_PortIf3
      operation Oper
        14 x arg, all with server-argument-impl-policy=USE-ARGUMENT-TYPE:
          CurrMeasEolOffsHiBrdgVltg_Arg: type=float32, direction=IN
          CurrMeasMotCurrOffsDifA_Arg: type=float32, direction=IN
          CurrMeasMotCurrOffsDifB_Arg: type=float32, direction=IN
          CurrMeasMotCurrOffsDifC_Arg: type=float32, direction=IN
          CurrMeasMotCurrOffsDifD_Arg: type=float32, direction=IN
          CurrMeasMotCurrOffsDifE_Arg: type=float32, direction=IN
          CurrMeasMotCurrOffsDifF_Arg: type=float32, direction=IN
          CurrMeasMotCurrOffsLoAvrgA_Arg: type=float32, direction=IN
          CurrMeasMotCurrOffsLoAvrgB_Arg: type=float32, direction=IN
          CurrMeasMotCurrOffsLoAvrgC_Arg: type=float32, direction=IN
          CurrMeasMotCurrOffsLoAvrgD_Arg: type=float32, direction=IN
          CurrMeasMotCurrOffsLoAvrgE_Arg: type=float32, direction=IN
          CurrMeasMotCurrOffsLoAvrgF_Arg: type=float32, direction=IN
          CurrMeasOffsWrReqSts_Arg: type=uint8, direction=OUT
    CurrMeasOffsWrReqSngIvtr_PortIf1
      operation Oper
        8 x arg, all with server-argument-impl-policy=USE-ARGUMENT-TYPE:
          CurrMeasEolOffsHiBrdgVltg_Arg: type=float32, direction=IN
          CurrMeasMotCurrOffsDifA_Arg: type=float32, direction=IN
          CurrMeasMotCurrOffsDifB_Arg: type=float32, direction=IN
          CurrMeasMotCurrOffsDifC_Arg: type=float32, direction=IN
          CurrMeasMotCurrOffsLoAvrgA_Arg: type=float32, direction=IN
          CurrMeasMotCurrOffsLoAvrgB_Arg: type=float32, direction=IN
          CurrMeasMotCurrOffsLoAvrgC_Arg: type=float32, direction=IN
          CurrMeasOffsWrReqSts_Arg: type=uint8, direction=OUT
    DiagcMgrIninCore_PortIf3
      operation Oper
        5 x arg, all with server-argument-impl-policy=USE-ARGUMENT-TYPE:
          ApplIdx_Arg: type=uint8, direction=IN
          NtcInfoArySize_Arg: type=uint8, direction=IN
          NtcInfoAry_Arg: type=Ary1D_NtcInfoRec4_DiagcMgr, direction=INOUT
          DiagcData_Arg: type=DiagcDataRec2, direction=OUT
          ProxySetNtcData_Arg: type=DiagcDataRec2, direction=OUT
    DmaEna2MilliSecToMotCtrlTrf_PortIf1
      operation Oper
    DmaEna2MilliSecToMotCtrlTrf1
      operation Oper
    DmaWaitForMotCtrlTo2MilliSecTrf_PortIf1
      operation Oper: possible-error=DmaWaitForMotCtrlTo2MilliSecTrf_PortIf1/E_NOT_OK
      error E_NOT_OK: error-code=1
    DmaWaitForMotCtrlTo2MilliSecTrf1
      operation Oper: possible-error=DmaWaitForMotCtrlTo2MilliSecTrf1/E_NOT_OK
      error E_NOT_OK: error-code=1
    FltInj_f32_PortIf1
      operation Oper
        arg SigPah_Arg: type=float32, direction=INOUT, server-argument-impl-policy=USE-ARGUMENT-TYPE
        arg LocnKey_Arg: type=uint16, direction=IN, server-argument-impl-policy=USE-ARGUMENT-TYPE
    FltInj_logl_PortIf1
      operation Oper
        arg SigPah_Arg: type=boolean, direction=INOUT, server-argument-impl-policy=USE-ARGUMENT-TYPE
        arg LocnKey_Arg: type=uint16, direction=IN, server-argument-impl-policy=USE-ARGUMENT-TYPE
    FltInj_u08_PortIf1
      operation Oper
        arg SigPah_Arg: type=uint8, direction=INOUT, server-argument-impl-policy=USE-ARGUMENT-TYPE
        arg LocnKey_Arg: type=uint16, direction=IN, server-argument-impl-policy=USE-ARGUMENT-TYPE
    FltInj_u0p16_PortIf1
      operation Oper
        arg SigPah_Arg: type=u0p16, direction=INOUT, server-argument-impl-policy=USE-ARGUMENT-TYPE
        arg LocnKey_Arg: type=uint16, direction=IN, server-argument-impl-policy=USE-ARGUMENT-TYPE
    FltInj3
      operation Oper
        arg SigPah_Arg: type=Uls24, direction=INOUT, server-argument-impl-policy=USE-ARGUMENT-TYPE
        arg LocnKey_Arg: type=Cnt16, direction=IN, server-argument-impl-policy=USE-ARGUMENT-TYPE
    FordClrBlaBoxNvm_PortIf1
      operation Oper: possible-error=FordClrBlaBoxNvm_PortIf1/E_NOT_OK
      error E_NOT_OK: error-code=1
    FSnsrlsHwCentr_PortIf1
      operation Oper
    GetCalPageReq_PortIf1
      operation Oper
        4 x arg, all with type=uint8, server-argument-impl-policy=USE-ARGUMENT-TYPE:
          Seg_Arg: direction=IN
          Mod_Arg: direction=IN
          Page_Arg: direction=INOUT
          Rtn_Arg: direction=OUT
    GetCtrlPrm_PortIf1
      operation Oper
        7 x arg, all with type=float32, direction=OUT, server-argument-impl-policy=USE-ARGUMENT-TYPE:
          MotVelCtrlPropGain_Arg
          MotVelCtrlIntgtrGain_Arg
          MotVelCtrlDerivtvGain_Arg
          MotVelCtrlAntiWdupLim_Arg
          MotVelCtrlAntiWdupGain_Arg
          MotVelCtrlDerivtvLpFilTiCon_Arg
          MotVelCtrlTqCmdLim_Arg
    GetDiagcDataApplX_PortIf2
      operation Oper
        arg DiagcData_Arg: type=DiagcDataRec2, direction=OUT, server-argument-impl-policy=USE-ARGUMENT-TYPE
    GetFricData_PortIf3
      operation Oper
        5 x arg, all with direction=OUT, server-argument-impl-policy=USE-ARGUMENT-TYPE:
          FricOffs_Arg: type=float32
          BasLineFric_Arg: type=Ary1D_f32_4
          VehLrndFric_Arg: type=Ary1D_f32_4
          Hys_Arg: type=Ary2D_f32_8_4
          RngCntr_Arg: type=Ary2D_u16_8_3
    GetFricLrngData_PortIf1
      operation Oper
        4 x arg, all with direction=OUT, server-argument-impl-policy=USE-ARGUMENT-TYPE:
          FricLrngEna_Arg: type=boolean
          FricLrngOffsOutpEna_Arg: type=boolean
          FricLrngOperMod_Arg: type=SysFricLrngOperMod1
          EolFric_Arg: type=float32
    GetFricOffsOutpDi_PortIf1
      operation Oper
        arg FricOffsOutpDi_Arg: type=boolean, direction=OUT, server-argument-impl-policy=USE-ARGUMENT-TYPE
    GetGearIdn_PortIf1
      operation Oper
        arg GearIdn_Arg: type=uint8, direction=OUT, server-argument-impl-policy=USE-ARGUMENT-TYPE
    GetGpio_PortIf1
      operation Oper: possible-error=GetGpio_PortIf1/E_NOT_OK
        arg PinSt_Arg: type=boolean, direction=OUT, server-argument-impl-policy=USE-ARGUMENT-TYPE
      error E_NOT_OK: error-code=1
    GetHwAgOffs_PortIf1
      operation Oper
        arg HwAgOffs_Arg: type=float32, direction=OUT, server-argument-impl-policy=USE-ARGUMENT-TYPE
        arg HwAgLrngStRst_Arg: type=boolean, direction=OUT, server-argument-impl-policy=USE-ARGUMENT-TYPE
    GetHwAgOverTrvlCnt_PortIf2
      operation Oper
        arg HwAgOverTrvlCnt_Arg: type=uint8, direction=OUT, server-argument-impl-policy=USE-ARGUMENT-TYPE
    GetHwAgTrimVal_PortIf2
      operation Oper
        arg HwAgTrimVal_Arg: type=float32, direction=OUT, server-argument-impl-policy=USE-ARGUMENT-TYPE
        arg HwAgTrimPrfmd_Arg: type=boolean, direction=OUT, server-argument-impl-policy=USE-ARGUMENT-TYPE
    GetHwTqOffs_PortIf1
      operation Oper
        arg HwTqOffs_Arg: type=float32, direction=OUT, server-argument-impl-policy=USE-ARGUMENT-TYPE
        arg HwTqLrngStRst_Arg: type=boolean, direction=OUT, server-argument-impl-policy=USE-ARGUMENT-TYPE
    GetMcuDiagcSpplData_PortIf1
      operation Oper
        arg McuDiagcData1_Arg: type=uint32, direction=OUT, server-argument-impl-policy=USE-ARGUMENT-TYPE
    GetMotCoggCmdPrm_PortIf1
      operation Oper
        arg MotCoggCmdY_Arg: type=Ary1D_s1p14_128, direction=OUT, server-argument-impl-policy=USE-ARGUMENT-TYPE
        arg Idx_Arg: type=uint8, direction=IN, server-argument-impl-policy=USE-ARGUMENT-TYPE
    GetMotPrmNomEol1  # OBSELETE
      operation Oper: possible-error=GetMotPrmNomEol1/E_NOT_OK
        arg MotKeNom: type=MotCon1, direction=OUT, server-argument-impl-policy=USE-ARGUMENT-TYPE
        arg MotRNom: type=R6, direction=OUT, server-argument-impl-policy=USE-ARGUMENT-TYPE
      error E_NOT_OK: error-code=1
    GetMotPrmNomEol2
      operation Oper: possible-error=GetMotPrmNomEol2/E_NOT_OK
        arg MotBackEmfConNom_Arg: type=MotCon1, direction=OUT, server-argument-impl-policy=USE-ARGUMENT-TYPE
        arg MotRNom_Arg: type=R6, direction=OUT, server-argument-impl-policy=USE-ARGUMENT-TYPE
      error E_NOT_OK: error-code=1
    GetMotRplCoggPrm_PortIf1
      operation Oper
        9 x arg, all with direction=OUT, server-argument-impl-policy=USE-ARGUMENT-TYPE:
          CoggOrder1_Arg: type=uint16
          CoggOrder1X_Arg: type=s1p14
          CoggOrder1Y_Arg: type=s1p14
          CoggOrder2_Arg: type=uint16
          CoggOrder2X_Arg: type=s1p14
          CoggOrder2Y_Arg: type=s1p14
          CoggOrder3_Arg: type=uint16
          CoggOrder3X_Arg: type=s1p14
          CoggOrder3Y_Arg: type=s1p14
    GetMotTqCmdSca_PortIf1
      operation Oper
        arg MotTqCmdSca_Arg: type=float32, direction=OUT, server-argument-impl-policy=USE-ARGUMENT-TYPE
    GetNtcActv_PortIf1
      operation Oper: possible-error=GetNtcActv_PortIf1/E_NOT_OK
        arg NtcNr_Arg: type=NtcNr1, direction=IN, server-argument-impl-policy=USE-ARGUMENT-TYPE
        arg NtcActv_Arg: type=boolean, direction=OUT, server-argument-impl-policy=USE-ARGUMENT-TYPE
      error E_NOT_OK: error-code=1
    GetNtcActv1_PortIf1
      operation Oper: possible-error=GetNtcActv1_PortIf1/E_NOT_OK
        arg NtcNr: type=NtcNr1, direction=IN, server-argument-impl-policy=USE-ARGUMENT-TYPE
        arg NtcActv: type=boolean, direction=OUT, server-argument-impl-policy=USE-ARGUMENT-TYPE
      error E_NOT_OK: error-code=1
    GetNtcActvCore_PortIf1
      operation Oper
        arg NtcNr_Arg: type=NtcNr1, direction=IN, server-argument-impl-policy=USE-ARGUMENT-TYPE
        arg NtcActv_Arg: type=boolean, direction=OUT, server-argument-impl-policy=USE-ARGUMENT-TYPE
    GetNtcDebCntrApplX_PortIf1
      operation Oper
        arg DebCntrIdx_Arg: type=uint8, direction=IN, server-argument-impl-policy=USE-ARGUMENT-TYPE
        arg DebCntr_Arg: type=sint16, direction=OUT, server-argument-impl-policy=USE-ARGUMENT-TYPE
    GetNtcInfoApplX_PortIf2
      operation Oper
        arg NtcInfoIdx_Arg: type=uint8, direction=IN, server-argument-impl-policy=USE-ARGUMENT-TYPE
        arg NtcInfo_Arg: type=NtcInfoRec4, direction=OUT, server-argument-impl-policy=USE-ARGUMENT-TYPE
    GetNtcQlfrSts_PortIf1
      operation Oper: possible-error=GetNtcQlfrSts_PortIf1/E_NOT_OK
        arg NtcNr_Arg: type=NtcNr1, direction=IN, server-argument-impl-policy=USE-ARGUMENT-TYPE
        arg NtcQlfr_Arg: type=SigQlfr1, direction=OUT, server-argument-impl-policy=USE-ARGUMENT-TYPE
      error E_NOT_OK: error-code=1
    GetNtcQlfrSts1
      operation Oper: possible-error=GetNtcQlfrSts1/E_NOT_OK
        arg NtcNr: type=NtcNr1, direction=IN, server-argument-impl-policy=USE-ARGUMENT-TYPE
        arg NtcQlfr: type=SigQlfr1, direction=OUT, server-argument-impl-policy=USE-ARGUMENT-TYPE
      error E_NOT_OK: error-code=1
    GetNtcQlfrSts1_PortIf1  # OBSOLETE
      operation Oper: possible-error=GetNtcQlfrSts1_PortIf1/E_NOT_OK
        arg NtcNr: type=NtcNr1, direction=IN, server-argument-impl-policy=USE-ARGUMENT-TYPE
        arg NtcQlfr: type=SigQlfr1, direction=OUT, server-argument-impl-policy=USE-ARGUMENT-TYPE
      error E_NOT_OK: error-code=1
    GetNtcQlfrStsCore_PortIf1
      operation Oper
        arg NtcNr_Arg: type=NtcNr1, direction=IN, server-argument-impl-policy=USE-ARGUMENT-TYPE
        arg NtcQlfr_Arg: type=SigQlfr1, direction=OUT, server-argument-impl-policy=USE-ARGUMENT-TYPE
    GetNtcSts_PortIf1
      operation Oper: possible-error=GetNtcSts_PortIf1/E_NOT_OK
        arg NtcNr_Arg: type=NtcNr1, direction=IN, server-argument-impl-policy=USE-ARGUMENT-TYPE
        arg NtcInfoSts_Arg: type=uint8, direction=OUT, server-argument-impl-policy=USE-ARGUMENT-TYPE
      error E_NOT_OK: error-code=1
    GetNtcStsCore_PortIf1
      operation Oper
        arg NtcNr_Arg: type=NtcNr1, direction=IN, server-argument-impl-policy=USE-ARGUMENT-TYPE
        arg NtcInfoSts_Arg: type=uint8, direction=OUT, server-argument-impl-policy=USE-ARGUMENT-TYPE
    GetPullCmpPrm_PortIf1
      operation Oper
        4 x arg, all with direction=OUT, server-argument-impl-policy=USE-ARGUMENT-TYPE:
          PullCmpCmdTot_Arg: type=float32
          PullCmpShoTerm_Arg: type=float32
          PullCmpLongTerm_Arg: type=float32
          LrngEnad_Arg: type=boolean
    GetRefTmr100MicroSec32bit_PortIf1
      operation Oper
        arg RefTmr_Arg: type=uint32, direction=OUT, server-argument-impl-policy=USE-ARGUMENT-TYPE
    GetRefTmr100MicroSec32bit1
      operation Oper
        arg RefTmr: type=uint32, direction=OUT, server-argument-impl-policy=USE-ARGUMENT-TYPE
    GetRefTmr1MicroSec32bit_PortIf1
      operation Oper
        arg RefTmr_Arg: type=uint32, direction=OUT, server-argument-impl-policy=USE-ARGUMENT-TYPE
    GetRefTmr1MicroSec32bit1
      operation Oper
        arg RefTmr: type=uint32, direction=OUT, server-argument-impl-policy=USE-ARGUMENT-TYPE
    GetSegInfoReq_PortIf2
      operation Oper
        7 x arg, all with server-argument-impl-policy=USE-ARGUMENT-TYPE:
          Mod_Arg: type=GetSegMod1, direction=IN
          Seg_Arg: type=uint8, direction=IN
          SegInfo_Arg: type=uint8, direction=IN
          MpgIdx_Arg: type=uint8, direction=IN
          Resp_Arg: type=uint8, direction=INOUT
          RespLen_Arg: type=uint8, direction=INOUT
          Rtn_Arg: type=uint8, direction=OUT
    GetSigImcData_f32_PortIf1
      operation Oper: possible-error=GetSigImcData_f32_PortIf1/E_NOT_OK
        arg SigId_Arg: type=uint16, direction=IN, server-argument-impl-policy=USE-ARGUMENT-TYPE
        arg Data_Arg: type=float32, direction=OUT, server-argument-impl-policy=USE-ARGUMENT-TYPE
        arg Sts_Arg: type=ImcArbnRxSts1, direction=OUT, server-argument-impl-policy=USE-ARGUMENT-TYPE
      error E_NOT_OK: error-code=1
    GetSigImcData_logl_PortIf1
      operation Oper: possible-error=GetSigImcData_logl_PortIf1/E_NOT_OK
        arg SigId_Arg: type=uint16, direction=IN, server-argument-impl-policy=USE-ARGUMENT-TYPE
        arg Data_Arg: type=boolean, direction=OUT, server-argument-impl-policy=USE-ARGUMENT-TYPE
        arg Sts_Arg: type=ImcArbnRxSts1, direction=OUT, server-argument-impl-policy=USE-ARGUMENT-TYPE
      error E_NOT_OK: error-code=1
    GetSigImcData_s08_PortIf1
      operation Oper: possible-error=GetSigImcData_s08_PortIf1/E_NOT_OK
        arg SigId_Arg: type=uint16, direction=IN, server-argument-impl-policy=USE-ARGUMENT-TYPE
        arg Data_Arg: type=sint8, direction=OUT, server-argument-impl-policy=USE-ARGUMENT-TYPE
        arg Sts_Arg: type=ImcArbnRxSts1, direction=OUT, server-argument-impl-policy=USE-ARGUMENT-TYPE
      error E_NOT_OK: error-code=1
    GetSigImcData_s16_PortIf1
      operation Oper: possible-error=GetSigImcData_s16_PortIf1/E_NOT_OK
        arg SigId_Arg: type=uint16, direction=IN, server-argument-impl-policy=USE-ARGUMENT-TYPE
        arg Data_Arg: type=sint16, direction=OUT, server-argument-impl-policy=USE-ARGUMENT-TYPE
        arg Sts_Arg: type=ImcArbnRxSts1, direction=OUT, server-argument-impl-policy=USE-ARGUMENT-TYPE
      error E_NOT_OK: error-code=1
    GetSigImcData_s32_PortIf1
      operation Oper: possible-error=GetSigImcData_s32_PortIf1/E_NOT_OK
        arg SigId_Arg: type=uint16, direction=IN, server-argument-impl-policy=USE-ARGUMENT-TYPE
        arg Data_Arg: type=sint32, direction=OUT, server-argument-impl-policy=USE-ARGUMENT-TYPE
        arg Sts_Arg: type=ImcArbnRxSts1, direction=OUT, server-argument-impl-policy=USE-ARGUMENT-TYPE
      error E_NOT_OK: error-code=1
    GetSigImcData_u08_PortIf1
      operation Oper: possible-error=GetSigImcData_u08_PortIf1/E_NOT_OK
        arg SigId_Arg: type=uint16, direction=IN, server-argument-impl-policy=USE-ARGUMENT-TYPE
        arg Data_Arg: type=uint8, direction=OUT, server-argument-impl-policy=USE-ARGUMENT-TYPE
        arg Sts_Arg: type=ImcArbnRxSts1, direction=OUT, server-argument-impl-policy=USE-ARGUMENT-TYPE
      error E_NOT_OK: error-code=1
    GetSigImcData_u16_PortIf1
      operation Oper: possible-error=GetSigImcData_u16_PortIf1/E_NOT_OK
        arg SigId_Arg: type=uint16, direction=IN, server-argument-impl-policy=USE-ARGUMENT-TYPE
        arg Data_Arg: type=uint16, direction=OUT, server-argument-impl-policy=USE-ARGUMENT-TYPE
        arg Sts_Arg: type=ImcArbnRxSts1, direction=OUT, server-argument-impl-policy=USE-ARGUMENT-TYPE
      error E_NOT_OK: error-code=1
    GetSigImcData_u32_PortIf1
      operation Oper: possible-error=GetSigImcData_u32_PortIf1/E_NOT_OK
        arg SigId_Arg: type=uint16, direction=IN, server-argument-impl-policy=USE-ARGUMENT-TYPE
        arg Data_Arg: type=uint32, direction=OUT, server-argument-impl-policy=USE-ARGUMENT-TYPE
        arg Sts_Arg: type=ImcArbnRxSts1, direction=OUT, server-argument-impl-policy=USE-ARGUMENT-TYPE
      error E_NOT_OK: error-code=1
    GetSigImcDataExtdSts_f32_PortIf1
      operation Oper: possible-error=GetSigImcDataExtdSts_f32_PortIf1/E_NOT_OK
        4 x arg, all with server-argument-impl-policy=USE-ARGUMENT-TYPE:
          SigId_Arg: type=uint16, direction=IN
          Data_Arg: type=float32, direction=OUT
          Sts_Arg: type=ImcArbnRxExtdSts1, direction=OUT
          DataSrc_Arg: type=ImcArbnRxDataSrc1, direction=OUT
      error E_NOT_OK: error-code=1
    GetSigImcDataExtdSts_logl_PortIf1
      operation Oper: possible-error=GetSigImcDataExtdSts_logl_PortIf1/E_NOT_OK
        4 x arg, all with server-argument-impl-policy=USE-ARGUMENT-TYPE:
          SigId_Arg: type=uint16, direction=IN
          Data_Arg: type=boolean, direction=OUT
          Sts_Arg: type=ImcArbnRxExtdSts1, direction=OUT
          DataSrc_Arg: type=ImcArbnRxDataSrc1, direction=OUT
      error E_NOT_OK: error-code=1
    GetSigImcDataExtdSts_s08_PortIf1
      operation Oper: possible-error=GetSigImcDataExtdSts_s08_PortIf1/E_NOT_OK
        4 x arg, all with server-argument-impl-policy=USE-ARGUMENT-TYPE:
          SigId_Arg: type=uint16, direction=IN
          Data_Arg: type=sint8, direction=OUT
          Sts_Arg: type=ImcArbnRxExtdSts1, direction=OUT
          DataSrc_Arg: type=ImcArbnRxDataSrc1, direction=OUT
      error E_NOT_OK: error-code=1
    GetSigImcDataExtdSts_s16_PortIf1
      operation Oper: possible-error=GetSigImcDataExtdSts_s16_PortIf1/E_NOT_OK
        4 x arg, all with server-argument-impl-policy=USE-ARGUMENT-TYPE:
          SigId_Arg: type=uint16, direction=IN
          Data_Arg: type=sint16, direction=OUT
          Sts_Arg: type=ImcArbnRxExtdSts1, direction=OUT
          DataSrc_Arg: type=ImcArbnRxDataSrc1, direction=OUT
      error E_NOT_OK: error-code=1
    GetSigImcDataExtdSts_s32_PortIf1
      operation Oper: possible-error=GetSigImcDataExtdSts_s32_PortIf1/E_NOT_OK
        4 x arg, all with server-argument-impl-policy=USE-ARGUMENT-TYPE:
          SigId_Arg: type=uint16, direction=IN
          Data_Arg: type=sint32, direction=OUT
          Sts_Arg: type=ImcArbnRxExtdSts1, direction=OUT
          DataSrc_Arg: type=ImcArbnRxDataSrc1, direction=OUT
      error E_NOT_OK: error-code=1
    GetSigImcDataExtdSts_u08_PortIf1
      operation Oper: possible-error=GetSigImcDataExtdSts_u08_PortIf1/E_NOT_OK
        4 x arg, all with server-argument-impl-policy=USE-ARGUMENT-TYPE:
          SigId_Arg: type=uint16, direction=IN
          Data_Arg: type=uint8, direction=OUT
          Sts_Arg: type=ImcArbnRxExtdSts1, direction=OUT
          DataSrc_Arg: type=ImcArbnRxDataSrc1, direction=OUT
      error E_NOT_OK: error-code=1
    GetSigImcDataExtdSts_u16_PortIf1
      operation Oper: possible-error=GetSigImcDataExtdSts_u16_PortIf1/E_NOT_OK
        4 x arg, all with server-argument-impl-policy=USE-ARGUMENT-TYPE:
          SigId_Arg: type=uint16, direction=IN
          Data_Arg: type=uint16, direction=OUT
          Sts_Arg: type=ImcArbnRxExtdSts1, direction=OUT
          DataSrc_Arg: type=ImcArbnRxDataSrc1, direction=OUT
      error E_NOT_OK: error-code=1
    GetSigImcDataExtdSts_u32_PortIf1
      operation Oper: possible-error=GetSigImcDataExtdSts_u32_PortIf1/E_NOT_OK
        4 x arg, all with server-argument-impl-policy=USE-ARGUMENT-TYPE:
          SigId_Arg: type=uint16, direction=IN
          Data_Arg: type=uint32, direction=OUT
          Sts_Arg: type=ImcArbnRxExtdSts1, direction=OUT
          DataSrc_Arg: type=ImcArbnRxDataSrc1, direction=OUT
      error E_NOT_OK: error-code=1
    GetTiSpan100MicroSec32bit_PortIf1
      operation Oper
        arg RefTmr_Arg: type=uint32, direction=IN, server-argument-impl-policy=USE-ARGUMENT-TYPE
        arg TiSpan_Arg: type=uint32, direction=OUT, server-argument-impl-policy=USE-ARGUMENT-TYPE
    GetTiSpan100MicroSec32bit1
      operation Oper
        arg RefTmr: type=uint32, direction=IN, server-argument-impl-policy=USE-ARGUMENT-TYPE
        arg TiSpan: type=uint32, direction=OUT, server-argument-impl-policy=USE-ARGUMENT-TYPE
    GetTiSpan1MicroSec32bit_PortIf1
      operation Oper
        arg RefTmr_Arg: type=uint32, direction=IN, server-argument-impl-policy=USE-ARGUMENT-TYPE
        arg TiSpan_Arg: type=uint32, direction=OUT, server-argument-impl-policy=USE-ARGUMENT-TYPE
    GetTiSpan1MicroSec32bit1
      operation Oper
        arg RefTmr: type=uint32, direction=IN, server-argument-impl-policy=USE-ARGUMENT-TYPE
        arg TiSpan: type=uint32, direction=OUT, server-argument-impl-policy=USE-ARGUMENT-TYPE
    GetTxRateGroup_PortIf1
      operation Oper: possible-error=GetTxRateGroup_PortIf1/E_NOT_OK
        arg RateGroup_Arg: type=uint8, direction=IN, server-argument-impl-policy=USE-ARGUMENT-TYPE
        arg Buf_Arg: type=uint8, direction=OUT, server-argument-impl-policy=USE-ARGUMENT-TYPE
      error E_NOT_OK: error-code=1
    GetTxSigGroup_PortIf1
      operation Oper: possible-error=GetTxSigGroup_PortIf1/E_NOT_OK
        arg SigGroupId_Arg: type=uint8, direction=IN, server-argument-impl-policy=USE-ARGUMENT-TYPE
        arg Buf_Arg: type=uint8, direction=OUT, server-argument-impl-policy=USE-ARGUMENT-TYPE
      error E_NOT_OK: error-code=1
    GetYawRateOffs_PortIf1
      operation Oper
        arg VehYawRateOffs_Arg: type=float32, direction=OUT, server-argument-impl-policy=USE-ARGUMENT-TYPE
        arg VehYawRateLrngStRst_Arg: type=boolean, direction=OUT, server-argument-impl-policy=USE-ARGUMENT-TYPE
    GtmGetSentData_PortIf2
      operation Oper: possible-error=GtmGetSentData_PortIf2/E_NOT_OK
        arg BufStrt_Arg: type=uint32, direction=OUT, server-argument-impl-policy=USE-ARGUMENT-TYPE
      error E_NOT_OK: error-code=1
    HwAg0ClrLtch_PortIf1
      operation Oper
    HwAg0MeasHwAg0AutoTrim1  # OBSOLETE
      operation Oper
    HwAg0MeasHwAg0ClrTrim1  # OBSOLETE
      operation Oper
    HwAg0MeasHwAg0ReadTrim2  # OBSOLETE
      operation Oper
        arg HwAg0MeasHwAg0WrOffsTrimData: type=Ag19, direction=OUT, server-argument-impl-policy=USE-ARGUMENT-TYPE
    HwAg0MeasHwAg0TrimPrfmdSts2  # OBSOLETE
      operation Oper
        arg HwAg0MeasHwAg0OffsTrimPrfmdStsData: type=Logl1, direction=OUT, server-argument-impl-policy=USE-ARGUMENT-TYPE
    HwAg0MeasHwAg0WrTrim2  # OBSOLETE
      operation Oper
        arg HwAg0MeasHwAg0WrTrimData: type=Ag19, direction=IN, server-argument-impl-policy=USE-ARGUMENT-TYPE
    HwAg1ClrLtch_PortIf1
      operation Oper
    HwAg1MeasHwAg1AutoTrim1  # OBSOLETE
      operation Oper
    HwAg1MeasHwAg1ClrTrim1  # OBSOLETE
      operation Oper
    HwAg1MeasHwAg1ReadTrim2  # OBSOLETE
      operation Oper
        arg HwAg1MeasHwAg1WrOffsTrimData: type=Ag19, direction=OUT, server-argument-impl-policy=USE-ARGUMENT-TYPE
    HwAg1MeasHwAg1TrimPrfmdSts2  # OBSOLETE
      operation Oper
        arg HwAg1MeasHwAg1OffsTrimPrfmdStsData: type=Logl1, direction=OUT, server-argument-impl-policy=USE-ARGUMENT-TYPE
    HwAg1MeasHwAg1WrTrim2  # OBSOLETE
      operation Oper
        arg HwAg1MeasHwAg1WrTrimData: type=Ag19, direction=IN, server-argument-impl-policy=USE-ARGUMENT-TYPE
    HwAgAutTrim_PortIf1
      operation Oper
    HwAgClrLtch_PortIf1
      operation Oper
    HwAgClrTrim_PortIf1
      operation Oper
    HwAgReadTrim_PortIf1
      operation Oper
        arg HwAgReadTrimData_Arg: type=float32, direction=OUT, server-argument-impl-policy=USE-ARGUMENT-TYPE
    HwAgTrimPrfmdSts_PortIf1
      operation Oper
        arg HwAgOffsTrimPrfmdStsData_Arg: type=boolean, direction=OUT, server-argument-impl-policy=USE-ARGUMENT-TYPE
    HwAgWrTrim_PortIf1
      operation Oper
        arg HwAgWrOffsTrimData_Arg: type=float32, direction=IN, server-argument-impl-policy=USE-ARGUMENT-TYPE
    HwTq0MeasHwTq0AutTrim_PortIf1  # OBSOLETE
      operation Oper
    HwTq0MeasHwTq0ClrTrim_PortIf1  # OBSOLETE
      operation Oper
    HwTq0MeasHwTq0ReadTrim_PortIf1  # OBSOLETE
      operation Oper
        arg HwTq0MeasHwTq0ReadTrimData_Arg: type=float32, direction=OUT, server-argument-impl-policy=USE-ARGUMENT-TYPE
    HwTq0MeasHwTq0TrimPrfmdSts_PortIf1  # OBSOLETE
      operation Oper
        arg HwTq0MeasHwTq0OffsTrimPrfmdStsData_Arg: type=boolean, direction=OUT, server-argument-impl-policy=USE-ARGUMENT-TYPE
    HwTq0MeasHwTq0WrTrim_PortIf1  # OBSOLETE
      operation Oper
        arg HwTq0MeasHwTq0WrOffsTrimData_Arg: type=float32, direction=IN, server-argument-impl-policy=USE-ARGUMENT-TYPE
    HwTq1MeasHwTq1AutTrim_PortIf1  # OBSOLETE
      operation Oper
    HwTq1MeasHwTq1ClrTrim_PortIf1  # OBSOLETE
      operation Oper
    HwTq1MeasHwTq1ReadTrim_PortIf1  # OBSOLETE
      operation Oper
        arg HwTq1MeasHwTq1ReadTrimData_Arg: type=float32, direction=OUT, server-argument-impl-policy=USE-ARGUMENT-TYPE
    HwTq1MeasHwTq1TrimPrfmdSts_PortIf1  # OBSOLETE
      operation Oper
        arg HwTq1MeasHwTq1OffsTrimPrfmdStsData_Arg: type=boolean, direction=OUT, server-argument-impl-policy=USE-ARGUMENT-TYPE
    HwTq1MeasHwTq1WrTrim_PortIf1  # OBSOLETE
      operation Oper
        arg HwTq1MeasHwTq1WrOffsTrimData_Arg: type=float32, direction=IN, server-argument-impl-policy=USE-ARGUMENT-TYPE
    HwTq2MeasHwTq2AutTrim_PortIf1  # OBSOLETE
      operation Oper
    HwTq2MeasHwTq2ClrTrim_PortIf1  # OBSOLETE
      operation Oper
    HwTq2MeasHwTq2ReadTrim_PortIf1  # OBSOLETE
      operation Oper
        arg HwTq2MeasHwTq2ReadTrimData_Arg: type=float32, direction=OUT, server-argument-impl-policy=USE-ARGUMENT-TYPE
    HwTq2MeasHwTq2TrimPrfmdSts_PortIf1  # OBSOLETE
      operation Oper
        arg HwTq2MeasHwTq2OffsTrimPrfmdStsData_Arg: type=boolean, direction=OUT, server-argument-impl-policy=USE-ARGUMENT-TYPE
    HwTq2MeasHwTq2WrTrim_PortIf1  # OBSOLETE
      operation Oper
        arg HwTq2MeasHwTq2WrOffsTrimData_Arg: type=float32, direction=IN, server-argument-impl-policy=USE-ARGUMENT-TYPE
    HwTq3MeasHwTq3AutTrim_PortIf1  # OBSOLETE
      operation Oper
    HwTq3MeasHwTq3ClrTrim_PortIf1  # OBSOLETE
      operation Oper
    HwTq3MeasHwTq3ReadTrim_PortIf1  # OBSOLETE
      operation Oper
        arg HwTq3MeasHwTq3ReadTrimData_Arg: type=float32, direction=OUT, server-argument-impl-policy=USE-ARGUMENT-TYPE
    HwTq3MeasHwTq3TrimPrfmdSts_PortIf1  # OBSOLETE
      operation Oper
        arg HwTq3MeasHwTq3OffsTrimPrfmdStsData_Arg: type=boolean, direction=OUT, server-argument-impl-policy=USE-ARGUMENT-TYPE
    HwTq3MeasHwTq3WrTrim_PortIf1  # OBSOLETE
      operation Oper
        arg HwTq3MeasHwTq3WrOffsTrimData_Arg: type=float32, direction=IN, server-argument-impl-policy=USE-ARGUMENT-TYPE
    HwTqClrSnsrSca_PortIf1
      operation Oper
    HwTqMeasHwTqAutTrim_PortIf1
      operation Oper
    HwTqMeasHwTqClrTrim_PortIf1
      operation Oper
    HwTqMeasHwTqReadTrim_PortIf1
      operation Oper
        arg HwTqReadTrimData_Arg: type=float32, direction=OUT, server-argument-impl-policy=USE-ARGUMENT-TYPE
    HwTqMeasHwTqTrimPrfmdSts_PortIf1
      operation Oper
        arg HwTqOffsTrimPrfmdStsData_Arg: type=boolean, direction=OUT, server-argument-impl-policy=USE-ARGUMENT-TYPE
    HwTqMeasHwTqWrTrim_PortIf1
      operation Oper
        arg HwTqWrOffsTrimData_Arg: type=float32, direction=IN, server-argument-impl-policy=USE-ARGUMENT-TYPE
    HwTqReadSnsrSca_PortIf2
      operation Oper
        arg HwTqReadScaData_Arg: type=float32, direction=OUT, server-argument-impl-policy=USE-ARGUMENT-TYPE
    HwTqSnsrScaPrfmdSts_PortIf1
      operation Oper
        arg HwTqScaPrfmdStsData_Arg: type=boolean, direction=OUT, server-argument-impl-policy=USE-ARGUMENT-TYPE
    HwTqWrSnsrSca_PortIf1
      operation Oper
        arg HwTqScaVal_Arg: type=float32, direction=IN, server-argument-impl-policy=USE-ARGUMENT-TYPE
    InitFricLrngTbl_PortIf1
      operation Oper
    MeasTrigStrt_PortIf1
      operation Oper
    MotAgCmpBackEmfRead1  # OBSELETE
      operation Oper: possible-error=MotAgCmpBackEmfRead1/E_NOT_OK
        arg MotAgBackEmfRead: type=Ag9, direction=OUT, server-argument-impl-policy=USE-ARGUMENT-TYPE
      error E_NOT_OK: error-code=1
    MotAgCmpBackEmfRead2  # OBSELETE
      operation Oper
        arg MotAgBackEmfRead: type=Ag9, direction=OUT, server-argument-impl-policy=USE-ARGUMENT-TYPE
    MotAgCmpBackEmfWr1
      operation Oper: possible-error=MotAgCmpBackEmfWr1/E_NOT_OK
        arg MotAgCmpBackEmfWrData: type=Ag9, direction=IN, server-argument-impl-policy=USE-ARGUMENT-TYPE
      error E_NOT_OK: error-code=1
    MotAgEolPrmRead_PortIf1
      operation Oper
        arg MotAgEolPrmData_Arg: type=MotAgEolPrmRec1, direction=OUT, server-argument-impl-policy=USE-ARGUMENT-TYPE
    MotAgEolPrmWr_PortIf1
      operation Oper
        arg MotAgEolPrmData_Arg: type=MotAgEolPrmRec1, direction=IN, server-argument-impl-policy=USE-ARGUMENT-TYPE
    MotAgMeasEolPrmRead_PortIf2
      operation Oper
        arg MotAgEolPrmRead_Arg: type=MotAgMeasEolPrmRec1, direction=OUT, server-argument-impl-policy=USE-ARGUMENT-TYPE
    MotAgMeasEolPrmWr_PortIf2
      operation Oper
        arg MotAgSinCosEolCalData_Arg: type=MotAgMeasEolPrmRec1, direction=IN, server-argument-impl-policy=USE-ARGUMENT-TYPE
    MotAgMeasMotAgCoeffTblRead_PortIf1
      operation Oper
        arg MotAgCoeffTbl_Arg: type=Ary1D_f32_26, direction=OUT, server-argument-impl-policy=USE-ARGUMENT-TYPE
    MotAgMeasMotAgCoeffTblWr_PortIf1
      operation Oper
        arg MotAgCoeffTbl_Arg: type=Ary1D_f32_26, direction=IN, server-argument-impl-policy=USE-ARGUMENT-TYPE
    NxtrCalIdsCalDevlpRd_PortIf1
      operation Oper: possible-error=NxtrCalIdsCalDevlpRd_PortIf1/E_NOT_OK
        5 x arg, all with server-argument-impl-policy=USE-ARGUMENT-TYPE:
          CalRegn: type=uint8, direction=IN
          CalAuthor: type=Ary1D_u8_6, direction=OUT
          CalVers: type=uint8, direction=OUT
          CalTiStamp: type=uint32, direction=OUT
          CalDescr: type=Ary1D_u8_48, direction=OUT
      error E_NOT_OK: error-code=1
    NxtrCalIdsCalRelRd_PortIf1
      operation Oper
        arg CalRegn: type=uint8, direction=IN, server-argument-impl-policy=USE-ARGUMENT-TYPE
        arg RelNr: type=uint32, direction=OUT, server-argument-impl-policy=USE-ARGUMENT-TYPE
        arg RelSt: type=uint8, direction=OUT, server-argument-impl-policy=USE-ARGUMENT-TYPE
    NxtrSwIdsPsrInfoRd_PortIf1
      operation Oper: possible-error=NxtrSwIdsPsrInfoRd_PortIf1/E_NOT_OK
        arg PsrId: type=uint32, direction=OUT, server-argument-impl-policy=USE-ARGUMENT-TYPE
        arg PsrRev: type=uint8, direction=OUT, server-argument-impl-policy=USE-ARGUMENT-TYPE
      error E_NOT_OK: error-code=1
    NxtrSwIdsSwBuildDateTiRd_PortIf1
      operation Oper
        arg SwBuildDateTi: type=Ary1D_u8_20, direction=OUT, server-argument-impl-policy=USE-ARGUMENT-TYPE
    NxtrSwIdsSwRelInfoRd_PortIf1
      operation Oper
        arg SwOrigin: type=uint8, direction=OUT, server-argument-impl-policy=USE-ARGUMENT-TYPE
        arg SwAuthor: type=Ary1D_u8_6, direction=OUT, server-argument-impl-policy=USE-ARGUMENT-TYPE
    NxtrSwIdsSwRelNrRd_PortIf1
      operation Oper
        arg SwRelNr: type=Ary1D_u8_16, direction=OUT, server-argument-impl-policy=USE-ARGUMENT-TYPE
    NxtrSwIdsSwRelVerRd_PortIf1
      operation Oper
        arg SwRelVer: type=Ary1D_u8_16, direction=OUT, server-argument-impl-policy=USE-ARGUMENT-TYPE
    OnlineTunRamAdrMpg_PortIf1
      operation Oper: possible-error=OnlineTunRamAdrMpg_PortIf1/E_NOT_OK
        arg ReqAdr_Arg: type=uint32, direction=IN, server-argument-impl-policy=USE-ARGUMENT-TYPE
        arg CorrdAdr_Arg: type=uint32, direction=INOUT, server-argument-impl-policy=USE-ARGUMENT-TYPE
        arg ReqTyp_Arg: type=AdrMpgReqTyp1, direction=IN, server-argument-impl-policy=USE-ARGUMENT-TYPE
      error E_NOT_OK: error-code=1
    PolarityCfgRead1
      operation Oper: possible-error=PolarityCfgRead1/E_NOT_OK
        arg PolarityCfgSaved: type=Cnt15, direction=OUT, server-argument-impl-policy=USE-ARGUMENT-TYPE
      error E_NOT_OK: error-code=1
    PolarityCfgWr1
      operation Oper: possible-error=PolarityCfgWr1/E_NOT_OK
        arg PolarityCfgSaved: type=Cnt15, direction=IN, server-argument-impl-policy=USE-ARGUMENT-TYPE
      error E_NOT_OK: error-code=1
    PwrTurnOffCtrl_PortIf1
      operation Oper
        arg PinSt_Arg: type=boolean, direction=IN, server-argument-impl-policy=USE-ARGUMENT-TYPE
    ReadErrInjReg_PortIf1
      operation Oper
        arg ErrId_Arg: type=uint32, direction=OUT, server-argument-impl-policy=USE-ARGUMENT-TYPE
    ReadLtchCntrData_PortIf1
      operation Oper
        arg ReadLtchCntrAry_Arg: type=Ary1D_u08_20, direction=OUT, server-argument-impl-policy=USE-ARGUMENT-TYPE
    ReadNtcFltAry_PortIf1
      operation Oper
        arg DiagcMgrReadFltInfo_Arg: type=Ary1D_ReadFltInfoRec1_20, direction=OUT, server-argument-impl-policy=USE-ARGUMENT-TYPE
    ReadNtcInfoAndDebCntr_PortIf1
      operation Oper
        arg NtcNr_Arg: type=NtcNr1, direction=IN, server-argument-impl-policy=USE-ARGUMENT-TYPE
        arg NtcInfo_Arg: type=NtcInfoRec4, direction=OUT, server-argument-impl-policy=USE-ARGUMENT-TYPE
        arg DebCntr_Arg: type=sint16, direction=OUT, server-argument-impl-policy=USE-ARGUMENT-TYPE
    ReadSnpshtData_PortIf1  # OBSOLETE
      operation Oper  # OBSOLETE
        arg ReadSnpshtDataAry_Arg: type=Ary1D_SnpshtDataRec1_8, direction=OUT, server-argument-impl-policy=USE-ARGUMENT-TYPE
    ReadSnpshtData_PortIf2
      operation Oper
        arg ReadSnpshtDataAry_Arg: type=Ary1D_SnpshtDataRec2_8, direction=OUT, server-argument-impl-policy=USE-ARGUMENT-TYPE
    ResvCrcHwUnit_PortIf2
      operation Oper: possible-error=ResvCrcHwUnit_PortIf2/E_NOT_OK
        6 x arg, all with server-argument-impl-policy=USE-ARGUMENT-TYPE:
          Mod_Arg: type=CrcHwResvMod1, direction=IN
          CrcCfg_Arg: type=CrcHwResvCfg1, direction=IN
          CrcHwInRegAdr_Arg: type=uint32, direction=OUT
          CrcHwOutRegAdr_Arg: type=uint32, direction=OUT
          StrtVal_Arg: type=uint32, direction=IN
          ResvKey_Arg: type=uint32, direction=INOUT
      error E_NOT_OK: error-code=1
    RstHwAgOverTrvlCnt_PortIf1
      operation Oper
    RstHwTq_PortIf1
      operation Oper
    RstMaxHwAgCwAndCcw_PortIf1
      operation Oper
    RstPullCmp_PortIf1
      operation Oper
    RstSnsrlsHwCentr_PortIf1
      operation Oper
    RstYawAndAg_PortIf1
      operation Oper
    RtCalChgReq_PortIf1
      operation Oper: possible-error=RtCalChgReq_PortIf1/E_NOT_OK
      error E_NOT_OK: error-code=1
    RtnMaxHwAgCwAndCcw_PortIf1
      operation Oper
        arg HwAgCcwMax_Arg: type=float32, direction=OUT, server-argument-impl-policy=USE-ARGUMENT-TYPE
        arg HwAgCwMax_Arg: type=float32, direction=OUT, server-argument-impl-policy=USE-ARGUMENT-TYPE
    SerlComRstEot_PortIf1
      operation Oper
    SetCalPageReq_PortIf1
      operation Oper
        arg Seg_Arg: type=uint8, direction=IN, server-argument-impl-policy=USE-ARGUMENT-TYPE
        arg Mod_Arg: type=uint8, direction=IN, server-argument-impl-policy=USE-ARGUMENT-TYPE
        arg Page_Arg: type=uint8, direction=IN, server-argument-impl-policy=USE-ARGUMENT-TYPE
    SetCtrlPrm_PortIf1
      operation Oper
        7 x arg, all with type=float32, direction=IN, server-argument-impl-policy=USE-ARGUMENT-TYPE:
          MotVelCtrlPropGain_Arg
          MotVelCtrlIntgtrGain_Arg
          MotVelCtrlDerivtvGain_Arg
          MotVelCtrlAntiWdupLim_Arg
          MotVelCtrlAntiWdupGain_Arg
          MotVelCtrlDerivtvLpFilTiCon_Arg
          MotVelCtrlTqCmdLim_Arg
    SetFctGpio_PortIf1
      operation Oper: possible-error=SetFctGpio_PortIf1/E_NOT_OK
      error E_NOT_OK: error-code=1
    SetFctPeriph_PortIf1
      operation Oper: possible-error=SetFctPeriph_PortIf1/E_NOT_OK
      error E_NOT_OK: error-code=1
    SetFricData_PortIf3
      operation Oper
        5 x arg, all with direction=IN, server-argument-impl-policy=USE-ARGUMENT-TYPE:
          FricOffs_Arg: type=float32
          BasLineFric_Arg: type=Ary1D_f32_4
          VehLrndFric_Arg: type=Ary1D_f32_4
          Hys_Arg: type=Ary2D_f32_8_4
          RngCntr_Arg: type=Ary2D_u16_8_3
    SetFricLrngData_PortIf1
      operation Oper
        4 x arg, all with direction=IN, server-argument-impl-policy=USE-ARGUMENT-TYPE:
          FricLrngEna_Arg: type=boolean
          FricLrngOffsOutpEna_Arg: type=boolean
          FricLrngOperMod_Arg: type=SysFricLrngOperMod1
          EolFric_Arg: type=float32
    SetFricOffsOutpDi_PortIf1
      operation Oper
        arg FricOffsOutpDi_Arg: type=boolean, direction=IN, server-argument-impl-policy=USE-ARGUMENT-TYPE
    SetGpio_PortIf1
      operation Oper: possible-error=SetGpio_PortIf1/E_NOT_OK
        arg PinSt_Arg: type=boolean, direction=IN, server-argument-impl-policy=USE-ARGUMENT-TYPE
      error E_NOT_OK: error-code=1
    SetHwAgOffs_PortIf1
      operation Oper
        arg HwAgOffs_Arg: type=float32, direction=IN, server-argument-impl-policy=USE-ARGUMENT-TYPE
        arg HwAgLrngStRst_Arg: type=boolean, direction=IN, server-argument-impl-policy=USE-ARGUMENT-TYPE
    SetHwAgOverTrvlCnt_PortIf2
      operation Oper
        arg HwAgOverTrvlCnt_Arg: type=uint8, direction=IN, server-argument-impl-policy=USE-ARGUMENT-TYPE
    SetHwAgTrimVal_PortIf2
      operation Oper
        arg HwAgTrimVal_Arg: type=float32, direction=IN, server-argument-impl-policy=USE-ARGUMENT-TYPE
        arg HwAgTrimPrfmd_Arg: type=boolean, direction=IN, server-argument-impl-policy=USE-ARGUMENT-TYPE
    SetHwTqOffs_PortIf1
      operation Oper
        arg HwTqOffs_Arg: type=float32, direction=IN, server-argument-impl-policy=USE-ARGUMENT-TYPE
        arg HwTqLrngStRst_Arg: type=boolean, direction=IN, server-argument-impl-policy=USE-ARGUMENT-TYPE
    SetManTqCmd_PortIf1
      operation Oper: possible-error=SetManTqCmd_PortIf1/E_NOT_OK
        arg ManTqCmd_Arg: type=float32, direction=IN, server-argument-impl-policy=USE-ARGUMENT-TYPE
        arg ManTqCmdEna_Arg: type=boolean, direction=IN, server-argument-impl-policy=USE-ARGUMENT-TYPE
      error E_NOT_OK: error-code=1
    SetManTqCmd1
      operation Oper: possible-error=SetManTqCmd1/E_NOT_OK
        arg ManTqCmd: type=Tq1, direction=IN, server-argument-impl-policy=USE-ARGUMENT-TYPE
        arg ManTqCmdEna: type=boolean, direction=IN, server-argument-impl-policy=USE-ARGUMENT-TYPE
      error E_NOT_OK: error-code=1
    SetMotCoggCmdPrm_PortIf1
      operation Oper
        arg MotCoggCmdY_Arg: type=Ary1D_s1p14_128, direction=IN, server-argument-impl-policy=USE-ARGUMENT-TYPE
        arg Idx_Arg: type=uint8, direction=IN, server-argument-impl-policy=USE-ARGUMENT-TYPE
    SetMotPrmNomEol1  # OBSELETE
      operation Oper: possible-error=SetMotPrmNomEol1/E_NOT_OK
        arg MotKeNom: type=MotCon1, direction=IN, server-argument-impl-policy=USE-ARGUMENT-TYPE
        arg MotRNom: type=R6, direction=IN, server-argument-impl-policy=USE-ARGUMENT-TYPE
      error E_NOT_OK: error-code=1
    SetMotPrmNomEol2
      operation Oper: possible-error=SetMotPrmNomEol2/E_NOT_OK
        arg MotBackEmfConNom_Arg: type=MotCon1, direction=IN, server-argument-impl-policy=USE-ARGUMENT-TYPE
        arg MotRNom_Arg: type=R6, direction=IN, server-argument-impl-policy=USE-ARGUMENT-TYPE
      error E_NOT_OK: error-code=1
    SetMotRplCoggPrm_PortIf1
      operation Oper
        9 x arg, all with direction=IN, server-argument-impl-policy=USE-ARGUMENT-TYPE:
          CoggOrder1_Arg: type=uint16
          CoggOrder1X_Arg: type=s1p14
          CoggOrder1Y_Arg: type=s1p14
          CoggOrder2_Arg: type=uint16
          CoggOrder2X_Arg: type=s1p14
          CoggOrder2Y_Arg: type=s1p14
          CoggOrder3_Arg: type=uint16
          CoggOrder3X_Arg: type=s1p14
          CoggOrder3Y_Arg: type=s1p14
    SetMotTqCmdSca_PortIf1
      operation Oper
        arg MotTqCmdSca_Arg: type=float32, direction=IN, server-argument-impl-policy=USE-ARGUMENT-TYPE
    SetNtcSts_PortIf1
      operation Oper: possible-error=SetNtcSts_PortIf1/E_NOT_OK
        4 x arg, all with direction=IN, server-argument-impl-policy=USE-ARGUMENT-TYPE:
          NtcNr_Arg: type=NtcNr1
          NtcStInfo_Arg: type=uint8
          NtcSts_Arg: type=NtcSts1
          DebStep_Arg: type=uint16
      error E_NOT_OK: error-code=1
    SetNtcSts1
      operation Oper: possible-error=SetNtcSts1/E_NOT_OK
        4 x arg, all with direction=IN, server-argument-impl-policy=USE-ARGUMENT-TYPE:
          NtcNr: type=NtcNr1
          NtcStInfo: type=uint8
          NtcSts: type=NtcSts1
          DebStep: type=uint16
      error E_NOT_OK: error-code=1
    SetNtcStsAndSnpshtData_PortIf1
      operation Oper: possible-error=SetNtcStsAndSnpshtData_PortIf1/E_NOT_OK
        7 x arg, all with direction=IN, server-argument-impl-policy=USE-ARGUMENT-TYPE:
          NtcNr_Arg: type=NtcNr1
          NtcStInfo_Arg: type=uint8
          NtcSts_Arg: type=NtcSts1
          DebStep_Arg: type=uint16
          SpclSnpshtData{0..2}_Arg: type=uint32
      error E_NOT_OK: error-code=1
    SetNtcStsCore_PortIf2
      operation Oper: possible-error=SetNtcStsCore_PortIf2/E_NOT_OK
        12 x arg, all with server-argument-impl-policy=USE-ARGUMENT-TYPE:
          NtcNr_Arg: type=NtcNr1, direction=IN
          NtcStInfo_Arg: type=uint8, direction=IN
          NtcSts_Arg: type=NtcSts1, direction=IN
          DebStep_Arg: type=uint16, direction=IN
          DiagcData_Arg: type=DiagcDataRec2, direction=INOUT
          ProxySetNtcData_Arg: type=DiagcDataRec2, direction=INOUT
          NtcInfo_Arg: type=NtcInfoRec4, direction=INOUT
          NtcInfoDebCntr_Arg: type=sint16, direction=INOUT
          SpclSnpshtData{0..2}_Arg: type=uint32, direction=IN
          SpclSnpshtDataPrsnt_Arg: type=boolean, direction=IN
      error E_NOT_OK: error-code=1
    SetPullCmpLongTerm_PortIf1
      operation Oper
        arg PullCmpLongTerm_Arg: type=float32, direction=IN, server-argument-impl-policy=USE-ARGUMENT-TYPE
    SetPullCmpShoTerm_PortIf1
      operation Oper
        arg PullCmpShoTerm_Arg: type=float32, direction=IN, server-argument-impl-policy=USE-ARGUMENT-TYPE
    SetRxSigGroup_PortIf1
      operation Oper: possible-error=SetRxSigGroup_PortIf1/E_NOT_OK
        arg SigGroup_Arg: type=uint8, direction=IN, server-argument-impl-policy=USE-ARGUMENT-TYPE
        arg DataSrc_Arg: type=ImcArbnRxDataSrc1, direction=IN, server-argument-impl-policy=USE-ARGUMENT-TYPE
        arg Buf_Arg: type=Ary1D_u08_8, direction=IN, server-argument-impl-policy=USE-ARGUMENT-TYPE
      error E_NOT_OK: error-code=1
    SetYawRateOffs_PortIf1
      operation Oper
        arg VehYawRateOffs_Arg: type=float32, direction=IN, server-argument-impl-policy=USE-ARGUMENT-TYPE
        arg VehYawRateLrngStRst_Arg: type=boolean, direction=IN, server-argument-impl-policy=USE-ARGUMENT-TYPE
    StackMeasClr_PortIf1
      operation Oper
    StopCtrl_PortIf1
      operation Oper
        arg MotVelCtrlVelSlewRate_Arg: type=float32, direction=IN, server-argument-impl-policy=USE-ARGUMENT-TYPE
    StrtCtrl_PortIf1
      operation Oper
        arg MotVelCtrlMotVelTar_Arg: type=float32, direction=IN, server-argument-impl-policy=USE-ARGUMENT-TYPE
        arg MotVelCtrlVelSlewRate_Arg: type=float32, direction=IN, server-argument-impl-policy=USE-ARGUMENT-TYPE
    StrtErrInjCntr_PortIf1
      operation Oper
    SwCalGetPrm_PortIf1
      operation Oper
        11 x arg, all with direction=OUT, server-argument-impl-policy=USE-ARGUMENT-TYPE:
          BoostModlnIdx_Arg: type=float32
          HldModlnIdx_Arg: type=float32
          CoolDwnModlnIdx_Arg: type=float32
          Ramp{1..3}Ti_Arg: type=uint8
          BoostTi_Arg: type=uint8
          HldTi_Arg: type=uint16
          CoolDwnTi_Arg: type=uint16
          PosnStepSize_Arg: type=u0p16
          ElecRevCnt_Arg: type=uint8
    SwCalSetPrm_PortIf1
      operation Oper: possible-error=SwCalSetPrm_PortIf1/E_NOT_OK
        11 x arg, all with direction=IN, server-argument-impl-policy=USE-ARGUMENT-TYPE:
          BoostModlnIdx_Arg: type=float32
          HldModlnIdx_Arg: type=float32
          CoolDwnModlnIdx_Arg: type=float32
          Ramp{1..3}Ti_Arg: type=uint8
          BoostTi_Arg: type=uint8
          HldTi_Arg: type=uint16
          CoolDwnTi_Arg: type=uint16
          PosnStepSize_Arg: type=u0p16
          ElecRevCnt_Arg: type=uint8
      error E_NOT_OK: error-code=1
    SwCalStop_PortIf1
      operation Oper
    SwCalStrt_PortIf1
      operation Oper
    SwCalStsCallBack_PortIf1
      operation Oper
        arg ElecRev_Arg: type=uint8, direction=IN, server-argument-impl-policy=USE-ARGUMENT-TYPE
        arg PosIdx_Arg: type=uint16, direction=IN, server-argument-impl-policy=USE-ARGUMENT-TYPE
        arg SnsrData_Arg: type=Ary1D_u16_12, direction=IN, server-argument-impl-policy=USE-ARGUMENT-TYPE
    UpdErrInjReg_PortIf1
      operation Oper
        arg NtcNr_Arg: type=uint16, direction=IN, server-argument-impl-policy=USE-ARGUMENT-TYPE
        arg NtcStInfo_Arg: type=uint8, direction=IN, server-argument-impl-policy=USE-ARGUMENT-TYPE
        arg ErrInjNr_Arg: type=uint8, direction=IN, server-argument-impl-policy=USE-ARGUMENT-TYPE
    UpdHwAgTrimVal_PortIf1
      operation Oper
        arg UpdHwAgTrimValSrvResp_Arg: type=uint8, direction=OUT, server-argument-impl-policy=USE-ARGUMENT-TYPE
    XcpCalChgReq_PortIf1
      operation Oper: possible-error=XcpCalChgReq_PortIf1/E_NOT_OK
      error E_NOT_OK: error-code=1
  69 x sender receiver interface:
    ActvGroup_PortIf1: invalidation-policy{data-element=ActvGroup_PortIf1/Val, handle-invalid=DONT-INVALIDATE}
      data Val: type=uint8
    Ag2: invalidation-policy{data-element=Ag2/Val, handle-invalid=DONT-INVALIDATE}
      data Val: sw-calibration-access=READ-ONLY, type=Ag5
    Ag3: invalidation-policy{data-element=Ag3/Val, handle-invalid=DONT-INVALIDATE}
      data Val: sw-calibration-access=READ-ONLY, type=Ag7
    Ag4: invalidation-policy{data-element=Ag4/Val, handle-invalid=DONT-INVALIDATE}
      data Val: sw-calibration-access=READ-ONLY, type=Ag8
    Ag6: invalidation-policy{data-element=Ag6/Val, handle-invalid=DONT-INVALIDATE}
      data Val: sw-calibration-access=READ-ONLY, type=Ag10
    AgAry1D1: invalidation-policy{data-element=AgAry1D1/Ary1D, handle-invalid=DONT-INVALIDATE}
      data Ary1D: sw-calibration-access=READ-ONLY, type=AgAry1D2
    Ary1D_u08_17_PortIf1: invalidation-policy{data-element=Ary1D_u08_17_PortIf1/Ary1D, handle-invalid=DONT-INVALIDATE}
      data Ary1D: sw-calibration-access=READ-ONLY, type=Ary1D_u08_17
    Ary1D_u0p16_8_PortIf1: invalidation-policy{data-element=Ary1D_u0p16_8_PortIf1/Ary1D, handle-invalid=DONT-INVALIDATE}
      data Ary1D: sw-calibration-access=READ-ONLY, type=Ary1D_u0p16_8
    Ary1D_u32_8_PortIf1: invalidation-policy{data-element=Ary1D_u32_8_PortIf1/Ary1D, handle-invalid=DONT-INVALIDATE}
      data Ary1D: sw-calibration-access=READ-ONLY, type=Ary1D_u32_8
    BattVltgSt1_PortIf1: invalidation-policy{data-element=BattVltgSt1_PortIf1/Val, handle-invalid=DONT-INVALIDATE}
      data Val: sw-calibration-access=READ-ONLY, type=BattVltgSt1
    boolean_PortIf1: invalidation-policy{data-element=boolean_PortIf1/Logl, handle-invalid=DONT-INVALIDATE}
      data Logl: sw-calibration-access=READ-ONLY, type=boolean
    CalCopySts_PortIf1: invalidation-policy{data-element=CalCopySts_PortIf1/Val, handle-invalid=DONT-INVALIDATE}
      data Val: type=CalCopySts1
    Cnt12: invalidation-policy{data-element=Cnt12/Val, handle-invalid=DONT-INVALIDATE}
      data Val: sw-calibration-access=READ-ONLY, type=Cnt22
    Cnt13: invalidation-policy{data-element=Cnt13/Val, handle-invalid=DONT-INVALIDATE}
      data Val: sw-calibration-access=READ-ONLY, type=Cnt13
    Cnt6: invalidation-policy{data-element=Cnt6/Val, handle-invalid=DONT-INVALIDATE}
      data Val: sw-calibration-access=READ-ONLY, type=uint8
    CntAry1D1: invalidation-policy{data-element=CntAry1D1/Ary1D, handle-invalid=DONT-INVALIDATE}
      data Ary1D: sw-calibration-access=READ-ONLY, type=CntAry1D2
    Curr1: invalidation-policy{data-element=Curr1/Val, handle-invalid=DONT-INVALIDATE}
      data Val: sw-calibration-access=READ-ONLY, type=Curr1
    Curr2: invalidation-policy{data-element=Curr2/Val, handle-invalid=DONT-INVALIDATE}
      data Val: sw-calibration-access=READ-ONLY, type=Curr6
    Curr3: invalidation-policy{data-element=Curr3/Val, handle-invalid=DONT-INVALIDATE}
      data Val: sw-calibration-access=READ-ONLY, type=Curr7
    float32_PortIf1: invalidation-policy{data-element=float32_PortIf1/Val, handle-invalid=DONT-INVALIDATE}
      data Val: sw-calibration-access=READ-ONLY, type=float32
    FordArbnCmd1_PortIf1: invalidation-policy{data-element=FordArbnCmd1_PortIf1/Val, handle-invalid=DONT-INVALIDATE}
      data Val: type=FordArbnCmd1
    FordEpsSysSt1_PortIf1: invalidation-policy{data-element=FordEpsSysSt1_PortIf1/Val, handle-invalid=DONT-INVALIDATE}
      data Val: type=FordEpsSysSt1
    FordFeatSt1_PortIf1: invalidation-policy{data-element=FordFeatSt1_PortIf1/Val, handle-invalid=DONT-INVALIDATE}
      data Val: type=FordFeatSt1
    FordVehWhlDirRaw1_PortIf1: invalidation-policy{data-element=FordVehWhlDirRaw1_PortIf1/Val, handle-invalid=DONT-INVALIDATE}
      data Val: type=FordVehWhlDirRaw1
    FordVltgOperSt1_PortIf1: invalidation-policy{data-element=FordVltgOperSt1_PortIf1/Val, handle-invalid=DONT-INVALIDATE}
      data Val: sw-calibration-access=READ-ONLY, type=FordVltgOperSt1
    HwAgSnsrTyp1_PortIf1: invalidation-policy{data-element=HwAgSnsrTyp1_PortIf1/Val, handle-invalid=DONT-INVALIDATE}
      data Val: sw-calibration-access=READ-ONLY, type=HwAgSnsrTyp1
    ImcArbnRxSts1_PortIf1: invalidation-policy{data-element=ImcArbnRxSts1_PortIf1/Val, handle-invalid=DONT-INVALIDATE}
      data Val: sw-calibration-access=READ-ONLY, type=ImcArbnRxSts1
    Indu2: invalidation-policy{data-element=Indu2/Val, handle-invalid=DONT-INVALIDATE}
      data Val: sw-calibration-access=READ-ONLY, type=Indu1
    IvtrFetFltPha1_PortIf1: invalidation-policy{data-element=IvtrFetFltPha1_PortIf1/Val, handle-invalid=DONT-INVALIDATE}
      data Val: sw-calibration-access=READ-ONLY, type=IvtrFetFltPha1
    IvtrFetFltTyp1_PortIf1: invalidation-policy{data-element=IvtrFetFltTyp1_PortIf1/Val, handle-invalid=DONT-INVALIDATE}
      data Val: sw-calibration-access=READ-ONLY, type=IvtrFetFltTyp1
    LoaSt1_PortIf1: invalidation-policy{data-element=LoaSt1_PortIf1/Val, handle-invalid=DONT-INVALIDATE}
      data Val: sw-calibration-access=READ-ONLY, type=LoaSt1
    Logl1: invalidation-policy{data-element=Logl1/Logl, handle-invalid=DONT-INVALIDATE}
      data Logl: sw-calibration-access=READ-ONLY, type=boolean
    MfgEnaSt1_PortIf1: invalidation-policy{data-element=MfgEnaSt1_PortIf1/Val, handle-invalid=DONT-INVALIDATE}
      data Val: type=MfgEnaSt1
    MotCon1: invalidation-policy{data-element=MotCon1/Val, handle-invalid=DONT-INVALIDATE}
      data Val: sw-calibration-access=READ-ONLY, type=MotCon1
    MotCurrEolCalSt_PortIf1: invalidation-policy{data-element=MotCurrEolCalSt_PortIf1/Val, handle-invalid=DONT-INVALIDATE}
      data Val: sw-calibration-access=READ-ONLY, type=MotCurrEolCalSt2
    MotCurrEolCalSt2_PortIf1: invalidation-policy{data-element=MotCurrEolCalSt2_PortIf1/Val, handle-invalid=DONT-INVALIDATE}
      data Val: sw-calibration-access=READ-ONLY, type=MotCurrEolCalSt2
    MotQuad1: invalidation-policy{data-element=MotQuad1/Val, handle-invalid=DONT-INVALIDATE}
      data Val: sw-calibration-access=READ-ONLY, type=MotQuad1
    MotQuad1_PortIf1: invalidation-policy{data-element=MotQuad1_PortIf1/Val, handle-invalid=DONT-INVALIDATE}
      data Val: sw-calibration-access=READ-ONLY, type=MotQuad1
    R4: invalidation-policy{data-element=R4/Val, handle-invalid=DONT-INVALIDATE}
      data Val: sw-calibration-access=READ-ONLY, type=R5
    R6: invalidation-policy{data-element=R6/Val, handle-invalid=DONT-INVALIDATE}
      data Val: sw-calibration-access=READ-ONLY, type=R6
    s18p13_PortIf1: invalidation-policy{data-element=s18p13_PortIf1/Val, handle-invalid=DONT-INVALIDATE}
      data Val: sw-calibration-access=READ-ONLY, type=s18p13
    s23pm8_PortIf1: invalidation-policy{data-element=s23pm8_PortIf1/Val, handle-invalid=DONT-INVALIDATE}
      data Val: sw-calibration-access=READ-ONLY, type=s23pm8
    s5p10: invalidation-policy{data-element=s5p10/Val, handle-invalid=DONT-INVALIDATE}
      data Val: sw-calibration-access=READ-ONLY, type=s5p10
    s5p10_PortIf1: invalidation-policy{data-element=s5p10_PortIf1/Val, handle-invalid=DONT-INVALIDATE}
      data Val: sw-calibration-access=READ-ONLY, type=sint16
    s8p7: invalidation-policy{data-element=s8p7/Val, handle-invalid=DONT-INVALIDATE}
      data Val: sw-calibration-access=READ-ONLY, type=s8p7
    s8p7_PortIf1: invalidation-policy{data-element=s8p7_PortIf1/Val, handle-invalid=DONT-INVALIDATE}
      data Val: sw-calibration-access=READ-ONLY, type=s8p7
    SigQlfr_PortIf1: invalidation-policy{data-element=SigQlfr_PortIf1/Val, handle-invalid=DONT-INVALIDATE}
      data Val: sw-calibration-access=READ-ONLY, type=SigQlfr1
    SigQlfr1: invalidation-policy{data-element=SigQlfr1/Val, handle-invalid=DONT-INVALIDATE}
      data Val: sw-calibration-access=READ-ONLY, type=SigQlfr1
    SigQlfr1_PortIf1: invalidation-policy{data-element=SigQlfr1_PortIf1/Val, handle-invalid=DONT-INVALIDATE}
      data Val: sw-calibration-access=READ-ONLY, type=SigQlfr1
    sint16_PortIf1: invalidation-policy{data-element=sint16_PortIf1/Val, handle-invalid=DONT-INVALIDATE}
      data Val: sw-calibration-access=READ-ONLY, type=sint16
    sint32_PortIf1: invalidation-policy{data-element=sint32_PortIf1/Val, handle-invalid=DONT-INVALIDATE}
      data Val: sw-calibration-access=READ-ONLY, type=sint32
    sint8_PortIf1: invalidation-policy{data-element=sint8_PortIf1/Val, handle-invalid=DONT-INVALIDATE}
      data Val: sw-calibration-access=READ-ONLY, type=sint8
    SteerMod1_PortIf1: invalidation-policy{data-element=SteerMod1_PortIf1/Val, handle-invalid=DONT-INVALIDATE}
      data Val: sw-calibration-access=READ-ONLY, type=SteerMod1
    SysSt1: invalidation-policy{data-element=SysSt1/Val, handle-invalid=DONT-INVALIDATE}
      data Val: sw-calibration-access=READ-ONLY, type=SysSt1
    SysSt1_PortIf1: invalidation-policy{data-element=SysSt1_PortIf1/Val, handle-invalid=DONT-INVALIDATE}
      data Val: sw-calibration-access=READ-ONLY, type=SysSt1
    T1: invalidation-policy{data-element=T1/Val, handle-invalid=DONT-INVALIDATE}
      data Val: sw-calibration-access=READ-ONLY, type=T1
    T5: invalidation-policy{data-element=T5/Val, handle-invalid=DONT-INVALIDATE}
      data Val: sw-calibration-access=READ-ONLY, type=T2
    T6: invalidation-policy{data-element=T6/Val, handle-invalid=DONT-INVALIDATE}
      data Val: sw-calibration-access=READ-ONLY, type=T3
    Tq1: invalidation-policy{data-element=Tq1/Val, handle-invalid=DONT-INVALIDATE}
      data Val: sw-calibration-access=READ-ONLY, type=Tq1
    u0p16_PortIf1: invalidation-policy{data-element=u0p16_PortIf1/Val, handle-invalid=DONT-INVALIDATE}
      data Val: sw-calibration-access=READ-ONLY, type=u0p16
    uint16_PortIf1: invalidation-policy{data-element=uint16_PortIf1/Val, handle-invalid=DONT-INVALIDATE}
      data Val: sw-calibration-access=READ-ONLY, type=uint16
    uint32_PortIf1: invalidation-policy{data-element=uint32_PortIf1/Val, handle-invalid=DONT-INVALIDATE}
      data Val: sw-calibration-access=READ-ONLY, type=uint32
    uint8_PortIf1: invalidation-policy{data-element=uint8_PortIf1/Val, handle-invalid=DONT-INVALIDATE}
      data Val: sw-calibration-access=READ-ONLY, type=uint8
    Uls3: invalidation-policy{data-element=Uls3/Val, handle-invalid=DONT-INVALIDATE}
      data Val: sw-calibration-access=READ-ONLY, type=Uls3
    Vel1: invalidation-policy{data-element=Vel1/Val, handle-invalid=DONT-INVALIDATE}
      data Val: sw-calibration-access=READ-ONLY, type=Vel1
    Volt1: invalidation-policy{data-element=Volt1/Val, handle-invalid=DONT-INVALIDATE}
      data Val: sw-calibration-access=READ-ONLY, type=Volt1
    Volt3: invalidation-policy{data-element=Volt3/Val, handle-invalid=DONT-INVALIDATE}
      data Val: sw-calibration-access=READ-ONLY, type=Volt3
    Volt4: invalidation-policy{data-element=Volt4/Val, handle-invalid=DONT-INVALIDATE}
      data Val: sw-calibration-access=READ-ONLY, type=Volt6
    Volt6: invalidation-policy{data-element=Volt6/Val, handle-invalid=DONT-INVALIDATE}
      data Val: sw-calibration-access=READ-ONLY, type=Volt17
package /PortInterface
  client server interface WdgM_AliveSupervision: is-service=true
    operation CheckpointReached: possible-error=WdgM_AliveSupervision/E_NOT_OK  # Indicates to the Watchdog Manager that a Checkpoint within a Supervised Entity has been reached.
    error E_NOT_OK: error-code=1
package /PortInterfaces
  9 x client server interface:
    CmnMfgSrvCmnMfgSrvMaiFct
      operation Oper
        7 x arg, all with server-argument-impl-policy=USE-ARGUMENT-TYPE:
          CmnMfgSrvCmnMfgSrvSrvId: type=uint8, direction=IN
          CmnMfgSrvCmnMfgSrvSubFct: type=uint8, direction=IN
          CmnMfgSrvCmnMfgSrvPrmId: type=uint16, direction=IN
          CmnMfgSrvCmnMfgSrvDataBufferPtr: type=uint8, direction=INOUT
          CmnMfgSrvCmnMfgSrvReqLen: type=uint16, direction=IN
          CmnMfgSrvCmnMfgSrvRespLen: type=uint16, direction=OUT
          CmnMfgSrvCmnMfgSrvRespCod: type=uint8, direction=OUT
    CmnMfgSrvIfCmnMfgSrvIfImdtTx
      operation Oper
        arg CmnMfgSrvCmnMfgSrvDataBufferPtr: type=Ary1D_u8_CmnMfgSrvIf, direction=IN, server-argument-impl-policy=USE-ARGUMENT-TYPE
        arg CmnMfgSrvCmnMfgSrvDataLen: type=uint16, direction=IN, server-argument-impl-policy=USE-ARGUMENT-TYPE
    MCalReadVrfyFailFltInfo_PortIf1
      operation Oper
        arg PrphlId_Arg: type=uint8, direction=IN, server-argument-impl-policy=USE-ARGUMENT-TYPE
        arg ErrId_Arg: type=uint16, direction=IN, server-argument-impl-policy=USE-ARGUMENT-TYPE
    PolarityCfgRead_PortIf1
      operation Oper: possible-error=PolarityCfgRead_PortIf1/E_NOT_OK
        arg PolarityCfgSaved_Arg: type=uint32, direction=OUT, server-argument-impl-policy=USE-ARGUMENT-TYPE
      error E_NOT_OK: error-code=1
    PolarityCfgWr_PortIf1
      operation Oper: possible-error=PolarityCfgWr_PortIf1/E_NOT_OK
        arg PolarityCfgSaved_Arg: type=uint32, direction=IN, server-argument-impl-policy=USE-ARGUMENT-TYPE
      error E_NOT_OK: error-code=1
    SerlComRstEot_PortIf1
      operation Oper
    SetCalPageReq_PortIf1
      operation Oper
        arg Seg_Arg: type=uint8, direction=IN, server-argument-impl-policy=USE-ARGUMENT-TYPE
        arg Mod_Arg: type=uint8, direction=IN, server-argument-impl-policy=USE-ARGUMENT-TYPE
        arg Page_Arg: type=uint8, direction=IN, server-argument-impl-policy=USE-ARGUMENT-TYPE
    StackMeasRead_PortIf1
      operation Operation
        arg StackMeasRes_Arg: type=Ary1D_u8_48, direction=OUT, server-argument-impl-policy=USE-ARGUMENT-TYPE
    XcpCalChgReq_PortIf1
      operation Oper: possible-error=XcpCalChgReq_PortIf1/E_NOT_OK
      error E_NOT_OK: error-code=1
  5 x sender receiver interface:
    boolean_PortIf1: invalidation-policy{data-element=boolean_PortIf1/Logl, handle-invalid=DONT-INVALIDATE}
      data Logl: type=boolean
    FordArbnCmd1_PortIf1: invalidation-policy{data-element=FordArbnCmd1_PortIf1/Val, handle-invalid=DONT-INVALIDATE}
      data Val: type=FordArbnCmd1
    s5p10_PortIf1: invalidation-policy{data-element=s5p10_PortIf1/Val, handle-invalid=DONT-INVALIDATE}
      data Val: sw-calibration-access=READ-ONLY, type=s5p10
    s8p7_PortIf1: invalidation-policy{data-element=s8p7_PortIf1/Val, handle-invalid=DONT-INVALIDATE}
      data Val: sw-calibration-access=READ-ONLY, type=s8p7
    u8p8_PortIf1: invalidation-policy{data-element=u8p8_PortIf1/Val, handle-invalid=DONT-INVALIDATE}
      data Val: sw-calibration-access=READ-ONLY, type=u8p8
package /Predefined_DEV/PortInterfaces
  42 x client server interface:
    NvMAdministration: is-service=true
      operation SetBlockProtection: possible-error=NvMAdministration/E_NOT_OK
        arg ProtectionEnabled: type=boolean, direction=IN, server-argument-impl-policy=USE-ARGUMENT-TYPE
      error E_NOT_OK: error-code=1
    NvMNotifyInitBlock: is-service=true
      operation InitBlock
    NvMNotifyJobFinished: is-service=true
      operation JobFinished
        arg ServiceId: type=NvM_ServiceIdType, direction=IN, server-argument-impl-policy=USE-ARGUMENT-TYPE
        arg JobResult: type=NvM_RequestResultType, direction=IN, server-argument-impl-policy=USE-ARGUMENT-TYPE
    NvMService: is-service=true
      operation GetErrorStatus: possible-error=NvMService/E_NOT_OK
        arg ErrorStatus: type=NvM_RequestResultType, direction=OUT, server-argument-impl-policy=USE-ARGUMENT-TYPE
      error E_NOT_OK: error-code=1
    NvMService_AC2: is-service=true
      operation GetErrorStatus: possible-error=NvMService_AC2/E_NOT_OK
        arg ErrorStatus: type=NvM_RequestResultType, direction=OUT, server-argument-impl-policy=USE-ARGUMENT-TYPE
      operation ReadBlock: possible-error=NvMService_AC2/E_NOT_OK
        arg DstPtr: type=dtRef_VOID, direction=IN, server-argument-impl-policy=USE-ARGUMENT-TYPE
      operation WriteBlock: possible-error=NvMService_AC2/E_NOT_OK
        arg SrcPtr: type=dtRef_const_VOID, direction=IN, server-argument-impl-policy=USE-ARGUMENT-TYPE
      error E_NOT_OK: error-code=1
    NvMService_AC2_Defs: is-service=true
      4 x operation, all with possible-error=NvMService_AC2_Defs/E_NOT_OK:
        GetErrorStatus
          arg ErrorStatus: type=NvM_RequestResultType, direction=OUT, server-argument-impl-policy=USE-ARGUMENT-TYPE
        ReadBlock
          arg DstPtr: type=dtRef_VOID, direction=IN, server-argument-impl-policy=USE-ARGUMENT-TYPE
        RestoreBlockDefaults
          arg DstPtr: type=dtRef_VOID, direction=IN, server-argument-impl-policy=USE-ARGUMENT-TYPE
        WriteBlock
          arg SrcPtr: type=dtRef_const_VOID, direction=IN, server-argument-impl-policy=USE-ARGUMENT-TYPE
      error E_NOT_OK: error-code=1
    NvMService_AC2_DS: is-service=true
      5 x operation, all with possible-error=NvMService_AC2_DS/E_NOT_OK:
        GetDataIndex
          arg DataIndex: type=uint8, direction=OUT, server-argument-impl-policy=USE-ARGUMENT-TYPE
        GetErrorStatus
          arg ErrorStatus: type=NvM_RequestResultType, direction=OUT, server-argument-impl-policy=USE-ARGUMENT-TYPE
        ReadBlock
          arg DstPtr: type=dtRef_VOID, direction=IN, server-argument-impl-policy=USE-ARGUMENT-TYPE
        SetDataIndex
          arg DataIndex: type=uint8, direction=IN, server-argument-impl-policy=USE-ARGUMENT-TYPE
        WriteBlock
          arg SrcPtr: type=dtRef_const_VOID, direction=IN, server-argument-impl-policy=USE-ARGUMENT-TYPE
      error E_NOT_OK: error-code=1
    NvMService_AC2_DS_Defs: is-service=true
      6 x operation, all with possible-error=NvMService_AC2_DS_Defs/E_NOT_OK:
        GetDataIndex
          arg DataIndex: type=uint8, direction=OUT, server-argument-impl-policy=USE-ARGUMENT-TYPE
        GetErrorStatus
          arg ErrorStatus: type=NvM_RequestResultType, direction=OUT, server-argument-impl-policy=USE-ARGUMENT-TYPE
        ReadBlock
          arg DstPtr: type=dtRef_VOID, direction=IN, server-argument-impl-policy=USE-ARGUMENT-TYPE
        RestoreBlockDefaults
          arg DstPtr: type=dtRef_VOID, direction=IN, server-argument-impl-policy=USE-ARGUMENT-TYPE
        SetDataIndex
          arg DataIndex: type=uint8, direction=IN, server-argument-impl-policy=USE-ARGUMENT-TYPE
        WriteBlock
          arg SrcPtr: type=dtRef_const_VOID, direction=IN, server-argument-impl-policy=USE-ARGUMENT-TYPE
      error E_NOT_OK: error-code=1
    NvMService_AC2_SRBS: is-service=true
      4 x operation, all with possible-error=NvMService_AC2_SRBS/E_NOT_OK:
        GetErrorStatus
          arg ErrorStatus: type=NvM_RequestResultType, direction=OUT, server-argument-impl-policy=USE-ARGUMENT-TYPE
        ReadBlock
          arg DstPtr: type=dtRef_VOID, direction=IN, server-argument-impl-policy=USE-ARGUMENT-TYPE
        SetRamBlockStatus
          arg RamBlockStatus: type=boolean, direction=IN, server-argument-impl-policy=USE-ARGUMENT-TYPE
        WriteBlock
          arg SrcPtr: type=dtRef_const_VOID, direction=IN, server-argument-impl-policy=USE-ARGUMENT-TYPE
      error E_NOT_OK: error-code=1
    NvMService_AC2_SRBS_Defs: is-service=true
      5 x operation, all with possible-error=NvMService_AC2_SRBS_Defs/E_NOT_OK:
        GetErrorStatus
          arg ErrorStatus: type=NvM_RequestResultType, direction=OUT, server-argument-impl-policy=USE-ARGUMENT-TYPE
        ReadBlock
          arg DstPtr: type=dtRef_VOID, direction=IN, server-argument-impl-policy=USE-ARGUMENT-TYPE
        RestoreBlockDefaults
          arg DstPtr: type=dtRef_VOID, direction=IN, server-argument-impl-policy=USE-ARGUMENT-TYPE
        SetRamBlockStatus
          arg RamBlockStatus: type=boolean, direction=IN, server-argument-impl-policy=USE-ARGUMENT-TYPE
        WriteBlock
          arg SrcPtr: type=dtRef_const_VOID, direction=IN, server-argument-impl-policy=USE-ARGUMENT-TYPE
      error E_NOT_OK: error-code=1
    NvMService_AC2_SRBS_DS: is-service=true
      6 x operation, all with possible-error=NvMService_AC2_SRBS_DS/E_NOT_OK:
        GetDataIndex
          arg DataIndex: type=uint8, direction=OUT, server-argument-impl-policy=USE-ARGUMENT-TYPE
        GetErrorStatus
          arg ErrorStatus: type=NvM_RequestResultType, direction=OUT, server-argument-impl-policy=USE-ARGUMENT-TYPE
        ReadBlock
          arg DstPtr: type=dtRef_VOID, direction=IN, server-argument-impl-policy=USE-ARGUMENT-TYPE
        SetDataIndex
          arg DataIndex: type=uint8, direction=IN, server-argument-impl-policy=USE-ARGUMENT-TYPE
        SetRamBlockStatus
          arg RamBlockStatus: type=boolean, direction=IN, server-argument-impl-policy=USE-ARGUMENT-TYPE
        WriteBlock
          arg SrcPtr: type=dtRef_const_VOID, direction=IN, server-argument-impl-policy=USE-ARGUMENT-TYPE
      error E_NOT_OK: error-code=1
    NvMService_AC2_SRBS_DS_Defs: is-service=true
      7 x operation, all with possible-error=NvMService_AC2_SRBS_DS_Defs/E_NOT_OK:
        GetDataIndex
          arg DataIndex: type=uint8, direction=OUT, server-argument-impl-policy=USE-ARGUMENT-TYPE
        GetErrorStatus
          arg ErrorStatus: type=NvM_RequestResultType, direction=OUT, server-argument-impl-policy=USE-ARGUMENT-TYPE
        ReadBlock
          arg DstPtr: type=dtRef_VOID, direction=IN, server-argument-impl-policy=USE-ARGUMENT-TYPE
        RestoreBlockDefaults
          arg DstPtr: type=dtRef_VOID, direction=IN, server-argument-impl-policy=USE-ARGUMENT-TYPE
        SetDataIndex
          arg DataIndex: type=uint8, direction=IN, server-argument-impl-policy=USE-ARGUMENT-TYPE
        SetRamBlockStatus
          arg RamBlockStatus: type=boolean, direction=IN, server-argument-impl-policy=USE-ARGUMENT-TYPE
        WriteBlock
          arg SrcPtr: type=dtRef_const_VOID, direction=IN, server-argument-impl-policy=USE-ARGUMENT-TYPE
      error E_NOT_OK: error-code=1
    NvMService_AC3: is-service=true
      5 x operation, all with possible-error=NvMService_AC3/E_NOT_OK:
        EraseBlock
        GetErrorStatus
          arg ErrorStatus: type=NvM_RequestResultType, direction=OUT, server-argument-impl-policy=USE-ARGUMENT-TYPE
        InvalidateNvBlock
        ReadBlock
          arg DstPtr: type=dtRef_VOID, direction=IN, server-argument-impl-policy=USE-ARGUMENT-TYPE
        WriteBlock
          arg SrcPtr: type=dtRef_const_VOID, direction=IN, server-argument-impl-policy=USE-ARGUMENT-TYPE
      error E_NOT_OK: error-code=1
    NvMService_AC3_Defs: is-service=true
      6 x operation, all with possible-error=NvMService_AC3_Defs/E_NOT_OK:
        EraseBlock
        GetErrorStatus
          arg ErrorStatus: type=NvM_RequestResultType, direction=OUT, server-argument-impl-policy=USE-ARGUMENT-TYPE
        InvalidateNvBlock
        ReadBlock
          arg DstPtr: type=dtRef_VOID, direction=IN, server-argument-impl-policy=USE-ARGUMENT-TYPE
        RestoreBlockDefaults
          arg DstPtr: type=dtRef_VOID, direction=IN, server-argument-impl-policy=USE-ARGUMENT-TYPE
        WriteBlock
          arg SrcPtr: type=dtRef_const_VOID, direction=IN, server-argument-impl-policy=USE-ARGUMENT-TYPE
      error E_NOT_OK: error-code=1
    NvMService_AC3_DS: is-service=true
      7 x operation, all with possible-error=NvMService_AC3_DS/E_NOT_OK:
        EraseBlock
        GetDataIndex
          arg DataIndex: type=uint8, direction=OUT, server-argument-impl-policy=USE-ARGUMENT-TYPE
        GetErrorStatus
          arg ErrorStatus: type=NvM_RequestResultType, direction=OUT, server-argument-impl-policy=USE-ARGUMENT-TYPE
        InvalidateNvBlock
        ReadBlock
          arg DstPtr: type=dtRef_VOID, direction=IN, server-argument-impl-policy=USE-ARGUMENT-TYPE
        SetDataIndex
          arg DataIndex: type=uint8, direction=IN, server-argument-impl-policy=USE-ARGUMENT-TYPE
        WriteBlock
          arg SrcPtr: type=dtRef_const_VOID, direction=IN, server-argument-impl-policy=USE-ARGUMENT-TYPE
      error E_NOT_OK: error-code=1
    NvMService_AC3_DS_Defs: is-service=true
      8 x operation, all with possible-error=NvMService_AC3_DS_Defs/E_NOT_OK:
        EraseBlock
        GetDataIndex
          arg DataIndex: type=uint8, direction=OUT, server-argument-impl-policy=USE-ARGUMENT-TYPE
        GetErrorStatus
          arg ErrorStatus: type=NvM_RequestResultType, direction=OUT, server-argument-impl-policy=USE-ARGUMENT-TYPE
        InvalidateNvBlock
        ReadBlock
          arg DstPtr: type=dtRef_VOID, direction=IN, server-argument-impl-policy=USE-ARGUMENT-TYPE
        RestoreBlockDefaults
          arg DstPtr: type=dtRef_VOID, direction=IN, server-argument-impl-policy=USE-ARGUMENT-TYPE
        SetDataIndex
          arg DataIndex: type=uint8, direction=IN, server-argument-impl-policy=USE-ARGUMENT-TYPE
        WriteBlock
          arg SrcPtr: type=dtRef_const_VOID, direction=IN, server-argument-impl-policy=USE-ARGUMENT-TYPE
      error E_NOT_OK: error-code=1
    NvMService_AC3_SRBS: is-service=true
      6 x operation, all with possible-error=NvMService_AC3_SRBS/E_NOT_OK:
        EraseBlock
        GetErrorStatus
          arg ErrorStatus: type=NvM_RequestResultType, direction=OUT, server-argument-impl-policy=USE-ARGUMENT-TYPE
        InvalidateNvBlock
        ReadBlock
          arg DstPtr: type=dtRef_VOID, direction=IN, server-argument-impl-policy=USE-ARGUMENT-TYPE
        SetRamBlockStatus
          arg RamBlockStatus: type=boolean, direction=IN, server-argument-impl-policy=USE-ARGUMENT-TYPE
        WriteBlock
          arg SrcPtr: type=dtRef_const_VOID, direction=IN, server-argument-impl-policy=USE-ARGUMENT-TYPE
      error E_NOT_OK: error-code=1
    NvMService_AC3_SRBS_Defs: is-service=true
      7 x operation, all with possible-error=NvMService_AC3_SRBS_Defs/E_NOT_OK:
        EraseBlock
        GetErrorStatus
          arg ErrorStatus: type=NvM_RequestResultType, direction=OUT, server-argument-impl-policy=USE-ARGUMENT-TYPE
        InvalidateNvBlock
        ReadBlock
          arg DstPtr: type=dtRef_VOID, direction=IN, server-argument-impl-policy=USE-ARGUMENT-TYPE
        RestoreBlockDefaults
          arg DstPtr: type=dtRef_VOID, direction=IN, server-argument-impl-policy=USE-ARGUMENT-TYPE
        SetRamBlockStatus
          arg RamBlockStatus: type=boolean, direction=IN, server-argument-impl-policy=USE-ARGUMENT-TYPE
        WriteBlock
          arg SrcPtr: type=dtRef_const_VOID, direction=IN, server-argument-impl-policy=USE-ARGUMENT-TYPE
      error E_NOT_OK: error-code=1
    NvMService_AC3_SRBS_DS: is-service=true
      8 x operation, all with possible-error=NvMService_AC3_SRBS_DS/E_NOT_OK:
        EraseBlock
        GetDataIndex
          arg DataIndex: type=uint8, direction=OUT, server-argument-impl-policy=USE-ARGUMENT-TYPE
        GetErrorStatus
          arg ErrorStatus: type=NvM_RequestResultType, direction=OUT, server-argument-impl-policy=USE-ARGUMENT-TYPE
        InvalidateNvBlock
        ReadBlock
          arg DstPtr: type=dtRef_VOID, direction=IN, server-argument-impl-policy=USE-ARGUMENT-TYPE
        SetDataIndex
          arg DataIndex: type=uint8, direction=IN, server-argument-impl-policy=USE-ARGUMENT-TYPE
        SetRamBlockStatus
          arg RamBlockStatus: type=boolean, direction=IN, server-argument-impl-policy=USE-ARGUMENT-TYPE
        WriteBlock
          arg SrcPtr: type=dtRef_const_VOID, direction=IN, server-argument-impl-policy=USE-ARGUMENT-TYPE
      error E_NOT_OK: error-code=1
    NvMService_AC3_SRBS_DS_Defs: is-service=true
      9 x operation, all with possible-error=NvMService_AC3_SRBS_DS_Defs/E_NOT_OK:
        EraseBlock
        GetDataIndex
          arg DataIndex: type=uint8, direction=OUT, server-argument-impl-policy=USE-ARGUMENT-TYPE
        GetErrorStatus
          arg ErrorStatus: type=NvM_RequestResultType, direction=OUT, server-argument-impl-policy=USE-ARGUMENT-TYPE
        InvalidateNvBlock
        ReadBlock
          arg DstPtr: type=dtRef_VOID, direction=IN, server-argument-impl-policy=USE-ARGUMENT-TYPE
        RestoreBlockDefaults
          arg DstPtr: type=dtRef_VOID, direction=IN, server-argument-impl-policy=USE-ARGUMENT-TYPE
        SetDataIndex
          arg DataIndex: type=uint8, direction=IN, server-argument-impl-policy=USE-ARGUMENT-TYPE
        SetRamBlockStatus
          arg RamBlockStatus: type=boolean, direction=IN, server-argument-impl-policy=USE-ARGUMENT-TYPE
        WriteBlock
          arg SrcPtr: type=dtRef_const_VOID, direction=IN, server-argument-impl-policy=USE-ARGUMENT-TYPE
      error E_NOT_OK: error-code=1
    NvMService_SRBS: is-service=true
      operation GetErrorStatus: possible-error=NvMService_SRBS/E_NOT_OK
        arg ErrorStatus: type=NvM_RequestResultType, direction=OUT, server-argument-impl-policy=USE-ARGUMENT-TYPE
      operation SetRamBlockStatus: possible-error=NvMService_SRBS/E_NOT_OK
        arg RamBlockStatus: type=boolean, direction=IN, server-argument-impl-policy=USE-ARGUMENT-TYPE
      error E_NOT_OK: error-code=1
    NvSWC_NvMAdministration
      operation SetBlockProtection: possible-error=NvSWC_NvMAdministration/E_NOT_OK
        arg ProtectionEnabled: type=boolean, direction=IN, server-argument-impl-policy=USE-ARGUMENT-TYPE
      error E_NOT_OK: error-code=1
    NvSWC_NvMNotifyInitBlock
      operation InitBlock
    NvSWC_NvMNotifyJobFinished
      operation JobFinished
        arg ServiceId: type=NvM_ServiceIdType, direction=IN, server-argument-impl-policy=USE-ARGUMENT-TYPE
        arg JobResult: type=NvM_RequestResultType, direction=IN, server-argument-impl-policy=USE-ARGUMENT-TYPE
    NvSWC_NvMService
      operation GetErrorStatus: possible-error=NvSWC_NvMService/E_NOT_OK
        arg ErrorStatus: type=NvM_RequestResultType, direction=OUT, server-argument-impl-policy=USE-ARGUMENT-TYPE
      error E_NOT_OK: error-code=1
    NvSWC_NvMService_AC2
      operation GetErrorStatus: possible-error=NvSWC_NvMService_AC2/E_NOT_OK
        arg ErrorStatus: type=NvM_RequestResultType, direction=OUT, server-argument-impl-policy=USE-ARGUMENT-TYPE
      operation ReadBlock: possible-error=NvSWC_NvMService_AC2/E_NOT_OK
        arg DstPtr: type=dtRef_VOID, direction=IN, server-argument-impl-policy=USE-ARGUMENT-TYPE
      operation WriteBlock: possible-error=NvSWC_NvMService_AC2/E_NOT_OK
        arg SrcPtr: type=dtRef_const_VOID, direction=IN, server-argument-impl-policy=USE-ARGUMENT-TYPE
      error E_NOT_OK: error-code=1
    NvSWC_NvMService_AC2_Defs
      4 x operation, all with possible-error=NvSWC_NvMService_AC2_Defs/E_NOT_OK:
        GetErrorStatus
          arg ErrorStatus: type=NvM_RequestResultType, direction=OUT, server-argument-impl-policy=USE-ARGUMENT-TYPE
        ReadBlock
          arg DstPtr: type=dtRef_VOID, direction=IN, server-argument-impl-policy=USE-ARGUMENT-TYPE
        RestoreBlockDefaults
          arg DstPtr: type=dtRef_VOID, direction=IN, server-argument-impl-policy=USE-ARGUMENT-TYPE
        WriteBlock
          arg SrcPtr: type=dtRef_const_VOID, direction=IN, server-argument-impl-policy=USE-ARGUMENT-TYPE
      error E_NOT_OK: error-code=1
    NvSWC_NvMService_AC2_DS
      5 x operation, all with possible-error=NvSWC_NvMService_AC2_DS/E_NOT_OK:
        GetDataIndex
          arg DataIndex: type=uint8, direction=OUT, server-argument-impl-policy=USE-ARGUMENT-TYPE
        GetErrorStatus
          arg ErrorStatus: type=NvM_RequestResultType, direction=OUT, server-argument-impl-policy=USE-ARGUMENT-TYPE
        ReadBlock
          arg DstPtr: type=dtRef_VOID, direction=IN, server-argument-impl-policy=USE-ARGUMENT-TYPE
        SetDataIndex
          arg DataIndex: type=uint8, direction=IN, server-argument-impl-policy=USE-ARGUMENT-TYPE
        WriteBlock
          arg SrcPtr: type=dtRef_const_VOID, direction=IN, server-argument-impl-policy=USE-ARGUMENT-TYPE
      error E_NOT_OK: error-code=1
    NvSWC_NvMService_AC2_DS_Defs
      6 x operation, all with possible-error=NvSWC_NvMService_AC2_DS_Defs/E_NOT_OK:
        GetDataIndex
          arg DataIndex: type=uint8, direction=OUT, server-argument-impl-policy=USE-ARGUMENT-TYPE
        GetErrorStatus
          arg ErrorStatus: type=NvM_RequestResultType, direction=OUT, server-argument-impl-policy=USE-ARGUMENT-TYPE
        ReadBlock
          arg DstPtr: type=dtRef_VOID, direction=IN, server-argument-impl-policy=USE-ARGUMENT-TYPE
        RestoreBlockDefaults
          arg DstPtr: type=dtRef_VOID, direction=IN, server-argument-impl-policy=USE-ARGUMENT-TYPE
        SetDataIndex
          arg DataIndex: type=uint8, direction=IN, server-argument-impl-policy=USE-ARGUMENT-TYPE
        WriteBlock
          arg SrcPtr: type=dtRef_const_VOID, direction=IN, server-argument-impl-policy=USE-ARGUMENT-TYPE
      error E_NOT_OK: error-code=1
    NvSWC_NvMService_AC2_SRBS
      4 x operation, all with possible-error=NvSWC_NvMService_AC2_SRBS/E_NOT_OK:
        GetErrorStatus
          arg ErrorStatus: type=NvM_RequestResultType, direction=OUT, server-argument-impl-policy=USE-ARGUMENT-TYPE
        ReadBlock
          arg DstPtr: type=dtRef_VOID, direction=IN, server-argument-impl-policy=USE-ARGUMENT-TYPE
        SetRamBlockStatus
          arg RamBlockStatus: type=boolean, direction=IN, server-argument-impl-policy=USE-ARGUMENT-TYPE
        WriteBlock
          arg SrcPtr: type=dtRef_const_VOID, direction=IN, server-argument-impl-policy=USE-ARGUMENT-TYPE
      error E_NOT_OK: error-code=1
    NvSWC_NvMService_AC2_SRBS_Defs
      5 x operation, all with possible-error=NvSWC_NvMService_AC2_SRBS_Defs/E_NOT_OK:
        GetErrorStatus
          arg ErrorStatus: type=NvM_RequestResultType, direction=OUT, server-argument-impl-policy=USE-ARGUMENT-TYPE
        ReadBlock
          arg DstPtr: type=dtRef_VOID, direction=IN, server-argument-impl-policy=USE-ARGUMENT-TYPE
        RestoreBlockDefaults
          arg DstPtr: type=dtRef_VOID, direction=IN, server-argument-impl-policy=USE-ARGUMENT-TYPE
        SetRamBlockStatus
          arg RamBlockStatus: type=boolean, direction=IN, server-argument-impl-policy=USE-ARGUMENT-TYPE
        WriteBlock
          arg SrcPtr: type=dtRef_const_VOID, direction=IN, server-argument-impl-policy=USE-ARGUMENT-TYPE
      error E_NOT_OK: error-code=1
    NvSWC_NvMService_AC2_SRBS_DS
      6 x operation, all with possible-error=NvSWC_NvMService_AC2_SRBS_DS/E_NOT_OK:
        GetDataIndex
          arg DataIndex: type=uint8, direction=OUT, server-argument-impl-policy=USE-ARGUMENT-TYPE
        GetErrorStatus
          arg ErrorStatus: type=NvM_RequestResultType, direction=OUT, server-argument-impl-policy=USE-ARGUMENT-TYPE
        ReadBlock
          arg DstPtr: type=dtRef_VOID, direction=IN, server-argument-impl-policy=USE-ARGUMENT-TYPE
        SetDataIndex
          arg DataIndex: type=uint8, direction=IN, server-argument-impl-policy=USE-ARGUMENT-TYPE
        SetRamBlockStatus
          arg RamBlockStatus: type=boolean, direction=IN, server-argument-impl-policy=USE-ARGUMENT-TYPE
        WriteBlock
          arg SrcPtr: type=dtRef_const_VOID, direction=IN, server-argument-impl-policy=USE-ARGUMENT-TYPE
      error E_NOT_OK: error-code=1
    NvSWC_NvMService_AC2_SRBS_DS_Defs
      7 x operation, all with possible-error=NvSWC_NvMService_AC2_SRBS_DS_Defs/E_NOT_OK:
        GetDataIndex
          arg DataIndex: type=uint8, direction=OUT, server-argument-impl-policy=USE-ARGUMENT-TYPE
        GetErrorStatus
          arg ErrorStatus: type=NvM_RequestResultType, direction=OUT, server-argument-impl-policy=USE-ARGUMENT-TYPE
        ReadBlock
          arg DstPtr: type=dtRef_VOID, direction=IN, server-argument-impl-policy=USE-ARGUMENT-TYPE
        RestoreBlockDefaults
          arg DstPtr: type=dtRef_VOID, direction=IN, server-argument-impl-policy=USE-ARGUMENT-TYPE
        SetDataIndex
          arg DataIndex: type=uint8, direction=IN, server-argument-impl-policy=USE-ARGUMENT-TYPE
        SetRamBlockStatus
          arg RamBlockStatus: type=boolean, direction=IN, server-argument-impl-policy=USE-ARGUMENT-TYPE
        WriteBlock
          arg SrcPtr: type=dtRef_const_VOID, direction=IN, server-argument-impl-policy=USE-ARGUMENT-TYPE
      error E_NOT_OK: error-code=1
    NvSWC_NvMService_AC3
      5 x operation, all with possible-error=NvSWC_NvMService_AC3/E_NOT_OK:
        EraseBlock
        GetErrorStatus
          arg ErrorStatus: type=NvM_RequestResultType, direction=OUT, server-argument-impl-policy=USE-ARGUMENT-TYPE
        InvalidateNvBlock
        ReadBlock
          arg DstPtr: type=dtRef_VOID, direction=IN, server-argument-impl-policy=USE-ARGUMENT-TYPE
        WriteBlock
          arg SrcPtr: type=dtRef_const_VOID, direction=IN, server-argument-impl-policy=USE-ARGUMENT-TYPE
      error E_NOT_OK: error-code=1
    NvSWC_NvMService_AC3_Defs
      6 x operation, all with possible-error=NvSWC_NvMService_AC3_Defs/E_NOT_OK:
        EraseBlock
        GetErrorStatus
          arg ErrorStatus: type=NvM_RequestResultType, direction=OUT, server-argument-impl-policy=USE-ARGUMENT-TYPE
        InvalidateNvBlock
        ReadBlock
          arg DstPtr: type=dtRef_VOID, direction=IN, server-argument-impl-policy=USE-ARGUMENT-TYPE
        RestoreBlockDefaults
          arg DstPtr: type=dtRef_VOID, direction=IN, server-argument-impl-policy=USE-ARGUMENT-TYPE
        WriteBlock
          arg SrcPtr: type=dtRef_const_VOID, direction=IN, server-argument-impl-policy=USE-ARGUMENT-TYPE
      error E_NOT_OK: error-code=1
    NvSWC_NvMService_AC3_DS
      7 x operation, all with possible-error=NvSWC_NvMService_AC3_DS/E_NOT_OK:
        EraseBlock
        GetDataIndex
          arg DataIndex: type=uint8, direction=OUT, server-argument-impl-policy=USE-ARGUMENT-TYPE
        GetErrorStatus
          arg ErrorStatus: type=NvM_RequestResultType, direction=OUT, server-argument-impl-policy=USE-ARGUMENT-TYPE
        InvalidateNvBlock
        ReadBlock
          arg DstPtr: type=dtRef_VOID, direction=IN, server-argument-impl-policy=USE-ARGUMENT-TYPE
        SetDataIndex
          arg DataIndex: type=uint8, direction=IN, server-argument-impl-policy=USE-ARGUMENT-TYPE
        WriteBlock
          arg SrcPtr: type=dtRef_const_VOID, direction=IN, server-argument-impl-policy=USE-ARGUMENT-TYPE
      error E_NOT_OK: error-code=1
    NvSWC_NvMService_AC3_DS_Defs
      8 x operation, all with possible-error=NvSWC_NvMService_AC3_DS_Defs/E_NOT_OK:
        EraseBlock
        GetDataIndex
          arg DataIndex: type=uint8, direction=OUT, server-argument-impl-policy=USE-ARGUMENT-TYPE
        GetErrorStatus
          arg ErrorStatus: type=NvM_RequestResultType, direction=OUT, server-argument-impl-policy=USE-ARGUMENT-TYPE
        InvalidateNvBlock
        ReadBlock
          arg DstPtr: type=dtRef_VOID, direction=IN, server-argument-impl-policy=USE-ARGUMENT-TYPE
        RestoreBlockDefaults
          arg DstPtr: type=dtRef_VOID, direction=IN, server-argument-impl-policy=USE-ARGUMENT-TYPE
        SetDataIndex
          arg DataIndex: type=uint8, direction=IN, server-argument-impl-policy=USE-ARGUMENT-TYPE
        WriteBlock
          arg SrcPtr: type=dtRef_const_VOID, direction=IN, server-argument-impl-policy=USE-ARGUMENT-TYPE
      error E_NOT_OK: error-code=1
    NvSWC_NvMService_AC3_SRBS
      6 x operation, all with possible-error=NvSWC_NvMService_AC3_SRBS/E_NOT_OK:
        EraseBlock
        GetErrorStatus
          arg ErrorStatus: type=NvM_RequestResultType, direction=OUT, server-argument-impl-policy=USE-ARGUMENT-TYPE
        InvalidateNvBlock
        ReadBlock
          arg DstPtr: type=dtRef_VOID, direction=IN, server-argument-impl-policy=USE-ARGUMENT-TYPE
        SetRamBlockStatus
          arg RamBlockStatus: type=boolean, direction=IN, server-argument-impl-policy=USE-ARGUMENT-TYPE
        WriteBlock
          arg SrcPtr: type=dtRef_const_VOID, direction=IN, server-argument-impl-policy=USE-ARGUMENT-TYPE
      error E_NOT_OK: error-code=1
    NvSWC_NvMService_AC3_SRBS_Defs
      7 x operation, all with possible-error=NvSWC_NvMService_AC3_SRBS_Defs/E_NOT_OK:
        EraseBlock
        GetErrorStatus
          arg ErrorStatus: type=NvM_RequestResultType, direction=OUT, server-argument-impl-policy=USE-ARGUMENT-TYPE
        InvalidateNvBlock
        ReadBlock
          arg DstPtr: type=dtRef_VOID, direction=IN, server-argument-impl-policy=USE-ARGUMENT-TYPE
        RestoreBlockDefaults
          arg DstPtr: type=dtRef_VOID, direction=IN, server-argument-impl-policy=USE-ARGUMENT-TYPE
        SetRamBlockStatus
          arg RamBlockStatus: type=boolean, direction=IN, server-argument-impl-policy=USE-ARGUMENT-TYPE
        WriteBlock
          arg SrcPtr: type=dtRef_const_VOID, direction=IN, server-argument-impl-policy=USE-ARGUMENT-TYPE
      error E_NOT_OK: error-code=1
    NvSWC_NvMService_AC3_SRBS_DS
      8 x operation, all with possible-error=NvSWC_NvMService_AC3_SRBS_DS/E_NOT_OK:
        EraseBlock
        GetDataIndex
          arg DataIndex: type=uint8, direction=OUT, server-argument-impl-policy=USE-ARGUMENT-TYPE
        GetErrorStatus
          arg ErrorStatus: type=NvM_RequestResultType, direction=OUT, server-argument-impl-policy=USE-ARGUMENT-TYPE
        InvalidateNvBlock
        ReadBlock
          arg DstPtr: type=dtRef_VOID, direction=IN, server-argument-impl-policy=USE-ARGUMENT-TYPE
        SetDataIndex
          arg DataIndex: type=uint8, direction=IN, server-argument-impl-policy=USE-ARGUMENT-TYPE
        SetRamBlockStatus
          arg RamBlockStatus: type=boolean, direction=IN, server-argument-impl-policy=USE-ARGUMENT-TYPE
        WriteBlock
          arg SrcPtr: type=dtRef_const_VOID, direction=IN, server-argument-impl-policy=USE-ARGUMENT-TYPE
      error E_NOT_OK: error-code=1
    NvSWC_NvMService_AC3_SRBS_DS_Defs
      9 x operation, all with possible-error=NvSWC_NvMService_AC3_SRBS_DS_Defs/E_NOT_OK:
        EraseBlock
        GetDataIndex
          arg DataIndex: type=uint8, direction=OUT, server-argument-impl-policy=USE-ARGUMENT-TYPE
        GetErrorStatus
          arg ErrorStatus: type=NvM_RequestResultType, direction=OUT, server-argument-impl-policy=USE-ARGUMENT-TYPE
        InvalidateNvBlock
        ReadBlock
          arg DstPtr: type=dtRef_VOID, direction=IN, server-argument-impl-policy=USE-ARGUMENT-TYPE
        RestoreBlockDefaults
          arg DstPtr: type=dtRef_VOID, direction=IN, server-argument-impl-policy=USE-ARGUMENT-TYPE
        SetDataIndex
          arg DataIndex: type=uint8, direction=IN, server-argument-impl-policy=USE-ARGUMENT-TYPE
        SetRamBlockStatus
          arg RamBlockStatus: type=boolean, direction=IN, server-argument-impl-policy=USE-ARGUMENT-TYPE
        WriteBlock
          arg SrcPtr: type=dtRef_const_VOID, direction=IN, server-argument-impl-policy=USE-ARGUMENT-TYPE
      error E_NOT_OK: error-code=1
    NvSWC_NvMService_SRBS
      operation GetErrorStatus: possible-error=NvSWC_NvMService_SRBS/E_NOT_OK
        arg ErrorStatus: type=NvM_RequestResultType, direction=OUT, server-argument-impl-policy=USE-ARGUMENT-TYPE
      operation SetRamBlockStatus: possible-error=NvSWC_NvMService_SRBS/E_NOT_OK
        arg RamBlockStatus: type=boolean, direction=IN, server-argument-impl-policy=USE-ARGUMENT-TYPE
      error E_NOT_OK: error-code=1
