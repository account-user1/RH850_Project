AUTOSAR XML (schema 4-2-1)
package /Renesas/Port_ib_bswmd/BswModuleDescriptions
  bsw module description Port
    bsw internal behavior PortBehavior
      6 x exclusive area:
        PORT_SET_PIN_MODE_PROTECTION
        PORT_SET_PIN_DEFAULT_MODE_PROTECTION
        PORT_SET_PIN_DEFAULT_DIR_PROTECTION
        PORT_SET_PIN_DIR_PROTECTION
        PORT_SET_TO_DIO_ALT_PROTECTION
        PORT_REFRESHPORT_INTERNAL_PROTECTION
