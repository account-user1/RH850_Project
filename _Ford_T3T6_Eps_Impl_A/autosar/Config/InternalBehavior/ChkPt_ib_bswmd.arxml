AUTOSAR XML (schema 4-2-1)
package /Nexteer/ChkPt_ib_bswmd/BswModuleDescriptions
  bsw module description ChkPt: provided-entrys=[ChkPt_10msBswAppl10Strt, ChkPt_10msBswAppl10End]
    bsw internal behavior ChkPtBehavior
      bsw schedulable entity ChkPt_10msBswAppl10Strt: implemented-entry=ChkPt_10msBswAppl10Strt
      bsw schedulable entity ChkPt_10msBswAppl10End: implemented-entry=ChkPt_10msBswAppl10End
      bsw timing event ChkPt_10msBswAppl10StrtTimingEvent0: starts-on-event=ChkPt_10msBswAppl10Strt, period=0.01
      bsw timing event ChkPt_10msBswAppl10EndTimingEvent0: starts-on-event=ChkPt_10msBswAppl10End, period=0.01
  bsw module entry ChkPt_10msBswAppl10Strt: call-type=SCHEDULED, execution-context=TASK
  bsw module entry ChkPt_10msBswAppl10End: call-type=SCHEDULED, execution-context=TASK
