AUTOSAR XML (schema 4-2-1)
package /Nexteer/NvMProxy_ib_bswmd/BswModuleDescriptions
  bsw module description NvMProxy: provided-entrys=NvMProxy_MainFunction
    bsw internal behavior NvMProxyBehavior
      exclusive area NvMProxy_EXCLUSIVE_AREA_0
      bsw schedulable entity NvMProxy_MainFunction: implemented-entry=NvMProxy_MainFunction
      bsw timing event NvMProxy_MainFunctionTimingEvent0: starts-on-event=NvMProxy_MainFunction, period=0.01
  bsw module entry NvMProxy_MainFunction: call-type=SCHEDULED, execution-context=TASK
