AUTOSAR XML (schema 4-2-1)
package /ActiveEcuC
  module config FlsMem: implementation-config-variant=VARIANT-PRE-COMPILE
    ApplCRCRegnIdx: ApplCrcRegnNr=0
    3 x FlashCRCRegnConfig, all with StartingAddress=0, Length=0, PredefinedCrcAddress=4294967295, UseSymbolName=true:
      Application: StartingAddressSymbol=CCT_Range_01_Start, LengthSymbol=CCT_Range_01_Length, PredefinedCrcAddressSymbol=CCT_Range_01_Address
      NexteerCal: StartingAddressSymbol=CCT_Range_02_Start, LengthSymbol=CCT_Range_02_Length, PredefinedCrcAddressSymbol=CCT_Range_02_Address
      FordCal: StartingAddressSymbol=CCT_Range_03_Start, LengthSymbol=CCT_Range_03_Length, PredefinedCrcAddressSymbol=CCT_Range_03_Address
