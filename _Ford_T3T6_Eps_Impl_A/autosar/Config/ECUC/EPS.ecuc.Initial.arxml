[part 1 of 2: package /InitialEcuC]
AUTOSAR XML (schema 4-2-1)
package /InitialEcuC
  ecuc value collection InitialEcuC: ecuc-values=[Can, CanIf, CanSM, CanTp, Com, ComM, Dcm, Dem, EcuC, EcuM, PduR, Xcp]
  module config Can
    CanConfigSet
      CT_FD1_CAN_b4e1ca3b (CanController):
        CanControllerActivation = true
        CanControllerDefaultBaudrate = CanControllerBaudrateConfig
        CanWakeupSourceRef = EcuMCommonConfiguration/FD1_CAN_f26020e5
        CanControllerBaudrateConfig: CanControllerBaudRate=500
          CanControllerFdBaudrateConfig: CanControllerFdBaudRate=500
      CN_FD1_CAN_b4e1ca3b_Rx_Std (CanHardwareObject): CanHandleType=BASIC, CanIdType=STANDARD, CanIdValue=0, CanObjectType=RECEIVE, CanControllerRef=CanConfigSet/CT_FD1_CAN_b4e1ca3b
      CN_FD1_CAN_b4e1ca3b_Tx_Std (CanHardwareObject): CanHandleType=BASIC, CanIdType=STANDARD, CanIdValue=0, CanObjectType=TRANSMIT, CanControllerRef=CanConfigSet/CT_FD1_CAN_b4e1ca3b
    CanGeneral: CanIndex=0
  module config CanIf
    Can (CanIfCtrlDrvCfg): CanIfCtrlDrvInitHohConfigRef=CanIfInitHohCfg, CanIfCtrlDrvNameRef=CanGeneral
      CT_FD1_CAN_b4e1ca3b (CanIfCtrlCfg): CanIfCtrlCanCtrlRef=CanConfigSet/CT_FD1_CAN_b4e1ca3b
    CanIfInitCfg
      CanIfBufferCfg_Tx_Std_3290b631 (CanIfBufferCfg): CanIfBufferSize=0, CanIfBufferHthRef=CanIfInitHohCfg/CN_FD1_CAN_b4e1ca3b_Tx_Std
      CanIfInitHohCfg: CanIfInitRefCfgSet=CanConfigSet
        CN_FD1_CAN_b4e1ca3b_Rx_Std (CanIfHrhCfg): CanIfHrhCanCtrlIdRef=Can/CT_FD1_CAN_b4e1ca3b, CanIfHrhIdSymRef=CanConfigSet/CN_FD1_CAN_b4e1ca3b_Rx_Std
        CN_FD1_CAN_b4e1ca3b_Tx_Std (CanIfHthCfg): CanIfHthCanCtrlIdRef=Can/CT_FD1_CAN_b4e1ca3b, CanIfHthIdSymRef=CanConfigSet/CN_FD1_CAN_b4e1ca3b_Tx_Std
      45 x CanIfRxPduCfg, all with CanIfRxPduHrhIdRef=CanIfInitHohCfg/CN_FD1_CAN_b4e1ca3b_Rx_Std:
        ABS_BrkBst_Data_FD1_oFD1_CAN_Rx_3abd61be: CanIfRxPduCanId=1200, CanIfRxPduCanIdType=STANDARD_CAN, CanIfRxPduDlc=8, CanIfRxPduUserRxIndicationName=PduR_CanIfRxIndication, CanIfRxPduUserRxIndicationUL=PDUR, CanIfRxPduRef=PT_ABS_BrkBst_Data_FD1_PP_ABS_BrkBst_Data_FD1_Rx_3290b631_3cf8f7d5
        APIM_Send_Signals1_FD1_oFD1_CAN_Rx_3abd61be: CanIfRxPduCanId=1009, CanIfRxPduCanIdType=STANDARD_CAN, CanIfRxPduDlc=8, CanIfRxPduUserRxIndicationName=PduR_CanIfRxIndication, CanIfRxPduUserRxIndicationUL=PDUR, CanIfRxPduRef=PT_APIM_Send_Signals1_FD1_PP_APIM_Send_Signals1_FD1_Rx_3290b631_3cf8f7d5
        APIM_Send_Signals_2_FD1_oFD1_CAN_Rx_3abd61be: CanIfRxPduCanId=533, CanIfRxPduCanIdType=STANDARD_CAN, CanIfRxPduDlc=8, CanIfRxPduUserRxIndicationName=PduR_CanIfRxIndication, CanIfRxPduUserRxIndicationUL=PDUR, CanIfRxPduRef=PT_APIM_Send_Signals_2_FD1_PP_APIM_Send_Signals_2_FD1_Rx_3290b631_3cf8f7d5
        ActiveFrontStrg_Stat2_FD1_oFD1_CAN_Rx_3abd61be: CanIfRxPduCanId=138, CanIfRxPduCanIdType=STANDARD_CAN, CanIfRxPduDlc=8, CanIfRxPduUserRxIndicationName=PduR_CanIfRxIndication, CanIfRxPduUserRxIndicationUL=PDUR, CanIfRxPduRef=PT_ActiveFrontStrg_Stat2_FD1_PP_ActiveFrontStrg_Stat2_FD1_Rx_3290b631_3cf8f7d5
        BodyInfo_3_FD1_oFD1_CAN_Rx_3abd61be: CanIfRxPduCanId=947, CanIfRxPduCanIdType=STANDARD_CAN, CanIfRxPduDlc=8, CanIfRxPduUserRxIndicationName=PduR_CanIfRxIndication, CanIfRxPduUserRxIndicationUL=PDUR, CanIfRxPduRef=PT_BodyInfo_3_FD1_PP_BodyInfo_3_FD1_Rx_3290b631_3cf8f7d5
        Body_Info_4_FD1_oFD1_CAN_Rx_3abd61be: CanIfRxPduCanId=578, CanIfRxPduCanIdType=STANDARD_CAN, CanIfRxPduDlc=8, CanIfRxPduUserRxIndicationName=PduR_CanIfRxIndication, CanIfRxPduUserRxIndicationUL=PDUR, CanIfRxPduRef=PT_Body_Info_4_FD1_PP_Body_Info_4_FD1_Rx_3290b631_3cf8f7d5
        BrakeSnData_3_FD1_oFD1_CAN_Rx_3abd61be: CanIfRxPduCanId=119, CanIfRxPduCanIdType=STANDARD_CAN, CanIfRxPduDlc=8, CanIfRxPduUserRxIndicationName=PduR_CanIfRxIndication, CanIfRxPduUserRxIndicationUL=PDUR, CanIfRxPduRef=PT_BrakeSnData_3_FD1_PP_BrakeSnData_3_FD1_Rx_3290b631_3cf8f7d5
        BrakeSnData_4_FD1_oFD1_CAN_Rx_3abd61be: CanIfRxPduCanId=125, CanIfRxPduCanIdType=STANDARD_CAN, CanIfRxPduDlc=8, CanIfRxPduUserRxIndicationName=PduR_CanIfRxIndication, CanIfRxPduUserRxIndicationUL=PDUR, CanIfRxPduRef=PT_BrakeSnData_4_FD1_PP_BrakeSnData_4_FD1_Rx_3290b631_3cf8f7d5
        BrakeSnData_5_FD1_oFD1_CAN_Rx_3abd61be: CanIfRxPduCanId=118, CanIfRxPduCanIdType=STANDARD_CAN, CanIfRxPduDlc=8, CanIfRxPduUserRxIndicationName=PduR_CanIfRxIndication, CanIfRxPduUserRxIndicationUL=PDUR, CanIfRxPduRef=PT_BrakeSnData_5_FD1_PP_BrakeSnData_5_FD1_Rx_3290b631_3cf8f7d5
        BrakeSnData_6_FD1_oFD1_CAN_Rx_3abd61be: CanIfRxPduCanId=1044, CanIfRxPduCanIdType=STANDARD_CAN, CanIfRxPduDlc=8, CanIfRxPduUserRxIndicationName=PduR_CanIfRxIndication, CanIfRxPduUserRxIndicationUL=PDUR, CanIfRxPduRef=PT_BrakeSnData_6_FD1_PP_BrakeSnData_6_FD1_Rx_3290b631_3cf8f7d5
        BrakeSysFeatures_3_oFD1_CAN_Rx_3abd61be: CanIfRxPduCanId=1054, CanIfRxPduCanIdType=STANDARD_CAN, CanIfRxPduDlc=8, CanIfRxPduUserRxIndicationName=PduR_CanIfRxIndication, CanIfRxPduUserRxIndicationUL=PDUR, CanIfRxPduRef=PT_BrakeSysFeatures_3_PP_BrakeSysFeatures_3_Rx_3290b631_3cf8f7d5
        BrakeSysFeatures_FD1_oFD1_CAN_Rx_3abd61be: CanIfRxPduCanId=1045, CanIfRxPduCanIdType=STANDARD_CAN, CanIfRxPduDlc=8, CanIfRxPduUserRxIndicationName=PduR_CanIfRxIndication, CanIfRxPduUserRxIndicationUL=PDUR, CanIfRxPduRef=PT_BrakeSysFeatures_FD1_PP_BrakeSysFeatures_FD1_Rx_3290b631_3cf8f7d5
        Climate_Control_Data_FD1_oFD1_CAN_Rx_3abd61be: CanIfRxPduCanId=1050, CanIfRxPduCanIdType=STANDARD_CAN, CanIfRxPduDlc=8, CanIfRxPduUserRxIndicationName=PduR_CanIfRxIndication, CanIfRxPduUserRxIndicationUL=PDUR, CanIfRxPduRef=PT_Climate_Control_Data_FD1_PP_Climate_Control_Data_FD1_Rx_3290b631_3cf8f7d5
        Cluster_Info1_FD1_oFD1_CAN_Rx_3abd61be: CanIfRxPduCanId=1072, CanIfRxPduCanIdType=STANDARD_CAN, CanIfRxPduDlc=8, CanIfRxPduUserRxIndicationName=PduR_CanIfRxIndication, CanIfRxPduUserRxIndicationUL=PDUR, CanIfRxPduRef=PT_Cluster_Info1_FD1_PP_Cluster_Info1_FD1_Rx_3290b631_3cf8f7d5
        DesiredTorqBrk_FD1_oFD1_CAN_Rx_3abd61be: CanIfRxPduCanId=531, CanIfRxPduCanIdType=STANDARD_CAN, CanIfRxPduDlc=8, CanIfRxPduUserRxIndicationName=PduR_CanIfRxIndication, CanIfRxPduUserRxIndicationUL=PDUR, CanIfRxPduRef=PT_DesiredTorqBrk_FD1_PP_DesiredTorqBrk_FD1_Rx_3290b631_3cf8f7d5
        EngBrakeData_FD1_oFD1_CAN_Rx_3abd61be: CanIfRxPduCanId=357, CanIfRxPduCanIdType=STANDARD_CAN, CanIfRxPduDlc=8, CanIfRxPduUserRxIndicationName=PduR_CanIfRxIndication, CanIfRxPduUserRxIndicationUL=PDUR, CanIfRxPduRef=PT_EngBrakeData_FD1_PP_EngBrakeData_FD1_Rx_3290b631_3cf8f7d5
        EngVehicleSpThrottle2_FD1_oFD1_CAN_Rx_3abd61be: CanIfRxPduCanId=514, CanIfRxPduCanIdType=STANDARD_CAN, CanIfRxPduDlc=8, CanIfRxPduUserRxIndicationName=PduR_CanIfRxIndication, CanIfRxPduUserRxIndicationUL=PDUR, CanIfRxPduRef=PT_EngVehicleSpThrottle2_FD1_PP_EngVehicleSpThrottle2_FD1_Rx_3290b631_3cf8f7d5
        EngVehicleSpThrottle_FD1_oFD1_CAN_Rx_3abd61be: CanIfRxPduCanId=516, CanIfRxPduCanIdType=STANDARD_CAN, CanIfRxPduDlc=8, CanIfRxPduUserRxIndicationName=PduR_CanIfRxIndication, CanIfRxPduUserRxIndicationUL=PDUR, CanIfRxPduRef=PT_EngVehicleSpThrottle_FD1_PP_EngVehicleSpThrottle_FD1_Rx_3290b631_3cf8f7d5
        GGCC_Config_Mgmt_ID_1_FD1_oFD1_CAN_Rx_3abd61be: CanIfRxPduCanId=1034, CanIfRxPduCanIdType=STANDARD_CAN, CanIfRxPduDlc=8, CanIfRxPduUserRxIndicationName=PduR_CanIfRxIndication, CanIfRxPduUserRxIndicationUL=PDUR, CanIfRxPduRef=PT_GGCC_Config_Mgmt_ID_1_FD1_PP_GGCC_Config_Mgmt_ID_1_FD1_Rx_3290b631_3cf8f7d5
        Image_Processing_Data_FD1_oFD1_CAN_Rx_3abd61be: CanIfRxPduCanId=1105, CanIfRxPduCanIdType=STANDARD_CAN, CanIfRxPduDlc=8, CanIfRxPduUserRxIndicationName=PduR_CanIfRxIndication, CanIfRxPduUserRxIndicationUL=PDUR, CanIfRxPduRef=PT_Image_Processing_Data_FD1_PP_Image_Processing_Data_FD1_Rx_3290b631_3cf8f7d5
        Lane_Assist_Data1_FD1_oFD1_CAN_Rx_3abd61be: CanIfRxPduCanId=970, CanIfRxPduCanIdType=STANDARD_CAN, CanIfRxPduDlc=8, CanIfRxPduUserRxIndicationName=PduR_CanIfRxIndication, CanIfRxPduUserRxIndicationUL=PDUR, CanIfRxPduRef=PT_Lane_Assist_Data1_FD1_PP_Lane_Assist_Data1_FD1_Rx_3290b631_3cf8f7d5
        LateralMotionControl_FD1_oFD1_CAN_Rx_3abd61be: CanIfRxPduCanId=979, CanIfRxPduCanIdType=STANDARD_CAN, CanIfRxPduDlc=8, CanIfRxPduUserRxIndicationName=PduR_CanIfRxIndication, CanIfRxPduUserRxIndicationUL=PDUR, CanIfRxPduRef=PT_LateralMotionControl_FD1_PP_LateralMotionControl_FD1_Rx_3290b631_3cf8f7d5
        Mc_Send_Signals_2_FD1_oFD1_CAN_Rx_3abd61be: CanIfRxPduCanId=765, CanIfRxPduCanIdType=STANDARD_CAN, CanIfRxPduDlc=8, CanIfRxPduUserRxIndicationName=PduR_CanIfRxIndication, CanIfRxPduUserRxIndicationUL=PDUR, CanIfRxPduRef=PT_Mc_Send_Signals_2_FD1_PP_Mc_Send_Signals_2_FD1_Rx_3290b631_3cf8f7d5
        ParkAid_Data_FD1_oFD1_CAN_Rx_3abd61be: CanIfRxPduCanId=936, CanIfRxPduCanIdType=STANDARD_CAN, CanIfRxPduDlc=8, CanIfRxPduUserRxIndicationName=PduR_CanIfRxIndication, CanIfRxPduUserRxIndicationUL=PDUR, CanIfRxPduRef=PT_ParkAid_Data_FD1_PP_ParkAid_Data_FD1_Rx_3290b631_3cf8f7d5
        PowertrainData_10_FD1_oFD1_CAN_Rx_3abd61be: CanIfRxPduCanId=374, CanIfRxPduCanIdType=STANDARD_CAN, CanIfRxPduDlc=8, CanIfRxPduUserRxIndicationName=PduR_CanIfRxIndication, CanIfRxPduUserRxIndicationUL=PDUR, CanIfRxPduRef=PT_PowertrainData_10_FD1_PP_PowertrainData_10_FD1_Rx_3290b631_3cf8f7d5
        Steer_Assist_Data_FD1_oFD1_CAN_Rx_3abd61be: CanIfRxPduCanId=983, CanIfRxPduCanIdType=STANDARD_CAN, CanIfRxPduDlc=8, CanIfRxPduUserRxIndicationName=PduR_CanIfRxIndication, CanIfRxPduUserRxIndicationUL=PDUR, CanIfRxPduRef=PT_Steer_Assist_Data_FD1_PP_Steer_Assist_Data_FD1_Rx_3290b631_3cf8f7d5
        Steering_Data_FD1_oFD1_CAN_Rx_3abd61be: CanIfRxPduCanId=131, CanIfRxPduCanIdType=STANDARD_CAN, CanIfRxPduDlc=8, CanIfRxPduUserRxIndicationName=PduR_CanIfRxIndication, CanIfRxPduUserRxIndicationUL=PDUR, CanIfRxPduRef=PT_Steering_Data_FD1_PP_Steering_Data_FD1_Rx_3290b631_3cf8f7d5
        TesterFunctionalReq_FD1_Tp_oFD1_CAN_20_Rx_3abd61be: CanIfRxPduCanId=2015 if post-build-variant-condition{matching-criterion=Communication, value=0}, CanIfRxPduCanIdType=STANDARD_NO_FD_CAN, CanIfRxPduDlc=8, CanIfRxPduUserRxIndicationName=CanTp_RxIndication, CanIfRxPduUserRxIndicationType=PDUID_PDUINFOPTR, CanIfRxPduUserRxIndicationUL=CAN_TP, CanIfRxPduCanId=1759 if post-build-variant-condition{matching-criterion=Communication, value=1}, CanIfRxPduRef=PT_TesterFunctionalReq_FD1_Tp_20_PP_TesterFunctionalReq_FD1_Tp_Rx_20_3290b631_3cf8f7d5
        TesterFunctionalReq_FD1_Tp_oFD1_CAN_Rx_3abd61be: CanIfRxPduCanId=2015 if post-build-variant-condition{matching-criterion=Communication, value=0}, CanIfRxPduCanIdType=STANDARD_FD_CAN, CanIfRxPduDlc=64, CanIfRxPduUserRxIndicationName=CanTp_RxIndication, CanIfRxPduUserRxIndicationType=PDUID_PDUINFOPTR, CanIfRxPduUserRxIndicationUL=CAN_TP, CanIfRxPduCanId=1759 if post-build-variant-condition{matching-criterion=Communication, value=1}, CanIfRxPduRef=PT_TesterFunctionalReq_FD1_Tp_PP_TesterFunctionalReq_FD1_Tp_Rx_3290b631_3cf8f7d5
        TesterPhysicalReqPSCM_FD1_Tp_oFD1_CAN_20_Rx_3abd61be: CanIfRxPduCanId=1840 if post-build-variant-condition{matching-criterion=Communication, value=0}, CanIfRxPduCanIdType=STANDARD_NO_FD_CAN, CanIfRxPduDlc=8, CanIfRxPduUserRxIndicationName=CanTp_RxIndication, CanIfRxPduUserRxIndicationType=PDUID_PDUINFOPTR, CanIfRxPduUserRxIndicationUL=CAN_TP, CanIfRxPduCanId=1630 if post-build-variant-condition{matching-criterion=Communication, value=1}, CanIfRxPduRef=PT_TesterPhysicalReqPSCM_FD1_Tp_20_PP_TesterPhysicalReqPSCM_FD1_Tp_Rx_20_3290b631_3cf8f7d5
        TesterPhysicalReqPSCM_FD1_Tp_oFD1_CAN_Rx_3abd61be: CanIfRxPduCanId=1840 if post-build-variant-condition{matching-criterion=Communication, value=0}, CanIfRxPduCanIdType=STANDARD_FD_CAN, CanIfRxPduDlc=64, CanIfRxPduUserRxIndicationName=CanTp_RxIndication, CanIfRxPduUserRxIndicationType=PDUID_PDUINFOPTR, CanIfRxPduUserRxIndicationUL=CAN_TP, CanIfRxPduCanId=1630 if post-build-variant-condition{matching-criterion=Communication, value=1}, CanIfRxPduRef=PT_TesterPhysicalReqPSCM_FD1_Tp_PP_TesterPhysicalReqPSCM_FD1_Tp_Rx_3290b631_3cf8f7d5
        TrailerAid_Data3_FD1_oFD1_CAN_Rx_3abd61be: CanIfRxPduCanId=1116, CanIfRxPduCanIdType=STANDARD_CAN, CanIfRxPduDlc=8, CanIfRxPduUserRxIndicationName=PduR_CanIfRxIndication, CanIfRxPduUserRxIndicationUL=PDUR, CanIfRxPduRef=PT_TrailerAid_Data3_FD1_PP_TrailerAid_Data3_FD1_Rx_3290b631_3cf8f7d5
        TrailerAid_Data_FD1_oFD1_CAN_Rx_3abd61be: CanIfRxPduCanId=1114, CanIfRxPduCanIdType=STANDARD_CAN, CanIfRxPduDlc=8, CanIfRxPduUserRxIndicationName=PduR_CanIfRxIndication, CanIfRxPduUserRxIndicationUL=PDUR, CanIfRxPduRef=PT_TrailerAid_Data_FD1_PP_TrailerAid_Data_FD1_Rx_3290b631_3cf8f7d5
        TrailerAid_Stat1_FD1_oFD1_CAN_Rx_3abd61be: CanIfRxPduCanId=1106, CanIfRxPduCanIdType=STANDARD_CAN, CanIfRxPduDlc=8, CanIfRxPduUserRxIndicationName=PduR_CanIfRxIndication, CanIfRxPduUserRxIndicationUL=PDUR, CanIfRxPduRef=PT_TrailerAid_Stat1_FD1_PP_TrailerAid_Stat1_FD1_Rx_3290b631_3cf8f7d5
        TrailerAid_Stat2_FD1_oFD1_CAN_Rx_3abd61be: CanIfRxPduCanId=1111, CanIfRxPduCanIdType=STANDARD_CAN, CanIfRxPduDlc=8, CanIfRxPduUserRxIndicationName=PduR_CanIfRxIndication, CanIfRxPduUserRxIndicationUL=PDUR, CanIfRxPduRef=PT_TrailerAid_Stat2_FD1_PP_TrailerAid_Stat2_FD1_Rx_3290b631_3cf8f7d5
        TrailerAid_Stat3_FD1_oFD1_CAN_Rx_3abd61be: CanIfRxPduCanId=1113, CanIfRxPduCanIdType=STANDARD_CAN, CanIfRxPduDlc=8, CanIfRxPduUserRxIndicationName=PduR_CanIfRxIndication, CanIfRxPduUserRxIndicationUL=PDUR, CanIfRxPduRef=PT_TrailerAid_Stat3_FD1_PP_TrailerAid_Stat3_FD1_Rx_3290b631_3cf8f7d5
        TrailerBrakeInfo_FD1_oFD1_CAN_Rx_3abd61be: CanIfRxPduCanId=1093, CanIfRxPduCanIdType=STANDARD_CAN, CanIfRxPduDlc=8, CanIfRxPduUserRxIndicationName=PduR_CanIfRxIndication, CanIfRxPduUserRxIndicationUL=PDUR, CanIfRxPduRef=PT_TrailerBrakeInfo_FD1_PP_TrailerBrakeInfo_FD1_Rx_3290b631_3cf8f7d5
        TrailerInfo_2_FD1_oFD1_CAN_Rx_3abd61be: CanIfRxPduCanId=1146, CanIfRxPduCanIdType=STANDARD_CAN, CanIfRxPduDlc=8, CanIfRxPduUserRxIndicationName=PduR_CanIfRxIndication, CanIfRxPduUserRxIndicationUL=PDUR, CanIfRxPduRef=PT_TrailerInfo_2_FD1_PP_TrailerInfo_2_FD1_Rx_3290b631_3cf8f7d5
        TrailerInfo_FD1_oFD1_CAN_Rx_3abd61be: CanIfRxPduCanId=1091, CanIfRxPduCanIdType=STANDARD_CAN, CanIfRxPduDlc=8, CanIfRxPduUserRxIndicationName=PduR_CanIfRxIndication, CanIfRxPduUserRxIndicationUL=PDUR, CanIfRxPduRef=PT_TrailerInfo_FD1_PP_TrailerInfo_FD1_Rx_3290b631_3cf8f7d5
        TransGearData_FD1_oFD1_CAN_Rx_3abd61be: CanIfRxPduCanId=560, CanIfRxPduCanIdType=STANDARD_CAN, CanIfRxPduDlc=8, CanIfRxPduUserRxIndicationName=PduR_CanIfRxIndication, CanIfRxPduUserRxIndicationUL=PDUR, CanIfRxPduRef=PT_TransGearData_FD1_PP_TransGearData_FD1_Rx_3290b631_3cf8f7d5
        VehicleOperatingModes_FD1_oFD1_CAN_Rx_3abd61be: CanIfRxPduCanId=359, CanIfRxPduCanIdType=STANDARD_CAN, CanIfRxPduDlc=8, CanIfRxPduUserRxIndicationName=PduR_CanIfRxIndication, CanIfRxPduUserRxIndicationUL=PDUR, CanIfRxPduRef=PT_VehicleOperatingModes_FD1_PP_VehicleOperatingModes_FD1_Rx_3290b631_3cf8f7d5
        WheelData_FD1_oFD1_CAN_Rx_3abd61be: CanIfRxPduCanId=534, CanIfRxPduCanIdType=STANDARD_CAN, CanIfRxPduDlc=8, CanIfRxPduUserRxIndicationName=PduR_CanIfRxIndication, CanIfRxPduUserRxIndicationUL=PDUR, CanIfRxPduRef=PT_WheelData_FD1_PP_WheelData_FD1_Rx_3290b631_3cf8f7d5
        WheelSpeed_FD1_oFD1_CAN_Rx_3abd61be: CanIfRxPduCanId=535, CanIfRxPduCanIdType=STANDARD_CAN, CanIfRxPduDlc=8, CanIfRxPduUserRxIndicationName=PduR_CanIfRxIndication, CanIfRxPduUserRxIndicationUL=PDUR, CanIfRxPduRef=PT_WheelSpeed_FD1_PP_WheelSpeed_FD1_Rx_3290b631_3cf8f7d5
        Xcp_CRO_Msg_oFD1_CAN_Rx_3abd61be: CanIfRxPduCanId=1546 if post-build-variant-condition{matching-criterion=Communication, value=0}, CanIfRxPduCanIdType=STANDARD_CAN, CanIfRxPduDlc=8, CanIfRxPduUserRxIndicationName=Xcp_CanIfRxIndication, CanIfRxPduUserRxIndicationUL=XCP, CanIfRxPduCanId=1632 if post-build-variant-condition{matching-criterion=Communication, value=1}, CanIfRxPduRef=PT_Xcp_CRO_Msg_PP_Xcp_CRO_Msg_Rx_3290b631_3cf8f7d5
        Yaw_Data_FD1_oFD1_CAN_Rx_3abd61be: CanIfRxPduCanId=145, CanIfRxPduCanIdType=STANDARD_CAN, CanIfRxPduDlc=8, CanIfRxPduUserRxIndicationName=PduR_CanIfRxIndication, CanIfRxPduUserRxIndicationUL=PDUR, CanIfRxPduRef=PT_Yaw_Data_FD1_PP_Yaw_Data_FD1_Rx_3290b631_3cf8f7d5
      8 x CanIfTxPduCfg, all with CanIfTxPduBufferRef=CanIfBufferCfg_Tx_Std_3290b631:
        EPAS_INFO_FD1_oFD1_CAN_Tx_3abd61be: CanIfTxPduCanId=130 if post-build-variant-condition{matching-criterion=Communication, value=0}, CanIfTxPduCanIdType=STANDARD_FD_CAN, CanIfTxPduDlc=8, CanIfTxPduUserTxConfirmationName=PduR_CanIfTxConfirmation, CanIfTxPduUserTxConfirmationUL=PDUR, CanIfTxPduCanId=386 if post-build-variant-condition{matching-criterion=Communication, value=1}, CanIfTxPduRef=PT_EPAS_INFO_FD1_PP_EPAS_INFO_FD1_Tx_3290b631_3cf8f7d5
        Lane_Assist_Data3_FD1_oFD1_CAN_Tx_3abd61be: CanIfTxPduCanId=972 if post-build-variant-condition{matching-criterion=Communication, value=0}, CanIfTxPduCanIdType=STANDARD_FD_CAN, CanIfTxPduDlc=8, CanIfTxPduUserTxConfirmationName=PduR_CanIfTxConfirmation, CanIfTxPduUserTxConfirmationUL=PDUR, CanIfTxPduCanId=1228 if post-build-variant-condition{matching-criterion=Communication, value=1}, CanIfTxPduRef=PT_Lane_Assist_Data3_FD1_PP_Lane_Assist_Data3_FD1_Tx_3290b631_3cf8f7d5
        PSCM_AutoSar_NetwrkMgt_FD1_oFD1_CAN_Tx_3abd61be: CanIfTxPduCanId=1461 if post-build-variant-condition{matching-criterion=Communication, value=0}, CanIfTxPduCanIdType=STANDARD_FD_CAN, CanIfTxPduDlc=8, CanIfTxPduUserTxConfirmationName=CanNm_TxConfirmation, CanIfTxPduUserTxConfirmationUL=CAN_NM, CanIfTxPduCanId=1717 if post-build-variant-condition{matching-criterion=Communication, value=1}, CanIfTxPduRef=PSCM_AutoSar_NetwrkMgt_FD1_9b1e365c
        SteeringPinion_Data_FD1_oFD1_CAN_Tx_3abd61be: CanIfTxPduCanId=126 if post-build-variant-condition{matching-criterion=Communication, value=0}, CanIfTxPduCanIdType=STANDARD_FD_CAN, CanIfTxPduDlc=8, CanIfTxPduUserTxConfirmationName=PduR_CanIfTxConfirmation, CanIfTxPduUserTxConfirmationUL=PDUR, CanIfTxPduCanId=382 if post-build-variant-condition{matching-criterion=Communication, value=1}, CanIfTxPduRef=PT_SteeringPinion_Data_FD1_PP_SteeringPinion_Data_FD1_Tx_3290b631_3cf8f7d5
        TesterPhysicalResPSCM_FD1_Tp_oFD1_CAN_20_Tx_3abd61be: CanIfTxPduCanId=1848 if post-build-variant-condition{matching-criterion=Communication, value=0}, CanIfTxPduCanIdType=STANDARD_CAN, CanIfTxPduDlc=8, CanIfTxPduUserTxConfirmationName=CanTp_TxConfirmation, CanIfTxPduUserTxConfirmationUL=CAN_TP, CanIfTxPduCanId=1631 if post-build-variant-condition{matching-criterion=Communication, value=1}, CanIfTxPduRef=PT_TesterPhysicalResPSCM_FD1_Tp_20_PP_TesterPhysicalResPSCM_FD1_Tp_Tx_20_3290b631_3cf8f7d5
        TesterPhysicalResPSCM_FD1_Tp_oFD1_CAN_Tx_3abd61be: CanIfTxPduCanId=1848 if post-build-variant-condition{matching-criterion=Communication, value=0}, CanIfTxPduCanIdType=STANDARD_FD_CAN, CanIfTxPduDlc=64, CanIfTxPduUserTxConfirmationName=CanTp_TxConfirmation, CanIfTxPduUserTxConfirmationUL=CAN_TP, CanIfTxPduCanId=1631 if post-build-variant-condition{matching-criterion=Communication, value=1}, CanIfTxPduRef=PT_TesterPhysicalResPSCM_FD1_Tp_PP_TesterPhysicalResPSCM_FD1_Tp_Tx_3290b631_3cf8f7d5
        TrailerAid_Data2_FD1_oFD1_CAN_Tx_3abd61be: CanIfTxPduCanId=1047 if post-build-variant-condition{matching-criterion=Communication, value=0}, CanIfTxPduCanIdType=STANDARD_FD_CAN, CanIfTxPduDlc=8, CanIfTxPduUserTxConfirmationName=PduR_CanIfTxConfirmation, CanIfTxPduUserTxConfirmationUL=PDUR, CanIfTxPduCanId=1303 if post-build-variant-condition{matching-criterion=Communication, value=1}, CanIfTxPduRef=PT_TrailerAid_Data2_FD1_PP_TrailerAid_Data2_FD1_Tx_3290b631_3cf8f7d5
        Xcp_DTO_Msg_oFD1_CAN_Tx_3abd61be: CanIfTxPduCanId=1547 if post-build-variant-condition{matching-criterion=Communication, value=0}, CanIfTxPduCanIdType=STANDARD_CAN, CanIfTxPduDlc=8, CanIfTxPduUserTxConfirmationName=Xcp_CanIfTxConfirmation, CanIfTxPduUserTxConfirmationUL=XCP, CanIfTxPduCanId=1633 if post-build-variant-condition{matching-criterion=Communication, value=1}, CanIfTxPduRef=PT_Xcp_DTO_Msg_PP_Xcp_DTO_Msg_Tx_3290b631_3cf8f7d5
    CanIfPrivateCfg: CanIfPrivateSoftwareFilterType=LINEAR
    CanIfPublicCfg: CanIfPublicPnSupport=false
  module config CanSM
    CanSMConfiguration
      CHNL_cd1e16dc (CanSMManagerNetwork): CanSMComMNetworkHandleRef=ComMConfigSet/FD1_CAN_f26020e5
        CT_FD1_CAN_b4e1ca3b (CanSMController): CanSMControllerId=Can/CT_FD1_CAN_b4e1ca3b
  module config CanTp
    CanTpConfig: CanTpMainFunctionPeriod=0.005
      4 x CanTpChannel, all with CanTpChannelMode=CANTP_MODE_FULL_DUPLEX:
        TPCH_0b63929d
          RxNSdu_0b63929d (CanTpRxNSdu):
            CanTpRxAddressingFormat = CANTP_STANDARD
            CanTpRxDl = 8
            CanTpRxTaType = CANTP_FUNCTIONAL
            CanTpRxNSduRef = EcucPduCollection/PT_TesterFunctionalReq_FD1_20_PP_TesterFunctionalReq_FD1_Rx_20_3290b631_3cf8f7d5
            CanTpRxNPdu_b5f48067 (CanTpRxNPdu): CanTpRxNPduRef=PT_TesterFunctionalReq_FD1_Tp_20_PP_TesterFunctionalReq_FD1_Tp_Rx_20_3290b631_3cf8f7d5
        TPCH_4962324c
          RxNSdu_4962324c (CanTpRxNSdu):
            CanTpRxAddressingFormat = CANTP_STANDARD
            CanTpRxDl = 64
            CanTpRxTaType = CANTP_CANFD_PHYSICAL
            CanTpRxNSduRef = EcucPduCollection/PT_TesterPhysicalReqPSCM_FD1_PP_TesterPhysicalReqPSCM_FD1_Rx_3290b631_3cf8f7d5
            CanTpRxNPdu_35bd2844 (CanTpRxNPdu): CanTpRxNPduRef=PT_TesterPhysicalReqPSCM_FD1_Tp_PP_TesterPhysicalReqPSCM_FD1_Tp_Rx_3290b631_3cf8f7d5
            CanTpTxFcNPdu_35bd2844 (CanTpTxFcNPdu): CanTpTxFcNPduRef=PT_TesterPhysicalResPSCM_FD1_Tp_PP_TesterPhysicalResPSCM_FD1_Tp_Tx_3290b631_3cf8f7d5
          TxNSdu_769ddb63 (CanTpTxNSdu):
            CanTpTxAddressingFormat = CANTP_STANDARD
            CanTpTxDl = 64
            CanTpTxTaType = CANTP_CANFD_PHYSICAL
            CanTpTxNSduRef = EcucPduCollection/PT_TesterPhysicalResPSCM_FD1_PP_TesterPhysicalResPSCM_FD1_Tx_3290b631_3cf8f7d5
            CanTpRxFcNPdu_a3000bfc (CanTpRxFcNPdu): CanTpRxFcNPduRef=PT_TesterPhysicalReqPSCM_FD1_Tp_PP_TesterPhysicalReqPSCM_FD1_Tp_Rx_3290b631_3cf8f7d5
            CanTpTxNPdu_a3000bfc (CanTpTxNPdu): CanTpTxNPduRef=PT_TesterPhysicalResPSCM_FD1_Tp_PP_TesterPhysicalResPSCM_FD1_Tp_Tx_3290b631_3cf8f7d5
        TPCH_62a8e518
          RxNSdu_62a8e518 (CanTpRxNSdu):
            CanTpRxAddressingFormat = CANTP_STANDARD
            CanTpRxDl = 8
            CanTpRxTaType = CANTP_PHYSICAL
            CanTpRxNSduRef = EcucPduCollection/PT_TesterPhysicalReqPSCM_FD1_20_PP_TesterPhysicalReqPSCM_FD1_Rx_20_3290b631_3cf8f7d5
            CanTpRxNPdu_7cc48353 (CanTpRxNPdu): CanTpRxNPduRef=PT_TesterPhysicalReqPSCM_FD1_Tp_20_PP_TesterPhysicalReqPSCM_FD1_Tp_Rx_20_3290b631_3cf8f7d5
            CanTpTxFcNPdu_7cc48353 (CanTpTxFcNPdu): CanTpTxFcNPduRef=PT_TesterPhysicalResPSCM_FD1_Tp_20_PP_TesterPhysicalResPSCM_FD1_Tp_Tx_20_3290b631_3cf8f7d5
          TxNSdu_b29a3917 (CanTpTxNSdu):
            CanTpTxAddressingFormat = CANTP_STANDARD
            CanTpTxDl = 8
            CanTpTxTaType = CANTP_PHYSICAL
            CanTpTxNSduRef = EcucPduCollection/PT_TesterPhysicalResPSCM_FD1_20_PP_TesterPhysicalResPSCM_FD1_Tx_20_3290b631_3cf8f7d5
            CanTpRxFcNPdu_d4315ea8 (CanTpRxFcNPdu): CanTpRxFcNPduRef=PT_TesterPhysicalReqPSCM_FD1_Tp_20_PP_TesterPhysicalReqPSCM_FD1_Tp_Rx_20_3290b631_3cf8f7d5
            CanTpTxNPdu_d4315ea8 (CanTpTxNPdu): CanTpTxNPduRef=PT_TesterPhysicalResPSCM_FD1_Tp_20_PP_TesterPhysicalResPSCM_FD1_Tp_Tx_20_3290b631_3cf8f7d5
        TPCH_f2921bcf
          RxNSdu_f2921bcf (CanTpRxNSdu):
            CanTpRxAddressingFormat = CANTP_STANDARD
            CanTpRxDl = 64
            CanTpRxTaType = CANTP_CANFD_FUNCTIONAL
            CanTpRxNSduRef = EcucPduCollection/PT_TesterFunctionalReq_FD1_PP_TesterFunctionalReq_FD1_Rx_3290b631_3cf8f7d5
            CanTpRxNPdu_c40f6080 (CanTpRxNPdu): CanTpRxNPduRef=PT_TesterFunctionalReq_FD1_Tp_PP_TesterFunctionalReq_FD1_Tp_Rx_3290b631_3cf8f7d5
  module config Com
    ComConfig
      46 x ComIPdu, all with ComIPduType=NORMAL:
        ABS_BrkBst_Data_FD1_oFD1_CAN_3abd61be: ComIPduDirection=RECEIVE, ComIPduGroupRef=PSCM_FD_oFD1_CAN_Rx_fcef2243, ComIPduSignalRef=YawStabilityIndex_706a037f, ComPduIdRef=PT_ABS_BrkBst_Data_FD1_PP_ABS_BrkBst_Data_FD1_Rx_3290b631_3cf8f7d5
        APIM_Send_Signals1_FD1_oFD1_CAN_3abd61be: ComIPduDirection=RECEIVE, ComIPduGroupRef=PSCM_FD_oFD1_CAN_Rx_fcef2243, ComIPduSignalRef=TrlrAidCancl_B_Rq_630ef174, ComPduIdRef=PT_APIM_Send_Signals1_FD1_PP_APIM_Send_Signals1_FD1_Rx_3290b631_3cf8f7d5
        APIM_Send_Signals_2_FD1_oFD1_CAN_3abd61be: ComIPduDirection=RECEIVE, ComIPduGroupRef=PSCM_FD_oFD1_CAN_Rx_fcef2243, ComIPduSignalRef=TrlrAidMde_D_Rq_a35cbfab, ComPduIdRef=PT_APIM_Send_Signals_2_FD1_PP_APIM_Send_Signals_2_FD1_Rx_3290b631_3cf8f7d5
        ActiveFrontStrg_Stat2_FD1_oFD1_CAN_3abd61be: ComIPduDirection=RECEIVE, ComIPduGroupRef=PSCM_FD_oFD1_CAN_Rx_fcef2243, ComIPduSignalRef=SteWhlRelCalib_An_Sns_11fa9ae5, ComPduIdRef=PT_ActiveFrontStrg_Stat2_FD1_PP_ActiveFrontStrg_Stat2_FD1_Rx_3290b631_3cf8f7d5
        BodyInfo_3_FD1_oFD1_CAN_3abd61be: ComIPduDirection=RECEIVE, ComIPduGroupRef=PSCM_FD_oFD1_CAN_Rx_fcef2243, ComIPduSignalRef=Ignition_Status_3c341b34, ComIPduSignalRef=LifeCycMde_D_Actl_3c341b34, ComPduIdRef=PT_BodyInfo_3_FD1_PP_BodyInfo_3_FD1_Rx_3290b631_3cf8f7d5
        Body_Info_4_FD1_oFD1_CAN_3abd61be: ComIPduDirection=RECEIVE, ComIPduGroupRef=PSCM_FD_oFD1_CAN_Rx_fcef2243, ComIPduSignalRef=BattULo_U_Actl_0a3b9a6b, ComPduIdRef=PT_Body_Info_4_FD1_PP_Body_Info_4_FD1_Rx_3290b631_3cf8f7d5
        BrakeSnData_3_FD1_oFD1_CAN_3abd61be: ComIPduDirection=RECEIVE, ComIPduGroupRef=PSCM_FD_oFD1_CAN_Rx_fcef2243, ComIPduSignalRef=VehLatComp_A_Actl_470bb112, ComIPduSignalRef=VehLongComp_A_Actl_470bb112, ComIPduSignalRef=VehOverGnd_V_Est_470bb112, ComIPduSignalRef=VehYawComp_W_Actl_470bb112, ComPduIdRef=PT_BrakeSnData_3_FD1_PP_BrakeSnData_3_FD1_Rx_3290b631_3cf8f7d5
        BrakeSnData_4_FD1_oFD1_CAN_3abd61be: ComIPduDirection=RECEIVE, ComIPduGroupRef=PSCM_FD_oFD1_CAN_Rx_fcef2243, ComIPduSignalRef=BrkTot_Tq_Actl_22c61bd2, ComIPduSignalRef=VehVertComp_A_Actl_22c61bd2, ComPduIdRef=PT_BrakeSnData_4_FD1_PP_BrakeSnData_4_FD1_Rx_3290b631_3cf8f7d5
        BrakeSnData_5_FD1_oFD1_CAN_3abd61be: ComIPduDirection=RECEIVE, ComIPduGroupRef=PSCM_FD_oFD1_CAN_Rx_fcef2243, ComIPduSignalRef=DrvSte_D_Stat_bfc9faa4, ComIPduSignalRef=DrvSte_Tq_Rq_bfc9faa4, ComPduIdRef=PT_BrakeSnData_5_FD1_PP_BrakeSnData_5_FD1_Rx_3290b631_3cf8f7d5
        BrakeSnData_6_FD1_oFD1_CAN_3abd61be: ComIPduDirection=RECEIVE, ComIPduGroupRef=PSCM_FD_oFD1_CAN_Rx_fcef2243, ComIPduSignalRef=StePinOffst_An_Est_c3a8df7f, ComIPduSignalRef=StePinOffst_D_Stat_c3a8df7f, ComIPduSignalRef=StePinOffst_No_Cnt_c3a8df7f, ComIPduSignalRef=StePinOffst_No_Cs_c3a8df7f, ComPduIdRef=PT_BrakeSnData_6_FD1_PP_BrakeSnData_6_FD1_Rx_3290b631_3cf8f7d5
        BrakeSysFeatures_3_oFD1_CAN_3abd61be: ComIPduDirection=RECEIVE, ComIPduGroupRef=PSCM_FD_oFD1_CAN_Rx_fcef2243, ComIPduSignalRef=SelDrvMdeChassis2_D_Rq_e000acae, ComPduIdRef=PT_BrakeSysFeatures_3_PP_BrakeSysFeatures_3_Rx_3290b631_3cf8f7d5
        BrakeSysFeatures_FD1_oFD1_CAN_3abd61be: ComIPduDirection=RECEIVE, ComIPduGroupRef=PSCM_FD_oFD1_CAN_Rx_fcef2243, ComIPduSignalRef=LsmcBrkDecel_D_Stat_9f750b9f, ComIPduSignalRef=VehVActlBrk_D_Qf_9f750b9f, ComIPduSignalRef=VehVActlBrk_No_Cnt_9f750b9f, ComIPduSignalRef=VehVActlBrk_No_Cs_9f750b9f, ComIPduSignalRef=Veh_V_ActlBrk_9f750b9f, ComPduIdRef=PT_BrakeSysFeatures_FD1_PP_BrakeSysFeatures_FD1_Rx_3290b631_3cf8f7d5
        Climate_Control_Data_FD1_oFD1_CAN_3abd61be: ComIPduDirection=RECEIVE, ComIPduGroupRef=PSCM_FD_oFD1_CAN_Rx_fcef2243, ComIPduSignalRef=Outside_Air_Temp_Stat_f1463698, ComPduIdRef=PT_Climate_Control_Data_FD1_PP_Climate_Control_Data_FD1_Rx_3290b631_3cf8f7d5
        Cluster_Info1_FD1_oFD1_CAN_3abd61be: ComIPduDirection=RECEIVE, ComIPduGroupRef=PSCM_FD_oFD1_CAN_Rx_fcef2243, ComIPduSignalRef=OdometerMasterValue_09a60c78, ComPduIdRef=PT_Cluster_Info1_FD1_PP_Cluster_Info1_FD1_Rx_3290b631_3cf8f7d5
        DeliveryVersion_oFD1_CAN_3abd61be: ComIPduDirection=RECEIVE, ComIPduGroupRef=PSCM_FD_oFD1_CAN_Rx_fcef2243, ComIPduSignalRef=DeliveryIdle_f2797042, ComIPduSignalRef=DeliveryNumber_f2797042, ComIPduSignalRef=DeliverySipNumber_f2797042, ComIPduSignalRef=DeliverySubProjectNumber_f2797042, ComPduIdRef=PT_DeliveryVersion_PP_DeliveryVersion_Rx_3290b631_3cf8f7d5
        DesiredTorqBrk_FD1_oFD1_CAN_3abd61be: ComIPduDirection=RECEIVE, ComIPduGroupRef=PSCM_FD_oFD1_CAN_Rx_fcef2243, ComIPduSignalRef=AbsActv_B_Actl_eaa4779a, ComIPduSignalRef=CmbbBrkDis_B_Actl_eaa4779a, ComIPduSignalRef=CmbbDeny_B_ActlBrk_eaa4779a, ComIPduSignalRef=StabCtlBrkActv_B_Actl_eaa4779a, ComPduIdRef=PT_DesiredTorqBrk_FD1_PP_DesiredTorqBrk_FD1_Rx_3290b631_3cf8f7d5
        EPAS_INFO_FD1_oFD1_CAN_3abd61be: ComIPduDirection=SEND, ComIPduGroupRef=PSCM_FD_oFD1_CAN_Tx_fcef2243, ComIPduSignalRef=DrvSteActv_B_Stat_635efcb3, ComIPduSignalRef=DrvSte_Tq_Actl_635efcb3, ComIPduSignalRef=EPAS_Failure_635efcb3, ComIPduSignalRef=SAPPAngleControlStat1_635efcb3, ComIPduSignalRef=SAPPAngleControlStat2_635efcb3, ComIPduSignalRef=SAPPAngleControlStat3_635efcb3, ComIPduSignalRef=SAPPAngleControlStat4_635efcb3, ComIPduSignalRef=SAPPAngleControlStat5_635efcb3, ComIPduSignalRef=SAPPAngleControlStat6_635efcb3, ComIPduSignalRef=SteMdule_D_Stat_635efcb3, ComIPduSignalRef=SteMdule_I_Est_635efcb3, ComIPduSignalRef=SteMdule_U_Meas_635efcb3, ComIPduSignalRef=SteeringColumnTorque_635efcb3, ComIPduSignalRef=TrlrHitchLamp_D_Rqst_635efcb3, ComIPduSignalRef=VehVTrlrAid_B_Rq_635efcb3, ComIPduSignalRef=Veh_V_RqMxTrlrAid_635efcb3, ComPduIdRef=PT_EPAS_INFO_FD1_PP_EPAS_INFO_FD1_Tx_3290b631_3cf8f7d5
          ComTxIPdu: ComMinimumDelayTime=0.01, ComTxIPduUnusedAreasDefault=0
            ComTxModeFalse
              ComTxMode: ComTxModeMode=PERIODIC, ComTxModeTimeOffset=0, ComTxModeTimePeriod=0.02
            ComTxModeTrue
              ComTxMode: ComTxModeMode=PERIODIC, ComTxModeTimeOffset=0, ComTxModeTimePeriod=0.02
        EngBrakeData_FD1_oFD1_CAN_3abd61be: ComIPduDirection=RECEIVE, ComIPduGroupRef=PSCM_FD_oFD1_CAN_Rx_fcef2243, ComIPduSignalRef=BPedDrvAppl_D_QF_aea354aa, ComIPduSignalRef=BpedDrvAppl_D_Actl_aea354aa, ComPduIdRef=PT_EngBrakeData_FD1_PP_EngBrakeData_FD1_Rx_3290b631_3cf8f7d5
        EngVehicleSpThrottle2_FD1_oFD1_CAN_3abd61be: ComIPduDirection=RECEIVE, ComIPduGroupRef=PSCM_FD_oFD1_CAN_Rx_fcef2243, ComIPduSignalRef=GearRvrse_D_Actl_2508f61f, ComIPduSignalRef=VehVActlEng_D_Qf_2508f61f, ComIPduSignalRef=VehVActlEng_No_Cnt_2508f61f, ComIPduSignalRef=VehVActlEng_No_Cs_2508f61f, ComIPduSignalRef=VehVTrlrAid_B_Avail_2508f61f, ComIPduSignalRef=Veh_V_ActlEng_2508f61f, ComPduIdRef=PT_EngVehicleSpThrottle2_FD1_PP_EngVehicleSpThrottle2_FD1_Rx_3290b631_3cf8f7d5
        EngVehicleSpThrottle_FD1_oFD1_CAN_3abd61be: ComIPduDirection=RECEIVE, ComIPduGroupRef=PSCM_FD_oFD1_CAN_Rx_fcef2243, ComIPduSignalRef=ApedPosPcActl_D_Qf_a3d34b0d, ComIPduSignalRef=ApedPos_Pc_ActlArb_a3d34b0d, ComIPduSignalRef=EngAout_N_Actl_a3d34b0d, ComPduIdRef=PT_EngVehicleSpThrottle_FD1_PP_EngVehicleSpThrottle_FD1_Rx_3290b631_3cf8f7d5
        FileVersion_oFD1_CAN_3abd61be: ComIPduDirection=RECEIVE, ComIPduGroupRef=PSCM_FD_oFD1_CAN_Rx_fcef2243, ComIPduSignalRef=FileVersionDay_216bb0c2, ComIPduSignalRef=FileVersionMonth_216bb0c2, ComIPduSignalRef=FileVersionNumber_216bb0c2, ComIPduSignalRef=FileVersionYear_216bb0c2, ComPduIdRef=PT_FileVersion_PP_FileVersion_Rx_3290b631_3cf8f7d5
        GGCC_Config_Mgmt_ID_1_FD1_oFD1_CAN_3abd61be: ComIPduDirection=RECEIVE, ComIPduGroupRef=PSCM_FD_oFD1_CAN_Rx_fcef2243, ComIPduSignalRef=VehicleGGCCData_575096ac, ComPduIdRef=PT_GGCC_Config_Mgmt_ID_1_FD1_PP_GGCC_Config_Mgmt_ID_1_FD1_Rx_3290b631_3cf8f7d5
        Image_Processing_Data_FD1_oFD1_CAN_3abd61be: ComIPduDirection=RECEIVE, ComIPduGroupRef=PSCM_FD_oFD1_CAN_Rx_fcef2243, ComIPduSignalRef=TrlrRvrseEnbl_D2_Stat_ae9dea9d, ComIPduSignalRef=TrlrRvrseMsgTxt_D2_Rq_ae9dea9d, ComPduIdRef=PT_Image_Processing_Data_FD1_PP_Image_Processing_Data_FD1_Rx_3290b631_3cf8f7d5
        Lane_Assist_Data1_FD1_oFD1_CAN_3abd61be: ComIPduDirection=RECEIVE, ComIPduGroupRef=PSCM_FD_oFD1_CAN_Rx_fcef2243, ComIPduSignalRef=LaCurvature_No_Calc_d64ac390, ComIPduSignalRef=LaRampType_B_Req_d64ac390, ComIPduSignalRef=LaRefAng_No_Req_d64ac390, ComIPduSignalRef=LdwActvIntns_D_Req_d64ac390, ComIPduSignalRef=LdwActvStats_D_Req_d64ac390, ComIPduSignalRef=LkaActvStats_D2_Req_d64ac390, ComIPduSignalRef=LkaDrvOvrrd_D_Rq_d64ac390, ComPduIdRef=PT_Lane_Assist_Data1_FD1_PP_Lane_Assist_Data1_FD1_Rx_3290b631_3cf8f7d5
        Lane_Assist_Data3_FD1_oFD1_CAN_3abd61be: ComIPduDirection=SEND, ComIPduGroupRef=PSCM_FD_oFD1_CAN_Tx_fcef2243, ComIPduSignalRef=LaActAvail_D_Actl_3724073d, ComIPduSignalRef=LaActDeny_B_Actl_3724073d, ComIPduSignalRef=LaHandsOff_B_Actl_3724073d, ComIPduSignalRef=LsmcBrkDecelEnbl_D_Rq_3724073d, ComIPduSignalRef=LsmcBrk_Tq_Rq_3724073d, ComIPduSignalRef=TjaHandsOnCnfdnc_B_Est_3724073d, ComIPduSignalRef=TrlrAn_An_TrgtCalc_3724073d, ComPduIdRef=PT_Lane_Assist_Data3_FD1_PP_Lane_Assist_Data3_FD1_Tx_3290b631_3cf8f7d5
          ComTxIPdu: ComMinimumDelayTime=0.01, ComTxIPduUnusedAreasDefault=0
            ComTxModeFalse
              ComTxMode: ComTxModeMode=PERIODIC, ComTxModeTimeOffset=0, ComTxModeTimePeriod=0.03
            ComTxModeTrue
              ComTxMode: ComTxModeMode=PERIODIC, ComTxModeTimeOffset=0, ComTxModeTimePeriod=0.03
        LateralMotionControl_FD1_oFD1_CAN_3abd61be: ComIPduDirection=RECEIVE, ComIPduGroupRef=PSCM_FD_oFD1_CAN_Rx_fcef2243, ComIPduSignalRef=HandsOffCnfm_B_Rq_5abef978, ComIPduSignalRef=LatCtlCurv_NoRate_Actl_5abef978, ComIPduSignalRef=LatCtlCurv_No_Actl_5abef978, ComIPduSignalRef=LatCtlPathOffst_L_Actl_5abef978, ComIPduSignalRef=LatCtlPath_An_Actl_5abef978, ComIPduSignalRef=LatCtlPrecision_D_Rq_5abef978, ComIPduSignalRef=LatCtlRampType_D_Rq_5abef978, ComIPduSignalRef=LatCtlRng_L_Max_5abef978, ComIPduSignalRef=LatCtl_D_Rq_5abef978, ComPduIdRef=PT_LateralMotionControl_FD1_PP_LateralMotionControl_FD1_Rx_3290b631_3cf8f7d5
        Mc_Send_Signals_2_FD1_oFD1_CAN_3abd61be: ComIPduDirection=RECEIVE, ComIPduGroupRef=PSCM_FD_oFD1_CAN_Rx_fcef2243, ComIPduSignalRef=EsaOn_B_Rq_bffaafb8, ComPduIdRef=PT_Mc_Send_Signals_2_FD1_PP_Mc_Send_Signals_2_FD1_Rx_3290b631_3cf8f7d5
        ParkAid_Data_FD1_oFD1_CAN_3abd61be: ComIPduDirection=RECEIVE, ComIPduGroupRef=PSCM_FD_oFD1_CAN_Rx_fcef2243, ComIPduSignalRef=ApaSys_D_Stat_ef286bfc, ComIPduSignalRef=EPASExtAngleStatReq_ef286bfc, ComIPduSignalRef=ExtSteeringAngleReq2_ef286bfc, ComPduIdRef=PT_ParkAid_Data_FD1_PP_ParkAid_Data_FD1_Rx_3290b631_3cf8f7d5
        PowertrainData_10_FD1_oFD1_CAN_3abd61be: ComIPduDirection=RECEIVE, ComIPduGroupRef=PSCM_FD_oFD1_CAN_Rx_fcef2243, ComIPduSignalRef=GearPos_D_Actl_1e331f99, ComIPduSignalRef=TrnRng_D_Rq_1e331f99, ComPduIdRef=PT_PowertrainData_10_FD1_PP_PowertrainData_10_FD1_Rx_3290b631_3cf8f7d5
        Steer_Assist_Data_FD1_oFD1_CAN_3abd61be: ComIPduDirection=RECEIVE, ComIPduGroupRef=PSCM_FD_oFD1_CAN_Rx_fcef2243, ComIPduSignalRef=CmbbObjClass_D_Stat_dafea5bb, ComIPduSignalRef=CmbbObjColl_T_Actl_dafea5bb, ComIPduSignalRef=CmbbObjConfdnc_D_Stat_dafea5bb, ComIPduSignalRef=CmbbObjDistLat_L_Actl_dafea5bb, ComIPduSignalRef=CmbbObjDistLong_L_Actl_dafea5bb, ComIPduSignalRef=CmbbObjRelLat_V_Actl_dafea5bb, ComIPduSignalRef=CmbbObjRelLong_V_Actl_dafea5bb, ComIPduSignalRef=EsaEnbl_D2_Rq_dafea5bb, ComPduIdRef=PT_Steer_Assist_Data_FD1_PP_Steer_Assist_Data_FD1_Rx_3290b631_3cf8f7d5
        SteeringPinion_Data_FD1_oFD1_CAN_3abd61be: ComIPduDirection=SEND, ComIPduGroupRef=PSCM_FD_oFD1_CAN_Tx_fcef2243, ComIPduSignalRef=StePinAn_No_Cnt_837112cd, ComIPduSignalRef=StePinAn_No_Cs_837112cd, ComIPduSignalRef=StePinCompAnEst_D_Qf_837112cd, ComIPduSignalRef=StePinComp_An_Est_837112cd, ComIPduSignalRef=StePinRelInit_An_Sns_837112cd, ComIPduSignalRef=StePw_B_Rq_837112cd, ComPduIdRef=PT_SteeringPinion_Data_FD1_PP_SteeringPinion_Data_FD1_Tx_3290b631_3cf8f7d5
          ComTxIPdu: ComMinimumDelayTime=0, ComTxIPduUnusedAreasDefault=0
            ComTxModeFalse
              ComTxMode: ComTxModeMode=PERIODIC, ComTxModeTimeOffset=0, ComTxModeTimePeriod=0.01
            ComTxModeTrue
              ComTxMode: ComTxModeMode=PERIODIC, ComTxModeTimeOffset=0, ComTxModeTimePeriod=0.01
        Steering_Data_FD1_oFD1_CAN_3abd61be: ComIPduDirection=RECEIVE, ComIPduGroupRef=PSCM_FD_oFD1_CAN_Rx_fcef2243, ComIPduSignalRef=TurnLghtSwtch_D_Stat_7262fead, ComPduIdRef=PT_Steering_Data_FD1_PP_Steering_Data_FD1_Rx_3290b631_3cf8f7d5
        TrailerAid_Data2_FD1_oFD1_CAN_3abd61be: ComIPduDirection=SEND, ComIPduGroupRef=PSCM_FD_oFD1_CAN_Tx_fcef2243, ComIPduSignalRef=EsaOn_B_Stat_51142c79, ComIPduSignalRef=HitchToTrlrAxle_L_Calc_51142c79, ComIPduSignalRef=LatCtlLim_D_Stat_51142c79, ComIPduSignalRef=LatCtlSte_D_Stat_51142c79, ComIPduSignalRef=SelDrvMdeSte_D_Stat_51142c79, ComIPduSignalRef=TrlrAidEnbl_D2_Stat_51142c79, ComIPduSignalRef=TrlrAidMsgTxt_D2_Rq_51142c79, ComIPduSignalRef=TrlrAidSetup_D2_Stat_51142c79, ComIPduSignalRef=TrlrAidTrgtId_No_Rq_51142c79, ComIPduSignalRef=TrlrAidTrlrId_No_Rq_51142c79, ComIPduSignalRef=TrlrAnOffst_An2_Calc_51142c79, ComIPduSignalRef=TrlrAn_An_MxCalc_51142c79, ComIPduSignalRef=TrlrAn_An_WarnCalc_51142c79, ComPduIdRef=PT_TrailerAid_Data2_FD1_PP_TrailerAid_Data2_FD1_Tx_3290b631_3cf8f7d5
          ComTxIPdu: ComMinimumDelayTime=0.02, ComTxIPduUnusedAreasDefault=0
            ComTxModeFalse
              ComTxMode: ComTxModeMode=MIXED, ComTxModeNumberOfRepetitions=0, ComTxModeRepetitionPeriod=0, ComTxModeTimeOffset=0, ComTxModeTimePeriod=1
            ComTxModeTrue
              ComTxMode: ComTxModeMode=MIXED, ComTxModeNumberOfRepetitions=0, ComTxModeRepetitionPeriod=0, ComTxModeTimeOffset=0, ComTxModeTimePeriod=1
        TrailerAid_Data3_FD1_oFD1_CAN_3abd61be: ComIPduDirection=RECEIVE, ComIPduGroupRef=PSCM_FD_oFD1_CAN_Rx_fcef2243, ComIPduSignalRef=TrlrAidEnbl_D2_Rq_cc1bcd0f, ComIPduSignalRef=TrlrAidSetup_D2_Rq_cc1bcd0f, ComPduIdRef=PT_TrailerAid_Data3_FD1_PP_TrailerAid_Data3_FD1_Rx_3290b631_3cf8f7d5
        TrailerAid_Data_FD1_oFD1_CAN_3abd61be: ComIPduDirection=RECEIVE, ComIPduGroupRef=PSCM_FD_oFD1_CAN_Rx_fcef2243, ComIPduSignalRef=TrlrAnOffstDir_D_Mem_0edbb78e, ComIPduSignalRef=TrlrAxleToBmpr_L_Actl_0edbb78e, ComIPduSignalRef=TrlrIdType_D_Stat_0edbb78e, ComIPduSignalRef=TrlrId_No_Actl_0edbb78e, ComIPduSignalRef=TrlrRvrseCancl_B_Rq_0edbb78e, ComPduIdRef=PT_TrailerAid_Data_FD1_PP_TrailerAid_Data_FD1_Rx_3290b631_3cf8f7d5
        TrailerAid_Stat1_FD1_oFD1_CAN_3abd61be: ComIPduDirection=RECEIVE, ComIPduGroupRef=PSCM_FD_oFD1_CAN_Rx_fcef2243, ComIPduSignalRef=TrlrSnsId_No_Actl_ea9ce863, ComPduIdRef=PT_TrailerAid_Stat1_FD1_PP_TrailerAid_Stat1_FD1_Rx_3290b631_3cf8f7d5
        TrailerAid_Stat2_FD1_oFD1_CAN_3abd61be: ComIPduDirection=RECEIVE, ComIPduGroupRef=PSCM_FD_oFD1_CAN_Rx_fcef2243, ComIPduSignalRef=TrlrHitYaw_AnRate_Actl_96fdcdb8, ComIPduSignalRef=TrlrHitchYaw_An_Actl_96fdcdb8, ComIPduSignalRef=TrlrHitchYaw_D_Stat_96fdcdb8, ComIPduSignalRef=TrlrYawWActl_D_Qf_96fdcdb8, ComIPduSignalRef=TrlrYaw_W_Actl_96fdcdb8, ComPduIdRef=PT_TrailerAid_Stat2_FD1_PP_TrailerAid_Stat2_FD1_Rx_3290b631_3cf8f7d5
        TrailerAid_Stat3_FD1_oFD1_CAN_3abd61be: ComIPduDirection=RECEIVE, ComIPduGroupRef=PSCM_FD_oFD1_CAN_Rx_fcef2243, ComIPduSignalRef=HitchToVehAxle_L_Calc_0bf22cce, ComIPduSignalRef=TrlrAidTrgtId_No_Actl_0bf22cce, ComIPduSignalRef=TrlrAid_An3_Actl_0bf22cce, ComIPduSignalRef=TrlrAid_AnRate2_Actl_0bf22cce, ComIPduSignalRef=TrlrAid_D2_Stat_0bf22cce, ComIPduSignalRef=TrlrRvrse_D_Stat_0bf22cce, ComIPduSignalRef=TrlrTrgtAcquire_D_Stat_0bf22cce, ComPduIdRef=PT_TrailerAid_Stat3_FD1_PP_TrailerAid_Stat3_FD1_Rx_3290b631_3cf8f7d5
        TrailerBrakeInfo_FD1_oFD1_CAN_3abd61be: ComIPduDirection=RECEIVE, ComIPduGroupRef=PSCM_FD_oFD1_CAN_Rx_fcef2243, ComIPduSignalRef=TrlrBrkActCnnct_B_Actl_e983cb78, ComPduIdRef=PT_TrailerBrakeInfo_FD1_PP_TrailerBrakeInfo_FD1_Rx_3290b631_3cf8f7d5
        TrailerInfo_2_FD1_oFD1_CAN_3abd61be: ComIPduDirection=RECEIVE, ComIPduGroupRef=PSCM_FD_oFD1_CAN_Rx_fcef2243, ComIPduSignalRef=TrlrAidCtl_U_RqDrv_372f28fe, ComIPduSignalRef=TrlrAidSwtch_D_RqDrv_372f28fe, ComPduIdRef=PT_TrailerInfo_2_FD1_PP_TrailerInfo_2_FD1_Rx_3290b631_3cf8f7d5
        TrailerInfo_FD1_oFD1_CAN_3abd61be: ComIPduDirection=RECEIVE, ComIPduGroupRef=PSCM_FD_oFD1_CAN_Rx_fcef2243, ComIPduSignalRef=TrlrLampCnnct_B_Actl_6acffff2, ComPduIdRef=PT_TrailerInfo_FD1_PP_TrailerInfo_FD1_Rx_3290b631_3cf8f7d5
        TransGearData_FD1_oFD1_CAN_3abd61be: ComIPduDirection=RECEIVE, ComIPduGroupRef=PSCM_FD_oFD1_CAN_Rx_fcef2243, ComIPduSignalRef=GearLvrPos_D_Actl_8c4ca771, ComPduIdRef=PT_TransGearData_FD1_PP_TransGearData_FD1_Rx_3290b631_3cf8f7d5
        VehicleOperatingModes_FD1_oFD1_CAN_3abd61be: ComIPduDirection=RECEIVE, ComIPduGroupRef=PSCM_FD_oFD1_CAN_Rx_fcef2243, ComIPduSignalRef=ElPw_D_StatStrtStop_e6deed9e, ComIPduSignalRef=ElPw_D_Stat_e6deed9e, ComIPduSignalRef=PrplWhlTot2_Tq_Actl_e6deed9e, ComIPduSignalRef=PwPckTq_D_Stat_e6deed9e, ComPduIdRef=PT_VehicleOperatingModes_FD1_PP_VehicleOperatingModes_FD1_Rx_3290b631_3cf8f7d5
        WheelData_FD1_oFD1_CAN_3abd61be: ComIPduDirection=RECEIVE, ComIPduGroupRef=PSCM_FD_oFD1_CAN_Rx_fcef2243, ComIPduSignalRef=WhlDirFl_D_Actl_91fa0768, ComIPduSignalRef=WhlDirFr_D_Actl_91fa0768, ComIPduSignalRef=WhlDirRl_D_Actl_91fa0768, ComIPduSignalRef=WhlDirRr_D_Actl_91fa0768, ComIPduSignalRef=WhlRotatFl_No_Cnt_91fa0768, ComIPduSignalRef=WhlRotatFr_No_Cnt_91fa0768, ComIPduSignalRef=WhlRotatRl_No_Cnt_91fa0768, ComIPduSignalRef=WhlRotatRr_No_Cnt_91fa0768, ComPduIdRef=PT_WheelData_FD1_PP_WheelData_FD1_Rx_3290b631_3cf8f7d5
        WheelSpeed_FD1_oFD1_CAN_3abd61be: ComIPduDirection=RECEIVE, ComIPduGroupRef=PSCM_FD_oFD1_CAN_Rx_fcef2243, ComIPduSignalRef=WhlFl_W_Meas_5a620481, ComIPduSignalRef=WhlFr_W_Meas_5a620481, ComIPduSignalRef=WhlRl_W_Meas_5a620481, ComIPduSignalRef=WhlRr_W_Meas_5a620481, ComPduIdRef=PT_WheelSpeed_FD1_PP_WheelSpeed_FD1_Rx_3290b631_3cf8f7d5
        Yaw_Data_FD1_oFD1_CAN_3abd61be: ComIPduDirection=RECEIVE, ComIPduGroupRef=PSCM_FD_oFD1_CAN_Rx_fcef2243, ComIPduSignalRef=VehYaw_W_Actl_f318059c, ComPduIdRef=PT_Yaw_Data_FD1_PP_Yaw_Data_FD1_Rx_3290b631_3cf8f7d5
      PSCM_FD_oFD1_CAN_Rx_fcef2243 (ComIPduGroup)
      PSCM_FD_oFD1_CAN_Tx_fcef2243 (ComIPduGroup)
      168 x ComSignal:
        AbsActv_B_Actl_eaa4779a: ComBitPosition=45, ComBitSize=1, ComSignalEndianness=BIG_ENDIAN, ComSignalInitValue=0, ComSignalType=BOOLEAN, ComTimeout=0, ComSystemTemplateSystemSignalRef=AbsActv_B_Actl
        ApaSys_D_Stat_ef286bfc: ComBitPosition=61, ComBitSize=3, ComSignalEndianness=BIG_ENDIAN, ComSignalInitValue=0, ComSignalType=UINT8, ComTimeout=0, ComSystemTemplateSystemSignalRef=ApaSys_D_Stat
        ApedPosPcActl_D_Qf_a3d34b0d: ComBitPosition=7, ComBitSize=2, ComSignalEndianness=BIG_ENDIAN, ComSignalInitValue=1, ComSignalType=UINT8, ComTimeout=0, ComSystemTemplateSystemSignalRef=ApedPosPcActl_D_Qf
        ApedPos_Pc_ActlArb_a3d34b0d: ComBitPosition=1, ComBitSize=10, ComSignalEndianness=BIG_ENDIAN, ComSignalInitValue=0, ComSignalType=UINT16, ComTimeout=0, ComSystemTemplateSystemSignalRef=ApedPos_Pc_ActlArb
        BPedDrvAppl_D_QF_aea354aa: ComBitPosition=15, ComBitSize=2, ComSignalEndianness=BIG_ENDIAN, ComSignalInitValue=1, ComSignalType=UINT8, ComTimeout=0, ComSystemTemplateSystemSignalRef=BPedDrvAppl_D_QF
        BattULo_U_Actl_0a3b9a6b: ComBitPosition=39, ComBitSize=8, ComSignalEndianness=BIG_ENDIAN, ComSignalInitValue=255, ComSignalType=UINT8, ComTimeout=0, ComSystemTemplateSystemSignalRef=BattULo_U_Actl
        BpedDrvAppl_D_Actl_aea354aa: ComBitPosition=5, ComBitSize=2, ComSignalEndianness=BIG_ENDIAN, ComSignalInitValue=1, ComSignalType=UINT8, ComTimeout=0, ComSystemTemplateSystemSignalRef=BpedDrvAppl_D_Actl
        BrkTot_Tq_Actl_22c61bd2: ComBitPosition=27, ComBitSize=13, ComSignalEndianness=BIG_ENDIAN, ComSignalInitValue=0, ComSignalType=UINT16, ComTimeout=0, ComSystemTemplateSystemSignalRef=BrkTot_Tq_Actl
        CmbbBrkDis_B_Actl_eaa4779a: ComBitPosition=56, ComBitSize=1, ComSignalEndianness=BIG_ENDIAN, ComSignalInitValue=0, ComSignalType=BOOLEAN, ComTimeout=0, ComSystemTemplateSystemSignalRef=CmbbBrkDis_B_Actl
        CmbbDeny_B_ActlBrk_eaa4779a: ComBitPosition=60, ComBitSize=1, ComSignalEndianness=BIG_ENDIAN, ComSignalInitValue=0, ComSignalType=BOOLEAN, ComTimeout=0, ComSystemTemplateSystemSignalRef=CmbbDeny_B_ActlBrk
        CmbbObjClass_D_Stat_dafea5bb: ComBitPosition=13, ComBitSize=4, ComSignalEndianness=BIG_ENDIAN, ComSignalInitValue=0, ComSignalType=UINT8, ComTimeout=0, ComSystemTemplateSystemSignalRef=CmbbObjClass_D_Stat
        CmbbObjColl_T_Actl_dafea5bb: ComBitPosition=30, ComBitSize=7, ComSignalEndianness=BIG_ENDIAN, ComSignalInitValue=126, ComSignalType=UINT8, ComTimeout=0, ComSystemTemplateSystemSignalRef=CmbbObjColl_T_Actl
        CmbbObjConfdnc_D_Stat_dafea5bb: ComBitPosition=9, ComBitSize=2, ComSignalEndianness=BIG_ENDIAN, ComSignalInitValue=0, ComSignalType=UINT8, ComTimeout=0, ComSystemTemplateSystemSignalRef=CmbbObjConfdnc_D_Stat
        CmbbObjDistLat_L_Actl_dafea5bb: ComBitPosition=45, ComBitSize=9, ComSignalEndianness=BIG_ENDIAN, ComSignalInitValue=510, ComSignalType=UINT16, ComTimeout=0, ComSystemTemplateSystemSignalRef=CmbbObjDistLat_L_Actl
        CmbbObjDistLong_L_Actl_dafea5bb: ComBitPosition=7, ComBitSize=10, ComSignalEndianness=BIG_ENDIAN, ComSignalInitValue=1022, ComSignalType=UINT16, ComTimeout=0, ComSystemTemplateSystemSignalRef=CmbbObjDistLong_L_Actl
        CmbbObjRelLat_V_Actl_dafea5bb: ComBitPosition=23, ComBitSize=9, ComSignalEndianness=BIG_ENDIAN, ComSignalInitValue=510, ComSignalType=UINT16, ComTimeout=0, ComSystemTemplateSystemSignalRef=CmbbObjRelLat_V_Actl
        CmbbObjRelLong_V_Actl_dafea5bb: ComBitPosition=39, ComBitSize=10, ComSignalEndianness=BIG_ENDIAN, ComSignalInitValue=1022, ComSignalType=UINT16, ComTimeout=0, ComSystemTemplateSystemSignalRef=CmbbObjRelLong_V_Actl
        DeliveryIdle_f2797042: ComBitPosition=64, ComBitSize=16, ComSignalEndianness=LITTLE_ENDIAN, ComSignalInitValue=0, ComSignalType=UINT16, ComSystemTemplateSystemSignalRef=DeliveryIdle
        DeliveryNumber_f2797042: ComBitPosition=56, ComBitSize=8, ComSignalEndianness=LITTLE_ENDIAN, ComSignalInitValue=0, ComSignalType=UINT8, ComSystemTemplateSystemSignalRef=DeliveryNumber
        DeliverySipNumber_f2797042: ComBitPosition=0, ComBitSize=24, ComSignalEndianness=LITTLE_ENDIAN, ComSignalInitValue=1507332, ComSignalType=UINT32, ComSystemTemplateSystemSignalRef=DeliverySipNumber
        DeliverySubProjectNumber_f2797042: ComBitPosition=24, ComBitSize=32, ComSignalEndianness=LITTLE_ENDIAN, ComSignalInitValue=23072854, ComSignalType=UINT32, ComSystemTemplateSystemSignalRef=DeliverySubProjectNumber
        DrvSteActv_B_Stat_635efcb3: ComBitPosition=10, ComBitSize=1, ComSignalEndianness=BIG_ENDIAN, ComSignalInitValue=0, ComSignalType=BOOLEAN, ComTransferProperty=PENDING, ComSystemTemplateSystemSignalRef=DrvSteActv_B_Stat
        DrvSte_D_Stat_bfc9faa4: ComBitPosition=19, ComBitSize=4, ComSignalEndianness=BIG_ENDIAN, ComSignalInitValue=0, ComSignalType=UINT8, ComTimeout=0, ComSystemTemplateSystemSignalRef=DrvSte_D_Stat
        DrvSte_Tq_Actl_635efcb3: ComBitPosition=47, ComBitSize=8, ComSignalEndianness=BIG_ENDIAN, ComSignalInitValue=128, ComSignalType=UINT8, ComTransferProperty=PENDING, ComSystemTemplateSystemSignalRef=DrvSte_Tq_Actl
        DrvSte_Tq_Rq_bfc9faa4: ComBitPosition=31, ComBitSize=8, ComSignalEndianness=BIG_ENDIAN, ComSignalInitValue=128, ComSignalType=UINT8, ComTimeout=0, ComSystemTemplateSystemSignalRef=DrvSte_Tq_Rq
        EPASExtAngleStatReq_ef286bfc: ComBitPosition=23, ComBitSize=1, ComSignalEndianness=BIG_ENDIAN, ComSignalInitValue=0, ComSignalType=BOOLEAN, ComTimeout=0, ComSystemTemplateSystemSignalRef=EPASExtAngleStatReq
        EPAS_Failure_635efcb3: ComBitPosition=9, ComBitSize=2, ComSignalEndianness=BIG_ENDIAN, ComSignalInitValue=0, ComSignalType=UINT8, ComTransferProperty=PENDING, ComSystemTemplateSystemSignalRef=EPAS_Failure
        ElPw_D_StatStrtStop_e6deed9e: ComBitPosition=31, ComBitSize=4, ComSignalEndianness=BIG_ENDIAN, ComSignalInitValue=0, ComSignalType=UINT8, ComTimeout=0, ComSystemTemplateSystemSignalRef=ElPw_D_StatStrtStop
        ElPw_D_Stat_e6deed9e: ComBitPosition=3, ComBitSize=3, ComSignalEndianness=BIG_ENDIAN, ComSignalInitValue=0, ComSignalType=UINT8, ComTimeout=0, ComSystemTemplateSystemSignalRef=ElPw_D_Stat
        EngAout_N_Actl_a3d34b0d: ComBitPosition=28, ComBitSize=13, ComSignalEndianness=BIG_ENDIAN, ComSignalInitValue=0, ComSignalType=UINT16, ComTimeout=0, ComSystemTemplateSystemSignalRef=EngAout_N_Actl
        EsaEnbl_D2_Rq_dafea5bb: ComBitPosition=52, ComBitSize=2, ComSignalEndianness=BIG_ENDIAN, ComSignalInitValue=0, ComSignalType=UINT8, ComTimeout=0, ComSystemTemplateSystemSignalRef=EsaEnbl_D2_Rq
        EsaOn_B_Rq_bffaafb8: ComBitPosition=15, ComBitSize=1, ComSignalEndianness=BIG_ENDIAN, ComSignalInitValue=1, ComSignalType=BOOLEAN, ComTimeout=0, ComSystemTemplateSystemSignalRef=EsaOn_B_Rq
        EsaOn_B_Stat_51142c79: ComBitPosition=23, ComBitSize=1, ComSignalEndianness=BIG_ENDIAN, ComSignalInitValue=1, ComSignalType=BOOLEAN, ComTransferProperty=TRIGGERED_ON_CHANGE_WITHOUT_REPETITION, ComSystemTemplateSystemSignalRef=EsaOn_B_Stat
        ExtSteeringAngleReq2_ef286bfc: ComBitPosition=22, ComBitSize=15, ComSignalEndianness=BIG_ENDIAN, ComSignalInitValue=0, ComSignalType=UINT16, ComTimeout=0, ComSystemTemplateSystemSignalRef=ExtSteeringAngleReq2
        FileVersionDay_216bb0c2: ComBitPosition=16, ComBitSize=8, ComSignalEndianness=LITTLE_ENDIAN, ComSignalInitValue=48, ComSignalType=UINT8, ComSystemTemplateSystemSignalRef=FileVersionDay
        FileVersionMonth_216bb0c2: ComBitPosition=8, ComBitSize=8, ComSignalEndianness=LITTLE_ENDIAN, ComSignalInitValue=17, ComSignalType=UINT8, ComSystemTemplateSystemSignalRef=FileVersionMonth
        FileVersionNumber_216bb0c2: ComBitPosition=24, ComBitSize=8, ComSignalEndianness=LITTLE_ENDIAN, ComSignalInitValue=5, ComSignalType=UINT8, ComSystemTemplateSystemSignalRef=FileVersionNumber
        FileVersionYear_216bb0c2: ComBitPosition=0, ComBitSize=8, ComSignalEndianness=LITTLE_ENDIAN, ComSignalInitValue=23, ComSignalType=UINT8, ComSystemTemplateSystemSignalRef=FileVersionYear
        GearLvrPos_D_Actl_8c4ca771: ComBitPosition=12, ComBitSize=4, ComSignalEndianness=BIG_ENDIAN, ComSignalInitValue=14, ComSignalType=UINT8, ComTimeout=0, ComSystemTemplateSystemSignalRef=GearLvrPos_D_Actl
        GearPos_D_Actl_1e331f99: ComBitPosition=3, ComBitSize=4, ComSignalEndianness=BIG_ENDIAN, ComSignalInitValue=15, ComSignalType=UINT8, ComTimeout=0, ComSystemTemplateSystemSignalRef=GearPos_D_Actl
        GearRvrse_D_Actl_2508f61f: ComBitPosition=4, ComBitSize=3, ComSignalEndianness=BIG_ENDIAN, ComSignalInitValue=7, ComSignalType=UINT8, ComTimeout=0, ComSystemTemplateSystemSignalRef=GearRvrse_D_Actl
        HandsOffCnfm_B_Rq_5abef978: ComBitPosition=51, ComBitSize=1, ComSignalEndianness=BIG_ENDIAN, ComSignalInitValue=0, ComSignalType=BOOLEAN, ComTimeout=0, ComSystemTemplateSystemSignalRef=HandsOffCnfm_B_Rq
        HitchToTrlrAxle_L_Calc_51142c79: ComBitPosition=7, ComBitSize=9, ComSignalEndianness=BIG_ENDIAN, ComSignalInitValue=0, ComSignalType=UINT16, ComTransferProperty=PENDING, ComSystemTemplateSystemSignalRef=HitchToTrlrAxle_L_Calc
        HitchToVehAxle_L_Calc_0bf22cce: ComBitPosition=7, ComBitSize=8, ComSignalEndianness=BIG_ENDIAN, ComSignalInitValue=255, ComSignalType=UINT8, ComTimeout=0, ComSystemTemplateSystemSignalRef=HitchToVehAxle_L_Calc
        Ignition_Status_3c341b34: ComBitPosition=7, ComBitSize=4, ComSignalEndianness=BIG_ENDIAN, ComSignalInitValue=0, ComSignalType=UINT8, ComTimeout=0, ComSystemTemplateSystemSignalRef=Ignition_Status
        LaActAvail_D_Actl_3724073d: ComBitPosition=5, ComBitSize=2, ComSignalEndianness=BIG_ENDIAN, ComSignalInitValue=0, ComSignalType=UINT8, ComTransferProperty=PENDING, ComSystemTemplateSystemSignalRef=LaActAvail_D_Actl
        LaActDeny_B_Actl_3724073d: ComBitPosition=6, ComBitSize=1, ComSignalEndianness=BIG_ENDIAN, ComSignalInitValue=0, ComSignalType=BOOLEAN, ComTransferProperty=PENDING, ComSystemTemplateSystemSignalRef=LaActDeny_B_Actl
        LaCurvature_No_Calc_d64ac390: ComBitPosition=15, ComBitSize=12, ComSignalEndianness=BIG_ENDIAN, ComSignalInitValue=2048, ComSignalType=UINT16, ComTimeout=0, ComSystemTemplateSystemSignalRef=LaCurvature_No_Calc
        LaHandsOff_B_Actl_3724073d: ComBitPosition=7, ComBitSize=1, ComSignalEndianness=BIG_ENDIAN, ComSignalInitValue=1, ComSignalType=BOOLEAN, ComTransferProperty=PENDING, ComSystemTemplateSystemSignalRef=LaHandsOff_B_Actl
        LaRampType_B_Req_d64ac390: ComBitPosition=39, ComBitSize=1, ComSignalEndianness=BIG_ENDIAN, ComSignalInitValue=0, ComSignalType=BOOLEAN, ComTimeout=0, ComSystemTemplateSystemSignalRef=LaRampType_B_Req
        LaRefAng_No_Req_d64ac390: ComBitPosition=19, ComBitSize=12, ComSignalEndianness=BIG_ENDIAN, ComSignalInitValue=2048, ComSignalType=UINT16, ComTimeout=0, ComSystemTemplateSystemSignalRef=LaRefAng_No_Req
        LatCtlCurv_NoRate_Actl_5abef978: ComBitPosition=12, ComBitSize=13, ComSignalEndianness=BIG_ENDIAN, ComSignalInitValue=4096, ComSignalType=UINT16, ComTimeout=0, ComSystemTemplateSystemSignalRef=LatCtlCurv_NoRate_Actl
        LatCtlCurv_No_Actl_5abef978: ComBitPosition=7, ComBitSize=11, ComSignalEndianness=BIG_ENDIAN, ComSignalInitValue=1000, ComSignalType=UINT16, ComTimeout=0, ComSystemTemplateSystemSignalRef=LatCtlCurv_No_Actl
        LatCtlLim_D_Stat_51142c79: ComBitPosition=22, ComBitSize=2, ComSignalEndianness=BIG_ENDIAN, ComSignalInitValue=0, ComSignalType=UINT8, ComTransferProperty=TRIGGERED_ON_CHANGE_WITHOUT_REPETITION, ComSystemTemplateSystemSignalRef=LatCtlLim_D_Stat
        LatCtlPathOffst_L_Actl_5abef978: ComBitPosition=47, ComBitSize=10, ComSignalEndianness=BIG_ENDIAN, ComSignalInitValue=512, ComSignalType=UINT16, ComTimeout=0, ComSystemTemplateSystemSignalRef=LatCtlPathOffst_L_Actl
        LatCtlPath_An_Actl_5abef978: ComBitPosition=31, ComBitSize=11, ComSignalEndianness=BIG_ENDIAN, ComSignalInitValue=1000, ComSignalType=UINT16, ComTimeout=0, ComSystemTemplateSystemSignalRef=LatCtlPath_An_Actl
        LatCtlPrecision_D_Rq_5abef978: ComBitPosition=33, ComBitSize=2, ComSignalEndianness=BIG_ENDIAN, ComSignalInitValue=0, ComSignalType=UINT8, ComTimeout=0, ComSystemTemplateSystemSignalRef=LatCtlPrecision_D_Rq
        LatCtlRampType_D_Rq_5abef978: ComBitPosition=53, ComBitSize=2, ComSignalEndianness=BIG_ENDIAN, ComSignalInitValue=0, ComSignalType=UINT8, ComTimeout=0, ComSystemTemplateSystemSignalRef=LatCtlRampType_D_Rq
        LatCtlRng_L_Max_5abef978: ComBitPosition=63, ComBitSize=6, ComSignalEndianness=BIG_ENDIAN, ComSignalInitValue=0, ComSignalType=UINT8, ComTimeout=0, ComSystemTemplateSystemSignalRef=LatCtlRng_L_Max
        LatCtlSte_D_Stat_51142c79: ComBitPosition=20, ComBitSize=3, ComSignalEndianness=BIG_ENDIAN, ComSignalInitValue=0, ComSignalType=UINT8, ComTransferProperty=TRIGGERED_ON_CHANGE_WITHOUT_REPETITION, ComSystemTemplateSystemSignalRef=LatCtlSte_D_Stat
        LatCtl_D_Rq_5abef978: ComBitPosition=36, ComBitSize=3, ComSignalEndianness=BIG_ENDIAN, ComSignalInitValue=0, ComSignalType=UINT8, ComTimeout=0, ComSystemTemplateSystemSignalRef=LatCtl_D_Rq
        LdwActvIntns_D_Req_d64ac390: ComBitPosition=1, ComBitSize=2, ComSignalEndianness=BIG_ENDIAN, ComSignalInitValue=0, ComSignalType=UINT8, ComTimeout=0, ComSystemTemplateSystemSignalRef=LdwActvIntns_D_Req
        LdwActvStats_D_Req_d64ac390: ComBitPosition=4, ComBitSize=3, ComSignalEndianness=BIG_ENDIAN, ComSignalInitValue=0, ComSignalType=UINT8, ComTimeout=0, ComSystemTemplateSystemSignalRef=LdwActvStats_D_Req
        LifeCycMde_D_Actl_3c341b34: ComBitPosition=53, ComBitSize=4, ComSignalEndianness=BIG_ENDIAN, ComSignalInitValue=0, ComSignalType=UINT8, ComTimeout=0, ComSystemTemplateSystemSignalRef=LifeCycMde_D_Actl
        LkaActvStats_D2_Req_d64ac390: ComBitPosition=7, ComBitSize=3, ComSignalEndianness=BIG_ENDIAN, ComSignalInitValue=0, ComSignalType=UINT8, ComTimeout=0, ComSystemTemplateSystemSignalRef=LkaActvStats_D2_Req
        LkaDrvOvrrd_D_Rq_d64ac390: ComBitPosition=38, ComBitSize=2, ComSignalEndianness=BIG_ENDIAN, ComSignalInitValue=0, ComSignalType=UINT8, ComTimeout=0, ComSystemTemplateSystemSignalRef=LkaDrvOvrrd_D_Rq
        LsmcBrkDecelEnbl_D_Rq_3724073d: ComBitPosition=1, ComBitSize=2, ComSignalEndianness=BIG_ENDIAN, ComSignalInitValue=0, ComSignalType=UINT8, ComTransferProperty=PENDING, ComSystemTemplateSystemSignalRef=LsmcBrkDecelEnbl_D_Rq
        LsmcBrkDecel_D_Stat_9f750b9f: ComBitPosition=39, ComBitSize=3, ComSignalEndianness=BIG_ENDIAN, ComSignalInitValue=0, ComSignalType=UINT8, ComTimeout=0, ComSystemTemplateSystemSignalRef=LsmcBrkDecel_D_Stat
        LsmcBrk_Tq_Rq_3724073d: ComBitPosition=15, ComBitSize=13, ComSignalEndianness=BIG_ENDIAN, ComSignalInitValue=0, ComSignalType=UINT16, ComTransferProperty=PENDING, ComSystemTemplateSystemSignalRef=LsmcBrk_Tq_Rq
        OdometerMasterValue_09a60c78: ComBitPosition=15, ComBitSize=24, ComSignalEndianness=BIG_ENDIAN, ComSignalInitValue=0, ComSignalType=UINT32, ComTimeout=0, ComSystemTemplateSystemSignalRef=OdometerMasterValue
        Outside_Air_Temp_Stat_f1463698: ComBitPosition=7, ComBitSize=8, ComSignalEndianness=BIG_ENDIAN, ComSignalInitValue=254, ComSignalType=UINT8, ComTimeout=0, ComSystemTemplateSystemSignalRef=Outside_Air_Temp_Stat
        PrplWhlTot2_Tq_Actl_e6deed9e: ComBitPosition=15, ComBitSize=16, ComSignalEndianness=BIG_ENDIAN, ComSignalInitValue=0, ComSignalType=UINT16, ComTimeout=0, ComSystemTemplateSystemSignalRef=PrplWhlTot2_Tq_Actl
        PwPckTq_D_Stat_e6deed9e: ComBitPosition=5, ComBitSize=2, ComSignalEndianness=BIG_ENDIAN, ComSignalInitValue=0, ComSignalType=UINT8, ComTimeout=0, ComSystemTemplateSystemSignalRef=PwPckTq_D_Stat
        SAPPAngleControlStat1_635efcb3: ComBitPosition=23, ComBitSize=2, ComSignalEndianness=BIG_ENDIAN, ComSignalInitValue=0, ComSignalType=UINT8, ComTransferProperty=PENDING, ComSystemTemplateSystemSignalRef=SAPPAngleControlStat1
        SAPPAngleControlStat2_635efcb3: ComBitPosition=11, ComBitSize=1, ComSignalEndianness=BIG_ENDIAN, ComSignalInitValue=0, ComSignalType=BOOLEAN, ComTransferProperty=PENDING, ComSystemTemplateSystemSignalRef=SAPPAngleControlStat2
        SAPPAngleControlStat3_635efcb3: ComBitPosition=12, ComBitSize=1, ComSignalEndianness=BIG_ENDIAN, ComSignalInitValue=0, ComSignalType=BOOLEAN, ComTransferProperty=PENDING, ComSystemTemplateSystemSignalRef=SAPPAngleControlStat3
        SAPPAngleControlStat4_635efcb3: ComBitPosition=13, ComBitSize=1, ComSignalEndianness=BIG_ENDIAN, ComSignalInitValue=0, ComSignalType=BOOLEAN, ComTransferProperty=PENDING, ComSystemTemplateSystemSignalRef=SAPPAngleControlStat4
        SAPPAngleControlStat5_635efcb3: ComBitPosition=14, ComBitSize=1, ComSignalEndianness=BIG_ENDIAN, ComSignalInitValue=0, ComSignalType=BOOLEAN, ComTransferProperty=PENDING, ComSystemTemplateSystemSignalRef=SAPPAngleControlStat5
        SAPPAngleControlStat6_635efcb3: ComBitPosition=15, ComBitSize=1, ComSignalEndianness=BIG_ENDIAN, ComSignalInitValue=0, ComSignalType=BOOLEAN, ComTransferProperty=PENDING, ComSystemTemplateSystemSignalRef=SAPPAngleControlStat6
        SelDrvMdeChassis2_D_Rq_e000acae: ComBitPosition=45, ComBitSize=5, ComSignalEndianness=BIG_ENDIAN, ComSignalInitValue=0, ComSignalType=UINT8, ComTimeout=0, ComSystemTemplateSystemSignalRef=SelDrvMdeChassis2_D_Rq
        SelDrvMdeSte_D_Stat_51142c79: ComBitPosition=17, ComBitSize=2, ComSignalEndianness=BIG_ENDIAN, ComSignalInitValue=0, ComSignalType=UINT8, ComTransferProperty=TRIGGERED_ON_CHANGE_WITHOUT_REPETITION, ComSystemTemplateSystemSignalRef=SelDrvMdeSte_D_Stat
        StabCtlBrkActv_B_Actl_eaa4779a: ComBitPosition=23, ComBitSize=1, ComSignalEndianness=BIG_ENDIAN, ComSignalInitValue=0, ComSignalType=BOOLEAN, ComTimeout=0, ComSystemTemplateSystemSignalRef=StabCtlBrkActv_B_Actl
        SteMdule_D_Stat_635efcb3: ComBitPosition=55, ComBitSize=3, ComSignalEndianness=BIG_ENDIAN, ComSignalInitValue=0, ComSignalType=UINT8, ComTransferProperty=PENDING, ComSystemTemplateSystemSignalRef=SteMdule_D_Stat
        SteMdule_I_Est_635efcb3: ComBitPosition=21, ComBitSize=12, ComSignalEndianness=BIG_ENDIAN, ComSignalInitValue=4095, ComSignalType=UINT16, ComTransferProperty=PENDING, ComSystemTemplateSystemSignalRef=SteMdule_I_Est
        SteMdule_U_Meas_635efcb3: ComBitPosition=39, ComBitSize=8, ComSignalEndianness=BIG_ENDIAN, ComSignalInitValue=255, ComSignalType=UINT8, ComTransferProperty=PENDING, ComSystemTemplateSystemSignalRef=SteMdule_U_Meas
        StePinAn_No_Cnt_837112cd: ComBitPosition=47, ComBitSize=4, ComSignalEndianness=BIG_ENDIAN, ComSignalInitValue=0, ComSignalType=UINT8, ComTransferProperty=PENDING, ComSystemTemplateSystemSignalRef=StePinAn_No_Cnt
        StePinAn_No_Cs_837112cd: ComBitPosition=39, ComBitSize=8, ComSignalEndianness=BIG_ENDIAN, ComSignalInitValue=0, ComSignalType=UINT8, ComTransferProperty=PENDING, ComSystemTemplateSystemSignalRef=StePinAn_No_Cs
        StePinCompAnEst_D_Qf_837112cd: ComBitPosition=43, ComBitSize=2, ComSignalEndianness=BIG_ENDIAN, ComSignalInitValue=1, ComSignalType=UINT8, ComTransferProperty=PENDING, ComSystemTemplateSystemSignalRef=StePinCompAnEst_D_Qf
        StePinComp_An_Est_837112cd: ComBitPosition=22, ComBitSize=15, ComSignalEndianness=BIG_ENDIAN, ComSignalInitValue=16000, ComSignalType=UINT16, ComTransferProperty=PENDING, ComSystemTemplateSystemSignalRef=StePinComp_An_Est
        StePinOffst_An_Est_c3a8df7f: ComBitPosition=7, ComBitSize=16, ComSignalEndianness=BIG_ENDIAN, ComSignalInitValue=65534, ComSignalType=UINT16, ComTimeout=0, ComSystemTemplateSystemSignalRef=StePinOffst_An_Est
        StePinOffst_D_Stat_c3a8df7f: ComBitPosition=23, ComBitSize=2, ComSignalEndianness=BIG_ENDIAN, ComSignalInitValue=0, ComSignalType=UINT8, ComTimeout=0, ComSystemTemplateSystemSignalRef=StePinOffst_D_Stat
        StePinOffst_No_Cnt_c3a8df7f: ComBitPosition=21, ComBitSize=4, ComSignalEndianness=BIG_ENDIAN, ComSignalInitValue=0, ComSignalType=UINT8, ComTimeout=0, ComSystemTemplateSystemSignalRef=StePinOffst_No_Cnt
        StePinOffst_No_Cs_c3a8df7f: ComBitPosition=31, ComBitSize=8, ComSignalEndianness=BIG_ENDIAN, ComSignalInitValue=0, ComSignalType=UINT8, ComTimeout=0, ComSystemTemplateSystemSignalRef=StePinOffst_No_Cs
        StePinRelInit_An_Sns_837112cd: ComBitPosition=7, ComBitSize=16, ComSignalEndianness=BIG_ENDIAN, ComSignalInitValue=65535, ComSignalType=UINT16, ComTransferProperty=PENDING, ComSystemTemplateSystemSignalRef=StePinRelInit_An_Sns
        StePw_B_Rq_837112cd: ComBitPosition=23, ComBitSize=1, ComSignalEndianness=BIG_ENDIAN, ComSignalInitValue=0, ComSignalType=BOOLEAN, ComTransferProperty=PENDING, ComSystemTemplateSystemSignalRef=StePw_B_Rq
        SteWhlRelCalib_An_Sns_11fa9ae5: ComBitPosition=15, ComBitSize=15, ComSignalEndianness=BIG_ENDIAN, ComSignalInitValue=0, ComSignalType=UINT16, ComTimeout=0, ComSystemTemplateSystemSignalRef=SteWhlRelCalib_An_Sns
        SteeringColumnTorque_635efcb3: ComBitPosition=7, ComBitSize=8, ComSignalEndianness=BIG_ENDIAN, ComSignalInitValue=254, ComSignalType=UINT8, ComTransferProperty=PENDING, ComSystemTemplateSystemSignalRef=SteeringColumnTorque
        TjaHandsOnCnfdnc_B_Est_3724073d: ComBitPosition=3, ComBitSize=1, ComSignalEndianness=BIG_ENDIAN, ComSignalInitValue=1, ComSignalType=BOOLEAN, ComTransferProperty=PENDING, ComSystemTemplateSystemSignalRef=TjaHandsOnCnfdnc_B_Est
        TrlrAidCancl_B_Rq_630ef174: ComBitPosition=48, ComBitSize=1, ComSignalEndianness=BIG_ENDIAN, ComSignalInitValue=0, ComSignalType=BOOLEAN, ComTimeout=0, ComSystemTemplateSystemSignalRef=TrlrAidCancl_B_Rq
        TrlrAidCtl_U_RqDrv_372f28fe: ComBitPosition=31, ComBitSize=12, ComSignalEndianness=BIG_ENDIAN, ComSignalInitValue=4094, ComSignalType=UINT16, ComTimeout=0, ComSystemTemplateSystemSignalRef=TrlrAidCtl_U_RqDrv
        TrlrAidEnbl_D2_Rq_cc1bcd0f: ComBitPosition=7, ComBitSize=3, ComSignalEndianness=BIG_ENDIAN, ComSignalInitValue=0, ComSignalType=UINT8, ComTimeout=0, ComSystemTemplateSystemSignalRef=TrlrAidEnbl_D2_Rq
        TrlrAidEnbl_D2_Stat_51142c79: ComBitPosition=31, ComBitSize=3, ComSignalEndianness=BIG_ENDIAN, ComSignalInitValue=0, ComSignalType=UINT8, ComTransferProperty=TRIGGERED_ON_CHANGE_WITHOUT_REPETITION, ComSystemTemplateSystemSignalRef=TrlrAidEnbl_D2_Stat
        TrlrAidMde_D_Rq_a35cbfab: ComBitPosition=5, ComBitSize=2, ComSignalEndianness=BIG_ENDIAN, ComSignalInitValue=0, ComSignalType=UINT8, ComTimeout=0, ComSystemTemplateSystemSignalRef=TrlrAidMde_D_Rq
        TrlrAidMsgTxt_D2_Rq_51142c79: ComBitPosition=14, ComBitSize=6, ComSignalEndianness=BIG_ENDIAN, ComSignalInitValue=0, ComSignalType=UINT8, ComTransferProperty=TRIGGERED_ON_CHANGE_WITHOUT_REPETITION, ComSystemTemplateSystemSignalRef=TrlrAidMsgTxt_D2_Rq
        TrlrAidSetup_D2_Rq_cc1bcd0f: ComBitPosition=4, ComBitSize=4, ComSignalEndianness=BIG_ENDIAN, ComSignalInitValue=0, ComSignalType=UINT8, ComTimeout=0, ComSystemTemplateSystemSignalRef=TrlrAidSetup_D2_Rq
        TrlrAidSetup_D2_Stat_51142c79: ComBitPosition=47, ComBitSize=3, ComSignalEndianness=BIG_ENDIAN, ComSignalInitValue=0, ComSignalType=UINT8, ComTransferProperty=PENDING, ComSystemTemplateSystemSignalRef=TrlrAidSetup_D2_Stat
        TrlrAidSwtch_D_RqDrv_372f28fe: ComBitPosition=35, ComBitSize=2, ComSignalEndianness=BIG_ENDIAN, ComSignalInitValue=0, ComSignalType=UINT8, ComTimeout=0, ComSystemTemplateSystemSignalRef=TrlrAidSwtch_D_RqDrv
        TrlrAidTrgtId_No_Actl_0bf22cce: ComBitPosition=47, ComBitSize=5, ComSignalEndianness=BIG_ENDIAN, ComSignalInitValue=0, ComSignalType=UINT8, ComTimeout=0, ComSystemTemplateSystemSignalRef=TrlrAidTrgtId_No_Actl
        TrlrAidTrgtId_No_Rq_51142c79: ComBitPosition=44, ComBitSize=5, ComSignalEndianness=BIG_ENDIAN, ComSignalInitValue=0, ComSignalType=UINT8, ComTransferProperty=PENDING, ComSystemTemplateSystemSignalRef=TrlrAidTrgtId_No_Rq
        TrlrAidTrlrId_No_Rq_51142c79: ComBitPosition=63, ComBitSize=4, ComSignalEndianness=BIG_ENDIAN, ComSignalInitValue=0, ComSignalType=UINT8, ComTransferProperty=PENDING, ComSystemTemplateSystemSignalRef=TrlrAidTrlrId_No_Rq
        TrlrAid_An3_Actl_0bf22cce: ComBitPosition=28, ComBitSize=11, ComSignalEndianness=BIG_ENDIAN, ComSignalInitValue=720, ComSignalType=UINT16, ComTimeout=0, ComSystemTemplateSystemSignalRef=TrlrAid_An3_Actl
        TrlrAid_AnRate2_Actl_0bf22cce: ComBitPosition=22, ComBitSize=10, ComSignalEndianness=BIG_ENDIAN, ComSignalInitValue=400, ComSignalType=UINT16, ComTimeout=0, ComSystemTemplateSystemSignalRef=TrlrAid_AnRate2_Actl
        TrlrAid_D2_Stat_0bf22cce: ComBitPosition=55, ComBitSize=4, ComSignalEndianness=BIG_ENDIAN, ComSignalInitValue=0, ComSignalType=UINT8, ComTimeout=0, ComSystemTemplateSystemSignalRef=TrlrAid_D2_Stat
        TrlrAnOffstDir_D_Mem_0edbb78e: ComBitPosition=62, ComBitSize=2, ComSignalEndianness=BIG_ENDIAN, ComSignalInitValue=0, ComSignalType=UINT8, ComTimeout=0, ComSystemTemplateSystemSignalRef=TrlrAnOffstDir_D_Mem
        TrlrAnOffst_An2_Calc_51142c79: ComBitPosition=39, ComBitSize=8, ComSignalEndianness=BIG_ENDIAN, ComSignalInitValue=128, ComSignalType=UINT8, ComTransferProperty=PENDING, ComSystemTemplateSystemSignalRef=TrlrAnOffst_An2_Calc
        TrlrAn_An_MxCalc_51142c79: ComBitPosition=55, ComBitSize=7, ComSignalEndianness=BIG_ENDIAN, ComSignalInitValue=0, ComSignalType=UINT8, ComTransferProperty=PENDING, ComSystemTemplateSystemSignalRef=TrlrAn_An_MxCalc
        TrlrAn_An_TrgtCalc_3724073d: ComBitPosition=31, ComBitSize=8, ComSignalEndianness=BIG_ENDIAN, ComSignalInitValue=128, ComSignalType=UINT8, ComTransferProperty=PENDING, ComSystemTemplateSystemSignalRef=TrlrAn_An_TrgtCalc
        TrlrAn_An_WarnCalc_51142c79: ComBitPosition=28, ComBitSize=5, ComSignalEndianness=BIG_ENDIAN, ComSignalInitValue=0, ComSignalType=UINT8, ComTransferProperty=PENDING, ComSystemTemplateSystemSignalRef=TrlrAn_An_WarnCalc
        TrlrAxleToBmpr_L_Actl_0edbb78e: ComBitPosition=7, ComBitSize=9, ComSignalEndianness=BIG_ENDIAN, ComSignalInitValue=0, ComSignalType=UINT16, ComTimeout=0, ComSystemTemplateSystemSignalRef=TrlrAxleToBmpr_L_Actl
        TrlrBrkActCnnct_B_Actl_e983cb78: ComBitPosition=6, ComBitSize=1, ComSignalEndianness=BIG_ENDIAN, ComSignalInitValue=0, ComSignalType=BOOLEAN, ComTimeout=0, ComSystemTemplateSystemSignalRef=TrlrBrkActCnnct_B_Actl
        TrlrHitYaw_AnRate_Actl_96fdcdb8: ComBitPosition=27, ComBitSize=12, ComSignalEndianness=BIG_ENDIAN, ComSignalInitValue=4094, ComSignalType=UINT16, ComTimeout=0, ComSystemTemplateSystemSignalRef=TrlrHitYaw_AnRate_Actl
        TrlrHitchLamp_D_Rqst_635efcb3: ComBitPosition=24, ComBitSize=1, ComSignalEndianness=BIG_ENDIAN, ComSignalInitValue=0, ComSignalType=BOOLEAN, ComTransferProperty=PENDING, ComSystemTemplateSystemSignalRef=TrlrHitchLamp_D_Rqst
        TrlrHitchYaw_An_Actl_96fdcdb8: ComBitPosition=23, ComBitSize=12, ComSignalEndianness=BIG_ENDIAN, ComSignalInitValue=4094, ComSignalType=UINT16, ComTimeout=0, ComSystemTemplateSystemSignalRef=TrlrHitchYaw_An_Actl
        TrlrHitchYaw_D_Stat_96fdcdb8: ComBitPosition=47, ComBitSize=4, ComSignalEndianness=BIG_ENDIAN, ComSignalInitValue=0, ComSignalType=UINT8, ComTimeout=0, ComSystemTemplateSystemSignalRef=TrlrHitchYaw_D_Stat
        TrlrIdType_D_Stat_0edbb78e: ComBitPosition=33, ComBitSize=2, ComSignalEndianness=BIG_ENDIAN, ComSignalInitValue=0, ComSignalType=UINT8, ComTimeout=0, ComSystemTemplateSystemSignalRef=TrlrIdType_D_Stat
        TrlrId_No_Actl_0edbb78e: ComBitPosition=12, ComBitSize=4, ComSignalEndianness=BIG_ENDIAN, ComSignalInitValue=0, ComSignalType=UINT8, ComTimeout=0, ComSystemTemplateSystemSignalRef=TrlrId_No_Actl
        TrlrLampCnnct_B_Actl_6acffff2: ComBitPosition=7, ComBitSize=1, ComSignalEndianness=BIG_ENDIAN, ComSignalInitValue=0, ComSignalType=BOOLEAN, ComTimeout=0, ComSystemTemplateSystemSignalRef=TrlrLampCnnct_B_Actl
        TrlrRvrseCancl_B_Rq_0edbb78e: ComBitPosition=8, ComBitSize=1, ComSignalEndianness=BIG_ENDIAN, ComSignalInitValue=0, ComSignalType=BOOLEAN, ComTimeout=0, ComSystemTemplateSystemSignalRef=TrlrRvrseCancl_B_Rq
        TrlrRvrseEnbl_D2_Stat_ae9dea9d: ComBitPosition=18, ComBitSize=3, ComSignalEndianness=BIG_ENDIAN, ComSignalInitValue=0, ComSignalType=UINT8, ComTimeout=0, ComSystemTemplateSystemSignalRef=TrlrRvrseEnbl_D2_Stat
        TrlrRvrseMsgTxt_D2_Rq_ae9dea9d: ComBitPosition=31, ComBitSize=6, ComSignalEndianness=BIG_ENDIAN, ComSignalInitValue=0, ComSignalType=UINT8, ComTimeout=0, ComSystemTemplateSystemSignalRef=TrlrRvrseMsgTxt_D2_Rq
        TrlrRvrse_D_Stat_0bf22cce: ComBitPosition=42, ComBitSize=2, ComSignalEndianness=BIG_ENDIAN, ComSignalInitValue=0, ComSignalType=UINT8, ComTimeout=0, ComSystemTemplateSystemSignalRef=TrlrRvrse_D_Stat
        TrlrSnsId_No_Actl_ea9ce863: ComBitPosition=0, ComSignalEndianness=opaque, ComSignalInitValue=0 0 0 0 0 0, ComSignalLength=6, ComSignalType=UINT8_N, ComTimeout=0, ComSystemTemplateSystemSignalRef=TrlrSnsId_No_Actl
        TrlrTrgtAcquire_D_Stat_0bf22cce: ComBitPosition=51, ComBitSize=3, ComSignalEndianness=BIG_ENDIAN, ComSignalInitValue=0, ComSignalType=UINT8, ComTimeout=0, ComSystemTemplateSystemSignalRef=TrlrTrgtAcquire_D_Stat
        TrlrYawWActl_D_Qf_96fdcdb8: ComBitPosition=43, ComBitSize=2, ComSignalEndianness=BIG_ENDIAN, ComSignalInitValue=1, ComSignalType=UINT8, ComTimeout=0, ComSystemTemplateSystemSignalRef=TrlrYawWActl_D_Qf
        TrlrYaw_W_Actl_96fdcdb8: ComBitPosition=7, ComBitSize=16, ComSignalEndianness=BIG_ENDIAN, ComSignalInitValue=65534, ComSignalType=UINT16, ComTimeout=0, ComSystemTemplateSystemSignalRef=TrlrYaw_W_Actl
        TrnRng_D_Rq_1e331f99: ComBitPosition=27, ComBitSize=4, ComSignalEndianness=BIG_ENDIAN, ComSignalInitValue=14, ComSignalType=UINT8, ComTimeout=0, ComSystemTemplateSystemSignalRef=TrnRng_D_Rq
        TurnLghtSwtch_D_Stat_7262fead: ComBitPosition=5, ComBitSize=2, ComSignalEndianness=BIG_ENDIAN, ComSignalInitValue=0, ComSignalType=UINT8, ComTimeout=0, ComSystemTemplateSystemSignalRef=TurnLghtSwtch_D_Stat
        VehLatComp_A_Actl_470bb112: ComBitPosition=43, ComBitSize=10, ComSignalEndianness=BIG_ENDIAN, ComSignalInitValue=1022, ComSignalType=UINT16, ComTimeout=0, ComSystemTemplateSystemSignalRef=VehLatComp_A_Actl
        VehLongComp_A_Actl_470bb112: ComBitPosition=49, ComBitSize=10, ComSignalEndianness=BIG_ENDIAN, ComSignalInitValue=1022, ComSignalType=UINT16, ComTimeout=0, ComSystemTemplateSystemSignalRef=VehLongComp_A_Actl
        VehOverGnd_V_Est_470bb112: ComBitPosition=7, ComBitSize=16, ComSignalEndianness=BIG_ENDIAN, ComSignalInitValue=0, ComSignalType=UINT16, ComTimeout=0, ComSystemTemplateSystemSignalRef=VehOverGnd_V_Est
        VehVActlBrk_D_Qf_9f750b9f: ComBitPosition=23, ComBitSize=2, ComSignalEndianness=BIG_ENDIAN, ComSignalInitValue=0, ComSignalType=UINT8, ComTimeout=0, ComSystemTemplateSystemSignalRef=VehVActlBrk_D_Qf
        VehVActlBrk_No_Cnt_9f750b9f: ComBitPosition=21, ComBitSize=4, ComSignalEndianness=BIG_ENDIAN, ComSignalInitValue=0, ComSignalType=UINT8, ComTimeout=0, ComSystemTemplateSystemSignalRef=VehVActlBrk_No_Cnt
        VehVActlBrk_No_Cs_9f750b9f: ComBitPosition=31, ComBitSize=8, ComSignalEndianness=BIG_ENDIAN, ComSignalInitValue=0, ComSignalType=UINT8, ComTimeout=0, ComSystemTemplateSystemSignalRef=VehVActlBrk_No_Cs
        VehVActlEng_D_Qf_2508f61f: ComBitPosition=38, ComBitSize=2, ComSignalEndianness=BIG_ENDIAN, ComSignalInitValue=0, ComSignalType=UINT8, ComTimeout=0, ComSystemTemplateSystemSignalRef=VehVActlEng_D_Qf
        VehVActlEng_No_Cnt_2508f61f: ComBitPosition=22, ComBitSize=4, ComSignalEndianness=BIG_ENDIAN, ComSignalInitValue=0, ComSignalType=UINT8, ComTimeout=0, ComSystemTemplateSystemSignalRef=VehVActlEng_No_Cnt
        VehVActlEng_No_Cs_2508f61f: ComBitPosition=15, ComBitSize=8, ComSignalEndianness=BIG_ENDIAN, ComSignalInitValue=0, ComSignalType=UINT8, ComTimeout=0, ComSystemTemplateSystemSignalRef=VehVActlEng_No_Cs
        VehVTrlrAid_B_Avail_2508f61f: ComBitPosition=23, ComBitSize=1, ComSignalEndianness=BIG_ENDIAN, ComSignalInitValue=0, ComSignalType=BOOLEAN, ComTimeout=0, ComSystemTemplateSystemSignalRef=VehVTrlrAid_B_Avail
        VehVTrlrAid_B_Rq_635efcb3: ComBitPosition=25, ComBitSize=1, ComSignalEndianness=BIG_ENDIAN, ComSignalInitValue=0, ComSignalType=BOOLEAN, ComTransferProperty=PENDING, ComSystemTemplateSystemSignalRef=VehVTrlrAid_B_Rq
        VehVertComp_A_Actl_22c61bd2: ComBitPosition=45, ComBitSize=10, ComSignalEndianness=BIG_ENDIAN, ComSignalInitValue=1022, ComSignalType=UINT16, ComTimeout=0, ComSystemTemplateSystemSignalRef=VehVertComp_A_Actl
        VehYawComp_W_Actl_470bb112: ComBitPosition=19, ComBitSize=12, ComSignalEndianness=BIG_ENDIAN, ComSignalInitValue=4094, ComSignalType=UINT16, ComTimeout=0, ComSystemTemplateSystemSignalRef=VehYawComp_W_Actl
        VehYaw_W_Actl_f318059c: ComBitPosition=23, ComBitSize=16, ComSignalEndianness=BIG_ENDIAN, ComSignalInitValue=65534, ComSignalType=UINT16, ComTimeout=0, ComSystemTemplateSystemSignalRef=VehYaw_W_Actl
        Veh_V_ActlBrk_9f750b9f: ComBitPosition=7, ComBitSize=16, ComSignalEndianness=BIG_ENDIAN, ComSignalInitValue=0, ComSignalType=UINT16, ComTimeout=0, ComSystemTemplateSystemSignalRef=Veh_V_ActlBrk
        Veh_V_ActlEng_2508f61f: ComBitPosition=55, ComBitSize=16, ComSignalEndianness=BIG_ENDIAN, ComSignalInitValue=0, ComSignalType=UINT16, ComTimeout=0, ComSystemTemplateSystemSignalRef=Veh_V_ActlEng
        Veh_V_RqMxTrlrAid_635efcb3: ComBitPosition=63, ComBitSize=8, ComSignalEndianness=BIG_ENDIAN, ComSignalInitValue=255, ComSignalType=UINT8, ComTransferProperty=PENDING, ComSystemTemplateSystemSignalRef=Veh_V_RqMxTrlrAid
        VehicleGGCCData_575096ac: ComBitPosition=0, ComSignalEndianness=opaque, ComSignalInitValue=0 0 0 0 0 0 0 0, ComSignalLength=8, ComSignalType=UINT8_N, ComTimeout=0, ComSystemTemplateSystemSignalRef=VehicleGGCCData
        WhlDirFl_D_Actl_91fa0768: ComBitPosition=35, ComBitSize=2, ComSignalEndianness=BIG_ENDIAN, ComSignalInitValue=0, ComSignalType=UINT8, ComTimeout=0, ComSystemTemplateSystemSignalRef=WhlDirFl_D_Actl
        WhlDirFr_D_Actl_91fa0768: ComBitPosition=37, ComBitSize=2, ComSignalEndianness=BIG_ENDIAN, ComSignalInitValue=0, ComSignalType=UINT8, ComTimeout=0, ComSystemTemplateSystemSignalRef=WhlDirFr_D_Actl
        WhlDirRl_D_Actl_91fa0768: ComBitPosition=39, ComBitSize=2, ComSignalEndianness=BIG_ENDIAN, ComSignalInitValue=0, ComSignalType=UINT8, ComTimeout=0, ComSystemTemplateSystemSignalRef=WhlDirRl_D_Actl
        WhlDirRr_D_Actl_91fa0768: ComBitPosition=33, ComBitSize=2, ComSignalEndianness=BIG_ENDIAN, ComSignalInitValue=0, ComSignalType=UINT8, ComTimeout=0, ComSystemTemplateSystemSignalRef=WhlDirRr_D_Actl
        WhlFl_W_Meas_5a620481: ComBitPosition=6, ComBitSize=15, ComSignalEndianness=BIG_ENDIAN, ComSignalInitValue=0, ComSignalType=UINT16, ComTimeout=0, ComSystemTemplateSystemSignalRef=WhlFl_W_Meas
        WhlFr_W_Meas_5a620481: ComBitPosition=22, ComBitSize=15, ComSignalEndianness=BIG_ENDIAN, ComSignalInitValue=0, ComSignalType=UINT16, ComTimeout=0, ComSystemTemplateSystemSignalRef=WhlFr_W_Meas
        WhlRl_W_Meas_5a620481: ComBitPosition=38, ComBitSize=15, ComSignalEndianness=BIG_ENDIAN, ComSignalInitValue=0, ComSignalType=UINT16, ComTimeout=0, ComSystemTemplateSystemSignalRef=WhlRl_W_Meas
        WhlRotatFl_No_Cnt_91fa0768: ComBitPosition=15, ComBitSize=8, ComSignalEndianness=BIG_ENDIAN, ComSignalInitValue=0, ComSignalType=UINT8, ComTimeout=0, ComSystemTemplateSystemSignalRef=WhlRotatFl_No_Cnt
        WhlRotatFr_No_Cnt_91fa0768: ComBitPosition=7, ComBitSize=8, ComSignalEndianness=BIG_ENDIAN, ComSignalInitValue=0, ComSignalType=UINT8, ComTimeout=0, ComSystemTemplateSystemSignalRef=WhlRotatFr_No_Cnt
        WhlRotatRl_No_Cnt_91fa0768: ComBitPosition=31, ComBitSize=8, ComSignalEndianness=BIG_ENDIAN, ComSignalInitValue=0, ComSignalType=UINT8, ComTimeout=0, ComSystemTemplateSystemSignalRef=WhlRotatRl_No_Cnt
        WhlRotatRr_No_Cnt_91fa0768: ComBitPosition=23, ComBitSize=8, ComSignalEndianness=BIG_ENDIAN, ComSignalInitValue=0, ComSignalType=UINT8, ComTimeout=0, ComSystemTemplateSystemSignalRef=WhlRotatRr_No_Cnt
        WhlRr_W_Meas_5a620481: ComBitPosition=54, ComBitSize=15, ComSignalEndianness=BIG_ENDIAN, ComSignalInitValue=0, ComSignalType=UINT16, ComTimeout=0, ComSystemTemplateSystemSignalRef=WhlRr_W_Meas
        YawStabilityIndex_706a037f: ComBitPosition=0, ComBitSize=9, ComSignalEndianness=BIG_ENDIAN, ComSignalInitValue=256, ComSignalType=UINT16, ComTimeout=0, ComSystemTemplateSystemSignalRef=YawStabilityIndex
    ComGeneral
  module config ComM
    ComMConfigSet: ComMPncEnabled=false
      FD1_CAN_f26020e5 (ComMChannel): ComMBusType=COMM_BUS_TYPE_CAN, ComMChannelId=0  # CN_FD1_CAN
        ComMNetworkManagement: ComMNmVariant=NONE
        CHNL_cd1e16dc (ComMUserPerChannel): ComMUserChannel=USR_CHNL_cd1e16dc
      USR_CHNL_cd1e16dc (ComMUser): ComMUserIdentifier=0  # CN_FD1_CAN
    ComMGeneral: ComMPncIdCounting=COMM_PNC_ID_COUNT_FROM_NM_MESSAGE, ComMPncSupport=false
