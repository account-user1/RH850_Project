AUTOSAR XML (schema 4-2-1)
package /ActiveEcuC
  module config Port: implementation-config-variant=VARIANT-POST-BUILD, module-description=Port_Impl
    PortGeneral:
      PortVersionCheckExternalModules = false
      PortDevErrorDetect = true
      PortSetPinDirectionApi = false
      PortSetPinDefaultDirectionApi = false
      PortSetPinModeApi = true
      PortSetPinDefaultModeApi = false
      PortVersionInfoApi = true
      PortDeviceName = R7F701373
      PortCriticalSectionProtection = true
      PortMaxMode = 4
      PortSetToDioAltModeApi = true
      PortUseWriteVerifyErrorInterface = false
      PortWriteVerify = WV_DISABLE
    PortConfigSet
      PortContainer: PortNumberOfPortPins=1
        PortPin:
          PortPinDirection = PORT_PIN_IN
          PortPinDirectionChangeable = false
          PortPinId = 1
          PortPinInitialMode = PORT_PIN_MODE_DIO
          PortPinLevelValue = PORT_PIN_LEVEL_LOW
          PortPinMode = PORT_PIN_MODE_DIO
          PortPinModeChangeable = false
      PortFilterGroupConfig
      PortGroup0
        PortPin0:
          PortPinDirectionChangeable = false
          PortPinDioAltModeChangeable = false
          PortPinModeChangeable = false
          PortPinLevelValue = PORT_PIN_LEVEL_LOW
          PortPinInitialMode = DIO
          PortPinDirection = PORT_PIN_IN
          PortInputBufferControl = false
          PortBiDirectionControl = false
          PortIpControl = false
          PortPullUpOption = false
          PortPullDownOption = false
          PortOutputLevelInversion = false
          PortDriveStrengthControl = SLOW
          PortInputSelection = TYPE1_SHMT1
          PortOpenDrainControl_Expansion = OpenDrain_N_Channel
          PortUniversalCharacteristicCntrl = false
        PortPin1:
          PortPinDirectionChangeable = false
          PortPinDioAltModeChangeable = false
          PortPinModeChangeable = false
          PortPinLevelValue = PORT_PIN_LEVEL_HIGH
          PortPinInitialMode = SENT1RX_ALT3_IN
          PortPinDirection = PORT_PIN_IN
          PortInputBufferControl = false
          PortBiDirectionControl = true
          PortIpControl = false
          PortPullUpOption = false
          PortPullDownOption = false
          PortOutputLevelInversion = false
          PortDriveStrengthControl = FAST
          PortInputSelection = TYPE1_SHMT1
          PortOpenDrainControl_Expansion = OpenDrain_N_Channel
          PortUniversalCharacteristicCntrl = false
        PortPin2:
          PortPinDirectionChangeable = false
          PortPinDioAltModeChangeable = false
          PortPinModeChangeable = false
          PortPinLevelValue = PORT_PIN_LEVEL_LOW
          PortPinInitialMode = CSIH0CSS4_ALT3_OUT
          PortPinDirection = PORT_PIN_OUT
          PortInputBufferControl = false
          PortBiDirectionControl = false
          PortIpControl = false
          PortPullUpOption = false
          PortPullDownOption = false
          PortOutputLevelInversion = false
          PortDriveStrengthControl = SLOW
          PortInputSelection = TYPE1_SHMT1
          PortOpenDrainControl_Expansion = PushPull
          PortUniversalCharacteristicCntrl = false
        PortPin3:
          PortPinDirectionChangeable = false
          PortPinDioAltModeChangeable = false
          PortPinModeChangeable = false
          PortPinLevelValue = PORT_PIN_LEVEL_LOW
          PortPinInitialMode = DIO
          PortPinDirection = PORT_PIN_IN
          PortInputBufferControl = true
          PortBiDirectionControl = false
          PortIpControl = false
          PortPullUpOption = false
          PortPullDownOption = false
          PortOutputLevelInversion = false
          PortDriveStrengthControl = SLOW
          PortInputSelection = TYPE1_SHMT1
          PortOpenDrainControl_Expansion = OpenDrain_N_Channel
          PortUniversalCharacteristicCntrl = false
        PortPin4:
          PortPinDirectionChangeable = false
          PortPinDioAltModeChangeable = false
          PortPinModeChangeable = false
          PortPinLevelValue = PORT_PIN_LEVEL_LOW
          PortPinInitialMode = DIO
          PortPinDirection = PORT_PIN_IN
          PortInputBufferControl = false
          PortBiDirectionControl = false
          PortIpControl = false
          PortPullUpOption = false
          PortPullDownOption = false
          PortOutputLevelInversion = false
          PortDriveStrengthControl = SLOW
          PortInputSelection = TYPE1_SHMT1
          PortOpenDrainControl_Expansion = OpenDrain_N_Channel
          PortUniversalCharacteristicCntrl = false
        PortPin5:
          PortPinDirectionChangeable = false
          PortPinDioAltModeChangeable = false
          PortPinModeChangeable = false
          PortPinLevelValue = PORT_PIN_LEVEL_LOW
          PortPinInitialMode = GTMAT1O0_ALT1_OUT
          PortPinDirection = PORT_PIN_OUT
          PortInputBufferControl = false
          PortBiDirectionControl = false
          PortIpControl = true
          PortPullUpOption = false
          PortPullDownOption = false
          PortOutputLevelInversion = false
          PortDriveStrengthControl = SLOW
          PortInputSelection = TYPE1_SHMT1
          PortOpenDrainControl_Expansion = PushPull
          PortUniversalCharacteristicCntrl = false
        PortPin6:
          PortPinDirectionChangeable = false
          PortPinDioAltModeChangeable = false
          PortPinModeChangeable = false
          PortPinLevelValue = PORT_PIN_LEVEL_LOW
          PortPinInitialMode = DIO
          PortPinDirection = PORT_PIN_IN
          PortInputBufferControl = false
          PortBiDirectionControl = false
          PortPullUpOption = false
          PortPullDownOption = false
          PortOutputLevelInversion = false
          PortDriveStrengthControl = SLOW
          PortInputSelection = TYPE1_SHMT1
          PortOpenDrainControl_Expansion = OpenDrain_N_Channel
          PortUniversalCharacteristicCntrl = false
        PortPin7:
          PortPinDirectionChangeable = false
          PortPinDioAltModeChangeable = false
          PortPinModeChangeable = true
          PortPinLevelValue = PORT_PIN_LEVEL_HIGH
          PortPinInitialMode = GTM0I4_ALT1_IN
          PortPinDirection = PORT_PIN_IN
          PortInputBufferControl = false
          PortBiDirectionControl = true
          PortIpControl = false
          PortPullUpOption = false
          PortPullDownOption = false
          PortOutputLevelInversion = false
          PortDriveStrengthControl = SLOW
          PortInputSelection = TYPE1_SHMT1
          PortOpenDrainControl_Expansion = OpenDrain_N_Channel
          PortUniversalCharacteristicCntrl = false
        PortPin8:
          PortPinDirectionChangeable = false
          PortPinDioAltModeChangeable = false
          PortPinModeChangeable = false
          PortPinLevelValue = PORT_PIN_LEVEL_LOW
          PortPinInitialMode = DIO
          PortPinDirection = PORT_PIN_IN
          PortInputBufferControl = false
          PortBiDirectionControl = false
          PortIpControl = false
          PortPullUpOption = false
          PortPullDownOption = false
          PortOutputLevelInversion = false
          PortDriveStrengthControl = SLOW
          PortInputSelection = TYPE1_SHMT1
          PortOpenDrainControl_Expansion = OpenDrain_N_Channel
          PortUniversalCharacteristicCntrl = false
        PortPin9:
          PortPinDirectionChangeable = false
          PortPinDioAltModeChangeable = false
          PortPinModeChangeable = false
          PortPinLevelValue = PORT_PIN_LEVEL_LOW
          PortPinInitialMode = DIO
          PortPinDirection = PORT_PIN_IN
          PortInputBufferControl = false
          PortBiDirectionControl = false
          PortIpControl = false
          PortPullUpOption = false
          PortPullDownOption = false
          PortOutputLevelInversion = false
          PortDriveStrengthControl = SLOW
          PortInputSelection = TYPE1_SHMT1
          PortOpenDrainControl_Expansion = OpenDrain_N_Channel
          PortUniversalCharacteristicCntrl = false
        PortPin10:
          PortPinDirectionChangeable = false
          PortPinDioAltModeChangeable = false
          PortPinModeChangeable = true
          PortPinLevelValue = PORT_PIN_LEVEL_LOW
          PortPinInitialMode = ALT_NOT_SUPPORTED
          PortPinDirection = PORT_PIN_IN
          PortInputBufferControl = false
          PortBiDirectionControl = false
          PortPullUpOption = false
          PortPullDownOption = false
          PortOutputLevelInversion = false
          PortDriveStrengthControl = SLOW
          PortInputSelection = TYPE1_SHMT1
          PortOpenDrainControl_Expansion = OpenDrain_N_Channel
          PortUniversalCharacteristicCntrl = false
        PortPin13:
          PortPinDirectionChangeable = false
          PortPinDioAltModeChangeable = false
          PortPinModeChangeable = false
          PortPinLevelValue = PORT_PIN_LEVEL_HIGH
          PortPinInitialMode = SENT4RX_ALT3_IN
          PortPinDirection = PORT_PIN_IN
          PortInputBufferControl = false
          PortBiDirectionControl = true
          PortIpControl = false
          PortPullUpOption = false
          PortPullDownOption = false
          PortOutputLevelInversion = false
          PortDriveStrengthControl = FAST
          PortInputSelection = TYPE1_SHMT1
          PortOpenDrainControl_Expansion = OpenDrain_N_Channel
          PortUniversalCharacteristicCntrl = false
        PortPin14:
          PortPinDirectionChangeable = false
          PortPinDioAltModeChangeable = false
          PortPinModeChangeable = false
          PortPinLevelValue = PORT_PIN_LEVEL_LOW
          PortPinInitialMode = DIO
          PortPinDirection = PORT_PIN_IN
          PortInputBufferControl = false
          PortBiDirectionControl = false
          PortIpControl = false
          PortPullUpOption = false
          PortPullDownOption = false
          PortOutputLevelInversion = false
          PortDriveStrengthControl = SLOW
          PortInputSelection = TYPE1_SHMT1
          PortOpenDrainControl_Expansion = OpenDrain_N_Channel
          PortUniversalCharacteristicCntrl = false
      PortGroup1
        PortPin1:
          PortPinDirectionChangeable = false
          PortPinDioAltModeChangeable = false
          PortPinModeChangeable = false
          PortPinLevelValue = PORT_PIN_LEVEL_LOW
          PortPinInitialMode = DIO
          PortPinDirection = PORT_PIN_IN
          PortInputBufferControl = false
          PortBiDirectionControl = false
          PortIpControl = false
          PortPullUpOption = false
          PortPullDownOption = false
          PortOutputLevelInversion = false
          PortDriveStrengthControl = SLOW
          PortInputSelection = TYPE1_SHMT1
          PortOpenDrainControl_Expansion = OpenDrain_N_Channel
          PortUniversalCharacteristicCntrl = false
        PortPin2:
          PortPinDirectionChangeable = false
          PortPinDioAltModeChangeable = false
          PortPinModeChangeable = false
          PortPinLevelValue = PORT_PIN_LEVEL_LOW
          PortPinInitialMode = DIO
          PortPinDirection = PORT_PIN_OUT
          PortInputBufferControl = false
          PortBiDirectionControl = false
          PortIpControl = false
          PortPullUpOption = false
          PortPullDownOption = false
          PortOutputLevelInversion = false
          PortDriveStrengthControl = SLOW
          PortInputSelection = TYPE1_SHMT1
          PortOpenDrainControl_Expansion = PushPull
          PortUniversalCharacteristicCntrl = false
        PortPin3:
          PortPinDirectionChangeable = false
          PortPinDioAltModeChangeable = false
          PortPinModeChangeable = false
          PortPinLevelValue = PORT_PIN_LEVEL_LOW
          PortPinInitialMode = DIO
          PortPinDirection = PORT_PIN_IN
          PortInputBufferControl = false
          PortBiDirectionControl = false
          PortIpControl = false
          PortPullUpOption = false
          PortPullDownOption = false
          PortOutputLevelInversion = false
          PortDriveStrengthControl = SLOW
          PortInputSelection = TYPE1_SHMT1
          PortOpenDrainControl_Expansion = OpenDrain_N_Channel
          PortUniversalCharacteristicCntrl = false
        PortPin4:
          PortPinDirectionChangeable = false
          PortPinDioAltModeChangeable = false
          PortPinModeChangeable = false
          PortPinLevelValue = PORT_PIN_LEVEL_LOW
          PortPinInitialMode = DIO
          PortPinDirection = PORT_PIN_OUT
          PortInputBufferControl = false
          PortBiDirectionControl = false
          PortIpControl = false
          PortPullUpOption = false
          PortPullDownOption = false
          PortOutputLevelInversion = false
          PortDriveStrengthControl = SLOW
          PortInputSelection = TYPE1_SHMT1
          PortOpenDrainControl_Expansion = PushPull
          PortUniversalCharacteristicCntrl = false
        PortPin5:
          PortPinDirectionChangeable = false
          PortPinDioAltModeChangeable = false
          PortPinModeChangeable = false
          PortPinLevelValue = PORT_PIN_LEVEL_LOW
          PortPinInitialMode = DIO_SUPP_PFC_PMCSR
          PortPinDirection = PORT_PIN_IN
          PortInputBufferControl = false
          PortBiDirectionControl = false
          PortPullUpOption = false
          PortPullDownOption = false
          PortOutputLevelInversion = false
          PortDriveStrengthControl = SLOW
          PortInputSelection = TYPE1_SHMT1
          PortOpenDrainControl_Expansion = OpenDrain_N_Channel
          PortUniversalCharacteristicCntrl = false
        PortPin6:
          PortPinDirectionChangeable = false
          PortPinDioAltModeChangeable = false
          PortPinModeChangeable = false
          PortPinLevelValue = PORT_PIN_LEVEL_LOW
          PortPinInitialMode = DIO
          PortPinDirection = PORT_PIN_IN
          PortInputBufferControl = false
          PortBiDirectionControl = false
          PortPullUpOption = false
          PortPullDownOption = false
          PortOutputLevelInversion = false
          PortDriveStrengthControl = SLOW
          PortInputSelection = TYPE1_SHMT1
          PortOpenDrainControl_Expansion = OpenDrain_N_Channel
          PortUniversalCharacteristicCntrl = false
        PortPin7:
          PortPinDirectionChangeable = false
          PortPinDioAltModeChangeable = false
          PortPinModeChangeable = false
          PortPinLevelValue = PORT_PIN_LEVEL_LOW
          PortPinInitialMode = DIO
          PortPinDirection = PORT_PIN_IN
          PortInputBufferControl = false
          PortBiDirectionControl = false
          PortPullUpOption = false
          PortPullDownOption = false
          PortOutputLevelInversion = false
          PortDriveStrengthControl = SLOW
          PortInputSelection = TYPE1_SHMT1
          PortOpenDrainControl_Expansion = OpenDrain_N_Channel
          PortUniversalCharacteristicCntrl = false
      PortGroup2
        PortPin0:
          PortPinDirectionChangeable = false
          PortPinDioAltModeChangeable = false
          PortPinModeChangeable = false
          PortPinLevelValue = PORT_PIN_LEVEL_LOW
          PortPinInitialMode = CSIH2SCO0_ALT3_OUT
          PortPinDirection = PORT_PIN_OUT
          PortInputBufferControl = false
          PortBiDirectionControl = false
          PortIpControl = true
          PortPullUpOption = false
          PortPullDownOption = false
          PortOutputLevelInversion = false
          PortDriveStrengthControl = SLOW
          PortInputSelection = TYPE1_SHMT1
          PortOpenDrainControl_Expansion = PushPull
          PortUniversalCharacteristicCntrl = false
        PortPin1:
          PortPinDirectionChangeable = false
          PortPinDioAltModeChangeable = false
          PortPinModeChangeable = false
          PortPinLevelValue = PORT_PIN_LEVEL_LOW
          PortPinInitialMode = CSIH2SO0_ALT3_OUT
          PortPinDirection = PORT_PIN_OUT
          PortInputBufferControl = false
          PortBiDirectionControl = false
          PortIpControl = true
          PortPullUpOption = false
          PortPullDownOption = false
          PortOutputLevelInversion = false
          PortDriveStrengthControl = SLOW
          PortInputSelection = TYPE1_SHMT1
          PortOpenDrainControl_Expansion = PushPull
          PortUniversalCharacteristicCntrl = false
        PortPin2:
          PortPinDirectionChangeable = false
          PortPinDioAltModeChangeable = false
          PortPinModeChangeable = false
          PortPinLevelValue = PORT_PIN_LEVEL_LOW
          PortPinInitialMode = CSIH2CSS1_ALT2_OUT
          PortPinDirection = PORT_PIN_OUT
          PortInputBufferControl = false
          PortBiDirectionControl = false
          PortIpControl = false
          PortPullUpOption = false
          PortPullDownOption = false
          PortOutputLevelInversion = false
          PortDriveStrengthControl = SLOW
          PortInputSelection = TYPE1_SHMT1
          PortOpenDrainControl_Expansion = PushPull
          PortUniversalCharacteristicCntrl = false
        PortPin3:
          PortPinDirectionChangeable = false
          PortPinDioAltModeChangeable = false
          PortPinModeChangeable = false
          PortPinLevelValue = PORT_PIN_LEVEL_LOW
          PortPinInitialMode = CSIH2SI0_ALT3_IN
          PortPinDirection = PORT_PIN_IN
          PortInputBufferControl = false
          PortBiDirectionControl = false
          PortIpControl = false
          PortPullUpOption = false
          PortPullDownOption = false
          PortOutputLevelInversion = false
          PortDriveStrengthControl = SLOW
          PortInputSelection = TYPE1_SHMT1
          PortOpenDrainControl_Expansion = OpenDrain_N_Channel
          PortUniversalCharacteristicCntrl = false
        PortPin4:
          PortPinDirectionChangeable = false
          PortPinDioAltModeChangeable = false
          PortPinModeChangeable = false
          PortPinLevelValue = PORT_PIN_LEVEL_LOW
          PortPinInitialMode = RLIN31RX_ALT3_IN
          PortPinDirection = PORT_PIN_IN
          PortInputBufferControl = false
          PortBiDirectionControl = false
          PortIpControl = false
          PortPullUpOption = true
          PortPullDownOption = false
          PortOutputLevelInversion = false
          PortDriveStrengthControl = SLOW
          PortInputSelection = TYPE1_SHMT1
          PortOpenDrainControl_Expansion = OpenDrain_N_Channel
          PortUniversalCharacteristicCntrl = false
        PortPin5:
          PortPinDirectionChangeable = false
          PortPinDioAltModeChangeable = false
          PortPinModeChangeable = false
          PortPinLevelValue = PORT_PIN_LEVEL_LOW
          PortPinInitialMode = RLIN31TX_ALT3_OUT
          PortPinDirection = PORT_PIN_OUT
          PortInputBufferControl = false
          PortBiDirectionControl = false
          PortIpControl = false
          PortPullUpOption = false
          PortPullDownOption = false
          PortOutputLevelInversion = false
          PortDriveStrengthControl = SLOW
          PortInputSelection = TYPE1_SHMT1
          PortOpenDrainControl_Expansion = PushPull
          PortUniversalCharacteristicCntrl = false
        PortPin6:
          PortPinDirectionChangeable = false
          PortPinDioAltModeChangeable = false
          PortPinModeChangeable = false
          PortPinLevelValue = PORT_PIN_LEVEL_LOW
          PortPinInitialMode = DIO
          PortPinDirection = PORT_PIN_IN
          PortInputBufferControl = false
          PortBiDirectionControl = false
          PortIpControl = false
          PortPullUpOption = false
          PortPullDownOption = false
          PortOutputLevelInversion = false
          PortDriveStrengthControl = SLOW
          PortInputSelection = TYPE1_SHMT1
          PortOpenDrainControl_Expansion = OpenDrain_N_Channel
          PortUniversalCharacteristicCntrl = false
        PortPin7:
          PortPinDirectionChangeable = false
          PortPinDioAltModeChangeable = false
          PortPinModeChangeable = false
          PortPinLevelValue = PORT_PIN_LEVEL_LOW
          PortPinInitialMode = RLIN30TX_ALT1_OUT
          PortPinDirection = PORT_PIN_OUT
          PortInputBufferControl = false
          PortBiDirectionControl = false
          PortIpControl = false
          PortPullUpOption = false
          PortPullDownOption = false
          PortOutputLevelInversion = false
          PortDriveStrengthControl = SLOW
          PortInputSelection = TYPE1_SHMT1
          PortOpenDrainControl_Expansion = PushPull
          PortUniversalCharacteristicCntrl = false
        PortPin8:
          PortPinDirectionChangeable = false
          PortPinDioAltModeChangeable = false
          PortPinModeChangeable = false
          PortPinLevelValue = PORT_PIN_LEVEL_LOW
          PortPinInitialMode = GTM1I1_ALT1_IN
          PortPinDirection = PORT_PIN_IN
          PortInputBufferControl = false
          PortBiDirectionControl = false
          PortIpControl = false
          PortPullUpOption = false
          PortPullDownOption = false
          PortOutputLevelInversion = false
          PortDriveStrengthControl = SLOW
          PortInputSelection = TYPE1_SHMT1
          PortOpenDrainControl_Expansion = OpenDrain_N_Channel
          PortUniversalCharacteristicCntrl = false
        PortPin9:
          PortPinDirectionChangeable = false
          PortPinDioAltModeChangeable = false
          PortPinModeChangeable = false
          PortPinLevelValue = PORT_PIN_LEVEL_LOW
          PortPinInitialMode = RLIN30RX_ALT3_IN
          PortPinDirection = PORT_PIN_IN
          PortInputBufferControl = false
          PortBiDirectionControl = false
          PortIpControl = false
          PortPullUpOption = true
          PortPullDownOption = false
          PortOutputLevelInversion = false
          PortDriveStrengthControl = SLOW
          PortInputSelection = TYPE1_SHMT1
          PortOpenDrainControl_Expansion = OpenDrain_N_Channel
          PortUniversalCharacteristicCntrl = false
        PortPin10:
          PortPinDirectionChangeable = false
          PortPinDioAltModeChangeable = false
          PortPinModeChangeable = false
          PortPinLevelValue = PORT_PIN_LEVEL_LOW
          PortPinInitialMode = DIO
          PortPinDirection = PORT_PIN_IN
          PortInputBufferControl = false
          PortBiDirectionControl = false
          PortIpControl = false
          PortPullUpOption = false
          PortPullDownOption = false
          PortOutputLevelInversion = false
          PortDriveStrengthControl = SLOW
          PortInputSelection = TYPE1_SHMT1
          PortOpenDrainControl_Expansion = OpenDrain_N_Channel
          PortUniversalCharacteristicCntrl = false
        PortPin11:
          PortPinDirectionChangeable = false
          PortPinDioAltModeChangeable = false
          PortPinModeChangeable = false
          PortPinLevelValue = PORT_PIN_LEVEL_LOW
          PortPinInitialMode = DIO
          PortPinDirection = PORT_PIN_IN
          PortInputBufferControl = false
          PortBiDirectionControl = false
          PortIpControl = false
          PortPullUpOption = false
          PortPullDownOption = false
          PortOutputLevelInversion = false
          PortDriveStrengthControl = SLOW
          PortInputSelection = TYPE1_SHMT1
          PortOpenDrainControl_Expansion = OpenDrain_N_Channel
          PortUniversalCharacteristicCntrl = false
        PortPin12:
          PortPinDirectionChangeable = false
          PortPinDioAltModeChangeable = false
          PortPinModeChangeable = false
          PortPinLevelValue = PORT_PIN_LEVEL_LOW
          PortPinInitialMode = DIO
          PortPinDirection = PORT_PIN_IN
          PortInputBufferControl = false
          PortBiDirectionControl = false
          PortIpControl = false
          PortPullUpOption = false
          PortPullDownOption = false
          PortOutputLevelInversion = false
          PortDriveStrengthControl = SLOW
          PortInputSelection = TYPE1_SHMT1
          PortOpenDrainControl_Expansion = OpenDrain_N_Channel
          PortUniversalCharacteristicCntrl = false
        PortPin13:
          PortPinDirectionChangeable = false
          PortPinDioAltModeChangeable = false
          PortPinModeChangeable = false
          PortPinLevelValue = PORT_PIN_LEVEL_LOW
          PortPinInitialMode = DIO
          PortPinDirection = PORT_PIN_IN
          PortInputBufferControl = true
          PortBiDirectionControl = false
          PortIpControl = false
          PortPullUpOption = false
          PortPullDownOption = false
          PortOutputLevelInversion = false
          PortDriveStrengthControl = SLOW
          PortInputSelection = TYPE1_SHMT1
          PortOpenDrainControl_Expansion = OpenDrain_N_Channel
          PortUniversalCharacteristicCntrl = false
        PortPin14:
          PortPinDirectionChangeable = false
          PortPinDioAltModeChangeable = false
          PortPinModeChangeable = false
          PortPinLevelValue = PORT_PIN_LEVEL_LOW
          PortPinInitialMode = DIO
          PortPinDirection = PORT_PIN_IN
          PortInputBufferControl = false
          PortBiDirectionControl = false
          PortIpControl = false
          PortPullUpOption = false
          PortPullDownOption = false
          PortOutputLevelInversion = false
          PortDriveStrengthControl = SLOW
          PortInputSelection = TYPE1_SHMT1
          PortOpenDrainControl_Expansion = OpenDrain_N_Channel
          PortUniversalCharacteristicCntrl = false
        PortPin15:
          PortPinDirectionChangeable = false
          PortPinDioAltModeChangeable = false
          PortPinModeChangeable = false
          PortPinLevelValue = PORT_PIN_LEVEL_LOW
          PortPinInitialMode = DIO
          PortPinDirection = PORT_PIN_IN
          PortInputBufferControl = false
          PortBiDirectionControl = false
          PortIpControl = false
          PortPullUpOption = false
          PortPullDownOption = false
          PortOutputLevelInversion = false
          PortDriveStrengthControl = SLOW
          PortInputSelection = TYPE1_SHMT1
          PortOpenDrainControl_Expansion = OpenDrain_N_Channel
          PortUniversalCharacteristicCntrl = false
      PortGroup3
        PortPin0:
          PortPinDirectionChangeable = false
          PortPinDioAltModeChangeable = false
          PortPinModeChangeable = false
          PortPinLevelValue = PORT_PIN_LEVEL_LOW
          PortPinInitialMode = DIO
          PortPinDirection = PORT_PIN_IN
          PortInputBufferControl = false
          PortBiDirectionControl = false
          PortPullUpOption = false
          PortPullDownOption = false
          PortOutputLevelInversion = false
          PortDriveStrengthControl = SLOW
          PortInputSelection = TYPE1_SHMT1
          PortOpenDrainControl_Expansion = OpenDrain_N_Channel
          PortUniversalCharacteristicCntrl = false
        PortPin1:
          PortPinDirectionChangeable = false
          PortPinDioAltModeChangeable = false
          PortPinModeChangeable = true
          PortPinLevelValue = PORT_PIN_LEVEL_HIGH
          PortPinInitialMode = DIO
          PortPinDirection = PORT_PIN_IN
          PortInputBufferControl = false
          PortBiDirectionControl = true
          PortPullUpOption = false
          PortPullDownOption = false
          PortOutputLevelInversion = false
          PortDriveStrengthControl = FAST
          PortInputSelection = TYPE1_SHMT1
          PortOpenDrainControl_Expansion = OpenDrain_N_Channel
          PortUniversalCharacteristicCntrl = false
        PortPin2:
          PortPinDirectionChangeable = false
          PortPinDioAltModeChangeable = false
          PortPinModeChangeable = false
          PortPinLevelValue = PORT_PIN_LEVEL_LOW
          PortPinInitialMode = DIO
          PortPinDirection = PORT_PIN_IN
          PortInputBufferControl = false
          PortBiDirectionControl = false
          PortIpControl = false
          PortPullUpOption = false
          PortPullDownOption = false
          PortOutputLevelInversion = false
          PortDriveStrengthControl = SLOW
          PortInputSelection = TYPE1_SHMT1
          PortOpenDrainControl_Expansion = OpenDrain_N_Channel
          PortUniversalCharacteristicCntrl = false
        PortPin3:
          PortPinDirectionChangeable = false
          PortPinDioAltModeChangeable = false
          PortPinModeChangeable = false
          PortPinLevelValue = PORT_PIN_LEVEL_HIGH
          PortPinInitialMode = DIO
          PortPinDirection = PORT_PIN_OUT
          PortInputBufferControl = false
          PortBiDirectionControl = false
          PortIpControl = false
          PortPullUpOption = false
          PortPullDownOption = false
          PortOutputLevelInversion = false
          PortDriveStrengthControl = FAST
          PortInputSelection = TYPE1_SHMT1
          PortOpenDrainControl_Expansion = PushPull
          PortUniversalCharacteristicCntrl = false
        PortPin4:
          PortPinDirectionChangeable = false
          PortPinDioAltModeChangeable = false
          PortPinModeChangeable = true
          PortPinLevelValue = PORT_PIN_LEVEL_HIGH
          PortPinInitialMode = DIO
          PortPinDirection = PORT_PIN_IN
          PortInputBufferControl = false
          PortBiDirectionControl = true
          PortIpControl = false
          PortPullUpOption = false
          PortPullDownOption = false
          PortOutputLevelInversion = false
          PortDriveStrengthControl = FAST
          PortInputSelection = TYPE1_SHMT1
          PortOpenDrainControl_Expansion = OpenDrain_N_Channel
          PortUniversalCharacteristicCntrl = false
        PortPin5:
          PortPinDirectionChangeable = false
          PortPinDioAltModeChangeable = false
          PortPinModeChangeable = false
          PortPinLevelValue = PORT_PIN_LEVEL_LOW
          PortPinInitialMode = DIO
          PortPinDirection = PORT_PIN_IN
          PortInputBufferControl = false
          PortBiDirectionControl = false
          PortIpControl = false
          PortPullUpOption = false
          PortPullDownOption = false
          PortOutputLevelInversion = false
          PortDriveStrengthControl = SLOW
          PortInputSelection = TYPE1_SHMT1
          PortOpenDrainControl_Expansion = OpenDrain_N_Channel
          PortUniversalCharacteristicCntrl = false
        PortPin6:
          PortPinDirectionChangeable = false
          PortPinDioAltModeChangeable = false
          PortPinModeChangeable = false
          PortPinLevelValue = PORT_PIN_LEVEL_LOW
          PortPinInitialMode = DIO
          PortPinDirection = PORT_PIN_IN
          PortInputBufferControl = false
          PortBiDirectionControl = false
          PortIpControl = false
          PortPullUpOption = false
          PortPullDownOption = false
          PortOutputLevelInversion = false
          PortDriveStrengthControl = SLOW
          PortInputSelection = TYPE1_SHMT1
          PortOpenDrainControl_Expansion = OpenDrain_N_Channel
          PortUniversalCharacteristicCntrl = false
        PortPin7:
          PortPinDirectionChangeable = false
          PortPinDioAltModeChangeable = false
          PortPinModeChangeable = false
          PortPinLevelValue = PORT_PIN_LEVEL_LOW
          PortPinInitialMode = CSIH0CSS2_ALT3_OUT
          PortPinDirection = PORT_PIN_OUT
          PortInputBufferControl = false
          PortBiDirectionControl = false
          PortPullUpOption = false
          PortPullDownOption = false
          PortOutputLevelInversion = false
          PortDriveStrengthControl = SLOW
          PortInputSelection = TYPE1_SHMT1
          PortOpenDrainControl_Expansion = PushPull
          PortUniversalCharacteristicCntrl = false
        PortPin8:
          PortPinDirectionChangeable = false
          PortPinDioAltModeChangeable = false
          PortPinModeChangeable = false
          PortPinLevelValue = PORT_PIN_LEVEL_LOW
          PortPinInitialMode = DIO
          PortPinDirection = PORT_PIN_IN
          PortInputBufferControl = false
          PortBiDirectionControl = false
          PortIpControl = false
          PortPullUpOption = false
          PortPullDownOption = false
          PortOutputLevelInversion = false
          PortDriveStrengthControl = SLOW
          PortInputSelection = TYPE1_SHMT1
          PortOpenDrainControl_Expansion = OpenDrain_N_Channel
          PortUniversalCharacteristicCntrl = false
        PortPin9:
          PortPinDirectionChangeable = false
          PortPinDioAltModeChangeable = false
          PortPinModeChangeable = true
          PortPinLevelValue = PORT_PIN_LEVEL_HIGH
          PortPinInitialMode = DIO
          PortPinDirection = PORT_PIN_IN
          PortInputBufferControl = false
          PortBiDirectionControl = true
          PortIpControl = false
          PortPullUpOption = false
          PortPullDownOption = false
          PortOutputLevelInversion = false
          PortDriveStrengthControl = FAST
          PortInputSelection = TYPE1_SHMT1
          PortOpenDrainControl_Expansion = OpenDrain_N_Channel
          PortUniversalCharacteristicCntrl = false
        PortPin10:
          PortPinDirectionChangeable = false
          PortPinDioAltModeChangeable = false
          PortPinModeChangeable = false
          PortPinLevelValue = PORT_PIN_LEVEL_LOW
          PortPinInitialMode = DIO
          PortPinDirection = PORT_PIN_IN
          PortInputBufferControl = false
          PortBiDirectionControl = false
          PortIpControl = false
          PortPullUpOption = false
          PortPullDownOption = false
          PortOutputLevelInversion = false
          PortDriveStrengthControl = SLOW
          PortInputSelection = TYPE1_SHMT1
          PortOpenDrainControl_Expansion = OpenDrain_N_Channel
          PortUniversalCharacteristicCntrl = false
        PortPin11:
          PortPinDirectionChangeable = false
          PortPinDioAltModeChangeable = false
          PortPinModeChangeable = false
          PortPinLevelValue = PORT_PIN_LEVEL_LOW
          PortPinInitialMode = DIO
          PortPinDirection = PORT_PIN_IN
          PortInputBufferControl = true
          PortBiDirectionControl = false
          PortIpControl = false
          PortPullUpOption = false
          PortPullDownOption = false
          PortOutputLevelInversion = false
          PortDriveStrengthControl = SLOW
          PortInputSelection = TYPE1_SHMT1
          PortOpenDrainControl_Expansion = OpenDrain_N_Channel
          PortUniversalCharacteristicCntrl = false
        PortPin12:
          PortPinDirectionChangeable = false
          PortPinDioAltModeChangeable = true
          PortPinModeChangeable = false
          PortPinLevelValue = PORT_PIN_LEVEL_LOW
          PortPinInitialMode = GTMAT0O0_ALT1_OUT
          PortPinDirection = PORT_PIN_OUT
          PortInputBufferControl = false
          PortBiDirectionControl = false
          PortIpControl = true
          PortPullUpOption = false
          PortPullDownOption = false
          PortOutputLevelInversion = false
          PortDriveStrengthControl = SLOW
          PortInputSelection = TYPE1_SHMT1
          PortOpenDrainControl_Expansion = PushPull
          PortUniversalCharacteristicCntrl = false
        PortPin13:
          PortPinDirectionChangeable = false
          PortPinDioAltModeChangeable = false
          PortPinModeChangeable = false
          PortPinLevelValue = PORT_PIN_LEVEL_LOW
          PortPinInitialMode = DIO
          PortPinDirection = PORT_PIN_IN
          PortInputBufferControl = false
          PortBiDirectionControl = false
          PortIpControl = false
          PortPullUpOption = false
          PortPullDownOption = false
          PortOutputLevelInversion = false
          PortDriveStrengthControl = SLOW
          PortInputSelection = TYPE1_SHMT1
          PortOpenDrainControl_Expansion = OpenDrain_N_Channel
          PortUniversalCharacteristicCntrl = false
        PortPin14:
          PortPinDirectionChangeable = false
          PortPinDioAltModeChangeable = false
          PortPinModeChangeable = false
          PortPinLevelValue = PORT_PIN_LEVEL_LOW
          PortPinInitialMode = DIO
          PortPinDirection = PORT_PIN_IN
          PortInputBufferControl = false
          PortBiDirectionControl = false
          PortIpControl = false
          PortPullUpOption = false
          PortPullDownOption = false
          PortOutputLevelInversion = false
          PortDriveStrengthControl = SLOW
          PortInputSelection = TYPE1_SHMT1
          PortOpenDrainControl_Expansion = OpenDrain_N_Channel
          PortUniversalCharacteristicCntrl = false
      PortGroup4
        PortPin0:
          PortPinDirectionChangeable = false
          PortPinDioAltModeChangeable = false
          PortPinModeChangeable = false
          PortPinLevelValue = PORT_PIN_LEVEL_LOW
          PortPinInitialMode = GTM1I0_ALT1_IN
          PortPinDirection = PORT_PIN_IN
          PortInputBufferControl = false
          PortBiDirectionControl = false
          PortIpControl = false
          PortPullUpOption = false
          PortPullDownOption = false
          PortOutputLevelInversion = false
          PortDriveStrengthControl = SLOW
          PortInputSelection = TYPE1_SHMT1
          PortOpenDrainControl_Expansion = OpenDrain_N_Channel
          PortUniversalCharacteristicCntrl = false
        PortPin1:
          PortPinDirectionChangeable = false
          PortPinDioAltModeChangeable = true
          PortPinModeChangeable = false
          PortPinLevelValue = PORT_PIN_LEVEL_LOW
          PortPinInitialMode = GTMAT0O2_ALT1_OUT
          PortPinDirection = PORT_PIN_OUT
          PortInputBufferControl = false
          PortBiDirectionControl = false
          PortIpControl = true
          PortPullUpOption = false
          PortPullDownOption = false
          PortOutputLevelInversion = false
          PortDriveStrengthControl = SLOW
          PortInputSelection = TYPE1_SHMT1
          PortOpenDrainControl_Expansion = PushPull
          PortUniversalCharacteristicCntrl = false
        PortPin2:
          PortPinDirectionChangeable = false
          PortPinDioAltModeChangeable = false
          PortPinModeChangeable = false
          PortPinLevelValue = PORT_PIN_LEVEL_LOW
          PortPinInitialMode = DIO
          PortPinDirection = PORT_PIN_IN
          PortInputBufferControl = false
          PortBiDirectionControl = false
          PortIpControl = false
          PortPullUpOption = false
          PortPullDownOption = false
          PortOutputLevelInversion = false
          PortDriveStrengthControl = SLOW
          PortInputSelection = TYPE1_SHMT1
          PortOpenDrainControl_Expansion = OpenDrain_N_Channel
          PortUniversalCharacteristicCntrl = false
        PortPin3:
          PortPinDirectionChangeable = false
          PortPinDioAltModeChangeable = false
          PortPinModeChangeable = false
          PortPinLevelValue = PORT_PIN_LEVEL_LOW
          PortPinInitialMode = DIO
          PortPinDirection = PORT_PIN_IN
          PortInputBufferControl = false
          PortBiDirectionControl = false
          PortIpControl = false
          PortPullUpOption = false
          PortPullDownOption = false
          PortOutputLevelInversion = false
          PortDriveStrengthControl = SLOW
          PortInputSelection = TYPE1_SHMT1
          PortOpenDrainControl_Expansion = OpenDrain_N_Channel
          PortUniversalCharacteristicCntrl = false
        PortPin4:
          PortPinDirectionChangeable = false
          PortPinDioAltModeChangeable = false
          PortPinModeChangeable = false
          PortPinLevelValue = PORT_PIN_LEVEL_LOW
          PortPinInitialMode = DIO
          PortPinDirection = PORT_PIN_IN
          PortInputBufferControl = true
          PortBiDirectionControl = false
          PortIpControl = false
          PortPullUpOption = false
          PortPullDownOption = false
          PortOutputLevelInversion = false
          PortDriveStrengthControl = SLOW
          PortInputSelection = TYPE1_SHMT1
          PortOpenDrainControl_Expansion = OpenDrain_N_Channel
          PortUniversalCharacteristicCntrl = false
        PortPin5:
          PortPinDirectionChangeable = false
          PortPinDioAltModeChangeable = false
          PortPinModeChangeable = false
          PortPinLevelValue = PORT_PIN_LEVEL_LOW
          PortPinInitialMode = DIO
          PortPinDirection = PORT_PIN_IN
          PortInputBufferControl = false
          PortBiDirectionControl = false
          PortIpControl = false
          PortPullUpOption = false
          PortPullDownOption = false
          PortOutputLevelInversion = false
          PortDriveStrengthControl = SLOW
          PortInputSelection = TYPE1_SHMT1
          PortOpenDrainControl_Expansion = OpenDrain_N_Channel
          PortUniversalCharacteristicCntrl = false
        PortPin6:
          PortPinDirectionChangeable = false
          PortPinDioAltModeChangeable = false
          PortPinModeChangeable = false
          PortPinLevelValue = PORT_PIN_LEVEL_LOW
          PortPinInitialMode = DIO
          PortPinDirection = PORT_PIN_IN
          PortInputBufferControl = true
          PortBiDirectionControl = false
          PortPullUpOption = false
          PortPullDownOption = false
          PortOutputLevelInversion = false
          PortDriveStrengthControl = SLOW
          PortInputSelection = TYPE1_SHMT1
          PortOpenDrainControl_Expansion = OpenDrain_N_Channel
          PortUniversalCharacteristicCntrl = false
        PortPin7:
          PortPinDirectionChangeable = false
          PortPinDioAltModeChangeable = false
          PortPinModeChangeable = false
          PortPinLevelValue = PORT_PIN_LEVEL_LOW
          PortPinInitialMode = DIO
          PortPinDirection = PORT_PIN_IN
          PortInputBufferControl = false
          PortBiDirectionControl = false
          PortPullUpOption = false
          PortPullDownOption = false
          PortOutputLevelInversion = false
          PortDriveStrengthControl = SLOW
          PortInputSelection = TYPE1_SHMT1
          PortOpenDrainControl_Expansion = OpenDrain_N_Channel
          PortUniversalCharacteristicCntrl = false
        PortPin8:
          PortPinDirectionChangeable = false
          PortPinDioAltModeChangeable = true
          PortPinModeChangeable = false
          PortPinLevelValue = PORT_PIN_LEVEL_LOW
          PortPinInitialMode = GTMAT0O0N_ALT1_OUT
          PortPinDirection = PORT_PIN_OUT
          PortInputBufferControl = false
          PortBiDirectionControl = false
          PortIpControl = true
          PortPullUpOption = false
          PortPullDownOption = false
          PortOutputLevelInversion = false
          PortDriveStrengthControl = SLOW
          PortInputSelection = TYPE1_SHMT1
          PortOpenDrainControl_Expansion = PushPull
          PortUniversalCharacteristicCntrl = false
        PortPin9:
          PortPinDirectionChangeable = false
          PortPinDioAltModeChangeable = false
          PortPinModeChangeable = false
          PortPinLevelValue = PORT_PIN_LEVEL_LOW
          PortPinInitialMode = DIO
          PortPinDirection = PORT_PIN_IN
          PortInputBufferControl = false
          PortBiDirectionControl = false
          PortPullUpOption = false
          PortPullDownOption = false
          PortOutputLevelInversion = false
          PortDriveStrengthControl = SLOW
          PortInputSelection = TYPE1_SHMT1
          PortOpenDrainControl_Expansion = OpenDrain_N_Channel
          PortUniversalCharacteristicCntrl = false
        PortPin10:
          PortPinDirectionChangeable = false
          PortPinDioAltModeChangeable = false
          PortPinModeChangeable = false
          PortPinLevelValue = PORT_PIN_LEVEL_LOW
          PortPinInitialMode = MCAN1RX_ALT2_IN
          PortPinDirection = PORT_PIN_IN
          PortInputBufferControl = false
          PortBiDirectionControl = false
          PortIpControl = false
          PortPullUpOption = false
          PortPullDownOption = false
          PortOutputLevelInversion = false
          PortDriveStrengthControl = SLOW
          PortInputSelection = TYPE1_SHMT1
          PortOpenDrainControl_Expansion = OpenDrain_N_Channel
          PortUniversalCharacteristicCntrl = false
        PortPin11:
          PortPinDirectionChangeable = false
          PortPinDioAltModeChangeable = false
          PortPinModeChangeable = false
          PortPinLevelValue = PORT_PIN_LEVEL_HIGH
          PortPinInitialMode = MCAN1TX_ALT2_OUT
          PortPinDirection = PORT_PIN_OUT
          PortInputBufferControl = false
          PortBiDirectionControl = false
          PortIpControl = false
          PortPullUpOption = false
          PortPullDownOption = false
          PortOutputLevelInversion = false
          PortDriveStrengthControl = SLOW
          PortInputSelection = TYPE1_SHMT1
          PortOpenDrainControl_Expansion = PushPull
          PortUniversalCharacteristicCntrl = false
        PortPin12:
          PortPinDirectionChangeable = false
          PortPinDioAltModeChangeable = false
          PortPinModeChangeable = true
          PortPinLevelValue = PORT_PIN_LEVEL_HIGH
          PortPinInitialMode = GTM0I1_ALT1_IN
          PortPinDirection = PORT_PIN_IN
          PortInputBufferControl = false
          PortBiDirectionControl = true
          PortIpControl = false
          PortPullUpOption = false
          PortPullDownOption = false
          PortOutputLevelInversion = false
          PortDriveStrengthControl = SLOW
          PortInputSelection = TYPE1_SHMT1
          PortOpenDrainControl_Expansion = OpenDrain_N_Channel
          PortUniversalCharacteristicCntrl = false
        PortPin13:
          PortPinDirectionChangeable = false
          PortPinDioAltModeChangeable = false
          PortPinModeChangeable = false
          PortPinLevelValue = PORT_PIN_LEVEL_HIGH
          PortPinInitialMode = SENT2RX_ALT3_IN
          PortPinDirection = PORT_PIN_IN
          PortInputBufferControl = false
          PortBiDirectionControl = true
          PortIpControl = false
          PortPullUpOption = false
          PortPullDownOption = false
          PortOutputLevelInversion = false
          PortDriveStrengthControl = FAST
          PortInputSelection = TYPE1_SHMT1
          PortOpenDrainControl_Expansion = OpenDrain_N_Channel
          PortUniversalCharacteristicCntrl = false
        PortPin14:
          PortPinDirectionChangeable = false
          PortPinDioAltModeChangeable = false
          PortPinModeChangeable = false
          PortPinLevelValue = PORT_PIN_LEVEL_LOW
          PortPinInitialMode = DIO
          PortPinDirection = PORT_PIN_IN
          PortInputBufferControl = false
          PortBiDirectionControl = false
          PortIpControl = false
          PortPullUpOption = false
          PortPullDownOption = false
          PortOutputLevelInversion = false
          PortDriveStrengthControl = SLOW
          PortInputSelection = TYPE1_SHMT1
          PortOpenDrainControl_Expansion = OpenDrain_N_Channel
          PortUniversalCharacteristicCntrl = false
      PortGroup5
        PortPin0:
          PortPinDirectionChangeable = false
          PortPinDioAltModeChangeable = false
          PortPinModeChangeable = false
          PortPinLevelValue = PORT_PIN_LEVEL_LOW
          PortPinInitialMode = MCAN0RX_ALT3_IN
          PortPinDirection = PORT_PIN_IN
          PortInputBufferControl = false
          PortBiDirectionControl = false
          PortIpControl = false
          PortPullUpOption = false
          PortPullDownOption = false
          PortOutputLevelInversion = false
          PortDriveStrengthControl = SLOW
          PortInputSelection = TYPE1_SHMT1
          PortOpenDrainControl_Expansion = OpenDrain_N_Channel
          PortUniversalCharacteristicCntrl = false
        PortPin1:
          PortPinDirectionChangeable = false
          PortPinDioAltModeChangeable = false
          PortPinModeChangeable = false
          PortPinLevelValue = PORT_PIN_LEVEL_HIGH
          PortPinInitialMode = MCAN0TX_ALT3_OUT
          PortPinDirection = PORT_PIN_OUT
          PortInputBufferControl = false
          PortBiDirectionControl = false
          PortIpControl = false
          PortPullUpOption = false
          PortPullDownOption = false
          PortOutputLevelInversion = false
          PortDriveStrengthControl = SLOW
          PortInputSelection = TYPE1_SHMT1
          PortOpenDrainControl_Expansion = PushPull
          PortUniversalCharacteristicCntrl = false
        PortPin4:
          PortPinDirectionChangeable = false
          PortPinDioAltModeChangeable = false
          PortPinModeChangeable = false
          PortPinLevelValue = PORT_PIN_LEVEL_LOW
          PortPinInitialMode = DIO
          PortPinDirection = PORT_PIN_IN
          PortInputBufferControl = false
          PortBiDirectionControl = false
          PortIpControl = false
          PortPullUpOption = false
          PortPullDownOption = false
          PortOutputLevelInversion = false
          PortDriveStrengthControl = SLOW
          PortInputSelection = TYPE1_SHMT1
          PortOpenDrainControl_Expansion = OpenDrain_N_Channel
          PortUniversalCharacteristicCntrl = false
        PortPin5:
          PortPinDirectionChangeable = false
          PortPinDioAltModeChangeable = false
          PortPinModeChangeable = false
          PortPinLevelValue = PORT_PIN_LEVEL_LOW
          PortPinInitialMode = CSIH0SO0_ALT2_OUT
          PortPinDirection = PORT_PIN_OUT
          PortInputBufferControl = false
          PortBiDirectionControl = false
          PortIpControl = true
          PortPullUpOption = false
          PortPullDownOption = false
          PortOutputLevelInversion = false
          PortDriveStrengthControl = SLOW
          PortInputSelection = TYPE1_SHMT1
          PortOpenDrainControl_Expansion = PushPull
          PortUniversalCharacteristicCntrl = false
        PortPin6:
          PortPinDirectionChangeable = false
          PortPinDioAltModeChangeable = false
          PortPinModeChangeable = false
          PortPinLevelValue = PORT_PIN_LEVEL_LOW
          PortPinInitialMode = CSIH0SCO0_ALT2_OUT
          PortPinDirection = PORT_PIN_OUT
          PortInputBufferControl = false
          PortBiDirectionControl = false
          PortIpControl = true
          PortPullUpOption = false
          PortPullDownOption = false
          PortOutputLevelInversion = false
          PortDriveStrengthControl = SLOW
          PortInputSelection = TYPE1_SHMT1
          PortOpenDrainControl_Expansion = PushPull
          PortUniversalCharacteristicCntrl = false
        PortPin7:
          PortPinDirectionChangeable = false
          PortPinDioAltModeChangeable = false
          PortPinModeChangeable = false
          PortPinLevelValue = PORT_PIN_LEVEL_LOW
          PortPinInitialMode = CSIH0SI0_ALT2_IN
          PortPinDirection = PORT_PIN_IN
          PortInputBufferControl = false
          PortBiDirectionControl = false
          PortIpControl = false
          PortPullUpOption = false
          PortPullDownOption = false
          PortOutputLevelInversion = false
          PortDriveStrengthControl = SLOW
          PortInputSelection = TYPE1_SHMT1
          PortOpenDrainControl_Expansion = OpenDrain_N_Channel
          PortUniversalCharacteristicCntrl = false
        PortPin8:
          PortPinDirectionChangeable = false
          PortPinDioAltModeChangeable = true
          PortPinModeChangeable = false
          PortPinLevelValue = PORT_PIN_LEVEL_LOW
          PortPinInitialMode = GTMAT0O3_ALT1_OUT
          PortPinDirection = PORT_PIN_OUT
          PortInputBufferControl = false
          PortBiDirectionControl = false
          PortIpControl = true
          PortPullUpOption = false
          PortPullDownOption = false
          PortOutputLevelInversion = false
          PortDriveStrengthControl = SLOW
          PortInputSelection = TYPE1_SHMT1
          PortOpenDrainControl_Expansion = PushPull
          PortUniversalCharacteristicCntrl = false
        PortPin9:
          PortPinDirectionChangeable = false
          PortPinDioAltModeChangeable = true
          PortPinModeChangeable = false
          PortPinLevelValue = PORT_PIN_LEVEL_LOW
          PortPinInitialMode = GTMAT0O3N_ALT1_OUT
          PortPinDirection = PORT_PIN_OUT
          PortInputBufferControl = false
          PortBiDirectionControl = false
          PortIpControl = true
          PortPullUpOption = false
          PortPullDownOption = false
          PortOutputLevelInversion = false
          PortDriveStrengthControl = SLOW
          PortInputSelection = TYPE1_SHMT1
          PortOpenDrainControl_Expansion = PushPull
          PortUniversalCharacteristicCntrl = false
        PortPin10:
          PortPinDirectionChangeable = false
          PortPinDioAltModeChangeable = false
          PortPinModeChangeable = false
          PortPinLevelValue = PORT_PIN_LEVEL_LOW
          PortPinInitialMode = DIO
          PortPinDirection = PORT_PIN_IN
          PortInputBufferControl = false
          PortBiDirectionControl = false
          PortIpControl = false
          PortPullUpOption = false
          PortPullDownOption = false
          PortOutputLevelInversion = false
          PortDriveStrengthControl = SLOW
          PortInputSelection = TYPE1_SHMT1
          PortOpenDrainControl_Expansion = OpenDrain_N_Channel
          PortUniversalCharacteristicCntrl = false
        PortPin11:
          PortPinDirectionChangeable = false
          PortPinDioAltModeChangeable = false
          PortPinModeChangeable = false
          PortPinLevelValue = PORT_PIN_LEVEL_LOW
          PortPinInitialMode = DIO_SUPP_PMCSR
          PortPinDirection = PORT_PIN_IN
          PortInputBufferControl = true
          PortBiDirectionControl = false
          PortIpControl = false
          PortPullUpOption = false
          PortPullDownOption = false
          PortOutputLevelInversion = false
          PortDriveStrengthControl = SLOW
          PortInputSelection = TYPE1_SHMT1
          PortOpenDrainControl_Expansion = OpenDrain_N_Channel
          PortUniversalCharacteristicCntrl = false
        PortPin12:
          PortPinDirectionChangeable = false
          PortPinDioAltModeChangeable = false
          PortPinModeChangeable = false
          PortPinLevelValue = PORT_PIN_LEVEL_LOW
          PortPinInitialMode = DIO
          PortPinDirection = PORT_PIN_IN
          PortInputBufferControl = false
          PortBiDirectionControl = false
          PortIpControl = false
          PortPullUpOption = false
          PortPullDownOption = false
          PortOutputLevelInversion = false
          PortDriveStrengthControl = SLOW
          PortInputSelection = TYPE1_SHMT1
          PortOpenDrainControl_Expansion = OpenDrain_N_Channel
          PortUniversalCharacteristicCntrl = false
        PortPin13:
          PortPinDirectionChangeable = false
          PortPinDioAltModeChangeable = false
          PortPinModeChangeable = false
          PortPinLevelValue = PORT_PIN_LEVEL_LOW
          PortPinInitialMode = GTM1I2_ALT1_IN
          PortPinDirection = PORT_PIN_IN
          PortInputBufferControl = false
          PortBiDirectionControl = false
          PortIpControl = false
          PortPullUpOption = false
          PortPullDownOption = false
          PortOutputLevelInversion = false
          PortDriveStrengthControl = SLOW
          PortInputSelection = TYPE1_SHMT1
          PortOpenDrainControl_Expansion = OpenDrain_N_Channel
          PortUniversalCharacteristicCntrl = false
        PortPin14:
          PortPinDirectionChangeable = false
          PortPinDioAltModeChangeable = false
          PortPinModeChangeable = false
          PortPinLevelValue = PORT_PIN_LEVEL_LOW
          PortPinInitialMode = DIO
          PortPinDirection = PORT_PIN_IN
          PortInputBufferControl = false
          PortBiDirectionControl = false
          PortIpControl = false
          PortPullUpOption = false
          PortPullDownOption = false
          PortOutputLevelInversion = false
          PortDriveStrengthControl = SLOW
          PortInputSelection = TYPE1_SHMT1
          PortOpenDrainControl_Expansion = OpenDrain_N_Channel
          PortUniversalCharacteristicCntrl = false
        PortPin15:
          PortPinDirectionChangeable = false
          PortPinDioAltModeChangeable = true
          PortPinModeChangeable = false
          PortPinLevelValue = PORT_PIN_LEVEL_LOW
          PortPinInitialMode = GTMAT0O2N_ALT1_OUT
          PortPinDirection = PORT_PIN_OUT
          PortInputBufferControl = false
          PortBiDirectionControl = false
          PortIpControl = true
          PortPullUpOption = false
          PortPullDownOption = false
          PortOutputLevelInversion = false
          PortDriveStrengthControl = SLOW
          PortInputSelection = TYPE1_SHMT1
          PortOpenDrainControl_Expansion = PushPull
          PortUniversalCharacteristicCntrl = false
      PortGroup6
        PortPin0:
          PortPinDirectionChangeable = false
          PortPinDioAltModeChangeable = false
          PortPinModeChangeable = false
          PortPinLevelValue = PORT_PIN_LEVEL_LOW
          PortPinInitialMode = DIO
          PortPinDirection = PORT_PIN_IN
          PortInputBufferControl = false
          PortBiDirectionControl = false
          PortIpControl = false
          PortPullUpOption = false
          PortPullDownOption = false
          PortOutputLevelInversion = false
          PortDriveStrengthControl = SLOW
          PortInputSelection = TYPE1_SHMT1
          PortOpenDrainControl_Expansion = OpenDrain_N_Channel
          PortUniversalCharacteristicCntrl = false
        PortPin1:
          PortPinDirectionChangeable = false
          PortPinDioAltModeChangeable = false
          PortPinModeChangeable = false
          PortPinLevelValue = PORT_PIN_LEVEL_LOW
          PortPinInitialMode = DIO
          PortPinDirection = PORT_PIN_IN
          PortInputBufferControl = false
          PortBiDirectionControl = false
          PortIpControl = false
          PortPullUpOption = false
          PortPullDownOption = false
          PortOutputLevelInversion = false
          PortDriveStrengthControl = SLOW
          PortInputSelection = TYPE1_SHMT1
          PortOpenDrainControl_Expansion = OpenDrain_N_Channel
          PortUniversalCharacteristicCntrl = false
        PortPin2:
          PortPinDirectionChangeable = false
          PortPinDioAltModeChangeable = false
          PortPinModeChangeable = false
          PortPinLevelValue = PORT_PIN_LEVEL_LOW
          PortPinInitialMode = DIO
          PortPinDirection = PORT_PIN_IN
          PortInputBufferControl = false
          PortBiDirectionControl = false
          PortPullUpOption = false
          PortPullDownOption = false
          PortOutputLevelInversion = false
          PortDriveStrengthControl = SLOW
          PortInputSelection = TYPE1_SHMT1
          PortOpenDrainControl_Expansion = OpenDrain_N_Channel
          PortUniversalCharacteristicCntrl = false
        PortPin3:
          PortPinDirectionChangeable = false
          PortPinDioAltModeChangeable = false
          PortPinModeChangeable = false
          PortPinLevelValue = PORT_PIN_LEVEL_LOW
          PortPinInitialMode = DIO
          PortPinDirection = PORT_PIN_OUT
          PortInputBufferControl = false
          PortBiDirectionControl = false
          PortIpControl = false
          PortPullUpOption = false
          PortPullDownOption = false
          PortOutputLevelInversion = false
          PortDriveStrengthControl = SLOW
          PortInputSelection = TYPE1_SHMT1
          PortOpenDrainControl_Expansion = PushPull
          PortUniversalCharacteristicCntrl = false
        PortPin4:
          PortPinDirectionChangeable = false
          PortPinDioAltModeChangeable = false
          PortPinModeChangeable = false
          PortPinLevelValue = PORT_PIN_LEVEL_LOW
          PortPinInitialMode = DIO
          PortPinDirection = PORT_PIN_IN
          PortInputBufferControl = false
          PortBiDirectionControl = false
          PortPullUpOption = false
          PortPullDownOption = false
          PortOutputLevelInversion = false
          PortDriveStrengthControl = SLOW
          PortInputSelection = TYPE1_SHMT1
          PortOpenDrainControl_Expansion = OpenDrain_N_Channel
          PortUniversalCharacteristicCntrl = false
        PortPin5:
          PortPinDirectionChangeable = false
          PortPinDioAltModeChangeable = false
          PortPinModeChangeable = false
          PortPinLevelValue = PORT_PIN_LEVEL_LOW
          PortPinInitialMode = DIO
          PortPinDirection = PORT_PIN_IN
          PortInputBufferControl = false
          PortBiDirectionControl = false
          PortPullUpOption = false
          PortPullDownOption = false
          PortOutputLevelInversion = false
          PortDriveStrengthControl = SLOW
          PortInputSelection = TYPE1_SHMT1
          PortOpenDrainControl_Expansion = OpenDrain_N_Channel
          PortUniversalCharacteristicCntrl = false
        PortPin6:
          PortPinDirectionChangeable = false
          PortPinDioAltModeChangeable = false
          PortPinModeChangeable = false
          PortPinLevelValue = PORT_PIN_LEVEL_LOW
          PortPinInitialMode = DIO
          PortPinDirection = PORT_PIN_IN
          PortInputBufferControl = false
          PortBiDirectionControl = false
          PortPullUpOption = false
          PortPullDownOption = false
          PortOutputLevelInversion = false
          PortDriveStrengthControl = SLOW
          PortInputSelection = TYPE1_SHMT1
          PortOpenDrainControl_Expansion = OpenDrain_N_Channel
          PortUniversalCharacteristicCntrl = false
        PortPin10:
          PortPinDirectionChangeable = false
          PortPinDioAltModeChangeable = false
          PortPinModeChangeable = false
          PortPinLevelValue = PORT_PIN_LEVEL_LOW
          PortPinInitialMode = DIO
          PortPinDirection = PORT_PIN_IN
          PortInputBufferControl = false
          PortBiDirectionControl = false
          PortIpControl = false
          PortPullUpOption = false
          PortPullDownOption = false
          PortOutputLevelInversion = false
          PortDriveStrengthControl = SLOW
          PortInputSelection = TYPE1_SHMT1
          PortOpenDrainControl_Expansion = OpenDrain_N_Channel
          PortUniversalCharacteristicCntrl = false
        PortPin11:
          PortPinDirectionChangeable = false
          PortPinDioAltModeChangeable = false
          PortPinModeChangeable = false
          PortPinLevelValue = PORT_PIN_LEVEL_LOW
          PortPinInitialMode = DIO
          PortPinDirection = PORT_PIN_IN
          PortInputBufferControl = false
          PortBiDirectionControl = false
          PortPullUpOption = false
          PortPullDownOption = false
          PortOutputLevelInversion = false
          PortDriveStrengthControl = SLOW
          PortInputSelection = TYPE1_SHMT1
          PortOpenDrainControl_Expansion = OpenDrain_N_Channel
          PortUniversalCharacteristicCntrl = false
        PortPin12:
          PortPinDirectionChangeable = false
          PortPinDioAltModeChangeable = false
          PortPinModeChangeable = false
          PortPinLevelValue = PORT_PIN_LEVEL_LOW
          PortPinInitialMode = DIO
          PortPinDirection = PORT_PIN_IN
          PortInputBufferControl = false
          PortBiDirectionControl = false
          PortPullUpOption = false
          PortPullDownOption = false
          PortOutputLevelInversion = false
          PortDriveStrengthControl = SLOW
          PortInputSelection = TYPE1_SHMT1
          PortOpenDrainControl_Expansion = OpenDrain_N_Channel
          PortUniversalCharacteristicCntrl = false
        PortPin13:
          PortPinDirectionChangeable = false
          PortPinDioAltModeChangeable = false
          PortPinModeChangeable = false
          PortPinLevelValue = PORT_PIN_LEVEL_LOW
          PortPinInitialMode = DIO
          PortPinDirection = PORT_PIN_IN
          PortInputBufferControl = false
          PortBiDirectionControl = false
          PortIpControl = false
          PortPullUpOption = false
          PortPullDownOption = false
          PortOutputLevelInversion = false
          PortDriveStrengthControl = SLOW
          PortInputSelection = TYPE1_SHMT1
          PortOpenDrainControl_Expansion = OpenDrain_N_Channel
          PortUniversalCharacteristicCntrl = false
      PortGroup7
        PortPin0:
          PortPinDirectionChangeable = false
          PortPinDioAltModeChangeable = false
          PortPinModeChangeable = false
          PortPinLevelValue = PORT_PIN_LEVEL_LOW
          PortPinInitialMode = DIO
          PortPinDirection = PORT_PIN_IN
          PortInputBufferControl = false
          PortBiDirectionControl = false
          PortIpControl = false
          PortPullUpOption = false
          PortPullDownOption = false
          PortOutputLevelInversion = false
          PortDriveStrengthControl = SLOW
          PortInputSelection = TYPE1_SHMT1
          PortOpenDrainControl_Expansion = OpenDrain_N_Channel
          PortUniversalCharacteristicCntrl = false
        PortPin1:
          PortPinDirectionChangeable = false
          PortPinDioAltModeChangeable = false
          PortPinModeChangeable = false
          PortPinLevelValue = PORT_PIN_LEVEL_LOW
          PortPinInitialMode = DIO
          PortPinDirection = PORT_PIN_IN
          PortInputBufferControl = false
          PortBiDirectionControl = false
          PortPullUpOption = false
          PortPullDownOption = false
          PortOutputLevelInversion = false
          PortDriveStrengthControl = SLOW
          PortInputSelection = TYPE1_SHMT1
          PortOpenDrainControl_Expansion = OpenDrain_N_Channel
          PortUniversalCharacteristicCntrl = false
        PortPin2:
          PortPinDirectionChangeable = false
          PortPinDioAltModeChangeable = false
          PortPinModeChangeable = false
          PortPinLevelValue = PORT_PIN_LEVEL_LOW
          PortPinInitialMode = DIO
          PortPinDirection = PORT_PIN_IN
          PortInputBufferControl = false
          PortBiDirectionControl = false
          PortPullUpOption = false
          PortPullDownOption = false
          PortOutputLevelInversion = false
          PortDriveStrengthControl = SLOW
          PortInputSelection = TYPE1_SHMT1
          PortOpenDrainControl_Expansion = OpenDrain_N_Channel
          PortUniversalCharacteristicCntrl = false
        PortPin3:
          PortPinDirectionChangeable = false
          PortPinDioAltModeChangeable = false
          PortPinModeChangeable = false
          PortPinLevelValue = PORT_PIN_LEVEL_LOW
          PortPinInitialMode = DIO
          PortPinDirection = PORT_PIN_IN
          PortInputBufferControl = false
          PortBiDirectionControl = false
          PortPullUpOption = false
          PortPullDownOption = false
          PortOutputLevelInversion = false
          PortDriveStrengthControl = SLOW
          PortInputSelection = TYPE1_SHMT1
          PortOpenDrainControl_Expansion = OpenDrain_N_Channel
          PortUniversalCharacteristicCntrl = false
        PortPin4:
          PortPinDirectionChangeable = false
          PortPinDioAltModeChangeable = false
          PortPinModeChangeable = false
          PortPinLevelValue = PORT_PIN_LEVEL_LOW
          PortPinInitialMode = DIO
          PortPinDirection = PORT_PIN_IN
          PortInputBufferControl = false
          PortBiDirectionControl = false
          PortPullUpOption = false
          PortPullDownOption = false
          PortOutputLevelInversion = false
          PortDriveStrengthControl = SLOW
          PortInputSelection = TYPE1_SHMT1
          PortOpenDrainControl_Expansion = OpenDrain_N_Channel
          PortUniversalCharacteristicCntrl = false
        PortPin5:
          PortPinDirectionChangeable = false
          PortPinDioAltModeChangeable = false
          PortPinModeChangeable = false
          PortPinLevelValue = PORT_PIN_LEVEL_LOW
          PortPinInitialMode = DIO
          PortPinDirection = PORT_PIN_IN
          PortInputBufferControl = false
          PortBiDirectionControl = false
          PortPullUpOption = false
          PortPullDownOption = false
          PortOutputLevelInversion = false
          PortDriveStrengthControl = SLOW
          PortInputSelection = TYPE1_SHMT1
          PortOpenDrainControl_Expansion = OpenDrain_N_Channel
          PortUniversalCharacteristicCntrl = false
      PortGroup9
        PortPin7:
          PortPinDirectionChangeable = false
          PortPinDioAltModeChangeable = false
          PortPinModeChangeable = false
          PortPinLevelValue = PORT_PIN_LEVEL_LOW
          PortPinInitialMode = DIO_SUPP_PFC_PMCSR
          PortPinDirection = PORT_PIN_IN
          PortInputBufferControl = false
          PortBiDirectionControl = false
          PortIpControl = false
          PortPullUpOption = false
          PortPullDownOption = false
          PortOutputLevelInversion = false
          PortDriveStrengthControl = SLOW
          PortInputSelection = TYPE1_SHMT1
          PortOpenDrainControl_Expansion = OpenDrain_N_Channel
          PortUniversalCharacteristicCntrl = false
        PortPin8:
          PortPinDirectionChangeable = false
          PortPinDioAltModeChangeable = false
          PortPinModeChangeable = false
          PortPinLevelValue = PORT_PIN_LEVEL_LOW
          PortPinInitialMode = DIO_SUPP_PFC_PMCSR
          PortPinDirection = PORT_PIN_IN
          PortInputBufferControl = false
          PortBiDirectionControl = false
          PortIpControl = false
          PortPullUpOption = false
          PortPullDownOption = false
          PortOutputLevelInversion = false
          PortDriveStrengthControl = SLOW
          PortInputSelection = TYPE1_SHMT1
          PortOpenDrainControl_Expansion = OpenDrain_N_Channel
          PortUniversalCharacteristicCntrl = false
      PortGroupJtag0
        PortPin0:
          PortPinDirectionChangeable = false
          PortPinDioAltModeChangeable = false
          PortPinModeChangeable = false
          PortPinLevelValue = PORT_PIN_LEVEL_LOW
          PortPinInitialMode = DIO_SUPP_JPFCE_JPMCSR
          PortPinDirection = PORT_PIN_IN
          PortInputBufferControl = false
          PortBiDirectionControl = false
          PortPullUpOption = false
          PortPullDownOption = false
          PortOutputLevelInversion = false
          PortDriveStrengthControl = SLOW
          PortInputSelection = TYPE1_SHMT1
          PortOpenDrainControl_Expansion = PushPull
          PortUniversalCharacteristicCntrl = false
        PortPin1:
          PortPinDirectionChangeable = false
          PortPinDioAltModeChangeable = false
          PortPinModeChangeable = false
          PortPinLevelValue = PORT_PIN_LEVEL_LOW
          PortPinInitialMode = DIO_SUPP_JPFCE_JPMCSR
          PortPinDirection = PORT_PIN_IN
          PortInputBufferControl = false
          PortBiDirectionControl = false
          PortPullUpOption = false
          PortPullDownOption = false
          PortOutputLevelInversion = false
          PortDriveStrengthControl = SLOW
          PortInputSelection = TYPE1_SHMT1
          PortOpenDrainControl_Expansion = PushPull
          PortUniversalCharacteristicCntrl = false
        PortPin2:
          PortPinDirectionChangeable = false
          PortPinDioAltModeChangeable = false
          PortPinModeChangeable = false
          PortPinLevelValue = PORT_PIN_LEVEL_LOW
          PortPinInitialMode = DIO_SUPP_JPFCE_JPMCSR
          PortPinDirection = PORT_PIN_IN
          PortInputBufferControl = false
          PortBiDirectionControl = false
          PortPullUpOption = false
          PortPullDownOption = false
          PortOutputLevelInversion = false
          PortDriveStrengthControl = SLOW
          PortInputSelection = TYPE1_SHMT1
          PortOpenDrainControl_Expansion = PushPull
          PortUniversalCharacteristicCntrl = false
        PortPin3:
          PortPinDirectionChangeable = false
          PortPinDioAltModeChangeable = false
          PortPinModeChangeable = false
          PortPinLevelValue = PORT_PIN_LEVEL_LOW
          PortPinInitialMode = ALT_NOT_SUPPORTED
          PortPinDirection = PORT_PIN_IN
          PortInputBufferControl = false
          PortBiDirectionControl = false
          PortPullUpOption = false
          PortPullDownOption = false
          PortOutputLevelInversion = false
          PortDriveStrengthControl = SLOW
          PortInputSelection = TYPE1_SHMT1
          PortOpenDrainControl_Expansion = PushPull
          PortUniversalCharacteristicCntrl = false
        PortPin4: PortPinInitialMode=ALT_NOT_SUPPORTED, PortInputBufferControl=false
        PortPin5:
          PortPinDirectionChangeable = false
          PortPinDioAltModeChangeable = false
          PortPinModeChangeable = false
          PortPinLevelValue = PORT_PIN_LEVEL_LOW
          PortPinInitialMode = ALT_NOT_SUPPORTED
          PortPinDirection = PORT_PIN_IN
          PortInputBufferControl = false
          PortBiDirectionControl = false
          PortPullUpOption = false
          PortPullDownOption = false
          PortOutputLevelInversion = false
          PortDriveStrengthControl = SLOW
          PortInputSelection = TYPE1_SHMT1
          PortOpenDrainControl_Expansion = PushPull
          PortUniversalCharacteristicCntrl = false
    PortDemEventParameterRefs
