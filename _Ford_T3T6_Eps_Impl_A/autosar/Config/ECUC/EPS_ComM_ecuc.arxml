AUTOSAR XML (schema 4-2-1)
package /ActiveEcuC
  module config ComM: implementation-config-variant=VARIANT-PRE-COMPILE, module-description=ComM_Impl
    ComMGeneral:
      ComMPncIdCounting = COMM_PNC_ID_COUNT_FROM_NM_MESSAGE
      ComMPncSupport = false
      ComMWakeupInhibitionEnabled = false
      ComMPncGatewayEnabled = false
      ComMModeLimitationEnabled = false
      ComMEcuGroupClassification = 0
      ComMDevErrorDetect = true
      ComMSynchronousWakeUp = false
      ComMTMinFullComModeDuration = 5
      ComMVersionInfoApi = false
      ComMExtendedRamCheck = false
      ComMGeneration: ComMOutOfBoundsWriteSanitizer=false, ComMOutOfBoundsReadSanitizer=false
    ComMConfigSet: ComMPncEnabled=false
      FD1_CAN_f26020e5 (ComMChannel):  # CN_FD1_CAN
        ComMBusType = COMM_BUS_TYPE_CAN
        ComMChannelId = 0
        ComMPncGatewayType = COMM_GATEWAY_TYPE_NONE
        ComMNoWakeup = false
        ComMNoCom = false
        ComMFullCommRequestNotificationEnabled = false
        ComMMainFunctionPeriod = 0.01
        ComMNetworkManagement: ComMNmVariant=FULL, ComMPncNmRequest=false
        CHNL_cd1e16dc (ComMUserPerChannel): ComMUserChannel=USR_CHNL_cd1e16dc
      USR_CHNL_cd1e16dc (ComMUser): ComMUserIdentifier=0, ComMUserModeNotification=false  # CN_FD1_CAN
