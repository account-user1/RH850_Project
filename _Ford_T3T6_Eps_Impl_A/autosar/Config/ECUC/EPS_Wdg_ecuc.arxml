AUTOSAR XML (schema 4-2-1)
package /ActiveEcuC
  module config Wdg: implementation-config-variant=VARIANT-POST-BUILD, module-description=Wdg_Impl
    WdgGeneral:
      WdgVersionCheckExternalModules = false
      WdgDevErrorDetect = true
      WdgDisableAllowed = true
      WdgIndex = 0
      WdgInitialTimeout = 10
      WdgMaxTimeout = 10
      WdgRunArea = RAM
      WdgTriggerLocation = NULL
      WdgVersionInfoApi = false
      WdgCriticalSectionProtection = true
      WdgVaryingActivationCodeMode = ENABLE
      WdgDeviceName = R7F701373
      WdgInterruptConsistencyCheck = false
      WdgWriteVerify = WV_DISABLE
      WdgUseWriteVerifyErrorInterface = false
      WdgClockRef = McuWdtaCounterClk
    WdgPublishedInformation: WdgTriggerMode=WDG_WINDOW
    WdgSettingsConfig: WdgDefaultMode=WDGIF_SLOW_MODE
      WdgSettingsFast: WdgClkSettingsFast=TWO_POWOF_15_DIVBY_WDGCLK
      WdgSettingsOff
      WdgSettingsSlow: WdgClkSettingsSlow=TWO_POWOF_16_DIVBY_WDGCLK
