AUTOSAR XML (schema 4-2-1)
package /ActiveEcuC
  module config NxtrSwIds: implementation-config-variant=VARIANT-PRE-COMPILE
    NxtrSwIdsGeneral: SwRelNr=Ford_T3T6, SwRelVer=03.00.00, PrototypeBuild=false
