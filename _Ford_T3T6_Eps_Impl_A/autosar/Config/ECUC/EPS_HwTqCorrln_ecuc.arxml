AUTOSAR XML (schema 4-2-1)
package /ActiveEcuC
  module config HwTqCorrln: implementation-config-variant=VARIANT-PRE-COMPILE
    HwTqCorrlnGeneral: NTC_HwTqACorrlnFlt=NTCNR_0X070, NTC_HwTqBCorrlnFlt=NTCNR_0X071, NTC_HwTqCCorrlnFlt=NTCNR_0X072, NTC_HwTqDCorrlnFlt=NTCNR_0X073
