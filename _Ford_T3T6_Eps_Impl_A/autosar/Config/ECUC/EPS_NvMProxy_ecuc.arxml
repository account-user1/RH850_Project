AUTOSAR XML (schema 4-2-1)
package /ActiveEcuC
  module config NvMProxy: implementation-config-variant=VARIANT-PRE-COMPILE, module-description=NvMProxy_Impl
    NvMProxyCommon: NvmProxyIncludes=DiagcMgr.h, NvMOsApplicationRef=Appl10
    93 x NvMProxyBlkSet, all with NvMBlkFlt=None:
      Rte_NvmBlock_CDD_NvMProxy_ShtdwnClsChk: NvMProxyApplCallCbk=NULL_PTR, NvMBlkRef=Rte_NvmBlock_CDD_NvMProxy_ShtdwnClsChk
      Rte_NvmBlock_DiagcMgr_DiagcMgrLtchCntrAry: NvMProxyApplCallCbk=RestoreDiagcMgrLtchCntrAryDft, NvMBlkRef=Rte_NvmBlock_DiagcMgr_DiagcMgrLtchCntrAry
      Rte_NvmBlock_DiagcMgr_DiagcMgrNtcFltAry: NvMProxyApplCallCbk=RestoreNtcFltAryDft, NvMBlkRef=Rte_NvmBlock_DiagcMgr_DiagcMgrNtcFltAry
      Rte_NvmBlock_DiagcMgr_DiagcMgrApplCrc: NvMProxyApplCallCbk=RestoreSnpshtAryDft, NvMBlkRef=Rte_NvmBlock_DiagcMgr_DiagcMgrApplCrc
      Rte_NvmBlock_PolarityCfg_PolarityCfgSaved: NvMProxyApplCallCbk=NULL_PTR, NvMBlkRef=Rte_NvmBlock_PolarityCfg_PolarityCfgSaved
      Rte_NvmBlock_CDD_CurrMeas_CurrMeasEolGainCalSetABC: NvMProxyApplCallCbk=NULL_PTR, NvMBlkRef=Rte_NvmBlock_CDD_CurrMeas_CurrMeasEolGainCalSetABC
      Rte_NvmBlock_CDD_CurrMeas_CurrMeasEolOffsCalSetABC: NvMProxyApplCallCbk=NULL_PTR, NvMBlkRef=Rte_NvmBlock_CDD_CurrMeas_CurrMeasEolOffsCalSetABC
      Rte_NvmBlock_CDD_MotAgCmp_MotAgCmpMotAgBackEmf: NvMProxyApplCallCbk=NULL_PTR, NvMBlkRef=Rte_NvmBlock_CDD_MotAgCmp_MotAgCmpMotAgBackEmf
      Rte_NvmBlock_HwAgSnsrls_StordLstPrm: NvMProxyApplCallCbk=NULL_PTR, NvMBlkRef=Rte_NvmBlock_HwAgSnsrls_StordLstPrm
      Rte_NvmBlock_MotAg2Meas_MotAg2EolPrm: NvMProxyApplCallCbk=NULL_PTR, NvMBlkRef=Rte_NvmBlock_MotAg2Meas_MotAg2EolPrm
      Rte_NvmBlock_EotLrng_EotNvmData: NvMProxyApplCallCbk=NULL_PTR, NvMBlkRef=Rte_NvmBlock_EotLrng_EotNvmData
      Rte_NvmBlock_EotLrng_MaxHwAgCwAndCcw: NvMProxyApplCallCbk=NULL_PTR, NvMBlkRef=Rte_NvmBlock_EotLrng_MaxHwAgCwAndCcw
      Rte_NvmBlock_CDD_MotRplCoggCmd_MotCoggCmdY: NvMProxyApplCallCbk=NULL_PTR, NvMBlkRef=Rte_NvmBlock_CDD_MotRplCoggCmd_MotCoggCmdY
      Rte_NvmBlock_MotRplCoggCfg_MotRplCoggPrm: NvMProxyApplCallCbk=NULL_PTR, NvMBlkRef=Rte_NvmBlock_MotRplCoggCfg_MotRplCoggPrm
      Rte_NvmBlock_SysFricLrng_FricLrngData: NvMProxyApplCallCbk=NULL_PTR, NvMBlkRef=Rte_NvmBlock_SysFricLrng_FricLrngData
      Rte_NvmBlock_SysFricLrng_FricNonLrngData: NvMProxyApplCallCbk=NULL_PTR, NvMBlkRef=Rte_NvmBlock_SysFricLrng_FricNonLrngData
      Rte_NvmBlock_CDD_VrfyCritReg_MCalReadVrfyCritRegFltNvmInfo: NvMProxyApplCallCbk=NULL_PTR, NvMBlkRef=Rte_NvmBlock_CDD_VrfyCritReg_MCalReadVrfyCritRegFltNvmInfo
      Rte_NvmBlock_HwAg1Meas_HwAg1IfFltLtch: NvMProxyApplCallCbk=NULL_PTR, NvMBlkRef=Rte_NvmBlock_HwAg1Meas_HwAg1IfFltLtch
      Rte_NvmBlock_HwAg1Meas_HwAg1Offs: NvMProxyApplCallCbk=NULL_PTR, NvMBlkRef=Rte_NvmBlock_HwAg1Meas_HwAg1Offs
      Rte_NvmBlock_CDD_MotAg5Meas_MotAg5EolPrm: NvMProxyApplCallCbk=NULL_PTR, NvMBlkRef=Rte_NvmBlock_CDD_MotAg5Meas_MotAg5EolPrm
      Rte_NvmBlock_CDD_MotAg5Meas_MotAg5StVari: NvMProxyApplCallCbk=NULL_PTR, NvMBlkRef=Rte_NvmBlock_CDD_MotAg5Meas_MotAg5StVari
      Rte_NvmBlock_CDD_MotAg6Meas_MotAg6EolPrm: NvMProxyApplCallCbk=NULL_PTR, NvMBlkRef=Rte_NvmBlock_CDD_MotAg6Meas_MotAg6EolPrm
      Rte_NvmBlock_CDD_MotAg6Meas_MotAg6StVari: NvMProxyApplCallCbk=NULL_PTR, NvMBlkRef=Rte_NvmBlock_CDD_MotAg6Meas_MotAg6StVari
      Rte_NvmBlock_MotCtrlPrmEstimn_MotPrmNom: NvMProxyApplCallCbk=NULL_PTR, NvMBlkRef=Rte_NvmBlock_MotCtrlPrmEstimn_MotPrmNom
      Rte_NvmBlock_MotTqCmdSca_MotTqScaFac: NvMProxyApplCallCbk=NULL_PTR, NvMBlkRef=Rte_NvmBlock_MotTqCmdSca_MotTqScaFac
      Rte_NvmBlock_DutyCycThermProtn_FilStVal: NvMProxyApplCallCbk=NULL_PTR, NvMBlkRef=Rte_NvmBlock_DutyCycThermProtn_FilStVal
      Rte_NvmBlock_CmnMfgSrv_CcaHwPartNr: NvMProxyApplCallCbk=NULL_PTR, NvMBlkRef=Rte_NvmBlock_CmnMfgSrv_CcaHwPartNr
      Rte_NvmBlock_CmnMfgSrv_CcaSerlNr: NvMProxyApplCallCbk=NULL_PTR, NvMBlkRef=Rte_NvmBlock_CmnMfgSrv_CcaSerlNr
      Rte_NvmBlock_CmnMfgSrv_DiRestore: NvMProxyApplCallCbk=NULL_PTR, NvMBlkRef=Rte_NvmBlock_CmnMfgSrv_DiRestore
      Rte_NvmBlock_CmnMfgSrv_EpsSysSerlNr: NvMProxyApplCallCbk=NULL_PTR, NvMBlkRef=Rte_NvmBlock_CmnMfgSrv_EpsSysSerlNr
      Rte_NvmBlock_CmnMfgSrv_IgnCntr: NvMProxyApplCallCbk=NULL_PTR, NvMBlkRef=Rte_NvmBlock_CmnMfgSrv_IgnCntr
      Rte_NvmBlock_CmnMfgSrv_MfgTmpBuf{0..4}: NvMProxyApplCallCbk=NULL_PTR, NvMBlkRef=Rte_NvmBlock_CmnMfgSrv_MfgTmpBuf{0..4}
      Rte_NvmBlock_CmnMfgSrv_NxtrMfgEnaCntr: NvMProxyApplCallCbk=NULL_PTR, NvMBlkRef=Rte_NvmBlock_CmnMfgSrv_NxtrMfgEnaCntr
      Rte_NvmBlock_CmnMfgSrv_SeedKey: NvMProxyApplCallCbk=NULL_PTR, NvMBlkRef=Rte_NvmBlock_CmnMfgSrv_SeedKey
      SnpshtDataAry: NvMProxyApplCallCbk=NULL_PTR, NvMBlkRef=SnpshtDataAry
      Rte_NvmBlock_CDD_HwTq1Meas_HwTq1Offs: NvMProxyApplCallCbk=NULL_PTR, NvMBlkRef=Rte_NvmBlock_CDD_HwTq1Meas_HwTq1Offs
      Rte_NvmBlock_CDD_HwTq8Meas_HwTq8Offs: NvMProxyApplCallCbk=NULL_PTR, NvMBlkRef=Rte_NvmBlock_CDD_HwTq8Meas_HwTq8Offs
      Rte_NvmBlock_TEstimn_TFilStVal: NvMProxyApplCallCbk=NULL_PTR, NvMBlkRef=Rte_NvmBlock_TEstimn_TFilStVal
      Rte_NvmBlock_HwTq9Meas_HwTq9Offs: NvMProxyApplCallCbk=NULL_PTR, NvMBlkRef=Rte_NvmBlock_HwTq9Meas_HwTq9Offs
      Rte_NvmBlock_HwTq10Meas_HwTq10Offs: NvMProxyApplCallCbk=NULL_PTR, NvMBlkRef=Rte_NvmBlock_HwTq10Meas_HwTq10Offs
      Rte_NvmBlock_CustDiag_Did3003: NvMProxyApplCallCbk=NULL_PTR, NvMBlkRef=Rte_NvmBlock_CustDiag_Did3003
      Rte_NvmBlock_CustDiag_DidDE{00..04}: NvMProxyApplCallCbk=NULL_PTR, NvMBlkRef=Rte_NvmBlock_CustDiag_DidDE{00..04}
      Rte_NvmBlock_CustDiag_DidEE01: NvMProxyApplCallCbk=NULL_PTR, NvMBlkRef=Rte_NvmBlock_CustDiag_DidEE01
      Rte_NvmBlock_CustDiag_DidEE02: NvMProxyApplCallCbk=NULL_PTR, NvMBlkRef=Rte_NvmBlock_CustDiag_DidEE02
      Rte_NvmBlock_CustDiag_DidF111: NvMProxyApplCallCbk=NULL_PTR, NvMBlkRef=Rte_NvmBlock_CustDiag_DidF111
      Rte_NvmBlock_CustDiag_DidF113: NvMProxyApplCallCbk=NULL_PTR, NvMBlkRef=Rte_NvmBlock_CustDiag_DidF113
      Rte_NvmBlock_FordHwAgArbn_NonAbsOffs: NvMProxyApplCallCbk=NULL_PTR, NvMBlkRef=Rte_NvmBlock_FordHwAgArbn_NonAbsOffs
      Rte_NvmBlock_FordHwAgArbn_NonAbsOffsVldFlg: NvMProxyApplCallCbk=NULL_PTR, NvMBlkRef=Rte_NvmBlock_FordHwAgArbn_NonAbsOffsVldFlg
      Rte_NvmBlock_FordHwAgArbn_PrevIgnCycVal: NvMProxyApplCallCbk=NULL_PTR, NvMBlkRef=Rte_NvmBlock_FordHwAgArbn_PrevIgnCycVal
      Rte_NvmBlock_FordVehSpdArbn_FordVehTireCircum: NvMProxyApplCallCbk=NULL_PTR, NvMBlkRef=Rte_NvmBlock_FordVehSpdArbn_FordVehTireCircum
      Rte_NvmBlock_CustDiag_Did205A: NvMProxyApplCallCbk=NULL_PTR, NvMBlkRef=Rte_NvmBlock_CustDiag_Did205A
      Rte_NvmBlock_CustDiag_Did205B: NvMProxyApplCallCbk=NULL_PTR, NvMBlkRef=Rte_NvmBlock_CustDiag_Did205B
      Rte_NvmBlock_CustDiag_Did301A: NvMProxyApplCallCbk=NULL_PTR, NvMBlkRef=Rte_NvmBlock_CustDiag_Did301A
      Rte_NvmBlock_CustDiag_DidDE05: NvMProxyApplCallCbk=NULL_PTR, NvMBlkRef=Rte_NvmBlock_CustDiag_DidDE05
      Rte_NvmBlock_CustDiag_DidF18C: NvMProxyApplCallCbk=NULL_PTR, NvMBlkRef=Rte_NvmBlock_CustDiag_DidF18C
      Rte_NvmBlock_CustDiag_DidF18A: NvMProxyApplCallCbk=NULL_PTR, NvMBlkRef=Rte_NvmBlock_CustDiag_DidF18A
      Rte_NvmBlock_CustDiag_DidF166: NvMProxyApplCallCbk=NULL_PTR, NvMBlkRef=Rte_NvmBlock_CustDiag_DidF166
      Rte_NvmBlock_CustDiag_DidF163: NvMProxyApplCallCbk=NULL_PTR, NvMBlkRef=Rte_NvmBlock_CustDiag_DidF163
      Rte_NvmBlock_CustDiag_DidF162: NvMProxyApplCallCbk=NULL_PTR, NvMBlkRef=Rte_NvmBlock_CustDiag_DidF162
      Rte_NvmBlock_CustDiag_DidF15F: NvMProxyApplCallCbk=NULL_PTR, NvMBlkRef=Rte_NvmBlock_CustDiag_DidF15F
      Rte_NvmBlock_CustDiag_DidF110: NvMProxyApplCallCbk=NULL_PTR, NvMBlkRef=Rte_NvmBlock_CustDiag_DidF110
      Rte_NvmBlock_CustDiag_DidEE87: NvMProxyApplCallCbk=NULL_PTR, NvMBlkRef=Rte_NvmBlock_CustDiag_DidEE87
      Rte_NvmBlock_CustDiag_DidEE86: NvMProxyApplCallCbk=NULL_PTR, NvMBlkRef=Rte_NvmBlock_CustDiag_DidEE86
      Rte_NvmBlock_CustDiag_DidEE85: NvMProxyApplCallCbk=NULL_PTR, NvMBlkRef=Rte_NvmBlock_CustDiag_DidEE85
      Rte_NvmBlock_CustDiag_DidEE84: NvMProxyApplCallCbk=NULL_PTR, NvMBlkRef=Rte_NvmBlock_CustDiag_DidEE84
      Rte_NvmBlock_CustDiag_DidEE83: NvMProxyApplCallCbk=NULL_PTR, NvMBlkRef=Rte_NvmBlock_CustDiag_DidEE83
      Rte_NvmBlock_CustDiag_DidEE82: NvMProxyApplCallCbk=NULL_PTR, NvMBlkRef=Rte_NvmBlock_CustDiag_DidEE82
      Rte_NvmBlock_CustDiag_DidEE81: NvMProxyApplCallCbk=NULL_PTR, NvMBlkRef=Rte_NvmBlock_CustDiag_DidEE81
      Rte_NvmBlock_CustDiag_DidEE41: NvMProxyApplCallCbk=NULL_PTR, NvMBlkRef=Rte_NvmBlock_CustDiag_DidEE41
      Rte_NvmBlock_CustDiag_DidEE40: NvMProxyApplCallCbk=NULL_PTR, NvMBlkRef=Rte_NvmBlock_CustDiag_DidEE40
      Rte_NvmBlock_CustDiag_DidEE00: NvMProxyApplCallCbk=NULL_PTR, NvMBlkRef=Rte_NvmBlock_CustDiag_DidEE00
      Rte_NvmBlock_CustDiag_DidEED0: NvMProxyApplCallCbk=NULL_PTR, NvMBlkRef=Rte_NvmBlock_CustDiag_DidEED0
      Rte_NvmBlock_CustDiag_DidEE88: NvMProxyApplCallCbk=NULL_PTR, NvMBlkRef=Rte_NvmBlock_CustDiag_DidEE88
      Rte_NvmBlock_CustDiag_Did630F: NvMProxyApplCallCbk=NULL_PTR, NvMBlkRef=Rte_NvmBlock_CustDiag_Did630F
      Rte_NvmBlock_CustDiag_Did630FChk: NvMProxyApplCallCbk=NULL_PTR, NvMBlkRef=Rte_NvmBlock_CustDiag_Did630FChk
      Rte_NvmBlock_CustDiag_DidEE{21..23}: NvMProxyApplCallCbk=NULL_PTR, NvMBlkRef=Rte_NvmBlock_CustDiag_DidEE{21..23}
      Rte_NvmBlock_CustDiag_DidF190: NvMProxyApplCallCbk=NULL_PTR, NvMBlkRef=Rte_NvmBlock_CustDiag_DidF190
      Rte_NvmBlock_StackMeas_StackMeasApplCrc: NvMProxyApplCallCbk=NULL_PTR, NvMBlkRef=Rte_NvmBlock_StackMeas_StackMeasApplCrc
      Rte_NvmBlock_StackMeas_StackMeasRes: NvMProxyApplCallCbk=NULL_PTR, NvMBlkRef=Rte_NvmBlock_StackMeas_StackMeasRes
      Rte_NvmBlock_CDD_FordBlaBoxIfCmp1_ActvNiblCtrl: NvMProxyApplCallCbk=NULL_PTR, NvMBlkRef=Rte_NvmBlock_CDD_FordBlaBoxIfCmp1_ActvNiblCtrl
      Rte_NvmBlock_CDD_FordBlaBoxIfCmp1_LaneAssi: NvMProxyApplCallCbk=NULL_PTR, NvMBlkRef=Rte_NvmBlock_CDD_FordBlaBoxIfCmp1_LaneAssi
      Rte_NvmBlock_CDD_FordBlaBoxIfCmp1_PullDriftCmp: NvMProxyApplCallCbk=NULL_PTR, NvMBlkRef=Rte_NvmBlock_CDD_FordBlaBoxIfCmp1_PullDriftCmp
      Rte_NvmBlock_CDD_FordBlaBoxIfCmp1_TrlrBackupAssi: NvMProxyApplCallCbk=NULL_PTR, NvMBlkRef=Rte_NvmBlock_CDD_FordBlaBoxIfCmp1_TrlrBackupAssi
