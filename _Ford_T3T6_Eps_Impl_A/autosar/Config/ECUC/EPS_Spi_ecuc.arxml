AUTOSAR XML (schema 4-2-1)
package /ActiveEcuC
  module config Spi: implementation-config-variant=VARIANT-POST-BUILD, module-description=Spi_Impl
    SpiGeneral:
      SpiVersionCheckExternalModules = false
      SpiCancelApi = true
      SpiChannelBuffersAllowed = 0
      SpiDevErrorDetect = true
      SpiHwStatusApi = false
      SpiInterruptibleSeqAllowed = false
      SpiLevelDelivered = 1
      SpiSupportConcurrentSyncTransmit = false
      SpiVersionInfoApi = false
      SpiDmaMode = false
      SpiDmaTypeUsed = SPI_DMA_TYPE_TWO
      SpiDataConsistencyCheckEnable = true
      SpiDataWidthSelection = BITS_16
      SpiCriticalSectionProtection = true
      SpiHighPriorityHwHandlingEnable = false
      SpiAlreadyInitDetCheck = true
      SpiSeqStartNotificationEnable = false
      SpiSyncSeqEndNotificationEnable = false
      SpiPersistentHWConfiguration = true
      SpiMaxBaudrate = PCLK_DIV_BY_8
      SpiTimeOut = 65535
      SpiDeviceName = R7F701373
      SpiCSIHWriteVerify = WV_DISABLE
      SpiDMAWriteVerify = WV_DISABLE
      SpiECCSelfTest = ECC_None
      SpiInterruptConsistencyCheck = false
      SpiLoopBackSelfTest = LoopBack_None
      Spi_UseWriteVerifyErrorInterface = false
      SpiInternalErrorBufferSize = 32
    SpiDriver: SpiMaxChannel=41, SpiMaxJob=27, SpiMaxSequence=27
      SpiDemEventParameterRefs: SPI_E_HARDWARE_ERROR=SPI_E_HARDWARE_ERROR, SPI_E_DATA_TX_TIMEOUT_FAILURE=SPI_E_DATA_TX_TIMEOUT_FAILURE
      GateDrv0VrfyCmd0Ch (SpiChannel): SpiChannelId=36, SpiChannelType=IB, SpiDataWidth=15, SpiEbMaxLength=1, SpiIbNBuffers=1, SpiTransferStart=MSB, SpiDefaultData=0
      GateDrv0Diag2Ch (SpiChannel): SpiChannelId=32, SpiChannelType=IB, SpiDataWidth=15, SpiEbMaxLength=1, SpiIbNBuffers=1, SpiTransferStart=MSB, SpiDefaultData=0
      10 x SpiJob, all with SpiJobPriority=3, SpiJobEndNotification=NULL, SpiHwUnitSynchronous=ASYNCHRONOUS:
        PwrSplyJob5: SpiJobId=9, SpiPortPinSelect=CSL2, SpiDeviceAssignment=PwrSplyTmplMonr
          SpiChannelList: SpiChannelIndex=0, SpiChannelAssignment=PwrSplyCh5
        PwrSplyJob4: SpiJobId=8, SpiPortPinSelect=CSL2, SpiDeviceAssignment=PwrSplyTmplMonr
          SpiChannelList: SpiChannelIndex=0, SpiChannelAssignment=PwrSplyCh4
        PwrSplyJob7: SpiJobId=11, SpiPortPinSelect=CSL2, SpiDeviceAssignment=PwrSplyTmplMonr
          SpiChannelList: SpiChannelIndex=0, SpiChannelAssignment=PwrSplyCh7
        PwrSplyJob6: SpiJobId=10, SpiPortPinSelect=CSL2, SpiDeviceAssignment=PwrSplyTmplMonr
          SpiChannelList: SpiChannelIndex=0, SpiChannelAssignment=PwrSplyCh6
        PwrSplyJob9: SpiJobId=13, SpiPortPinSelect=CSL2, SpiDeviceAssignment=PwrSplyTmplMonr
          SpiChannelList: SpiChannelIndex=0, SpiChannelAssignment=PwrSplyCh9
        PwrSplyJob8: SpiJobId=12, SpiPortPinSelect=CSL2, SpiDeviceAssignment=PwrSplyTmplMonr
          SpiChannelList: SpiChannelIndex=0, SpiChannelAssignment=PwrSplyCh8
        GateDrv0Cfg9Job: SpiJobId=17, SpiPortPinSelect=CSL4, SpiDeviceAssignment=GateDrive
          GateDrv0Cfg9Ch (SpiChannelList): SpiChannelIndex=0, SpiChannelAssignment=SpiDriver/GateDrv0Cfg9Ch
        PwrSplyJob1: SpiJobId=5, SpiPortPinSelect=CSL2, SpiDeviceAssignment=PwrSplyTmplMonr
          SpiChannelList: SpiChannelIndex=0, SpiChannelAssignment=PwrSplyCh1
        PwrSplyJob3: SpiJobId=7, SpiPortPinSelect=CSL2, SpiDeviceAssignment=PwrSplyTmplMonr
          SpiChannelList: SpiChannelIndex=0, SpiChannelAssignment=PwrSplyCh3
        GateDrv0VrfyCmd1Job: SpiJobId=25, SpiPortPinSelect=CSL4, SpiDeviceAssignment=GateDrive
          GateDrv0VrfyCmd1Ch (SpiChannelList): SpiChannelIndex=0, SpiChannelAssignment=SpiDriver/GateDrv0VrfyCmd1Ch
      GateDrv0Cfg9Ch (SpiChannel): SpiChannelId=24, SpiChannelType=IB, SpiDataWidth=15, SpiEbMaxLength=1, SpiIbNBuffers=1, SpiTransferStart=MSB, SpiDefaultData=0
      PwrSplyJob2 (SpiJob):
        SpiJobId = 6
        SpiJobPriority = 3
        SpiJobEndNotification = NULL
        SpiPortPinSelect = CSL2
        SpiHwUnitSynchronous = ASYNCHRONOUS
        SpiDeviceAssignment = PwrSplyTmplMonr
        SpiChannelList: SpiChannelIndex=0, SpiChannelAssignment=PwrSplyCh2
      GateDrv0VrfyCmd2Seq (SpiSequence):
        SpiInterruptibleSequence = false
        SpiSeqStartNotification = NULL
        SpiHighPriorityHwSequence = false
        SpiSequenceId = 26
        SpiSeqEndNotification = NULL
        SpiJobAssignment = GateDrv0VrfyCmd2Job
      GateDrv0Cfg5Ch (SpiChannel): SpiChannelId=20, SpiChannelType=IB, SpiDataWidth=15, SpiEbMaxLength=1, SpiIbNBuffers=1, SpiTransferStart=MSB, SpiDefaultData=0
      GateDrv0Cfg1Ch (SpiChannel): SpiChannelId=16, SpiChannelType=IB, SpiDataWidth=15, SpiEbMaxLength=1, SpiIbNBuffers=1, SpiTransferStart=MSB, SpiDefaultData=0
      TmplMonrJob1 (SpiJob):
        SpiJobId = 0
        SpiJobPriority = 3
        SpiJobEndNotification = NULL
        SpiPortPinSelect = CSL2
        SpiHwUnitSynchronous = ASYNCHRONOUS
        SpiDeviceAssignment = PwrSplyTmplMonr
        SpiChannelList: SpiChannelIndex=0, SpiChannelAssignment=TmplMonrCh1
      GateDrv0Cfg11Seq (SpiSequence):
        SpiInterruptibleSequence = false
        SpiSeqStartNotification = NULL
        SpiHighPriorityHwSequence = false
        SpiSequenceId = 19
        SpiSeqEndNotification = NULL
        SpiJobAssignment = GateDrv0Cfg11Job
      5 x SpiJob, all with SpiJobPriority=3, SpiJobEndNotification=NULL, SpiHwUnitSynchronous=ASYNCHRONOUS:
        GateDrv0Cfg10Job: SpiJobId=18, SpiPortPinSelect=CSL4, SpiDeviceAssignment=GateDrive
          GateDrv0Cfg10Ch (SpiChannelList): SpiChannelIndex=0, SpiChannelAssignment=SpiDriver/GateDrv0Cfg10Ch
        TmplMonrJob5: SpiJobId=4, SpiPortPinSelect=CSL2, SpiDeviceAssignment=PwrSplyTmplMonr
          SpiChannelList: SpiChannelIndex=0, SpiChannelAssignment=TmplMonrCh5
        TmplMonrJob4: SpiJobId=3, SpiPortPinSelect=CSL2, SpiDeviceAssignment=PwrSplyTmplMonr
          SpiChannelList: SpiChannelIndex=0, SpiChannelAssignment=TmplMonrCh4
        TmplMonrJob3: SpiJobId=2, SpiPortPinSelect=CSL2, SpiDeviceAssignment=PwrSplyTmplMonr
          SpiChannelList: SpiChannelIndex=0, SpiChannelAssignment=TmplMonrCh3
        TmplMonrJob2: SpiJobId=1, SpiPortPinSelect=CSL2, SpiDeviceAssignment=PwrSplyTmplMonr
          SpiChannelList: SpiChannelIndex=0, SpiChannelAssignment=TmplMonrCh2
      GateDrv0Cfg10Ch (SpiChannel): SpiChannelId=25, SpiChannelType=IB, SpiDataWidth=15, SpiEbMaxLength=1, SpiIbNBuffers=1, SpiTransferStart=MSB, SpiDefaultData=0
      GateDrv0VrfyCmd2Job (SpiJob): SpiJobId=26, SpiJobPriority=3, SpiJobEndNotification=NULL, SpiPortPinSelect=CSL4, SpiHwUnitSynchronous=ASYNCHRONOUS, SpiDeviceAssignment=GateDrive
        GateDrv0VrfyCmd2Ch (SpiChannelList): SpiChannelIndex=0, SpiChannelAssignment=SpiDriver/GateDrv0VrfyCmd2Ch
      CSIH0_FIFO (SpiMemoryMode): SpiHwUnitSelection=CSIH0, SpiMemoryModeSelection=FIFO_MODE
      GateDrv0VrfyCmd1Ch (SpiChannel): SpiChannelId=37, SpiChannelType=IB, SpiDataWidth=15, SpiEbMaxLength=1, SpiIbNBuffers=1, SpiTransferStart=MSB, SpiDefaultData=0
      GateDrv0Diag1Ch (SpiChannel): SpiChannelId=31, SpiChannelType=IB, SpiDataWidth=15, SpiEbMaxLength=1, SpiIbNBuffers=1, SpiTransferStart=MSB, SpiDefaultData=0
      GateDrv0Cfg13Job (SpiJob): SpiJobId=21, SpiJobPriority=3, SpiJobEndNotification=NULL, SpiPortPinSelect=CSL4, SpiHwUnitSynchronous=ASYNCHRONOUS, SpiDeviceAssignment=GateDrive
        GateDrv0Cfg13Ch (SpiChannelList): SpiChannelIndex=0, SpiChannelAssignment=SpiDriver/GateDrv0Cfg13Ch
      GateDrv0Mask2Ch (SpiChannel): SpiChannelId=35, SpiChannelType=IB, SpiDataWidth=15, SpiEbMaxLength=1, SpiIbNBuffers=1, SpiTransferStart=MSB, SpiDefaultData=0
      GateDrv0VrfyCmd0Seq (SpiSequence):
        SpiInterruptibleSequence = false
        SpiSeqStartNotification = NULL
        SpiHighPriorityHwSequence = false
        SpiSequenceId = 24
        SpiSeqEndNotification = NULL
        SpiJobAssignment = GateDrv0VrfyCmd0Job
      GateDrv0Cfg6Ch (SpiChannel): SpiChannelId=21, SpiChannelType=IB, SpiDataWidth=15, SpiEbMaxLength=1, SpiIbNBuffers=1, SpiTransferStart=MSB, SpiDefaultData=0
      GateDrv0AllCfgSeq (SpiSequence):
        SpiInterruptibleSequence = false
        SpiSeqStartNotification = NULL
        SpiHighPriorityHwSequence = false
        SpiSequenceId = 15
        SpiSeqEndNotification = NULL
        SpiJobAssignment = GateDrv0AllCfgJob
      GateDrv0Cfg2Ch (SpiChannel): SpiChannelId=17, SpiChannelType=IB, SpiDataWidth=15, SpiEbMaxLength=1, SpiIbNBuffers=1, SpiTransferStart=MSB, SpiDefaultData=0
      GateDrv0CmnDiagJob (SpiJob): SpiJobId=22, SpiJobPriority=3, SpiJobEndNotification=NULL, SpiPortPinSelect=CSL4, SpiHwUnitSynchronous=ASYNCHRONOUS, SpiDeviceAssignment=GateDrive
        6 x SpiChannelList:
          GateDrv0Mask0Ch: SpiChannelIndex=0, SpiChannelAssignment=SpiDriver/GateDrv0Mask0Ch
          GateDrv0Diag0Ch: SpiChannelIndex=1, SpiChannelAssignment=SpiDriver/GateDrv0Diag0Ch
          GateDrv0Diag1Ch: SpiChannelIndex=2, SpiChannelAssignment=SpiDriver/GateDrv0Diag1Ch
          GateDrv0Diag2Ch: SpiChannelIndex=3, SpiChannelAssignment=SpiDriver/GateDrv0Diag2Ch
          GateDrv0VrfyRes0Ch: SpiChannelIndex=4, SpiChannelAssignment=SpiDriver/GateDrv0VrfyRes0Ch
          GateDrv0VrfyRes1Ch: SpiChannelIndex=5, SpiChannelAssignment=SpiDriver/GateDrv0VrfyRes1Ch
      6 x SpiChannel, all with SpiChannelType=IB, SpiDataWidth=15, SpiEbMaxLength=1, SpiIbNBuffers=1, SpiTransferStart=MSB, SpiDefaultData=0:
        TmplMonrCh5: SpiChannelId=4
        TmplMonrCh4: SpiChannelId=3
        TmplMonrCh1: SpiChannelId=0
        GateDrv0Cfg11Ch: SpiChannelId=26
        TmplMonrCh3: SpiChannelId=2
        TmplMonrCh2: SpiChannelId=1
      8 x SpiSequence, all with SpiInterruptibleSequence=false, SpiSeqStartNotification=NULL, SpiHighPriorityHwSequence=false, SpiSeqEndNotification=NULL:
        PwrSplySeq7: SpiSequenceId=11, SpiJobAssignment=PwrSplyJob7
        PwrSplySeq6: SpiSequenceId=10, SpiJobAssignment=PwrSplyJob6
        PwrSplySeq9: SpiSequenceId=13, SpiJobAssignment=PwrSplyJob9
        PwrSplySeq8: SpiSequenceId=12, SpiJobAssignment=PwrSplyJob8
        PwrSplySeq3: SpiSequenceId=7, SpiJobAssignment=PwrSplyJob3
        PwrSplySeq2: SpiSequenceId=6, SpiJobAssignment=PwrSplyJob2
        PwrSplySeq5: SpiSequenceId=9, SpiJobAssignment=PwrSplyJob5
        PwrSplySeq4: SpiSequenceId=8, SpiJobAssignment=PwrSplyJob4
      GateDrv0VrfyCmd0Job (SpiJob): SpiJobId=24, SpiJobPriority=3, SpiJobEndNotification=NULL, SpiPortPinSelect=CSL4, SpiHwUnitSynchronous=ASYNCHRONOUS, SpiDeviceAssignment=GateDrive
        GateDrv0VrfyCmd0Ch (SpiChannelList): SpiChannelIndex=0, SpiChannelAssignment=SpiDriver/GateDrv0VrfyCmd0Ch
      GateDrv0VrfyCmd1Seq (SpiSequence):
        SpiInterruptibleSequence = false
        SpiSeqStartNotification = NULL
        SpiHighPriorityHwSequence = false
        SpiSequenceId = 25
        SpiSeqEndNotification = NULL
        SpiJobAssignment = GateDrv0VrfyCmd1Job
      PwrSplySeq1 (SpiSequence):
        SpiInterruptibleSequence = false
        SpiSeqStartNotification = NULL
        SpiHighPriorityHwSequence = false
        SpiSequenceId = 5
        SpiSeqEndNotification = NULL
        SpiJobAssignment = PwrSplyJob1
      GateDrive (SpiExternalDevice):
        SpiBaudrate = 0
        SpiBaudrateConfiguration = 10
        SpiCsIdentifier = NULL
        SpiCsPolarity = LOW
        SpiDataShiftEdge = LEADING
        SpiEnableCs = true
        SpiHwUnit = CSIH0
        SpiShiftClockIdleLevel = HIGH
        SpiTimeClk2Cs = 0
        SpiClk2CsCount = 5
        SpiInputClockSelect = PCLK_DIVBY_8
        SpiInterruptDelayMode = false
        SpiParitySelection = ODD_PARITY
        SpiBroadcastingPriority = DOMINANT
        SpiCsIdleEnforcement = true
        SpiCsIdleTiming = IDLE_TIME_3_POINT_5
        SpiCsInactiveAfterLastData = true
        SpiCsHoldTiming = HOLD_TIME_0_POINT_5
        SpiCsSetupTime = SETUP_TIME_0_POINT_5
        SpiCsSelection = CS_VIA_PERIPHERAL_ENGINE
        SpiCsInterDataDelay = INTER_DATA_TIME_0_POINT_5
        SpiBaudrateRegisterSelect = CSIH_BAUDRATE_REGISTER_0
        SpiClockFrequencyRef = McuPLLClkSetting
      GateDrv0CmnDiagSeq (SpiSequence):
        SpiInterruptibleSequence = false
        SpiSeqStartNotification = NULL
        SpiHighPriorityHwSequence = false
        SpiSequenceId = 22
        SpiSeqEndNotification = NULL
        SpiJobAssignment = GateDrv0CmnDiagJob
      3 x SpiChannel, all with SpiChannelType=IB, SpiDataWidth=15, SpiEbMaxLength=1, SpiIbNBuffers=1, SpiTransferStart=MSB, SpiDefaultData=0:
        PwrSplyCh6: SpiChannelId=10
        GateDrv0Diag0Ch: SpiChannelId=30
        PwrSplyCh7: SpiChannelId=11
      TmplMonrSeq5 (SpiSequence):
        SpiInterruptibleSequence = false
        SpiSeqStartNotification = NULL
        SpiHighPriorityHwSequence = false
        SpiSequenceId = 4
        SpiSeqEndNotification = NULL
        SpiJobAssignment = TmplMonrJob5
      PwrSplyCh8 (SpiChannel): SpiChannelId=12, SpiChannelType=IB, SpiDataWidth=15, SpiEbMaxLength=1, SpiIbNBuffers=1, SpiTransferStart=MSB, SpiDefaultData=0
      GateDrv0VrfyCmd2Ch (SpiChannel): SpiChannelId=38, SpiChannelType=IB, SpiDataWidth=15, SpiEbMaxLength=1, SpiIbNBuffers=1, SpiTransferStart=MSB, SpiDefaultData=0
      TmplMonrSeq4 (SpiSequence):
        SpiInterruptibleSequence = false
        SpiSeqStartNotification = NULL
        SpiHighPriorityHwSequence = false
        SpiSequenceId = 3
        SpiSeqEndNotification = NULL
        SpiJobAssignment = TmplMonrJob4
      PwrSplyCh9 (SpiChannel): SpiChannelId=13, SpiChannelType=IB, SpiDataWidth=15, SpiEbMaxLength=1, SpiIbNBuffers=1, SpiTransferStart=MSB, SpiDefaultData=0
      GateDrv0Cfg11Job (SpiJob): SpiJobId=19, SpiJobPriority=3, SpiJobEndNotification=NULL, SpiPortPinSelect=CSL4, SpiHwUnitSynchronous=ASYNCHRONOUS, SpiDeviceAssignment=GateDrive
        GateDrv0Cfg11Ch (SpiChannelList): SpiChannelIndex=0, SpiChannelAssignment=SpiDriver/GateDrv0Cfg11Ch
      4 x SpiSequence, all with SpiInterruptibleSequence=false, SpiSeqStartNotification=NULL, SpiHighPriorityHwSequence=false, SpiSeqEndNotification=NULL:
        TmplMonrSeq3: SpiSequenceId=2, SpiJobAssignment=TmplMonrJob3
        TmplMonrSeq2: SpiSequenceId=1, SpiJobAssignment=TmplMonrJob2
        GateDrv0Cfg12Seq: SpiSequenceId=20, SpiJobAssignment=GateDrv0Cfg12Job
        TmplMonrSeq1: SpiSequenceId=0, SpiJobAssignment=TmplMonrJob1
      4 x SpiChannel, all with SpiChannelType=IB, SpiDataWidth=15, SpiEbMaxLength=1, SpiIbNBuffers=1, SpiTransferStart=MSB, SpiDefaultData=0:
        PwrSplyCh1: SpiChannelId=5
        PwrSplyCh2: SpiChannelId=6
        PwrSplyCh3: SpiChannelId=7
        PwrSplyCh4: SpiChannelId=8
      GateDrv0CtrlJob (SpiJob): SpiJobId=23, SpiJobPriority=3, SpiJobEndNotification=NULL, SpiPortPinSelect=CSL4, SpiHwUnitSynchronous=ASYNCHRONOUS, SpiDeviceAssignment=GateDrive
        GateDrv0CtrlCh (SpiChannelList): SpiChannelIndex=0, SpiChannelAssignment=SpiDriver/GateDrv0CtrlCh
      7 x SpiChannel, all with SpiChannelType=IB, SpiDataWidth=15, SpiEbMaxLength=1, SpiIbNBuffers=1, SpiTransferStart=MSB, SpiDefaultData=0:
        PwrSplyCh5: SpiChannelId=9
        GateDrv0CtrlCh: SpiChannelId=29
        GateDrv0Mask1Ch: SpiChannelId=34
        GateDrv0Cfg7Ch: SpiChannelId=22
        GateDrv0VrfyRes1Ch: SpiChannelId=40
        GateDrv0Cfg3Ch: SpiChannelId=18
        GateDrv0Cfg12Ch: SpiChannelId=27
      GateDrv0Cfg8Job (SpiJob): SpiJobId=16, SpiJobPriority=3, SpiJobEndNotification=NULL, SpiPortPinSelect=CSL4, SpiHwUnitSynchronous=ASYNCHRONOUS, SpiDeviceAssignment=GateDrive
        GateDrv0Cfg8Ch (SpiChannelList): SpiChannelIndex=0, SpiChannelAssignment=SpiDriver/GateDrv0Cfg8Ch
      GateDrv0Cfg9Seq (SpiSequence):
        SpiInterruptibleSequence = false
        SpiSeqStartNotification = NULL
        SpiHighPriorityHwSequence = false
        SpiSequenceId = 17
        SpiSeqEndNotification = NULL
        SpiJobAssignment = GateDrv0Cfg9Job
      PwrSplySeq10 (SpiSequence):
        SpiInterruptibleSequence = false
        SpiSeqStartNotification = NULL
        SpiHighPriorityHwSequence = false
        SpiSequenceId = 14
        SpiSeqEndNotification = NULL
        SpiJobAssignment = PwrSplyJob10
      PwrSplyJob10 (SpiJob):
        SpiJobId = 14
        SpiJobPriority = 3
        SpiJobEndNotification = NULL
        SpiPortPinSelect = CSL2
        SpiHwUnitSynchronous = ASYNCHRONOUS
        SpiDeviceAssignment = PwrSplyTmplMonr
        SpiChannelList: SpiChannelIndex=0, SpiChannelAssignment=PwrSplyCh10
      PwrSplyTmplMonr (SpiExternalDevice):
        SpiBaudrate = 0
        SpiBaudrateConfiguration = 10
        SpiCsIdentifier = NULL
        SpiCsPolarity = LOW
        SpiDataShiftEdge = LEADING
        SpiEnableCs = true
        SpiHwUnit = CSIH0
        SpiShiftClockIdleLevel = HIGH
        SpiTimeClk2Cs = 0
        SpiClk2CsCount = 5
        SpiInputClockSelect = PCLK_DIVBY_8
        SpiInterruptDelayMode = false
        SpiParitySelection = ODD_PARITY
        SpiBroadcastingPriority = DOMINANT
        SpiCsIdleEnforcement = true
        SpiCsIdleTiming = IDLE_TIME_3_POINT_5
        SpiCsInactiveAfterLastData = true
        SpiCsHoldTiming = HOLD_TIME_0_POINT_5
        SpiCsSetupTime = SETUP_TIME_0_POINT_5
        SpiCsSelection = CS_VIA_PERIPHERAL_ENGINE
        SpiCsInterDataDelay = INTER_DATA_TIME_0_POINT_5
        SpiBaudrateRegisterSelect = CSIH_BAUDRATE_REGISTER_0
        SpiClockFrequencyRef = McuPLLClkSetting
      GateDrv0AllCfgJob (SpiJob): SpiJobId=15, SpiJobPriority=3, SpiJobEndNotification=NULL, SpiPortPinSelect=CSL4, SpiHwUnitSynchronous=ASYNCHRONOUS, SpiDeviceAssignment=GateDrive
        11 x SpiChannelList:
          GateDrv0Cfg{0..7}Ch: SpiChannelIndex={0..7}, SpiChannelAssignment=SpiDriver/GateDrv0Cfg{0..7}Ch
          GateDrv0CtrlCh: SpiChannelIndex=8, SpiChannelAssignment=SpiDriver/GateDrv0CtrlCh
          GateDrv0Mask1Ch: SpiChannelIndex=9, SpiChannelAssignment=SpiDriver/GateDrv0Mask1Ch
          GateDrv0Mask2Ch: SpiChannelIndex=10, SpiChannelAssignment=SpiDriver/GateDrv0Mask2Ch
      GateDrv0Cfg10Seq (SpiSequence):
        SpiInterruptibleSequence = false
        SpiSeqStartNotification = NULL
        SpiHighPriorityHwSequence = false
        SpiSequenceId = 18
        SpiSeqEndNotification = NULL
        SpiJobAssignment = GateDrv0Cfg10Job
      GateDrv0Cfg8Seq (SpiSequence):
        SpiInterruptibleSequence = false
        SpiSeqStartNotification = NULL
        SpiHighPriorityHwSequence = false
        SpiSequenceId = 16
        SpiSeqEndNotification = NULL
        SpiJobAssignment = GateDrv0Cfg8Job
      5 x SpiChannel, all with SpiChannelType=IB, SpiDataWidth=15, SpiEbMaxLength=1, SpiIbNBuffers=1, SpiTransferStart=MSB, SpiDefaultData=0:
        GateDrv0Cfg8Ch: SpiChannelId=23
        GateDrv0Mask0Ch: SpiChannelId=33
        GateDrv0Cfg4Ch: SpiChannelId=19
        GateDrv0VrfyRes0Ch: SpiChannelId=39
        GateDrv0Cfg0Ch: SpiChannelId=15
      GateDrv0Cfg13Seq (SpiSequence):
        SpiInterruptibleSequence = false
        SpiSeqStartNotification = NULL
        SpiHighPriorityHwSequence = false
        SpiSequenceId = 21
        SpiSeqEndNotification = NULL
        SpiJobAssignment = GateDrv0Cfg13Job
      PwrSplyCh10 (SpiChannel): SpiChannelId=14, SpiChannelType=IB, SpiDataWidth=15, SpiEbMaxLength=1, SpiIbNBuffers=1, SpiTransferStart=MSB, SpiDefaultData=0
      GateDrv0CtrlSeq (SpiSequence):
        SpiInterruptibleSequence = false
        SpiSeqStartNotification = NULL
        SpiHighPriorityHwSequence = false
        SpiSequenceId = 23
        SpiSeqEndNotification = NULL
        SpiJobAssignment = GateDrv0CtrlJob
      GateDrv0Cfg12Job (SpiJob): SpiJobId=20, SpiJobPriority=3, SpiJobEndNotification=NULL, SpiPortPinSelect=CSL4, SpiHwUnitSynchronous=ASYNCHRONOUS, SpiDeviceAssignment=GateDrive
        GateDrv0Cfg12Ch (SpiChannelList): SpiChannelIndex=0, SpiChannelAssignment=SpiDriver/GateDrv0Cfg12Ch
      GateDrv0Cfg13Ch (SpiChannel): SpiChannelId=28, SpiChannelType=IB, SpiDataWidth=15, SpiEbMaxLength=1, SpiIbNBuffers=1, SpiTransferStart=MSB, SpiDefaultData=0
    SpiPublishedInformation: SpiMaxHwUnit=4
