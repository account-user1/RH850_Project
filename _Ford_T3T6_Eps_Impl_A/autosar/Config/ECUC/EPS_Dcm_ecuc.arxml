AUTOSAR XML (schema 4-2-1)
package /ActiveEcuC
  module config Dcm: implementation-config-variant=VARIANT-PRE-COMPILE, module-description=Dcm_Impl
    DcmConfigSet
      DcmGeneral:
        DcmKeepAliveTime = 6
        DcmDevErrorDetect = true
        DcmRequestManufacturerNotificationEnabled = true
        DcmRequestSupplierNotificationEnabled = false
        DcmRespondAllRequest = true
        DcmTaskTime = 0.01
        DcmVersionInfoApi = false
        DcmDspDataDefaultEndianness = LITTLE_ENDIAN
        DcmSupportedIDCalculationSuppressionEnabled = false
        DcmDtrDataProvisionViaDemEnabled = true
        DcmResetToFblAfterSessionFinalResposeEnabled = false
      DcmDsl
        DcmDslDiagResp: DcmDslDiagRespOnSecondDeclinedRequest=true, DcmDslDiagRespMaxNumOfDeclinedRequests=3, DcmDslDiagRespMaxNumRespPend=0
        DcmDslProtocol
          DcmDslProtocolRow:
            DcmDslProtocolID = DCM_UDS_ON_CAN
            DcmDslProtocolPriority = 0
            DcmSendRespPendOnTransToBoot = true
            DcmTimStrP2ServerAdjust = 0
            DcmTimStrP2StarServerAdjust = 0
            DcmDslProtocolEndiannessConvEnabled = false
            DcmDslProtocolIsParallelExecutab = false
            DcmDslProtocolPreemptTimeout = 0
            DcmDslProtocolMaximumResponseSize = 4095
            DcmDslProtocolRxBufferID = DcmDslBuffer
            DcmDslProtocolSIDTable = DcmDsdServiceTable
            DcmDslProtocolTxBufferID = DcmDslBuffer
            TN_TSTR_TN_PSCM_FD_Ch0_FD1_CAN (DcmDslConnection)
              DcmDslMainConnection: DcmDslProtocolRxTesterSourceAddr=0
                PT_TesterPhysicalResPSCM_FD1_20_PP_TesterPhysicalResPSCM_FD1_Tx_20_3290b631_3cf8f7d5 (DcmDslProtocolTx): DcmDslTxConfirmationPduId=0, DcmDslProtocolTxPduRef=PT_TesterPhysicalResPSCM_FD1_20_PP_TesterPhysicalResPSCM_FD1_Tx_20_3290b631_3cf8f7d5
                PT_TesterFunctionalReq_FD1_20_PP_TesterFunctionalReq_FD1_Rx_20_3290b631_3cf8f7d5 (DcmDslProtocolRx):
                  DcmDslProtocolRxAddrType = DCM_FUNCTIONAL_TYPE
                  DcmDslProtocolRxPduId = 0
                  DcmDslProtocolRxComMChannelRef = FD1_CAN_f26020e5
                  DcmDslProtocolRxPduRef = PT_TesterFunctionalReq_FD1_20_PP_TesterFunctionalReq_FD1_Rx_20_3290b631_3cf8f7d5
                PT_TesterPhysicalReqPSCM_FD1_20_PP_TesterPhysicalReqPSCM_FD1_Rx_20_3290b631_3cf8f7d5 (DcmDslProtocolRx):
                  DcmDslProtocolRxAddrType = DCM_PHYSICAL_TYPE
                  DcmDslProtocolRxPduId = 2
                  DcmDslProtocolRxComMChannelRef = FD1_CAN_f26020e5
                  DcmDslProtocolRxPduRef = PT_TesterPhysicalReqPSCM_FD1_20_PP_TesterPhysicalReqPSCM_FD1_Rx_20_3290b631_3cf8f7d5
            TN_TSTR_FD_TN_PSCM_FD_FD_Ch0_FD1_CAN (DcmDslConnection)
              DcmDslMainConnection: DcmDslProtocolRxTesterSourceAddr=0
                PT_TesterPhysicalReqPSCM_FD1_PP_TesterPhysicalReqPSCM_FD1_Rx_3290b631_3cf8f7d5 (DcmDslProtocolRx):
                  DcmDslProtocolRxAddrType = DCM_PHYSICAL_TYPE
                  DcmDslProtocolRxPduId = 3
                  DcmDslProtocolRxComMChannelRef = FD1_CAN_f26020e5
                  DcmDslProtocolRxPduRef = PT_TesterPhysicalReqPSCM_FD1_PP_TesterPhysicalReqPSCM_FD1_Rx_3290b631_3cf8f7d5
                PT_TesterPhysicalResPSCM_FD1_PP_TesterPhysicalResPSCM_FD1_Tx_3290b631_3cf8f7d5 (DcmDslProtocolTx): DcmDslTxConfirmationPduId=1, DcmDslProtocolTxPduRef=PT_TesterPhysicalResPSCM_FD1_PP_TesterPhysicalResPSCM_FD1_Tx_3290b631_3cf8f7d5
                PT_TesterFunctionalReq_FD1_PP_TesterFunctionalReq_FD1_Rx_3290b631_3cf8f7d5 (DcmDslProtocolRx):
                  DcmDslProtocolRxAddrType = DCM_FUNCTIONAL_TYPE
                  DcmDslProtocolRxPduId = 1
                  DcmDslProtocolRxComMChannelRef = FD1_CAN_f26020e5
                  DcmDslProtocolRxPduRef = PT_TesterFunctionalReq_FD1_PP_TesterFunctionalReq_FD1_Rx_3290b631_3cf8f7d5
        DcmDslBuffer: DcmDslBufferSize=1028
        DcmDslCallbackDCMRequestService
        DcmDslServiceRequestManufacturerNotification:
          DcmDslServiceRequestManufacturerNotificationConfirmationFnc = DcmDslServiceRequestManufacturerNotificationConfirmationFnc_DcmDslServiceRequestManufacturerNotification
          DcmDslServiceRequestManufacturerNotificationIndicationFnc = DcmDslServiceRequestManufacturerNotificationIndicationFnc_DcmDslServiceRequestManufacturerNotification
          DcmDslServiceRequestManufacturerNotificationUsePort = true
      DcmDsd
        DcmDsdServiceTable: DcmDsdSidTabId=0  # RequestDownload RequestTransferExit TransferData
          11 x DcmDsdService:
            ClearDiagInfo: DcmDsdSidTabServiceId=20, DcmDsdSidTabSubfuncAvail=false, DcmDsdSidTabFnc=Srv14ClrDiagcInfo, DcmDsdSidTabSessionLevelRef=DcmDspSession/Default, DcmDsdSidTabSessionLevelRef=ExtendedDiagnostic, DcmDsdSidTabSessionLevelRef=NexteerSession
            ControlDtcSetting: DcmDsdSidTabServiceId=133, DcmDsdSidTabSubfuncAvail=true, DcmDsdSidTabSessionLevelRef=ExtendedDiagnostic, DcmDsdSidTabSessionLevelRef=NexteerSession
              Enable (DcmDsdSubService): DcmDsdSubServiceId=1, DcmDsdSubServiceSessionLevelRef=ExtendedDiagnostic, DcmDsdSubServiceSessionLevelRef=NexteerSession
              Disable (DcmDsdSubService): DcmDsdSubServiceId=2, DcmDsdSubServiceSessionLevelRef=ExtendedDiagnostic, DcmDsdSubServiceSessionLevelRef=NexteerSession
            DiagSessionControl: DcmDsdSidTabServiceId=16, DcmDsdSidTabSubfuncAvail=true
              4 x DcmDsdSubService:
                Programming: DcmDsdSubServiceId=2, DcmDsdSubServiceModeRuleRef=EcuResetModeRule
                Default: DcmDsdSubServiceId=1
                Extended: DcmDsdSubServiceId=3, DcmDsdSubServiceSessionLevelRef=DcmDspSession/Default, DcmDsdSubServiceSessionLevelRef=ExtendedDiagnostic, DcmDsdSubServiceSessionLevelRef=NexteerSession
                NexteerSession_Start: DcmDsdSubServiceId=126
            ReadDataById: DcmDsdSidTabServiceId=34, DcmDsdSidTabSubfuncAvail=false
            EcuReset: DcmDsdSidTabServiceId=17, DcmDsdSidTabSubfuncAvail=true
              Hard (DcmDsdSubService): DcmDsdSubServiceId=1, DcmDsdSubServiceFnc=EcuReset_Hard, DcmDsdSubServiceModeRuleRef=EcuResetModeRule
            ReadDtcInfo: DcmDsdSidTabServiceId=25, DcmDsdSidTabSubfuncAvail=true, DcmDsdSidTabSessionLevelRef=DcmDspSession/Default, DcmDsdSidTabSessionLevelRef=ExtendedDiagnostic, DcmDsdSidTabSessionLevelRef=NexteerSession
              4 x DcmDsdSubService, all with DcmDsdSubServiceSessionLevelRef=DcmDspSession/Default, DcmDsdSubServiceSessionLevelRef=ExtendedDiagnostic, DcmDsdSubServiceSessionLevelRef=NexteerSession:
                RDTCBSM: DcmDsdSubServiceId=2
                RSUPDTC: DcmDsdSubServiceId=10
                RNODTCBSM: DcmDsdSubServiceId=1
                RDTCEDRBDN: DcmDsdSubServiceId=6
            TesterPresent: DcmDsdSidTabServiceId=62, DcmDsdSidTabSubfuncAvail=true
              TesterPresent (DcmDsdSubService): DcmDsdSubServiceId=0
            IoControlById: DcmDsdSidTabServiceId=47, DcmDsdSidTabSubfuncAvail=false, DcmDsdSidTabSessionLevelRef=ExtendedDiagnostic, DcmDsdSidTabSessionLevelRef=NexteerSession
            WriteDataById: DcmDsdSidTabServiceId=46, DcmDsdSidTabSubfuncAvail=false, DcmDsdSidTabSessionLevelRef=DcmDspSession/Programming, DcmDsdSidTabSessionLevelRef=ExtendedDiagnostic, DcmDsdSidTabSessionLevelRef=NexteerSession
            SecurityAccess: DcmDsdSidTabServiceId=39, DcmDsdSidTabSubfuncAvail=true, DcmDsdSidTabSessionLevelRef=DcmDspSession/Programming, DcmDsdSidTabSessionLevelRef=ExtendedDiagnostic, DcmDsdSidTabSessionLevelRef=NexteerSession
              4 x DcmDsdSubService, all with DcmDsdSubServiceSessionLevelRef=NexteerSession:
                Request_Seed_Security_Level_0x01_Request_Seed: DcmDsdSubServiceId=1, DcmDsdSubServiceSessionLevelRef=DcmDspSession/Programming
                Send_Key_Security_Level_0x01_Send_Key: DcmDsdSubServiceId=2, DcmDsdSubServiceSessionLevelRef=DcmDspSession/Programming
                Request_Seed_Security_Level_0x03_Request_Seed: DcmDsdSubServiceId=3, DcmDsdSubServiceSessionLevelRef=ExtendedDiagnostic
                Send_Key_Security_Level_0x03_Send_Key: DcmDsdSubServiceId=4, DcmDsdSubServiceSessionLevelRef=ExtendedDiagnostic
            RoutineControl: DcmDsdSidTabServiceId=49, DcmDsdSidTabSubfuncAvail=true, DcmDsdSidTabSessionLevelRef=DcmDspSession/Default, DcmDsdSidTabSessionLevelRef=ExtendedDiagnostic, DcmDsdSidTabSessionLevelRef=NexteerSession
      DcmPageBufferCfg: DcmPagedBufferEnabled=true
      DcmDsp: DcmDspMaxDidToRead=5, DcmDspReadDIDReportsNODIByte=false
        DcmDspSession
          3 x DcmDspSessionRow, all with DcmDspSessionP2StarServerMax=5, DcmDspSessionForBoot=DCM_NO_BOOT:
            ExtendedDiagnostic: DcmDspSessionLevel=3, DcmDspSessionP2ServerMax=0.05
            Programming: DcmDspSessionLevel=2, DcmDspSessionP2ServerMax=0.025
            Default: DcmDspSessionLevel=1, DcmDspSessionP2ServerMax=0.05
          DcmDspSessionCallback: DcmDspSessionCallbackFnc=DcmDspSessionCallback
          NexteerSession (DcmDspSessionRow): DcmDspSessionLevel=126, DcmDspSessionP2ServerMax=0.025, DcmDspSessionP2StarServerMax=5, DcmDspSessionForBoot=DCM_NO_BOOT
        Did_DID_F113_ECU_Delivery_Assembly_Number (DcmDspDid):
          DcmDspDidIdentifier = 61715
          DcmDspDidUsed = true
          DcmDspDidUsePort = USE_DATA_ELEMENT_SPECIFIC_INTERFACES
          DcmDspDidInfoRef = DidInfo_DID_F113_ECU_Delivery_Assembly_Number
          DcmDspDidSignal: DcmDspDidDataPos=0, DcmDspDidDataRef=DID_F113_ECU_Delivery_Assembly_Number
        DidInfo_DID_F113_ECU_Delivery_Assembly_Number (DcmDspDidInfo): DcmDspDidDynamicallyDefined=false
          DcmDspDidAccess
            DcmDspDidRead
            DcmDspDidWrite: DcmDspDidWriteSessionRef=DcmDspSession/Programming, DcmDspDidWriteSessionRef=NexteerSession
        DcmDspSecurity
          3 x DcmDspSecurityRow, all with DcmDspSecurityAttemptCounterEnabled=false, DcmDspSecurityDelayTime=0, DcmDspSecurityDelayTimeOnBoot=0, DcmDspSecurityNumAttDelay=0, DcmDspSecurityUsePort=USE_ASYNCH_CLIENT_SERVER:
            Un_locked_L1: DcmDspSecurityKeySize=18, DcmDspSecurityLevel=1, DcmDspSecuritySeedSize=16
              SecurityFixedBytes (DcmDspSecurityFixedBytes):
                DcmDspSecurityFixedByteValue = 17
                DcmDspSecurityFixedByteValue = 34
                DcmDspSecurityFixedByteValue = 51
                DcmDspSecurityFixedByteValue = 68
                DcmDspSecurityFixedByteValue = 85
                DcmDspSecurityFixedByteValue = 102
                DcmDspSecurityFixedByteValue = 119
                DcmDspSecurityFixedByteValue = 136
                DcmDspSecurityFixedByteValue = 153
                DcmDspSecurityFixedByteValue = 170
                DcmDspSecurityFixedByteValue = 187
                DcmDspSecurityFixedByteValue = 204
            Locked: DcmDspSecurityLevel=0, DcmDspSecurityKeySize=4, DcmDspSecuritySeedSize=4
            Un_locked_L3: DcmDspSecurityKeySize=16, DcmDspSecurityLevel=2, DcmDspSecuritySeedSize=16
              SecurityFixedBytes (DcmDspSecurityFixedBytes):
                DcmDspSecurityFixedByteValue = 0
                DcmDspSecurityFixedByteValue = 0
                DcmDspSecurityFixedByteValue = 0
                DcmDspSecurityFixedByteValue = 0
                DcmDspSecurityFixedByteValue = 0
                DcmDspSecurityFixedByteValue = 0
                DcmDspSecurityFixedByteValue = 0
                DcmDspSecurityFixedByteValue = 0
                DcmDspSecurityFixedByteValue = 0
                DcmDspSecurityFixedByteValue = 0
                DcmDspSecurityFixedByteValue = 0
                DcmDspSecurityFixedByteValue = 0
        DidInfo_DID_F111_ECU_Core_Assembly_Number (DcmDspDidInfo): DcmDspDidDynamicallyDefined=false
          DcmDspDidAccess
            DcmDspDidRead
            DcmDspDidWrite: DcmDspDidWriteSessionRef=DcmDspSession/Programming, DcmDspDidWriteSessionRef=NexteerSession
        Did_DID_F111_ECU_Core_Assembly_Number (DcmDspDid):
          DcmDspDidIdentifier = 61713
          DcmDspDidUsed = true
          DcmDspDidUsePort = USE_DATA_ELEMENT_SPECIFIC_INTERFACES
          DcmDspDidInfoRef = DidInfo_DID_F111_ECU_Core_Assembly_Number
          DcmDspDidSignal: DcmDspDidDataPos=0, DcmDspDidDataRef=DID_F111_ECU_Core_Assembly_Number
        DcmDspFaultMemory
          DcmDspFaultMemoryRecords
            DcmDspFaultMemoryExtDataRecord: DcmDspFaultMemoryExtDataRecordNumberLower=1
        NexteerDidRangeFD00toFD39 (DcmDspDidRange):
          DcmDspDidRangeHasGaps = false
          DcmDspDidRangeIdentifierLowerLimit = 64768
          DcmDspDidRangeIdentifierUpperLimit = 64825
          DcmDspDidRangeMaxDataLength = 1024
          DcmDspDidRangeUsePort = true
          DcmDspDidRangeInfoRef = DidInfo_NexteerDids_ReadWrite
        DidInfo_NexteerDids_ReadWrite (DcmDspDidInfo): DcmDspDidDynamicallyDefined=false
          DcmDspDidAccess
            DcmDspDidRead: DcmDspDidReadSessionRef=NexteerSession
            DcmDspDidWrite: DcmDspDidWriteSessionRef=NexteerSession
        DataInfo_DID_Nexteer (DcmDspDataInfo): DcmDspDataFixedLength=false
        DID_Dummy (DcmDspDid): DcmDspDidIdentifier=65535, DcmDspDidUsed=true, DcmDspDidUsePort=USE_DATA_ELEMENT_SPECIFIC_INTERFACES, DcmDspDidInfoRef=DidInfo_Dummy
          DcmDspDidSignal: DcmDspDidDataPos=0, DcmDspDidDataRef=Data_Dummy
        DidInfo_Dummy (DcmDspDidInfo): DcmDspDidDynamicallyDefined=false
          DcmDspDidAccess
            DcmDspDidWrite
            DcmDspDidControl:
              DcmDspDidControlMask = DCM_CONTROLMASK_INTERNAL
              DcmDspDidFreezeCurrentState = false
              DcmDspDidResetToDefault = false
              DcmDspDidReturnControlToEcu = true
              DcmDspDidShortTermAdjustment = true
            DcmDspDidRead
        Data_Dummy (DcmDspData):
          DcmDspDataSize = 8
          DcmDspDataUsePort = USE_DATA_ASYNCH_CLIENT_SERVER
          DcmDspDataType = UINT8
          DcmDspDataConditionCheckReadFncUsed = false
          DcmDspDataInfoRef = DataInfo_Dummy
        DataInfo_Dummy (DcmDspDataInfo): DcmDspDataFixedLength=false
        DidInfo_NexteerDids_IoControl (DcmDspDidInfo): DcmDspDidDynamicallyDefined=false
          DcmDspDidAccess
            DcmDspDidControl:
              DcmDspDidControlMask = DCM_CONTROLMASK_INTERNAL
              DcmDspDidFreezeCurrentState = false
              DcmDspDidResetToDefault = false
              DcmDspDidReturnControlToEcu = true
              DcmDspDidShortTermAdjustment = true
              DcmDspDidControlSessionRef = NexteerSession
            DcmDspDidRead: DcmDspDidReadSessionRef=NexteerSession
        NexteerDidRangeFD43toFEFF (DcmDspDidRange):
          DcmDspDidRangeHasGaps = false
          DcmDspDidRangeIdentifierLowerLimit = 64835
          DcmDspDidRangeIdentifierUpperLimit = 65279
          DcmDspDidRangeMaxDataLength = 1024
          DcmDspDidRangeUsePort = true
          DcmDspDidRangeInfoRef = DidInfo_NexteerDids_ReadWrite
        IoControl_Nexteer_FD40_Manual_Torque_Command (DcmDspDid):
          DcmDspDidIdentifier = 64832
          DcmDspDidUsed = true
          DcmDspDidUsePort = USE_DATA_ELEMENT_SPECIFIC_INTERFACES
          DcmDspDidInfoRef = DidInfo_NexteerDids_IoControl
          DcmDspDidSignal: DcmDspDidDataPos=0, DcmDspDidDataRef=Data_Nexteer_IoControl_FD40_Manual_Torque_Command
        Data_Nexteer_IoControl_FD40_Manual_Torque_Command (DcmDspData):
          DcmDspDataSize = 32
          DcmDspDataUsePort = USE_DATA_ASYNCH_CLIENT_SERVER
          DcmDspDataType = UINT8
          DcmDspDataConditionCheckReadFncUsed = false
          DcmDspDataInfoRef = DataInfo_IoControl_Nexteer
        DataInfo_IoControl_Nexteer (DcmDspDataInfo): DcmDspDataFixedLength=false
        3 x DcmDspRoutine, all with DcmDspRoutineUsePort=true, DcmDspRoutineUsed=true, DcmDspStopRoutineSupported=false, DcmDspRoutineInfoRef=Nexteer_CommonRoutine_0Strt0Stop1Sts:
          RTN_Nexteer_FD70_Clear_Nexteer_Trouble_Codes: DcmDspRequestResultsRoutineSupported=false, DcmDspRoutineIdentifier=64880
          RTN_Nexteer_FDF0_Current_Gain_Auto_Trim: DcmDspRequestResultsRoutineSupported=true, DcmDspRoutineIdentifier=65008
          RTN_Nexteer_FDF1_Current_Offset_Auto_Trim: DcmDspRequestResultsRoutineSupported=true, DcmDspRoutineIdentifier=65009
        Nexteer_CommonRoutine_0Strt0Stop1Sts (DcmDspRoutineInfo)
          DcmDspRoutineAuthorization: DcmDspRoutineSessionRef=NexteerSession
          DcmDspRoutineRequestResOut
            Data (DcmDspRoutineRequestResOutSignal): DcmDspRoutineSignalLength=8, DcmDspRoutineSignalPos=0, DcmDspRoutineSignalType=UINT8
        9 x DcmDspRoutine, all with DcmDspRoutineUsePort=true, DcmDspRoutineUsed=true, DcmDspRoutineInfoRef=Nexteer_CommonRoutine_0Strt0Stop1Sts:
          RTN_Nexteer_F100_Request_System_State_Enable: DcmDspRequestResultsRoutineSupported=true, DcmDspRoutineIdentifier=61696, DcmDspStopRoutineSupported=true
          RTN_Nexteer_F151_Defeat_Loss_of_Assist_Scale: DcmDspRequestResultsRoutineSupported=true, DcmDspRoutineIdentifier=61777, DcmDspStopRoutineSupported=true
          RTN_Nexteer_FDC2_Software_Based_Motor_Calibration: DcmDspRequestResultsRoutineSupported=true, DcmDspRoutineIdentifier=64962, DcmDspStopRoutineSupported=true
          RTN_Nexteer_FD81_Handwheel_Angle_1_Auto_Trim: DcmDspRequestResultsRoutineSupported=false, DcmDspRoutineIdentifier=64897, DcmDspStopRoutineSupported=false
          RTN_Nexteer_FD85_Handwheel_Angle_1_Clear_Trim: DcmDspRequestResultsRoutineSupported=false, DcmDspRoutineIdentifier=64901, DcmDspStopRoutineSupported=false
          RTN_Nexteer_FDA0_Handwheel_Torque_Sensor_0_Auto_Trim: DcmDspRequestResultsRoutineSupported=false, DcmDspRoutineIdentifier=64928, DcmDspStopRoutineSupported=false
          RTN_Nexteer_FDA1_Handwheel_Torque_Sensor_1_Auto_Trim: DcmDspRequestResultsRoutineSupported=false, DcmDspRoutineIdentifier=64929, DcmDspStopRoutineSupported=false
          RTN_Nexteer_FDA8_Handwheel_Torque_Sensor_0_Clear_Trim: DcmDspRequestResultsRoutineSupported=false, DcmDspRoutineIdentifier=64936, DcmDspStopRoutineSupported=false
          RTN_Nexteer_FDA9_Handwheel_Torque_Sensor_1_Clear_Trim: DcmDspRequestResultsRoutineSupported=false, DcmDspRoutineIdentifier=64937, DcmDspStopRoutineSupported=false
        Nexteer_F200_Micro_Diagnostic_Fault_Injection (DcmDspRoutineInfo)
          DcmDspRoutineAuthorization: DcmDspRoutineSessionRef=NexteerSession
          DcmDspStartRoutineIn
            Data (DcmDspStartRoutineInSignal): DcmDspRoutineSignalLength=32, DcmDspRoutineSignalPos=0, DcmDspRoutineSignalType=UINT8
        RTN_Nexteer_FE20_Motor_Velocity_Control (DcmDspRoutine):
          DcmDspRequestResultsRoutineSupported = false
          DcmDspRoutineIdentifier = 65056
          DcmDspRoutineUsePort = true
          DcmDspRoutineUsed = true
          DcmDspStopRoutineSupported = true
          DcmDspRoutineInfoRef = Nexteer_FE20_Motor_Velocity_Control
        IoControl_Nexteer_FD41_Assist_Linear_Gain (DcmDspDid):
          DcmDspDidIdentifier = 64833
          DcmDspDidUsed = true
          DcmDspDidUsePort = USE_DATA_ELEMENT_SPECIFIC_INTERFACES
          DcmDspDidInfoRef = DidInfo_NexteerDids_IoControl
          DcmDspDidSignal: DcmDspDidDataPos=0, DcmDspDidDataRef=Data_Nexteer_IoControl_FD41_Assist_Linear_Gain
        Data_Nexteer_IoControl_FD41_Assist_Linear_Gain (DcmDspData):
          DcmDspDataSize = 32
          DcmDspDataUsePort = USE_DATA_ASYNCH_CLIENT_SERVER
          DcmDspDataType = UINT8
          DcmDspDataConditionCheckReadFncUsed = false
          DcmDspDataInfoRef = DataInfo_IoControl_Nexteer
        RTN_Nexteer_F119_Defeat_Duty_Cycle_Thermal_Protection (DcmDspRoutine):
          DcmDspRequestResultsRoutineSupported = true
          DcmDspRoutineIdentifier = 61721
          DcmDspRoutineUsePort = true
          DcmDspRoutineUsed = true
          DcmDspStopRoutineSupported = true
          DcmDspRoutineInfoRef = Nexteer_CommonRoutine_0Strt0Stop1Sts
        DataInfo_DID_F10A_ECU_Cal_Config_Part_Number (DcmDspDataInfo): DcmDspDataFixedLength=true
        DID_F10A_ECU_Cal_Config_Part_Number (DcmDspData):
          DcmDspDataSize = 192
          DcmDspDataType = UINT8
          DcmDspDataUsePort = USE_DATA_ASYNCH_CLIENT_SERVER
          DcmDspDataInfoRef = DataInfo_DID_F10A_ECU_Cal_Config_Part_Number
        DID_EE02_Assist_On_Off (DcmDspData): DcmDspDataSize=8, DcmDspDataType=UINT8, DcmDspDataUsePort=USE_DATA_ASYNCH_CLIENT_SERVER, DcmDspDataInfoRef=DataInfo_DID_EE02_Assist_On_Off
        Did_DID_DE00_VehicleData (DcmDspDid):
          DcmDspDidIdentifier = 56832
          DcmDspDidUsed = true
          DcmDspDidUsePort = USE_DATA_ELEMENT_SPECIFIC_INTERFACES
          DcmDspDidInfoRef = DidInfo_DID_DE00_VehicleData
          DcmDspDidSignal: DcmDspDidDataPos=0, DcmDspDidDataRef=DID_DE00_VehicleData
        DID_F188_Vehicle_Manufacturer_ECU_Software_Number (DcmDspData):
          DcmDspDataSize = 192
          DcmDspDataType = UINT8
          DcmDspDataUsePort = USE_DATA_ASYNCH_CLIENT_SERVER
          DcmDspDataInfoRef = DataInfo_DID_F188_Vehicle_Manufacturer_ECU_Software_Number
        DataInfo_DID_F124_ECU_Calibration_Data_1_Number (DcmDspDataInfo): DcmDspDataFixedLength=true
        DID_3003_Gear_Hardware_Part_Number (DcmDspData):
          DcmDspDataSize = 192
          DcmDspDataType = UINT8
          DcmDspDataUsePort = USE_DATA_ASYNCH_CLIENT_SERVER
          DcmDspDataInfoRef = DataInfo_DID_3003_Gear_Hardware_Part_Number
        3 x DcmDspDataInfo, all with DcmDspDataFixedLength=true:
          DataInfo_DID_DE01_FIHSwFeatureConfig
          DataInfo_DID_DE02_FeatureConfig
          DataInfo_DID_EE01_XCP_Enable_Disable
        DidInfo_DID_F188_Vehicle_Manufacturer_ECU_Software_Number (DcmDspDidInfo)
          DcmDspDidAccess
            DcmDspDidRead: DcmDspDidReadSessionRef=DcmDspSession/Default, DcmDspDidReadSessionRef=ExtendedDiagnostic, DcmDspDidReadSessionRef=NexteerSession
        DID_EE01_XCP_Enable_Disable (DcmDspData): DcmDspDataSize=8, DcmDspDataType=UINT8, DcmDspDataUsePort=USE_DATA_ASYNCH_CLIENT_SERVER, DcmDspDataInfoRef=DataInfo_DID_EE01_XCP_Enable_Disable
        DataInfo_DID_EE02_Assist_On_Off (DcmDspDataInfo): DcmDspDataFixedLength=true
        3 x DcmDspDidInfo:
          DidInfo_DID_DE00_VehicleData
            DcmDspDidAccess
              DcmDspDidWrite: DcmDspDidWriteSessionRef=ExtendedDiagnostic, DcmDspDidWriteSessionRef=NexteerSession
              DcmDspDidRead: DcmDspDidReadSessionRef=DcmDspSession/Default, DcmDspDidReadSessionRef=ExtendedDiagnostic, DcmDspDidReadSessionRef=NexteerSession
          DidInfo_DID_EE02_Assist_On_Off
            DcmDspDidAccess
              DcmDspDidWrite: DcmDspDidWriteSessionRef=ExtendedDiagnostic, DcmDspDidWriteSessionRef=NexteerSession
              DcmDspDidRead: DcmDspDidReadSessionRef=DcmDspSession/Default, DcmDspDidReadSessionRef=ExtendedDiagnostic, DcmDspDidReadSessionRef=NexteerSession
          DidInfo_DID_F10A_ECU_Cal_Config_Part_Number
            DcmDspDidAccess
              DcmDspDidRead: DcmDspDidReadSessionRef=DcmDspSession/Default, DcmDspDidReadSessionRef=ExtendedDiagnostic, DcmDspDidReadSessionRef=NexteerSession
        3 x DcmDspDid, all with DcmDspDidUsed=true, DcmDspDidUsePort=USE_DATA_ELEMENT_SPECIFIC_INTERFACES:
          Did_DID_F124_ECU_Calibration_Data_1_Number: DcmDspDidIdentifier=61732, DcmDspDidInfoRef=DidInfo_DID_F124_ECU_Calibration_Data_1_Number
            DcmDspDidSignal: DcmDspDidDataPos=0, DcmDspDidDataRef=DID_F124_ECU_Calibration_Data_1_Number
          Did_DID_DE02_FeatureConfig: DcmDspDidIdentifier=56834, DcmDspDidInfoRef=DidInfo_DID_DE02_FeatureConfig
            DcmDspDidSignal: DcmDspDidDataPos=0, DcmDspDidDataRef=DID_DE02_FeatureConfig
          Did_DID_DE01_FIHSwFeatureConfig: DcmDspDidIdentifier=56833, DcmDspDidInfoRef=DidInfo_DID_DE01_FIHSwFeatureConfig
            DcmDspDidSignal: DcmDspDidDataPos=0, DcmDspDidDataRef=DID_DE01_FIHSwFeatureConfig
        DidInfo_DID_3003_Gear_Hardware_Part_Number (DcmDspDidInfo)
          DcmDspDidAccess
            DcmDspDidRead: DcmDspDidReadSessionRef=DcmDspSession/Default, DcmDspDidReadSessionRef=ExtendedDiagnostic, DcmDspDidReadSessionRef=NexteerSession
            DcmDspDidWrite: DcmDspDidWriteSessionRef=DcmDspSession/Programming, DcmDspDidWriteSessionRef=NexteerSession
        Did_DID_DE03_Enable_DisableDTCs (DcmDspDid):
          DcmDspDidIdentifier = 56835
          DcmDspDidUsed = true
          DcmDspDidUsePort = USE_DATA_ELEMENT_SPECIFIC_INTERFACES
          DcmDspDidInfoRef = DidInfo_DID_DE03_Enable_DisableDTCs
          DcmDspDidSignal: DcmDspDidDataPos=0, DcmDspDidDataRef=DID_DE03_Enable_DisableDTCs
        Did_DID_EE01_XCP_Enable_Disable (DcmDspDid):
          DcmDspDidIdentifier = 60929
          DcmDspDidUsed = true
          DcmDspDidUsePort = USE_DATA_ELEMENT_SPECIFIC_INTERFACES
          DcmDspDidInfoRef = DidInfo_DID_EE01_XCP_Enable_Disable
          DcmDspDidSignal: DcmDspDidDataPos=0, DcmDspDidDataRef=DID_EE01_XCP_Enable_Disable
        DidInfo_DID_EE01_XCP_Enable_Disable (DcmDspDidInfo)
          DcmDspDidAccess
            DcmDspDidWrite: DcmDspDidWriteSessionRef=ExtendedDiagnostic, DcmDspDidWriteSessionRef=NexteerSession
            DcmDspDidRead: DcmDspDidReadSessionRef=DcmDspSession/Default, DcmDspDidReadSessionRef=ExtendedDiagnostic, DcmDspDidReadSessionRef=NexteerSession
        DataInfo_DID_DE00_VehicleData (DcmDspDataInfo): DcmDspDataFixedLength=true
        DID_DE01_FIHSwFeatureConfig (DcmDspData): DcmDspDataSize=192, DcmDspDataType=UINT8, DcmDspDataUsePort=USE_DATA_ASYNCH_CLIENT_SERVER, DcmDspDataInfoRef=DataInfo_DID_DE01_FIHSwFeatureConfig
        DataInfo_DID_3003_Gear_Hardware_Part_Number (DcmDspDataInfo): DcmDspDataFixedLength=true
        Did_DID_F10A_ECU_Cal_Config_Part_Number (DcmDspDid):
          DcmDspDidIdentifier = 61706
          DcmDspDidUsed = true
          DcmDspDidUsePort = USE_DATA_ELEMENT_SPECIFIC_INTERFACES
          DcmDspDidInfoRef = DidInfo_DID_F10A_ECU_Cal_Config_Part_Number
          DcmDspDidSignal: DcmDspDidDataPos=0, DcmDspDidDataRef=DID_F10A_ECU_Cal_Config_Part_Number
        DataInfo_DID_F113_ECU_Delivery_Assembly_Number (DcmDspDataInfo): DcmDspDataFixedLength=true
        Did_DID_EE02_Assist_On_Off (DcmDspDid):
          DcmDspDidIdentifier = 60930
          DcmDspDidUsed = true
          DcmDspDidUsePort = USE_DATA_ELEMENT_SPECIFIC_INTERFACES
          DcmDspDidInfoRef = DidInfo_DID_EE02_Assist_On_Off
          DcmDspDidSignal: DcmDspDidDataPos=0, DcmDspDidDataRef=DID_EE02_Assist_On_Off
        DidInfo_DID_F124_ECU_Calibration_Data_1_Number (DcmDspDidInfo)
          DcmDspDidAccess
            DcmDspDidRead: DcmDspDidReadSessionRef=DcmDspSession/Default, DcmDspDidReadSessionRef=ExtendedDiagnostic, DcmDspDidReadSessionRef=NexteerSession
        DID_DE02_FeatureConfig (DcmDspData): DcmDspDataSize=192, DcmDspDataType=UINT8, DcmDspDataUsePort=USE_DATA_ASYNCH_CLIENT_SERVER, DcmDspDataInfoRef=DataInfo_DID_DE02_FeatureConfig
        Did_DID_F188_Vehicle_Manufacturer_ECU_Software_Number (DcmDspDid):
          DcmDspDidIdentifier = 61832
          DcmDspDidUsed = true
          DcmDspDidUsePort = USE_DATA_ELEMENT_SPECIFIC_INTERFACES
          DcmDspDidInfoRef = DidInfo_DID_F188_Vehicle_Manufacturer_ECU_Software_Number
          DcmDspDidSignal: DcmDspDidDataPos=0, DcmDspDidDataRef=DID_F188_Vehicle_Manufacturer_ECU_Software_Number
        DidInfo_DID_DE01_FIHSwFeatureConfig (DcmDspDidInfo)
          DcmDspDidAccess
            DcmDspDidWrite: DcmDspDidWriteSessionRef=ExtendedDiagnostic, DcmDspDidWriteSessionRef=NexteerSession
            DcmDspDidRead: DcmDspDidReadSessionRef=DcmDspSession/Default, DcmDspDidReadSessionRef=ExtendedDiagnostic, DcmDspDidReadSessionRef=NexteerSession
        DID_F111_ECU_Core_Assembly_Number (DcmDspData):
          DcmDspDataSize = 192
          DcmDspDataType = UINT8
          DcmDspDataUsePort = USE_DATA_ASYNCH_CLIENT_SERVER
          DcmDspDataInfoRef = DataInfo_DID_F111_ECU_Core_Assembly_Number
        DataInfo_DID_DE03_Enable_DisableDTCs (DcmDspDataInfo): DcmDspDataFixedLength=true
        DID_F113_ECU_Delivery_Assembly_Number (DcmDspData):
          DcmDspDataSize = 192
          DcmDspDataType = UINT8
          DcmDspDataUsePort = USE_DATA_ASYNCH_CLIENT_SERVER
          DcmDspDataInfoRef = DataInfo_DID_F113_ECU_Delivery_Assembly_Number
        DataInfo_DID_F188_Vehicle_Manufacturer_ECU_Software_Number (DcmDspDataInfo): DcmDspDataFixedLength=true
        3 x DcmDspData, all with DcmDspDataType=UINT8, DcmDspDataUsePort=USE_DATA_ASYNCH_CLIENT_SERVER:
          DID_DE03_Enable_DisableDTCs: DcmDspDataSize=512, DcmDspDataInfoRef=DataInfo_DID_DE03_Enable_DisableDTCs
          DID_DE00_VehicleData: DcmDspDataSize=192, DcmDspDataInfoRef=DataInfo_DID_DE00_VehicleData
          DID_F124_ECU_Calibration_Data_1_Number: DcmDspDataSize=192, DcmDspDataInfoRef=DataInfo_DID_F124_ECU_Calibration_Data_1_Number
        DidInfo_DID_DE03_Enable_DisableDTCs (DcmDspDidInfo)
          DcmDspDidAccess
            DcmDspDidWrite: DcmDspDidWriteSessionRef=ExtendedDiagnostic, DcmDspDidWriteSessionRef=NexteerSession
            DcmDspDidRead: DcmDspDidReadSessionRef=DcmDspSession/Default, DcmDspDidReadSessionRef=ExtendedDiagnostic, DcmDspDidReadSessionRef=NexteerSession
        DidInfo_DID_DE02_FeatureConfig (DcmDspDidInfo)
          DcmDspDidAccess
            DcmDspDidWrite: DcmDspDidWriteSessionRef=ExtendedDiagnostic, DcmDspDidWriteSessionRef=NexteerSession
            DcmDspDidRead: DcmDspDidReadSessionRef=DcmDspSession/Default, DcmDspDidReadSessionRef=ExtendedDiagnostic, DcmDspDidReadSessionRef=NexteerSession
        DataInfo_DID_F111_ECU_Core_Assembly_Number (DcmDspDataInfo): DcmDspDataFixedLength=true
        Did_DID_3003_Gear_Hardware_Part_Number (DcmDspDid):
          DcmDspDidIdentifier = 12291
          DcmDspDidUsed = true
          DcmDspDidUsePort = USE_DATA_ELEMENT_SPECIFIC_INTERFACES
          DcmDspDidInfoRef = DidInfo_DID_3003_Gear_Hardware_Part_Number
          DcmDspDidSignal: DcmDspDidDataPos=0, DcmDspDidDataRef=DID_3003_Gear_Hardware_Part_Number
        DID_DE04_PDCResetValue (DcmDspData): DcmDspDataSize=16, DcmDspDataType=UINT8, DcmDspDataUsePort=USE_DATA_ASYNCH_CLIENT_SERVER, DcmDspDataInfoRef=DataInfo_DID_DE04_PDCResetValue
        DidInfo_DID_DE04_PDCResetValue (DcmDspDidInfo)
          DcmDspDidAccess
            DcmDspDidWrite: DcmDspDidWriteSessionRef=ExtendedDiagnostic, DcmDspDidWriteSessionRef=NexteerSession
            DcmDspDidRead: DcmDspDidReadSessionRef=DcmDspSession/Default, DcmDspDidReadSessionRef=ExtendedDiagnostic, DcmDspDidReadSessionRef=NexteerSession
        Did_DID_DE04_PDCResetValue (DcmDspDid):
          DcmDspDidIdentifier = 56836
          DcmDspDidUsed = true
          DcmDspDidUsePort = USE_DATA_ELEMENT_SPECIFIC_INTERFACES
          DcmDspDidInfoRef = DidInfo_DID_DE04_PDCResetValue
          DcmDspDidSignal: DcmDspDidDataPos=0, DcmDspDidDataRef=DID_DE04_PDCResetValue
        DataInfo_DID_DE04_PDCResetValue (DcmDspDataInfo): DcmDspDataFixedLength=true
        4 x DcmDspRoutine, all with DcmDspRequestResultsRoutineSupported=false, DcmDspRoutineUsePort=true, DcmDspRoutineUsed=true, DcmDspStopRoutineSupported=false, DcmDspRoutineInfoRef=Nexteer_CommonRoutine_0Strt0Stop1Sts:
          RTN_Nexteer_FDA2_Handwheel_Torque_Sensor_2_Auto_Trim: DcmDspRoutineIdentifier=64930
          RTN_Nexteer_FDA3_Handwheel_Torque_Sensor_3_Auto_Trim: DcmDspRoutineIdentifier=64931
          RTN_Nexteer_FDAA_Handwheel_Torque_Sensor_2_Clear_Trim: DcmDspRoutineIdentifier=64938
          RTN_Nexteer_FDAB_Handwheel_Torque_Sensor_3_Clear_Trim: DcmDspRoutineIdentifier=64939
        DidInfo_DID_D100_Active_Diagnostic_Session (DcmDspDidInfo)
          DcmDspDidAccess
            DcmDspDidRead
        DID_D100_Active_Diagnostic_Session (DcmDspData):
          DcmDspDataSize = 8
          DcmDspDataType = UINT8
          DcmDspDataUsePort = USE_DATA_ASYNCH_CLIENT_SERVER
          DcmDspDataInfoRef = DataInfo_DID_D100_Active_Diagnostic_Session
        DataInfo_DID_D100_Active_Diagnostic_Session (DcmDspDataInfo): DcmDspDataFixedLength=true
        Did_DID_D100_Active_Diagnostic_Session (DcmDspDid):
          DcmDspDidIdentifier = 53504
          DcmDspDidUsed = true
          DcmDspDidUsePort = USE_DATA_ELEMENT_SPECIFIC_INTERFACES
          DcmDspDidInfoRef = DidInfo_DID_D100_Active_Diagnostic_Session
          DcmDspDidSignal: DcmDspDidDataPos=0, DcmDspDidDataRef=DID_D100_Active_Diagnostic_Session
        DID_EED0_SupplierFactoryMode (DcmDspData): DcmDspDataSize=8, DcmDspDataType=UINT8, DcmDspDataUsePort=USE_DATA_ASYNCH_CLIENT_SERVER, DcmDspDataInfoRef=DataInfo_DID_EED0_SupplierFactoryMode
        Did_DID_EE40_ResearchMessConfig (DcmDspDid):
          DcmDspDidIdentifier = 60992
          DcmDspDidUsed = true
          DcmDspDidUsePort = USE_DATA_ELEMENT_SPECIFIC_INTERFACES
          DcmDspDidInfoRef = DidInfo_DID_EE40_ResearchMessConfig
          DcmDspDidSignal: DcmDspDidDataPos=0, DcmDspDidDataRef=DID_EE40_ResearchMessConfig
        Did_DID_F163_Diagnostic_Specification_Version (DcmDspDid):
          DcmDspDidIdentifier = 61795
          DcmDspDidUsed = true
          DcmDspDidUsePort = USE_DATA_ELEMENT_SPECIFIC_INTERFACES
          DcmDspDidInfoRef = DidInfo_DID_F163_Diagnostic_Specification_Version
          DcmDspDidSignal: DcmDspDidDataPos=0, DcmDspDidDataRef=DID_F163_Diagnostic_Specification_Version
        DidInfo_DID_630F_Multiple_VIN_Storage_Original_VIN (DcmDspDidInfo)
          DcmDspDidAccess
            DcmDspDidRead: DcmDspDidReadSessionRef=DcmDspSession/Default, DcmDspDidReadSessionRef=ExtendedDiagnostic, DcmDspDidReadSessionRef=NexteerSession
        DidInfo_DID_D117_ECU_Internal_Temperature (DcmDspDidInfo)
          DcmDspDidAccess
            DcmDspDidRead: DcmDspDidReadSessionRef=DcmDspSession/Default, DcmDspDidReadSessionRef=ExtendedDiagnostic, DcmDspDidReadSessionRef=NexteerSession
        DID_EE03_IgnCycleCounter (DcmDspData): DcmDspDataSize=16, DcmDspDataType=UINT8, DcmDspDataUsePort=USE_DATA_ASYNCH_CLIENT_SERVER, DcmDspDataInfoRef=DataInfo_DID_EE03_IgnCycleCounter
        DID_EE21_CurrentLvlCounter (DcmDspData): DcmDspDataSize=160, DcmDspDataType=UINT8, DcmDspDataUsePort=USE_DATA_ASYNCH_CLIENT_SERVER, DcmDspDataInfoRef=DataInfo_DID_EE21_CurrentLvlCounter
        DataInfo_DID_301F_Steering_Pinion_Rotation_Speed (DcmDspDataInfo): DcmDspDataFixedLength=true
        DidInfo_DID_DD00_Global_Real_Time (DcmDspDidInfo)
          DcmDspDidAccess
            DcmDspDidRead: DcmDspDidReadSessionRef=DcmDspSession/Default, DcmDspDidReadSessionRef=ExtendedDiagnostic, DcmDspDidReadSessionRef=NexteerSession
        DidInfo_DID_330C_Steering_Shaft_Torque_Sensor_2 (DcmDspDidInfo)
          DcmDspDidAccess
            DcmDspDidRead: DcmDspDidReadSessionRef=DcmDspSession/Default, DcmDspDidReadSessionRef=ExtendedDiagnostic, DcmDspDidReadSessionRef=NexteerSession
        DataInfo_DID_3B4B_Steering_wheel_angle_alignment_offset (DcmDspDataInfo): DcmDspDataFixedLength=true
        DID_EE04_IgnOnTime (DcmDspData): DcmDspDataSize=16, DcmDspDataType=UINT8, DcmDspDataUsePort=USE_DATA_ASYNCH_CLIENT_SERVER, DcmDspDataInfoRef=DataInfo_DID_EE04_IgnOnTime
        DID_EE84_FIHSwReserved3 (DcmDspData): DcmDspDataSize=32, DcmDspDataType=UINT8, DcmDspDataUsePort=USE_DATA_ASYNCH_CLIENT_SERVER, DcmDspDataInfoRef=DataInfo_DID_EE84_FIHSwReserved3
        Did_DID_EED1_SupplierInternalFaultCode (DcmDspDid):
          DcmDspDidIdentifier = 61137
          DcmDspDidUsed = true
          DcmDspDidUsePort = USE_DATA_ELEMENT_SPECIFIC_INTERFACES
          DcmDspDidInfoRef = DidInfo_DID_EED1_SupplierInternalFaultCode
          DcmDspDidSignal: DcmDspDidDataPos=0, DcmDspDidDataRef=DID_EED1_SupplierInternalFaultCode
        DataInfo_DID_EE05_FinalMotTq (DcmDspDataInfo): DcmDspDataFixedLength=true
        Did_DID_EE86_FIHSwReserved5 (DcmDspDid):
          DcmDspDidIdentifier = 61062
          DcmDspDidUsed = true
          DcmDspDidUsePort = USE_DATA_ELEMENT_SPECIFIC_INTERFACES
          DcmDspDidInfoRef = DidInfo_DID_EE86_FIHSwReserved5
          DcmDspDidSignal: DcmDspDidDataPos=0, DcmDspDidDataRef=DID_EE86_FIHSwReserved5
        Did_DID_F166_NOS_Message_Database_1_Version_Number (DcmDspDid):
          DcmDspDidIdentifier = 61798
          DcmDspDidUsed = true
          DcmDspDidUsePort = USE_DATA_ELEMENT_SPECIFIC_INTERFACES
          DcmDspDidInfoRef = DidInfo_DID_F166_NOS_Message_Database_1_Version_Number
          DcmDspDidSignal: DcmDspDidDataPos=0, DcmDspDidDataRef=DID_F166_NOS_Message_Database_1_Version_Number
        DidInfo_DID_EE88_FIHSwReserved7 (DcmDspDidInfo)
          DcmDspDidAccess
            DcmDspDidWrite: DcmDspDidWriteSessionRef=ExtendedDiagnostic, DcmDspDidWriteSessionRef=NexteerSession
            DcmDspDidRead: DcmDspDidReadSessionRef=DcmDspSession/Default, DcmDspDidReadSessionRef=ExtendedDiagnostic, DcmDspDidReadSessionRef=NexteerSession
        DidInfo_DID_EE40_ResearchMessConfig (DcmDspDidInfo)
          DcmDspDidAccess
            DcmDspDidWrite: DcmDspDidWriteSessionRef=ExtendedDiagnostic, DcmDspDidWriteSessionRef=NexteerSession
            DcmDspDidRead: DcmDspDidReadSessionRef=DcmDspSession/Default, DcmDspDidReadSessionRef=ExtendedDiagnostic, DcmDspDidReadSessionRef=NexteerSession
        DID_EE41_ResearchFeatureSwitch (DcmDspData): DcmDspDataSize=8, DcmDspDataType=UINT8, DcmDspDataUsePort=USE_DATA_ASYNCH_CLIENT_SERVER, DcmDspDataInfoRef=DataInfo_DID_EE41_ResearchFeatureSwitch
        DID_D111_ECU_Power_Supply_Voltage (DcmDspData):
          DcmDspDataSize = 8
          DcmDspDataType = UINT8
          DcmDspDataUsePort = USE_DATA_ASYNCH_CLIENT_SERVER
          DcmDspDataInfoRef = DataInfo_DID_D111_ECU_Power_Supply_Voltage
        Did_DID_3B4B_Steering_wheel_angle_alignment_offset (DcmDspDid):
          DcmDspDidIdentifier = 15179
          DcmDspDidUsed = true
          DcmDspDidUsePort = USE_DATA_ELEMENT_SPECIFIC_INTERFACES
          DcmDspDidInfoRef = DidInfo_DID_3B4B_Steering_wheel_angle_alignment_offset
          DcmDspDidSignal: DcmDspDidDataPos=0, DcmDspDidDataRef=DID_3B4B_Steering_wheel_angle_alignment_offset
        DidInfo_DID_205B_Brake_Pull_Reduction_Activation_Counter (DcmDspDidInfo)
          DcmDspDidAccess
            DcmDspDidWrite: DcmDspDidWriteSessionRef=DcmDspSession/Programming, DcmDspDidWriteSessionRef=ExtendedDiagnostic, DcmDspDidWriteSessionRef=NexteerSession
            DcmDspDidRead: DcmDspDidReadSessionRef=DcmDspSession/Default, DcmDspDidReadSessionRef=ExtendedDiagnostic, DcmDspDidReadSessionRef=NexteerSession
        DidInfo_DID_EE42_ActiveFeatures (DcmDspDidInfo)
          DcmDspDidAccess
            DcmDspDidRead: DcmDspDidReadSessionRef=DcmDspSession/Default, DcmDspDidReadSessionRef=ExtendedDiagnostic, DcmDspDidReadSessionRef=NexteerSession
        DataInfo_DID_D111_ECU_Power_Supply_Voltage (DcmDspDataInfo): DcmDspDataFixedLength=true
        DID_EE80_FIHSwVer (DcmDspData): DcmDspDataSize=8, DcmDspDataType=UINT8, DcmDspDataUsePort=USE_DATA_ASYNCH_CLIENT_SERVER, DcmDspDataInfoRef=DataInfo_DID_EE80_FIHSwVer
        Did_DID_EE05_FinalMotTq (DcmDspDid): DcmDspDidIdentifier=60933, DcmDspDidUsed=true, DcmDspDidUsePort=USE_DATA_ELEMENT_SPECIFIC_INTERFACES, DcmDspDidInfoRef=DidInfo_DID_EE05_FinalMotTq
          DcmDspDidSignal: DcmDspDidDataPos=0, DcmDspDidDataRef=DID_EE05_FinalMotTq
        DID_330C_Steering_Shaft_Torque_Sensor_2 (DcmDspData):
          DcmDspDataSize = 8
          DcmDspDataType = UINT8
          DcmDspDataUsePort = USE_DATA_ASYNCH_CLIENT_SERVER
          DcmDspDataInfoRef = DataInfo_DID_330C_Steering_Shaft_Torque_Sensor_2
        DidInfo_DID_EE06_VINChanged (DcmDspDidInfo)
          DcmDspDidAccess
            DcmDspDidRead: DcmDspDidReadSessionRef=DcmDspSession/Default, DcmDspDidReadSessionRef=ExtendedDiagnostic, DcmDspDidReadSessionRef=NexteerSession
        Did_DID_D111_ECU_Power_Supply_Voltage (DcmDspDid):
          DcmDspDidIdentifier = 53521
          DcmDspDidUsed = true
          DcmDspDidUsePort = USE_DATA_ELEMENT_SPECIFIC_INTERFACES
          DcmDspDidInfoRef = DidInfo_DID_D111_ECU_Power_Supply_Voltage
          DcmDspDidSignal: DcmDspDidDataPos=0, DcmDspDidDataRef=DID_D111_ECU_Power_Supply_Voltage
        Did_DID_DD01_Total_Distance (DcmDspDid):
          DcmDspDidIdentifier = 56577
          DcmDspDidUsed = true
          DcmDspDidUsePort = USE_DATA_ELEMENT_SPECIFIC_INTERFACES
          DcmDspDidInfoRef = DidInfo_DID_DD01_Total_Distance
          DcmDspDidSignal: DcmDspDidDataPos=0, DcmDspDidDataRef=DID_DD01_Total_Distance
        DidInfo_DID_EE87_FIHSwReserved6 (DcmDspDidInfo)
          DcmDspDidAccess
            DcmDspDidWrite: DcmDspDidWriteSessionRef=ExtendedDiagnostic, DcmDspDidWriteSessionRef=NexteerSession
            DcmDspDidRead: DcmDspDidReadSessionRef=DcmDspSession/Default, DcmDspDidReadSessionRef=ExtendedDiagnostic, DcmDspDidReadSessionRef=NexteerSession
        DidInfo_DID_EE82_FIHSwReserved1 (DcmDspDidInfo)
          DcmDspDidAccess
            DcmDspDidWrite: DcmDspDidWriteSessionRef=ExtendedDiagnostic, DcmDspDidWriteSessionRef=NexteerSession
            DcmDspDidRead: DcmDspDidReadSessionRef=DcmDspSession/Default, DcmDspDidReadSessionRef=ExtendedDiagnostic, DcmDspDidReadSessionRef=NexteerSession
        3 x DcmDspDid, all with DcmDspDidUsed=true, DcmDspDidUsePort=USE_DATA_ELEMENT_SPECIFIC_INTERFACES:
          Did_DID_330C_Steering_Shaft_Torque_Sensor_2: DcmDspDidIdentifier=13068, DcmDspDidInfoRef=DidInfo_DID_330C_Steering_Shaft_Torque_Sensor_2
            DcmDspDidSignal: DcmDspDidDataPos=0, DcmDspDidDataRef=DID_330C_Steering_Shaft_Torque_Sensor_2
          Did_DID_205B_Brake_Pull_Reduction_Activation_Counter: DcmDspDidIdentifier=8283, DcmDspDidInfoRef=DidInfo_DID_205B_Brake_Pull_Reduction_Activation_Counter
            DcmDspDidSignal: DcmDspDidDataPos=0, DcmDspDidDataRef=DID_205B_Brake_Pull_Reduction_Activation_Counter
          Did_DID_EE80_FIHSwVer: DcmDspDidIdentifier=61056, DcmDspDidInfoRef=DidInfo_DID_EE80_FIHSwVer
            DcmDspDidSignal: DcmDspDidDataPos=0, DcmDspDidDataRef=DID_EE80_FIHSwVer
        DidInfo_DID_F18C_ECU_Serial_Number (DcmDspDidInfo)
          DcmDspDidAccess
            DcmDspDidWrite: DcmDspDidWriteSessionRef=NexteerSession
            DcmDspDidRead
        DataInfo_DID_3020_Steering_Pinion_Angle (DcmDspDataInfo): DcmDspDataFixedLength=true
        DID_EE83_FIHSwReserved2 (DcmDspData): DcmDspDataSize=32, DcmDspDataType=UINT8, DcmDspDataUsePort=USE_DATA_ASYNCH_CLIENT_SERVER, DcmDspDataInfoRef=DataInfo_DID_EE83_FIHSwReserved2
        DataInfo_DID_F166_NOS_Message_Database_1_Version_Number (DcmDspDataInfo): DcmDspDataFixedLength=true
        DidInfo_DID_F166_NOS_Message_Database_1_Version_Number (DcmDspDidInfo)
          DcmDspDidAccess
            DcmDspDidWrite: DcmDspDidWriteSessionRef=NexteerSession
            DcmDspDidRead: DcmDspDidReadSessionRef=DcmDspSession/Default, DcmDspDidReadSessionRef=ExtendedDiagnostic, DcmDspDidReadSessionRef=NexteerSession
        DataInfo_DID_EE41_ResearchFeatureSwitch (DcmDspDataInfo): DcmDspDataFixedLength=true
        DID_EE20_LoAFaultReporting (DcmDspData): DcmDspDataSize=192, DcmDspDataType=UINT8, DcmDspDataUsePort=USE_DATA_ASYNCH_CLIENT_SERVER, DcmDspDataInfoRef=DataInfo_DID_EE20_LoAFaultReporting
        DidInfo_DID_3020_Steering_Pinion_Angle (DcmDspDidInfo)
          DcmDspDidAccess
            DcmDspDidRead: DcmDspDidReadSessionRef=DcmDspSession/Default, DcmDspDidReadSessionRef=ExtendedDiagnostic, DcmDspDidReadSessionRef=NexteerSession
        DidInfo_DID_EE03_IgnCycleCounter (DcmDspDidInfo)
          DcmDspDidAccess
            DcmDspDidRead: DcmDspDidReadSessionRef=DcmDspSession/Default, DcmDspDidReadSessionRef=ExtendedDiagnostic, DcmDspDidReadSessionRef=NexteerSession
        DataInfo_DID_330C_Steering_Shaft_Torque_Sensor_2 (DcmDspDataInfo): DcmDspDataFixedLength=true
        DataInfo_DID_205B_Brake_Pull_Reduction_Activation_Counter (DcmDspDataInfo): DcmDspDataFixedLength=true
        Did_DID_F162_Software_Download_Specification_Version (DcmDspDid):
          DcmDspDidIdentifier = 61794
          DcmDspDidUsed = true
          DcmDspDidUsePort = USE_DATA_ELEMENT_SPECIFIC_INTERFACES
          DcmDspDidInfoRef = DidInfo_DID_F162_Software_Download_Specification_Version
          DcmDspDidSignal: DcmDspDidDataPos=0, DcmDspDidDataRef=DID_F162_Software_Download_Specification_Version
        DidInfo_DID_EE23_TempLvlCounters (DcmDspDidInfo)
          DcmDspDidAccess
            DcmDspDidRead: DcmDspDidReadSessionRef=DcmDspSession/Default, DcmDspDidReadSessionRef=ExtendedDiagnostic, DcmDspDidReadSessionRef=NexteerSession
        DataInfo_DID_EE80_FIHSwVer (DcmDspDataInfo): DcmDspDataFixedLength=true
        Did_DID_F180_Boot_Software_Identification (DcmDspDid):
          DcmDspDidIdentifier = 61824
          DcmDspDidUsed = true
          DcmDspDidUsePort = USE_DATA_ELEMENT_SPECIFIC_INTERFACES
          DcmDspDidInfoRef = DidInfo_DID_F180_Boot_Software_Identification
          DcmDspDidSignal: DcmDspDidDataPos=0, DcmDspDidDataRef=DID_F180_Boot_Software_Identification
        DataInfo_DID_EE84_FIHSwReserved3 (DcmDspDataInfo): DcmDspDataFixedLength=true
        DID_EE85_FIHSwReserved4 (DcmDspData): DcmDspDataSize=32, DcmDspDataType=UINT8, DcmDspDataUsePort=USE_DATA_ASYNCH_CLIENT_SERVER, DcmDspDataInfoRef=DataInfo_DID_EE85_FIHSwReserved4
        DidInfo_DID_EED1_SupplierInternalFaultCode (DcmDspDidInfo)
          DcmDspDidAccess
            DcmDspDidRead: DcmDspDidReadSessionRef=DcmDspSession/Default, DcmDspDidReadSessionRef=ExtendedDiagnostic, DcmDspDidReadSessionRef=NexteerSession
        DID_EE07_EPSSystemState (DcmDspData): DcmDspDataSize=8, DcmDspDataType=UINT8, DcmDspDataUsePort=USE_DATA_ASYNCH_CLIENT_SERVER, DcmDspDataInfoRef=DataInfo_DID_EE07_EPSSystemState
        DID_301A_Pull_Drift_Compensation_Value (DcmDspData):
          DcmDspDataSize = 16
          DcmDspDataType = UINT8
          DcmDspDataUsePort = USE_DATA_ASYNCH_CLIENT_SERVER
          DcmDspDataInfoRef = DataInfo_DID_301A_Pull_Drift_Compensation_Value
        DataInfo_DID_EE04_IgnOnTime (DcmDspDataInfo): DcmDspDataFixedLength=true
        DID_F162_Software_Download_Specification_Version (DcmDspData):
          DcmDspDataSize = 8
          DcmDspDataType = UINT8
          DcmDspDataUsePort = USE_DATA_ASYNCH_CLIENT_SERVER
          DcmDspDataInfoRef = DataInfo_DID_F162_Software_Download_Specification_Version
        DidInfo_DID_F162_Software_Download_Specification_Version (DcmDspDidInfo)
          DcmDspDidAccess
            DcmDspDidWrite: DcmDspDidWriteSessionRef=NexteerSession
            DcmDspDidRead
        DataInfo_DID_EE03_IgnCycleCounter (DcmDspDataInfo): DcmDspDataFixedLength=true
        Did_DID_D117_ECU_Internal_Temperature (DcmDspDid):
          DcmDspDidIdentifier = 53527
          DcmDspDidUsed = true
          DcmDspDidUsePort = USE_DATA_ELEMENT_SPECIFIC_INTERFACES
          DcmDspDidInfoRef = DidInfo_DID_D117_ECU_Internal_Temperature
          DcmDspDidSignal: DcmDspDidDataPos=0, DcmDspDidDataRef=DID_D117_ECU_Internal_Temperature
        Did_DID_205A_Torque_Steer_Compensation_Activation_Counter (DcmDspDid):
          DcmDspDidIdentifier = 8282
          DcmDspDidUsed = true
          DcmDspDidUsePort = USE_DATA_ELEMENT_SPECIFIC_INTERFACES
          DcmDspDidInfoRef = DidInfo_DID_205A_Torque_Steer_Compensation_Activation_Counter
          DcmDspDidSignal: DcmDspDidDataPos=0, DcmDspDidDataRef=DID_205A_Torque_Steer_Compensation_Activation_Counter
        DataInfo_DID_EE86_FIHSwReserved5 (DcmDspDataInfo): DcmDspDataFixedLength=true
        DataInfo_DID_630F_Multiple_VIN_Storage_Original_VIN (DcmDspDataInfo): DcmDspDataFixedLength=true
        DID_EE00_DevMessConfig (DcmDspData): DcmDspDataSize=24, DcmDspDataType=UINT8, DcmDspDataUsePort=USE_DATA_ASYNCH_CLIENT_SERVER, DcmDspDataInfoRef=DataInfo_DID_EE00_DevMessConfig
        DidInfo_DID_DD01_Total_Distance (DcmDspDidInfo)
          DcmDspDidAccess
            DcmDspDidRead: DcmDspDidReadSessionRef=DcmDspSession/Default, DcmDspDidReadSessionRef=ExtendedDiagnostic, DcmDspDidReadSessionRef=NexteerSession
        DataInfo_DID_F190_Vehicle_Identification_Number (DcmDspDataInfo): DcmDspDataFixedLength=true
        DataInfo_DID_301A_Pull_Drift_Compensation_Value (DcmDspDataInfo): DcmDspDataFixedLength=true
        DID_EE82_FIHSwReserved1 (DcmDspData): DcmDspDataSize=32, DcmDspDataType=UINT8, DcmDspDataUsePort=USE_DATA_ASYNCH_CLIENT_SERVER, DcmDspDataInfoRef=DataInfo_DID_EE82_FIHSwReserved1
        DidInfo_DID_3B4B_Steering_wheel_angle_alignment_offset (DcmDspDidInfo)
          DcmDspDidAccess
            DcmDspDidRead: DcmDspDidReadSessionRef=DcmDspSession/Default, DcmDspDidReadSessionRef=ExtendedDiagnostic, DcmDspDidReadSessionRef=NexteerSession
        Did_DID_EE87_FIHSwReserved6 (DcmDspDid):
          DcmDspDidIdentifier = 61063
          DcmDspDidUsed = true
          DcmDspDidUsePort = USE_DATA_ELEMENT_SPECIFIC_INTERFACES
          DcmDspDidInfoRef = DidInfo_DID_EE87_FIHSwReserved6
          DcmDspDidSignal: DcmDspDidDataPos=0, DcmDspDidDataRef=DID_EE87_FIHSwReserved6
        DataInfo_DID_F15F_NOS_Generation_Tool_Version_Number (DcmDspDataInfo): DcmDspDataFixedLength=true
        Did_DID_630F_Multiple_VIN_Storage_Original_VIN (DcmDspDid):
          DcmDspDidIdentifier = 25359
          DcmDspDidUsed = true
          DcmDspDidUsePort = USE_DATA_ELEMENT_SPECIFIC_INTERFACES
          DcmDspDidInfoRef = DidInfo_DID_630F_Multiple_VIN_Storage_Original_VIN
          DcmDspDidSignal: DcmDspDidDataPos=0, DcmDspDidDataRef=DID_630F_Multiple_VIN_Storage_Original_VIN
        DID_D117_ECU_Internal_Temperature (DcmDspData):
          DcmDspDataSize = 8
          DcmDspDataType = UINT8
          DcmDspDataUsePort = USE_DATA_ASYNCH_CLIENT_SERVER
          DcmDspDataInfoRef = DataInfo_DID_D117_ECU_Internal_Temperature
        DID_EE23_TempLvlCounters (DcmDspData): DcmDspDataSize=320, DcmDspDataType=UINT8, DcmDspDataUsePort=USE_DATA_ASYNCH_CLIENT_SERVER, DcmDspDataInfoRef=DataInfo_DID_EE23_TempLvlCounters
        Did_DID_F110_Subsystem_Specific_Diagnostic_Specification_Part_Number (DcmDspDid):
          DcmDspDidIdentifier = 61712
          DcmDspDidUsed = true
          DcmDspDidUsePort = USE_DATA_ELEMENT_SPECIFIC_INTERFACES
          DcmDspDidInfoRef = DidInfo_DID_F110_Subsystem_Specific_Diagnostic_Specification_Part_Number
          DcmDspDidSignal: DcmDspDidDataPos=0, DcmDspDidDataRef=DID_F110_Subsystem_Specific_Diagnostic_Specification_Part_Number
        DataInfo_DID_EE87_FIHSwReserved6 (DcmDspDataInfo): DcmDspDataFixedLength=true
        Did_DID_EE42_ActiveFeatures (DcmDspDid):
          DcmDspDidIdentifier = 60994
          DcmDspDidUsed = true
          DcmDspDidUsePort = USE_DATA_ELEMENT_SPECIFIC_INTERFACES
          DcmDspDidInfoRef = DidInfo_DID_EE42_ActiveFeatures
          DcmDspDidSignal: DcmDspDidDataPos=0, DcmDspDidDataRef=DID_EE42_ActiveFeatures
        DidInfo_DID_D118_Motor_Current (DcmDspDidInfo)
          DcmDspDidAccess
            DcmDspDidRead: DcmDspDidReadSessionRef=DcmDspSession/Default, DcmDspDidReadSessionRef=ExtendedDiagnostic, DcmDspDidReadSessionRef=NexteerSession
        Did_DID_EE22_VoltageLvlCounters (DcmDspDid):
          DcmDspDidIdentifier = 60962
          DcmDspDidUsed = true
          DcmDspDidUsePort = USE_DATA_ELEMENT_SPECIFIC_INTERFACES
          DcmDspDidInfoRef = DidInfo_DID_EE22_VoltageLvlCounters
          DcmDspDidSignal: DcmDspDidDataPos=0, DcmDspDidDataRef=DID_EE22_VoltageLvlCounters
        DID_DD00_Global_Real_Time (DcmDspData): DcmDspDataSize=32, DcmDspDataType=UINT8, DcmDspDataUsePort=USE_DATA_ASYNCH_CLIENT_SERVER, DcmDspDataInfoRef=DataInfo_DID_DD00_Global_Real_Time
        DataInfo_DID_EED1_SupplierInternalFaultCode (DcmDspDataInfo): DcmDspDataFixedLength=true
        DID_F180_Boot_Software_Identification (DcmDspData):
          DcmDspDataSize = 200
          DcmDspDataType = UINT8
          DcmDspDataUsePort = USE_DATA_ASYNCH_CLIENT_SERVER
          DcmDspDataInfoRef = DataInfo_DID_F180_Boot_Software_Identification
        DataInfo_DID_F163_Diagnostic_Specification_Version (DcmDspDataInfo): DcmDspDataFixedLength=true
        Did_DID_EE03_IgnCycleCounter (DcmDspDid):
          DcmDspDidIdentifier = 60931
          DcmDspDidUsed = true
          DcmDspDidUsePort = USE_DATA_ELEMENT_SPECIFIC_INTERFACES
          DcmDspDidInfoRef = DidInfo_DID_EE03_IgnCycleCounter
          DcmDspDidSignal: DcmDspDidDataPos=0, DcmDspDidDataRef=DID_EE03_IgnCycleCounter
        DID_EE86_FIHSwReserved5 (DcmDspData): DcmDspDataSize=32, DcmDspDataType=UINT8, DcmDspDataUsePort=USE_DATA_ASYNCH_CLIENT_SERVER, DcmDspDataInfoRef=DataInfo_DID_EE86_FIHSwReserved5
        DataInfo_DID_EE40_ResearchMessConfig (DcmDspDataInfo): DcmDspDataFixedLength=true
        3 x DcmDspDid, all with DcmDspDidUsed=true, DcmDspDidUsePort=USE_DATA_ELEMENT_SPECIFIC_INTERFACES:
          Did_DID_301A_Pull_Drift_Compensation_Value: DcmDspDidIdentifier=12314, DcmDspDidInfoRef=DidInfo_DID_301A_Pull_Drift_Compensation_Value
            DcmDspDidSignal: DcmDspDidDataPos=0, DcmDspDidDataRef=DID_301A_Pull_Drift_Compensation_Value
          Did_DID_EE83_FIHSwReserved2: DcmDspDidIdentifier=61059, DcmDspDidInfoRef=DidInfo_DID_EE83_FIHSwReserved2
            DcmDspDidSignal: DcmDspDidDataPos=0, DcmDspDidDataRef=DID_EE83_FIHSwReserved2
          Did_DID_F190_Vehicle_Identification_Number: DcmDspDidIdentifier=61840, DcmDspDidInfoRef=DidInfo_DID_F190_Vehicle_Identification_Number
            DcmDspDidSignal: DcmDspDidDataPos=0, DcmDspDidDataRef=DID_F190_Vehicle_Identification_Number
        DidInfo_DID_DD09_Vehicle_Speed (DcmDspDidInfo)
          DcmDspDidAccess
            DcmDspDidRead: DcmDspDidReadSessionRef=DcmDspSession/Default, DcmDspDidReadSessionRef=ExtendedDiagnostic, DcmDspDidReadSessionRef=NexteerSession
        DataInfo_DID_EE42_ActiveFeatures (DcmDspDataInfo): DcmDspDataFixedLength=true
        DidInfo_DID_F18A_System_Supplier_Identifier (DcmDspDidInfo)
          DcmDspDidAccess
            DcmDspDidWrite: DcmDspDidWriteSessionRef=NexteerSession
            DcmDspDidRead: DcmDspDidReadSessionRef=DcmDspSession/Default, DcmDspDidReadSessionRef=ExtendedDiagnostic, DcmDspDidReadSessionRef=NexteerSession
        DataInfo_DID_EE83_FIHSwReserved2 (DcmDspDataInfo): DcmDspDataFixedLength=true
        DID_205A_Torque_Steer_Compensation_Activation_Counter (DcmDspData):
          DcmDspDataSize = 16
          DcmDspDataType = UINT8
          DcmDspDataUsePort = USE_DATA_ASYNCH_CLIENT_SERVER
          DcmDspDataInfoRef = DataInfo_DID_205A_Torque_Steer_Compensation_Activation_Counter
        DataInfo_DID_EE22_VoltageLvlCounters (DcmDspDataInfo): DcmDspDataFixedLength=true
        DidInfo_DID_EE81_FIHSwReserved0 (DcmDspDidInfo)
          DcmDspDidAccess
            DcmDspDidWrite: DcmDspDidWriteSessionRef=ExtendedDiagnostic, DcmDspDidWriteSessionRef=NexteerSession
            DcmDspDidRead: DcmDspDidReadSessionRef=DcmDspSession/Default, DcmDspDidReadSessionRef=ExtendedDiagnostic, DcmDspDidReadSessionRef=NexteerSession
        3 x DcmDspData, all with DcmDspDataType=UINT8, DcmDspDataUsePort=USE_DATA_ASYNCH_CLIENT_SERVER:
          DID_F110_Subsystem_Specific_Diagnostic_Specification_Part_Number: DcmDspDataSize=192, DcmDspDataInfoRef=DataInfo_DID_F110_Subsystem_Specific_Diagnostic_Specification_Part_Number
          DID_F15F_NOS_Generation_Tool_Version_Number: DcmDspDataSize=80, DcmDspDataInfoRef=DataInfo_DID_F15F_NOS_Generation_Tool_Version_Number
          DID_EE43_SDMSteeringMode: DcmDspDataSize=8, DcmDspDataInfoRef=DataInfo_DID_EE43_SDMSteeringMode
        DidInfo_DID_F180_Boot_Software_Identification (DcmDspDidInfo)
          DcmDspDidAccess
            DcmDspDidRead: DcmDspDidReadSessionRef=DcmDspSession/Default, DcmDspDidReadSessionRef=ExtendedDiagnostic, DcmDspDidReadSessionRef=NexteerSession
        DID_EE22_VoltageLvlCounters (DcmDspData): DcmDspDataSize=320, DcmDspDataType=UINT8, DcmDspDataUsePort=USE_DATA_ASYNCH_CLIENT_SERVER, DcmDspDataInfoRef=DataInfo_DID_EE22_VoltageLvlCounters
        DID_F166_NOS_Message_Database_1_Version_Number (DcmDspData):
          DcmDspDataSize = 32
          DcmDspDataType = UINT8
          DcmDspDataUsePort = USE_DATA_ASYNCH_CLIENT_SERVER
          DcmDspDataInfoRef = DataInfo_DID_F166_NOS_Message_Database_1_Version_Number
        Did_DID_EE00_DevMessConfig (DcmDspDid):
          DcmDspDidIdentifier = 60928
          DcmDspDidUsed = true
          DcmDspDidUsePort = USE_DATA_ELEMENT_SPECIFIC_INTERFACES
          DcmDspDidInfoRef = DidInfo_DID_EE00_DevMessConfig
          DcmDspDidSignal: DcmDspDidDataPos=0, DcmDspDidDataRef=DID_EE00_DevMessConfig
        DID_EE87_FIHSwReserved6 (DcmDspData): DcmDspDataSize=32, DcmDspDataType=UINT8, DcmDspDataUsePort=USE_DATA_ASYNCH_CLIENT_SERVER, DcmDspDataInfoRef=DataInfo_DID_EE87_FIHSwReserved6
        Did_DID_3020_Steering_Pinion_Angle (DcmDspDid):
          DcmDspDidIdentifier = 12320
          DcmDspDidUsed = true
          DcmDspDidUsePort = USE_DATA_ELEMENT_SPECIFIC_INTERFACES
          DcmDspDidInfoRef = DidInfo_DID_3020_Steering_Pinion_Angle
          DcmDspDidSignal: DcmDspDidDataPos=0, DcmDspDidDataRef=DID_3020_Steering_Pinion_Angle
        DataInfo_DID_EE81_FIHSwReserved0 (DcmDspDataInfo): DcmDspDataFixedLength=true
        Did_DID_EE07_EPSSystemState (DcmDspDid):
          DcmDspDidIdentifier = 60935
          DcmDspDidUsed = true
          DcmDspDidUsePort = USE_DATA_ELEMENT_SPECIFIC_INTERFACES
          DcmDspDidInfoRef = DidInfo_DID_EE07_EPSSystemState
          DcmDspDidSignal: DcmDspDidDataPos=0, DcmDspDidDataRef=DID_EE07_EPSSystemState
        DidInfo_DID_EE20_LoAFaultReporting (DcmDspDidInfo)
          DcmDspDidAccess
            DcmDspDidRead: DcmDspDidReadSessionRef=DcmDspSession/Default, DcmDspDidReadSessionRef=ExtendedDiagnostic, DcmDspDidReadSessionRef=NexteerSession
        DataInfo_DID_F162_Software_Download_Specification_Version (DcmDspDataInfo): DcmDspDataFixedLength=true
        DidInfo_DID_EE84_FIHSwReserved3 (DcmDspDidInfo)
          DcmDspDidAccess
            DcmDspDidWrite: DcmDspDidWriteSessionRef=ExtendedDiagnostic, DcmDspDidWriteSessionRef=NexteerSession
            DcmDspDidRead: DcmDspDidReadSessionRef=DcmDspSession/Default, DcmDspDidReadSessionRef=ExtendedDiagnostic, DcmDspDidReadSessionRef=NexteerSession
        DidInfo_DID_EE00_DevMessConfig (DcmDspDidInfo)
          DcmDspDidAccess
            DcmDspDidWrite: DcmDspDidWriteSessionRef=ExtendedDiagnostic, DcmDspDidWriteSessionRef=NexteerSession
            DcmDspDidRead: DcmDspDidReadSessionRef=DcmDspSession/Default, DcmDspDidReadSessionRef=ExtendedDiagnostic, DcmDspDidReadSessionRef=NexteerSession
        DataInfo_DID_D118_Motor_Current (DcmDspDataInfo): DcmDspDataFixedLength=true
        Did_DID_EE23_TempLvlCounters (DcmDspDid):
          DcmDspDidIdentifier = 60963
          DcmDspDidUsed = true
          DcmDspDidUsePort = USE_DATA_ELEMENT_SPECIFIC_INTERFACES
          DcmDspDidInfoRef = DidInfo_DID_EE23_TempLvlCounters
          DcmDspDidSignal: DcmDspDidDataPos=0, DcmDspDidDataRef=DID_EE23_TempLvlCounters
        DidInfo_DID_F190_Vehicle_Identification_Number (DcmDspDidInfo)
          DcmDspDidAccess
            DcmDspDidRead: DcmDspDidReadSessionRef=DcmDspSession/Default, DcmDspDidReadSessionRef=ExtendedDiagnostic, DcmDspDidReadSessionRef=NexteerSession
        Did_DID_DD09_Vehicle_Speed (DcmDspDid):
          DcmDspDidIdentifier = 56585
          DcmDspDidUsed = true
          DcmDspDidUsePort = USE_DATA_ELEMENT_SPECIFIC_INTERFACES
          DcmDspDidInfoRef = DidInfo_DID_DD09_Vehicle_Speed
          DcmDspDidSignal: DcmDspDidDataPos=0, DcmDspDidDataRef=DID_DD09_Vehicle_Speed
        DataInfo_DID_EE88_FIHSwReserved7 (DcmDspDataInfo): DcmDspDataFixedLength=true
        DidInfo_DID_301A_Pull_Drift_Compensation_Value (DcmDspDidInfo)
          DcmDspDidAccess
            DcmDspDidWrite: DcmDspDidWriteSessionRef=DcmDspSession/Programming, DcmDspDidWriteSessionRef=ExtendedDiagnostic, DcmDspDidWriteSessionRef=NexteerSession
            DcmDspDidRead: DcmDspDidReadSessionRef=DcmDspSession/Default, DcmDspDidReadSessionRef=ExtendedDiagnostic, DcmDspDidReadSessionRef=NexteerSession
        DataInfo_DID_DD00_Global_Real_Time (DcmDspDataInfo): DcmDspDataFixedLength=true
        DID_EE81_FIHSwReserved0 (DcmDspData): DcmDspDataSize=32, DcmDspDataType=UINT8, DcmDspDataUsePort=USE_DATA_ASYNCH_CLIENT_SERVER, DcmDspDataInfoRef=DataInfo_DID_EE81_FIHSwReserved0
        DID_F18A_System_Supplier_Identifier (DcmDspData):
          DcmDspDataSize = 192
          DcmDspDataType = UINT8
          DcmDspDataUsePort = USE_DATA_ASYNCH_CLIENT_SERVER
          DcmDspDataInfoRef = DataInfo_DID_F18A_System_Supplier_Identifier
        3 x DcmDspDidInfo:
          DidInfo_DID_EE05_FinalMotTq
            DcmDspDidAccess
              DcmDspDidRead: DcmDspDidReadSessionRef=DcmDspSession/Default, DcmDspDidReadSessionRef=ExtendedDiagnostic, DcmDspDidReadSessionRef=NexteerSession
          DidInfo_DID_EE43_SDMSteeringMode
            DcmDspDidAccess
              DcmDspDidRead: DcmDspDidReadSessionRef=DcmDspSession/Default, DcmDspDidReadSessionRef=ExtendedDiagnostic, DcmDspDidReadSessionRef=NexteerSession
          DidInfo_DID_EE85_FIHSwReserved4
            DcmDspDidAccess
              DcmDspDidWrite: DcmDspDidWriteSessionRef=ExtendedDiagnostic, DcmDspDidWriteSessionRef=NexteerSession
              DcmDspDidRead: DcmDspDidReadSessionRef=DcmDspSession/Default, DcmDspDidReadSessionRef=ExtendedDiagnostic, DcmDspDidReadSessionRef=NexteerSession
        DataInfo_DID_EE82_FIHSwReserved1 (DcmDspDataInfo): DcmDspDataFixedLength=true
        DID_F190_Vehicle_Identification_Number (DcmDspData):
          DcmDspDataSize = 192
          DcmDspDataType = UINT8
          DcmDspDataUsePort = USE_DATA_ASYNCH_CLIENT_SERVER
          DcmDspDataInfoRef = DataInfo_DID_F190_Vehicle_Identification_Number
        DataInfo_DID_F18C_ECU_Serial_Number (DcmDspDataInfo): DcmDspDataFixedLength=true
        DidInfo_DID_F110_Subsystem_Specific_Diagnostic_Specification_Part_Number (DcmDspDidInfo)
          DcmDspDidAccess
            DcmDspDidWrite: DcmDspDidWriteSessionRef=NexteerSession
            DcmDspDidRead: DcmDspDidReadSessionRef=DcmDspSession/Default, DcmDspDidReadSessionRef=ExtendedDiagnostic, DcmDspDidReadSessionRef=NexteerSession
        DID_3020_Steering_Pinion_Angle (DcmDspData):
          DcmDspDataSize = 16
          DcmDspDataType = UINT8
          DcmDspDataUsePort = USE_DATA_ASYNCH_CLIENT_SERVER
          DcmDspDataInfoRef = DataInfo_DID_3020_Steering_Pinion_Angle
        4 x DcmDspDid, all with DcmDspDidUsed=true, DcmDspDidUsePort=USE_DATA_ELEMENT_SPECIFIC_INTERFACES:
          Did_DID_EE21_CurrentLvlCounter: DcmDspDidIdentifier=60961, DcmDspDidInfoRef=DidInfo_DID_EE21_CurrentLvlCounter
            DcmDspDidSignal: DcmDspDidDataPos=0, DcmDspDidDataRef=DID_EE21_CurrentLvlCounter
          Did_DID_301F_Steering_Pinion_Rotation_Speed: DcmDspDidIdentifier=12319, DcmDspDidInfoRef=DidInfo_DID_301F_Steering_Pinion_Rotation_Speed
            DcmDspDidSignal: DcmDspDidDataPos=0, DcmDspDidDataRef=DID_301F_Steering_Pinion_Rotation_Speed
          Did_DID_F18A_System_Supplier_Identifier: DcmDspDidIdentifier=61834, DcmDspDidInfoRef=DidInfo_DID_F18A_System_Supplier_Identifier
            DcmDspDidSignal: DcmDspDidDataPos=0, DcmDspDidDataRef=DID_F18A_System_Supplier_Identifier
          Did_DID_F18C_ECU_Serial_Number: DcmDspDidIdentifier=61836, DcmDspDidInfoRef=DidInfo_DID_F18C_ECU_Serial_Number
            DcmDspDidSignal: DcmDspDidDataPos=0, DcmDspDidDataRef=DID_F18C_ECU_Serial_Number
        DID_EE05_FinalMotTq (DcmDspData): DcmDspDataSize=16, DcmDspDataType=UINT8, DcmDspDataUsePort=USE_DATA_ASYNCH_CLIENT_SERVER, DcmDspDataInfoRef=DataInfo_DID_EE05_FinalMotTq
        DidInfo_DID_EE21_CurrentLvlCounter (DcmDspDidInfo)
          DcmDspDidAccess
            DcmDspDidRead: DcmDspDidReadSessionRef=DcmDspSession/Default, DcmDspDidReadSessionRef=ExtendedDiagnostic, DcmDspDidReadSessionRef=NexteerSession
        DataInfo_DID_EE07_EPSSystemState (DcmDspDataInfo): DcmDspDataFixedLength=true
        DataInfo_DID_DD01_Total_Distance (DcmDspDataInfo): DcmDspDataFixedLength=true
        Did_DID_EE82_FIHSwReserved1 (DcmDspDid):
          DcmDspDidIdentifier = 61058
          DcmDspDidUsed = true
          DcmDspDidUsePort = USE_DATA_ELEMENT_SPECIFIC_INTERFACES
          DcmDspDidInfoRef = DidInfo_DID_EE82_FIHSwReserved1
          DcmDspDidSignal: DcmDspDidDataPos=0, DcmDspDidDataRef=DID_EE82_FIHSwReserved1
        DidInfo_DID_EE22_VoltageLvlCounters (DcmDspDidInfo)
          DcmDspDidAccess
            DcmDspDidRead: DcmDspDidReadSessionRef=DcmDspSession/Default, DcmDspDidReadSessionRef=ExtendedDiagnostic, DcmDspDidReadSessionRef=NexteerSession
        DataInfo_DID_205A_Torque_Steer_Compensation_Activation_Counter (DcmDspDataInfo): DcmDspDataFixedLength=true
        DataInfo_DID_EE21_CurrentLvlCounter (DcmDspDataInfo): DcmDspDataFixedLength=true
        DID_DD09_Vehicle_Speed (DcmDspData): DcmDspDataSize=8, DcmDspDataType=UINT8, DcmDspDataUsePort=USE_DATA_ASYNCH_CLIENT_SERVER, DcmDspDataInfoRef=DataInfo_DID_DD09_Vehicle_Speed
        DataInfo_DID_EE43_SDMSteeringMode (DcmDspDataInfo): DcmDspDataFixedLength=true
        DID_3B4B_Steering_wheel_angle_alignment_offset (DcmDspData):
          DcmDspDataSize = 16
          DcmDspDataType = UINT8
          DcmDspDataUsePort = USE_DATA_ASYNCH_CLIENT_SERVER
          DcmDspDataInfoRef = DataInfo_DID_3B4B_Steering_wheel_angle_alignment_offset
        DID_EED1_SupplierInternalFaultCode (DcmDspData):
          DcmDspDataSize = 56
          DcmDspDataType = UINT8
          DcmDspDataUsePort = USE_DATA_ASYNCH_CLIENT_SERVER
          DcmDspDataInfoRef = DataInfo_DID_EED1_SupplierInternalFaultCode
        Did_DID_EE84_FIHSwReserved3 (DcmDspDid):
          DcmDspDidIdentifier = 61060
          DcmDspDidUsed = true
          DcmDspDidUsePort = USE_DATA_ELEMENT_SPECIFIC_INTERFACES
          DcmDspDidInfoRef = DidInfo_DID_EE84_FIHSwReserved3
          DcmDspDidSignal: DcmDspDidDataPos=0, DcmDspDidDataRef=DID_EE84_FIHSwReserved3
        DID_D118_Motor_Current (DcmDspData): DcmDspDataSize=16, DcmDspDataType=UINT8, DcmDspDataUsePort=USE_DATA_ASYNCH_CLIENT_SERVER, DcmDspDataInfoRef=DataInfo_DID_D118_Motor_Current
        DID_EE42_ActiveFeatures (DcmDspData): DcmDspDataSize=8, DcmDspDataType=UINT8, DcmDspDataUsePort=USE_DATA_ASYNCH_CLIENT_SERVER, DcmDspDataInfoRef=DataInfo_DID_EE42_ActiveFeatures
        DataInfo_DID_F18A_System_Supplier_Identifier (DcmDspDataInfo): DcmDspDataFixedLength=true
        DidInfo_DID_205A_Torque_Steer_Compensation_Activation_Counter (DcmDspDidInfo)
          DcmDspDidAccess
            DcmDspDidWrite: DcmDspDidWriteSessionRef=ExtendedDiagnostic, DcmDspDidWriteSessionRef=NexteerSession
            DcmDspDidRead: DcmDspDidReadSessionRef=DcmDspSession/Default, DcmDspDidReadSessionRef=ExtendedDiagnostic, DcmDspDidReadSessionRef=NexteerSession
        3 x DcmDspDataInfo, all with DcmDspDataFixedLength=true:
          DataInfo_DID_DD09_Vehicle_Speed
          DataInfo_DID_D117_ECU_Internal_Temperature
          DataInfo_DID_EE00_DevMessConfig
        DidInfo_DID_EE86_FIHSwReserved5 (DcmDspDidInfo)
          DcmDspDidAccess
            DcmDspDidWrite: DcmDspDidWriteSessionRef=ExtendedDiagnostic, DcmDspDidWriteSessionRef=NexteerSession
            DcmDspDidRead: DcmDspDidReadSessionRef=DcmDspSession/Default, DcmDspDidReadSessionRef=ExtendedDiagnostic, DcmDspDidReadSessionRef=NexteerSession
        Did_DID_EE20_LoAFaultReporting (DcmDspDid):
          DcmDspDidIdentifier = 60960
          DcmDspDidUsed = true
          DcmDspDidUsePort = USE_DATA_ELEMENT_SPECIFIC_INTERFACES
          DcmDspDidInfoRef = DidInfo_DID_EE20_LoAFaultReporting
          DcmDspDidSignal: DcmDspDidDataPos=0, DcmDspDidDataRef=DID_EE20_LoAFaultReporting
        DataInfo_DID_F110_Subsystem_Specific_Diagnostic_Specification_Part_Number (DcmDspDataInfo): DcmDspDataFixedLength=true
        DID_EE06_VINChanged (DcmDspData): DcmDspDataSize=8, DcmDspDataType=UINT8, DcmDspDataUsePort=USE_DATA_ASYNCH_CLIENT_SERVER, DcmDspDataInfoRef=DataInfo_DID_EE06_VINChanged
        Did_DID_EE81_FIHSwReserved0 (DcmDspDid):
          DcmDspDidIdentifier = 61057
          DcmDspDidUsed = true
          DcmDspDidUsePort = USE_DATA_ELEMENT_SPECIFIC_INTERFACES
          DcmDspDidInfoRef = DidInfo_DID_EE81_FIHSwReserved0
          DcmDspDidSignal: DcmDspDidDataPos=0, DcmDspDidDataRef=DID_EE81_FIHSwReserved0
        DID_F163_Diagnostic_Specification_Version (DcmDspData):
          DcmDspDataSize = 8
          DcmDspDataType = UINT8
          DcmDspDataUsePort = USE_DATA_ASYNCH_CLIENT_SERVER
          DcmDspDataInfoRef = DataInfo_DID_F163_Diagnostic_Specification_Version
        DidInfo_DID_EE83_FIHSwReserved2 (DcmDspDidInfo)
          DcmDspDidAccess
            DcmDspDidWrite: DcmDspDidWriteSessionRef=ExtendedDiagnostic, DcmDspDidWriteSessionRef=NexteerSession
            DcmDspDidRead: DcmDspDidReadSessionRef=DcmDspSession/Default, DcmDspDidReadSessionRef=ExtendedDiagnostic, DcmDspDidReadSessionRef=NexteerSession
        DataInfo_DID_EED0_SupplierFactoryMode (DcmDspDataInfo): DcmDspDataFixedLength=true
        Did_DID_F15F_NOS_Generation_Tool_Version_Number (DcmDspDid):
          DcmDspDidIdentifier = 61791
          DcmDspDidUsed = true
          DcmDspDidUsePort = USE_DATA_ELEMENT_SPECIFIC_INTERFACES
          DcmDspDidInfoRef = DidInfo_DID_F15F_NOS_Generation_Tool_Version_Number
          DcmDspDidSignal: DcmDspDidDataPos=0, DcmDspDidDataRef=DID_F15F_NOS_Generation_Tool_Version_Number
        DID_301F_Steering_Pinion_Rotation_Speed (DcmDspData):
          DcmDspDataSize = 8
          DcmDspDataType = UINT8
          DcmDspDataUsePort = USE_DATA_ASYNCH_CLIENT_SERVER
          DcmDspDataInfoRef = DataInfo_DID_301F_Steering_Pinion_Rotation_Speed
        DID_F18C_ECU_Serial_Number (DcmDspData): DcmDspDataSize=128, DcmDspDataType=UINT8, DcmDspDataUsePort=USE_DATA_ASYNCH_CLIENT_SERVER, DcmDspDataInfoRef=DataInfo_DID_F18C_ECU_Serial_Number
        DidInfo_DID_EE07_EPSSystemState (DcmDspDidInfo)
          DcmDspDidAccess
            DcmDspDidRead: DcmDspDidReadSessionRef=DcmDspSession/Default, DcmDspDidReadSessionRef=ExtendedDiagnostic, DcmDspDidReadSessionRef=NexteerSession
        DataInfo_DID_F180_Boot_Software_Identification (DcmDspDataInfo): DcmDspDataFixedLength=true
        Did_DID_EE06_VINChanged (DcmDspDid): DcmDspDidIdentifier=60934, DcmDspDidUsed=true, DcmDspDidUsePort=USE_DATA_ELEMENT_SPECIFIC_INTERFACES, DcmDspDidInfoRef=DidInfo_DID_EE06_VINChanged
          DcmDspDidSignal: DcmDspDidDataPos=0, DcmDspDidDataRef=DID_EE06_VINChanged
        DidInfo_DID_301F_Steering_Pinion_Rotation_Speed (DcmDspDidInfo)
          DcmDspDidAccess
            DcmDspDidRead: DcmDspDidReadSessionRef=DcmDspSession/Default, DcmDspDidReadSessionRef=ExtendedDiagnostic, DcmDspDidReadSessionRef=NexteerSession
        Did_DID_DD00_Global_Real_Time (DcmDspDid):
          DcmDspDidIdentifier = 56576
          DcmDspDidUsed = true
          DcmDspDidUsePort = USE_DATA_ELEMENT_SPECIFIC_INTERFACES
          DcmDspDidInfoRef = DidInfo_DID_DD00_Global_Real_Time
          DcmDspDidSignal: DcmDspDidDataPos=0, DcmDspDidDataRef=DID_DD00_Global_Real_Time
        Did_DID_EE04_IgnOnTime (DcmDspDid): DcmDspDidIdentifier=60932, DcmDspDidUsed=true, DcmDspDidUsePort=USE_DATA_ELEMENT_SPECIFIC_INTERFACES, DcmDspDidInfoRef=DidInfo_DID_EE04_IgnOnTime
          DcmDspDidSignal: DcmDspDidDataPos=0, DcmDspDidDataRef=DID_EE04_IgnOnTime
        DataInfo_DID_EE20_LoAFaultReporting (DcmDspDataInfo): DcmDspDataFixedLength=true
        Did_DID_EE88_FIHSwReserved7 (DcmDspDid):
          DcmDspDidIdentifier = 61064
          DcmDspDidUsed = true
          DcmDspDidUsePort = USE_DATA_ELEMENT_SPECIFIC_INTERFACES
          DcmDspDidInfoRef = DidInfo_DID_EE88_FIHSwReserved7
          DcmDspDidSignal: DcmDspDidDataPos=0, DcmDspDidDataRef=DID_EE88_FIHSwReserved7
        DataInfo_DID_EE23_TempLvlCounters (DcmDspDataInfo): DcmDspDataFixedLength=true
        Did_DID_EE41_ResearchFeatureSwitch (DcmDspDid):
          DcmDspDidIdentifier = 60993
          DcmDspDidUsed = true
          DcmDspDidUsePort = USE_DATA_ELEMENT_SPECIFIC_INTERFACES
          DcmDspDidInfoRef = DidInfo_DID_EE41_ResearchFeatureSwitch
          DcmDspDidSignal: DcmDspDidDataPos=0, DcmDspDidDataRef=DID_EE41_ResearchFeatureSwitch
        Did_DID_EE85_FIHSwReserved4 (DcmDspDid):
          DcmDspDidIdentifier = 61061
          DcmDspDidUsed = true
          DcmDspDidUsePort = USE_DATA_ELEMENT_SPECIFIC_INTERFACES
          DcmDspDidInfoRef = DidInfo_DID_EE85_FIHSwReserved4
          DcmDspDidSignal: DcmDspDidDataPos=0, DcmDspDidDataRef=DID_EE85_FIHSwReserved4
        DID_630F_Multiple_VIN_Storage_Original_VIN (DcmDspData):
          DcmDspDataSize = 192
          DcmDspDataType = UINT8
          DcmDspDataUsePort = USE_DATA_ASYNCH_CLIENT_SERVER
          DcmDspDataInfoRef = DataInfo_DID_630F_Multiple_VIN_Storage_Original_VIN
        DID_EE88_FIHSwReserved7 (DcmDspData): DcmDspDataSize=32, DcmDspDataType=UINT8, DcmDspDataUsePort=USE_DATA_ASYNCH_CLIENT_SERVER, DcmDspDataInfoRef=DataInfo_DID_EE88_FIHSwReserved7
        DidInfo_DID_EE41_ResearchFeatureSwitch (DcmDspDidInfo)
          DcmDspDidAccess
            DcmDspDidWrite: DcmDspDidWriteSessionRef=ExtendedDiagnostic, DcmDspDidWriteSessionRef=NexteerSession
            DcmDspDidRead: DcmDspDidReadSessionRef=DcmDspSession/Default, DcmDspDidReadSessionRef=ExtendedDiagnostic, DcmDspDidReadSessionRef=NexteerSession
        Did_DID_D118_Motor_Current (DcmDspDid):
          DcmDspDidIdentifier = 53528
          DcmDspDidUsed = true
          DcmDspDidUsePort = USE_DATA_ELEMENT_SPECIFIC_INTERFACES
          DcmDspDidInfoRef = DidInfo_DID_D118_Motor_Current
          DcmDspDidSignal: DcmDspDidDataPos=0, DcmDspDidDataRef=DID_D118_Motor_Current
        DataInfo_DID_EE06_VINChanged (DcmDspDataInfo): DcmDspDataFixedLength=true
        DidInfo_DID_EE80_FIHSwVer (DcmDspDidInfo)
          DcmDspDidAccess
            DcmDspDidRead: DcmDspDidReadSessionRef=DcmDspSession/Default, DcmDspDidReadSessionRef=ExtendedDiagnostic, DcmDspDidReadSessionRef=NexteerSession
        DID_DD01_Total_Distance (DcmDspData): DcmDspDataSize=24, DcmDspDataType=UINT8, DcmDspDataUsePort=USE_DATA_ASYNCH_CLIENT_SERVER, DcmDspDataInfoRef=DataInfo_DID_DD01_Total_Distance
        DidInfo_DID_EED0_SupplierFactoryMode (DcmDspDidInfo)
          DcmDspDidAccess
            DcmDspDidWrite: DcmDspDidWriteSessionRef=ExtendedDiagnostic, DcmDspDidWriteSessionRef=NexteerSession
            DcmDspDidRead: DcmDspDidReadSessionRef=DcmDspSession/Default, DcmDspDidReadSessionRef=ExtendedDiagnostic, DcmDspDidReadSessionRef=NexteerSession
        Did_DID_EED0_SupplierFactoryMode (DcmDspDid):
          DcmDspDidIdentifier = 61136
          DcmDspDidUsed = true
          DcmDspDidUsePort = USE_DATA_ELEMENT_SPECIFIC_INTERFACES
          DcmDspDidInfoRef = DidInfo_DID_EED0_SupplierFactoryMode
          DcmDspDidSignal: DcmDspDidDataPos=0, DcmDspDidDataRef=DID_EED0_SupplierFactoryMode
        DidInfo_DID_F15F_NOS_Generation_Tool_Version_Number (DcmDspDidInfo)
          DcmDspDidAccess
            DcmDspDidRead: DcmDspDidReadSessionRef=DcmDspSession/Default, DcmDspDidReadSessionRef=ExtendedDiagnostic, DcmDspDidReadSessionRef=NexteerSession
        DID_EE40_ResearchMessConfig (DcmDspData): DcmDspDataSize=24, DcmDspDataType=UINT8, DcmDspDataUsePort=USE_DATA_ASYNCH_CLIENT_SERVER, DcmDspDataInfoRef=DataInfo_DID_EE40_ResearchMessConfig
        Did_DID_EE43_SDMSteeringMode (DcmDspDid):
          DcmDspDidIdentifier = 60995
          DcmDspDidUsed = true
          DcmDspDidUsePort = USE_DATA_ELEMENT_SPECIFIC_INTERFACES
          DcmDspDidInfoRef = DidInfo_DID_EE43_SDMSteeringMode
          DcmDspDidSignal: DcmDspDidDataPos=0, DcmDspDidDataRef=DID_EE43_SDMSteeringMode
        DidInfo_DID_D111_ECU_Power_Supply_Voltage (DcmDspDidInfo)
          DcmDspDidAccess
            DcmDspDidRead: DcmDspDidReadSessionRef=DcmDspSession/Default, DcmDspDidReadSessionRef=ExtendedDiagnostic, DcmDspDidReadSessionRef=NexteerSession
        DataInfo_DID_EE85_FIHSwReserved4 (DcmDspDataInfo): DcmDspDataFixedLength=true
        DidInfo_DID_EE04_IgnOnTime (DcmDspDidInfo)
          DcmDspDidAccess
            DcmDspDidRead: DcmDspDidReadSessionRef=DcmDspSession/Default, DcmDspDidReadSessionRef=ExtendedDiagnostic, DcmDspDidReadSessionRef=NexteerSession
        DidInfo_DID_F163_Diagnostic_Specification_Version (DcmDspDidInfo)
          DcmDspDidAccess
            DcmDspDidWrite: DcmDspDidWriteSessionRef=NexteerSession
            DcmDspDidRead: DcmDspDidReadSessionRef=DcmDspSession/Default, DcmDspDidReadSessionRef=ExtendedDiagnostic, DcmDspDidReadSessionRef=NexteerSession
        DID_205B_Brake_Pull_Reduction_Activation_Counter (DcmDspData):
          DcmDspDataSize = 16
          DcmDspDataType = UINT8
          DcmDspDataUsePort = USE_DATA_ASYNCH_CLIENT_SERVER
          DcmDspDataInfoRef = DataInfo_DID_205B_Brake_Pull_Reduction_Activation_Counter
        Did_DID_F17C_NOS_Bootloader_Generation_Tool_Version_Number (DcmDspDid):
          DcmDspDidIdentifier = 61820
          DcmDspDidUsed = true
          DcmDspDidUsePort = USE_DATA_ELEMENT_SPECIFIC_INTERFACES
          DcmDspDidInfoRef = DidInfo_DID_F17C_NOS_Bootloader_Generation_Tool_Version_Number
          DcmDspDidSignal: DcmDspDidDataPos=0, DcmDspDidDataRef=DID_F17C_NOS_Bootloader_Generation_Tool_Version_Number
        DidInfo_DID_F17C_NOS_Bootloader_Generation_Tool_Version_Number (DcmDspDidInfo)
          DcmDspDidAccess
            DcmDspDidRead
        DID_F17C_NOS_Bootloader_Generation_Tool_Version_Number (DcmDspData):
          DcmDspDataSize = 88
          DcmDspDataType = UINT8
          DcmDspDataUsePort = USE_DATA_ASYNCH_CLIENT_SERVER
          DcmDspDataInfoRef = DataInfo_DID_F17C_NOS_Bootloader_Generation_Tool_Version_Number
        DataInfo_DID_F17C_NOS_Bootloader_Generation_Tool_Version_Number (DcmDspDataInfo): DcmDspDataFixedLength=true
        DID_DE05_Unused (DcmDspData): DcmDspDataSize=192, DcmDspDataType=UINT8, DcmDspDataUsePort=USE_DATA_ASYNCH_CLIENT_SERVER, DcmDspDataInfoRef=DataInfo_DID_DE05_Unused
        DidInfo_DID_DE05_Unused (DcmDspDidInfo)
          DcmDspDidAccess
            DcmDspDidWrite: DcmDspDidWriteSessionRef=ExtendedDiagnostic, DcmDspDidWriteSessionRef=NexteerSession
            DcmDspDidRead: DcmDspDidReadSessionRef=DcmDspSession/Default, DcmDspDidReadSessionRef=ExtendedDiagnostic, DcmDspDidReadSessionRef=NexteerSession
        DataInfo_DID_DE05_Unused (DcmDspDataInfo): DcmDspDataFixedLength=true
        Did_DID_DE05_Unused (DcmDspDid): DcmDspDidIdentifier=56837, DcmDspDidUsed=true, DcmDspDidUsePort=USE_DATA_ELEMENT_SPECIFIC_INTERFACES, DcmDspDidInfoRef=DidInfo_DID_DE05_Unused
          DcmDspDidSignal: DcmDspDidDataPos=0, DcmDspDidDataRef=DID_DE05_Unused
        NexteerDidRangeF194toF1FF (DcmDspDidRange):
          DcmDspDidRangeHasGaps = false
          DcmDspDidRangeIdentifierLowerLimit = 61844
          DcmDspDidRangeIdentifierUpperLimit = 61951
          DcmDspDidRangeMaxDataLength = 1024
          DcmDspDidRangeUsePort = true
          DcmDspDidRangeInfoRef = DidInfo_NexteerDids_ReadWrite
        RTN_Nexteer_F200_Micro_Diagnostic_Fault_Injection (DcmDspRoutine):
          DcmDspRequestResultsRoutineSupported = false
          DcmDspRoutineIdentifier = 61952
          DcmDspRoutineUsePort = true
          DcmDspRoutineUsed = true
          DcmDspStopRoutineSupported = false
          DcmDspRoutineInfoRef = Nexteer_F200_Micro_Diagnostic_Fault_Injection
        Nexteer_FE20_Motor_Velocity_Control (DcmDspRoutineInfo)
          DcmDspRoutineAuthorization: DcmDspRoutineSessionRef=NexteerSession
          DcmDspRoutineStopIn
            Data (DcmDspRoutineStopInSignal): DcmDspRoutineSignalLength=32, DcmDspRoutineSignalPos=0, DcmDspRoutineSignalType=UINT8
          DcmDspStartRoutineIn
            Data (DcmDspStartRoutineInSignal): DcmDspRoutineSignalLength=64, DcmDspRoutineSignalPos=0, DcmDspRoutineSignalType=UINT8
        Did_DID_EED2_SupplierInternalErrorMemory (DcmDspDid):
          DcmDspDidIdentifier = 61138
          DcmDspDidUsed = true
          DcmDspDidUsePort = USE_DATA_ELEMENT_SPECIFIC_INTERFACES
          DcmDspDidInfoRef = DidInfo_DID_EED2_SupplierInternalErrorMemory
          DcmDspDidSignal: DcmDspDidDataPos=0, DcmDspDidDataRef=DID_EED2_SupplierInternalErrorMemory
        RoutineInfo_RTN_200F_Clear_Steering_Angle_Centre_Position_Calibration (DcmDspRoutineInfo)
          DcmDspRoutineAuthorization: DcmDspRoutineSessionRef=ExtendedDiagnostic, DcmDspRoutineSessionRef=NexteerSession
          DcmDspStartRoutineOut
            Out_ResData (DcmDspStartRoutineOutSignal): DcmDspRoutineSignalLength=8, DcmDspRoutineSignalType=UINT8, DcmDspRoutineSignalPos=0
        RoutineInfo_RTN_DC00_Reset_Assist_Fault_Counters (DcmDspRoutineInfo)
          DcmDspRoutineAuthorization: DcmDspRoutineSessionRef=ExtendedDiagnostic, DcmDspRoutineSessionRef=NexteerSession
          DcmDspStartRoutineOut
            Out_ResData (DcmDspStartRoutineOutSignal): DcmDspRoutineSignalLength=8, DcmDspRoutineSignalType=UINT8, DcmDspRoutineSignalPos=0
        RTN_0202_On_Demand_Self_Test (DcmDspRoutine):
          DcmDspRequestResultsRoutineSupported = true
          DcmDspStopRoutineSupported = true
          DcmDspRoutineIdentifier = 514
          DcmDspRoutineUsePort = true
          DcmDspRoutineUsed = true
          DcmDspRoutineInfoRef = RoutineInfo_RTN_0202_On_Demand_Self_Test
        DataInfo_DID_EED2_SupplierInternalErrorMemory (DcmDspDataInfo): DcmDspDataFixedLength=true
        RoutineInfo_RTN_0202_On_Demand_Self_Test (DcmDspRoutineInfo)
          DcmDspRoutineRequestResOut
            Out_ResData (DcmDspRoutineRequestResOutSignal): DcmDspRoutineSignalType=VARIABLE_LENGTH, DcmDspRoutineSignalPos=0, DcmDspRoutineSignalLength=1272
          DcmDspRoutineAuthorization: DcmDspRoutineSessionRef=ExtendedDiagnostic, DcmDspRoutineSessionRef=NexteerSession
          DcmDspStartRoutineOut
            Out_ResData (DcmDspStartRoutineOutSignal): DcmDspRoutineSignalLength=8, DcmDspRoutineSignalType=UINT8, DcmDspRoutineSignalPos=0
          DcmDspRoutineStopOut
            Out_ResData (DcmDspRoutineStopOutSignal): DcmDspRoutineSignalLength=8, DcmDspRoutineSignalType=UINT8, DcmDspRoutineSignalPos=0
        DidInfo_DID_EED2_SupplierInternalErrorMemory (DcmDspDidInfo)
          DcmDspDidAccess
            DcmDspDidRead: DcmDspDidReadSessionRef=DcmDspSession/Default, DcmDspDidReadSessionRef=ExtendedDiagnostic, DcmDspDidReadSessionRef=NexteerSession
        RTN_DC00_Reset_Assist_Fault_Counters (DcmDspRoutine):
          DcmDspRequestResultsRoutineSupported = false
          DcmDspStopRoutineSupported = false
          DcmDspRoutineIdentifier = 56320
          DcmDspRoutineUsePort = true
          DcmDspRoutineUsed = true
          DcmDspRoutineInfoRef = RoutineInfo_RTN_DC00_Reset_Assist_Fault_Counters
        DID_EED2_SupplierInternalErrorMemory (DcmDspData):
          DcmDspDataSize = 32
          DcmDspDataType = UINT8
          DcmDspDataUsePort = USE_DATA_ASYNCH_CLIENT_SERVER
          DcmDspDataInfoRef = DataInfo_DID_EED2_SupplierInternalErrorMemory
        RTN_200E_Calibrate_Steering_Angle_Centre_Position (DcmDspRoutine):
          DcmDspRequestResultsRoutineSupported = false
          DcmDspStopRoutineSupported = false
          DcmDspRoutineIdentifier = 8206
          DcmDspRoutineUsePort = true
          DcmDspRoutineUsed = true
          DcmDspRoutineInfoRef = RoutineInfo_RTN_200E_Calibrate_Steering_Angle_Centre_Position
        RoutineInfo_RTN_200E_Calibrate_Steering_Angle_Centre_Position (DcmDspRoutineInfo)
          DcmDspRoutineAuthorization: DcmDspRoutineSessionRef=DcmDspSession/Default, DcmDspRoutineSessionRef=ExtendedDiagnostic, DcmDspRoutineSessionRef=NexteerSession
          DcmDspStartRoutineOut
            Out_ResData (DcmDspStartRoutineOutSignal): DcmDspRoutineSignalLength=8, DcmDspRoutineSignalType=UINT8, DcmDspRoutineSignalPos=0
        RTN_200F_Clear_Steering_Angle_Centre_Position_Calibration (DcmDspRoutine):
          DcmDspRequestResultsRoutineSupported = false
          DcmDspStopRoutineSupported = false
          DcmDspRoutineIdentifier = 8207
          DcmDspRoutineUsePort = true
          DcmDspRoutineUsed = true
          DcmDspRoutineInfoRef = RoutineInfo_RTN_200F_Clear_Steering_Angle_Centre_Position_Calibration
        DcmDspComControl
          DcmDspComControlAllChannel: DcmDspAllComMChannelRef=FD1_CAN_f26020e5
        4 x DcmDspRoutine, all with DcmDspRequestResultsRoutineSupported=false, DcmDspRoutineUsePort=true, DcmDspRoutineUsed=true, DcmDspStopRoutineSupported=false, DcmDspRoutineInfoRef=Nexteer_CommonRoutine_0Strt0Stop1Sts:
          RTN_Nexteer_FD54_Clear_Stack_Measurement_Result: DcmDspRoutineIdentifier=64852
          RTN_Nexteer_FD71_Clear_Nexteer_Snapshot_Data_Start: DcmDspRoutineIdentifier=64881
          RTN_Nexteer_FE88_System_Friction_Learning_Clear: DcmDspRoutineIdentifier=65160
          RTN_Nexteer_FE89_System_Friction_Learning_Initialize: DcmDspRoutineIdentifier=65161
      DcmProcessingConditions
        EcuResetModeCondition (DcmModeCondition): DcmConditionType=DCM_EQUALS, DcmBswModeRef=BswM_MDGP_BswMEcuResetMod.EcuResetEnabled
        EcuResetModeRule (DcmModeRule): DcmLogicalOperator=DCM_AND, DcmModeRuleNrcValue=34, DcmArgumentRef=EcuResetModeCondition
