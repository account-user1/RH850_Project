AUTOSAR XML (schema 4-2-1)
package /ActiveEcuC
  module config CanTp: implementation-config-variant=VARIANT-PRE-COMPILE, module-description=CanTp_Impl
    CanTpGeneral:
      CanTpSupportStandardAddressing = true
      CanTpUseOnlyFirstFc = true
      CanTpSupportExtendedAddressing = false
      CanTpSupportMixed11Addressing = false
      CanTpHavePaddingByte = true
      CanTpPaddingByte = 0
      CanTpPaddingActive = true
      CanTpChangeParameterApi = false
      CanTpDevErrorDetect = true
      CanTpReadParameterApi = false
      CanTpVersionInfoApi = false
      CanTpNumRxChannels = 0
      CanTpNumTxChannels = 0
      CanTpEnableSplitMainFunction = false
      CanTpOnlyNotifyInformedAppl = true
      CanTpRc = false
      CanTpTc = false
      CanTpEnableSynchronousTransmit = true
      CanTpEnableTransmitQueue = false
      CanTpFlexibleDataRateSupport = true
      CanTpSupportLongFirstFrames = true
    CanTpConfig: CanTpMainFunctionPeriod=0.005
      4 x CanTpChannel, all with CanTpChannelMode=CANTP_MODE_FULL_DUPLEX:
        TPCH_f2921bcf
          RxNSdu_f2921bcf (CanTpRxNSdu):
            CanTpRxAddressingFormat = CANTP_STANDARD
            CanTpRxDl = 8
            CanTpRxTaType = CANTP_CANFD_FUNCTIONAL
            CanTpRxPaddingActivation = CANTP_ON
            CanTpNar = 1.4
            CanTpNcr = 1.4
            CanTpNbr = 0.9
            CanTpRxNSduId = 3
            CanTpRxWftMax = 0
            CanTpBs = 0
            CanTpRxNSduRef = PT_TesterFunctionalReq_FD1_PP_TesterFunctionalReq_FD1_Rx_3290b631_3cf8f7d5
            CanTpRxNPdu_c40f6080 (CanTpRxNPdu): CanTpRxNPduId=3, CanTpRxNPduRef=PT_TesterFunctionalReq_FD1_Tp_PP_TesterFunctionalReq_FD1_Tp_Rx_3290b631_3cf8f7d5
        TPCH_0b63929d
          RxNSdu_0b63929d (CanTpRxNSdu):
            CanTpRxAddressingFormat = CANTP_STANDARD
            CanTpRxDl = 8
            CanTpRxTaType = CANTP_FUNCTIONAL
            CanTpRxPaddingActivation = CANTP_ON
            CanTpNar = 1.4
            CanTpNcr = 1.4
            CanTpNbr = 0.9
            CanTpRxNSduId = 0
            CanTpRxWftMax = 0
            CanTpBs = 0
            CanTpRxNSduRef = PT_TesterFunctionalReq_FD1_20_PP_TesterFunctionalReq_FD1_Rx_20_3290b631_3cf8f7d5
            CanTpRxNPdu_b5f48067 (CanTpRxNPdu): CanTpRxNPduId=2, CanTpRxNPduRef=PT_TesterFunctionalReq_FD1_Tp_20_PP_TesterFunctionalReq_FD1_Tp_Rx_20_3290b631_3cf8f7d5
        TPCH_62a8e518
          TxNSdu_b29a3917 (CanTpTxNSdu):
            CanTpTxAddressingFormat = CANTP_STANDARD
            CanTpTxDl = 8
            CanTpTxTaType = CANTP_PHYSICAL
            CanTpTxPaddingActivation = CANTP_ON
            CanTpNcs = 0.2
            CanTpNas = 1.4
            CanTpNbs = 1.4
            CanTpTc = false
            CanTpTxNSduId = 1
            CanTpTxNSduRef = PT_TesterPhysicalResPSCM_FD1_20_PP_TesterPhysicalResPSCM_FD1_Tx_20_3290b631_3cf8f7d5
            CanTpTxNPdu_d4315ea8 (CanTpTxNPdu): CanTpTxNPduConfirmationPduId=0, CanTpTxNPduRef=PT_TesterPhysicalResPSCM_FD1_Tp_20_PP_TesterPhysicalResPSCM_FD1_Tp_Tx_20_3290b631_3cf8f7d5
            CanTpRxFcNPdu_d4315ea8 (CanTpRxFcNPdu): CanTpRxFcNPduId=0, CanTpRxFcNPduRef=PT_TesterPhysicalReqPSCM_FD1_Tp_20_PP_TesterPhysicalReqPSCM_FD1_Tp_Rx_20_3290b631_3cf8f7d5
          RxNSdu_62a8e518 (CanTpRxNSdu):
            CanTpRxAddressingFormat = CANTP_STANDARD
            CanTpRxDl = 8
            CanTpRxTaType = CANTP_PHYSICAL
            CanTpRxPaddingActivation = CANTP_ON
            CanTpNar = 1.4
            CanTpNcr = 1.4
            CanTpNbr = 0.9
            CanTpRxNSduId = 1
            CanTpBs = 0
            CanTpRxWftMax = 0
            CanTpSTmin = 0.02
            CanTpRxNSduRef = PT_TesterPhysicalReqPSCM_FD1_20_PP_TesterPhysicalReqPSCM_FD1_Rx_20_3290b631_3cf8f7d5
            CanTpRxNPdu_7cc48353 (CanTpRxNPdu): CanTpRxNPduId=0, CanTpRxNPduRef=PT_TesterPhysicalReqPSCM_FD1_Tp_20_PP_TesterPhysicalReqPSCM_FD1_Tp_Rx_20_3290b631_3cf8f7d5
            CanTpTxFcNPdu_7cc48353 (CanTpTxFcNPdu): CanTpTxFcNPduConfirmationPduId=0, CanTpTxFcNPduRef=PT_TesterPhysicalResPSCM_FD1_Tp_20_PP_TesterPhysicalResPSCM_FD1_Tp_Tx_20_3290b631_3cf8f7d5
        TPCH_4962324c
          TxNSdu_769ddb63 (CanTpTxNSdu):
            CanTpTxAddressingFormat = CANTP_STANDARD
            CanTpTxDl = 8
            CanTpTxTaType = CANTP_CANFD_PHYSICAL
            CanTpTxPaddingActivation = CANTP_ON
            CanTpNcs = 0.2
            CanTpNas = 1.4
            CanTpNbs = 1.4
            CanTpTc = false
            CanTpTxNSduId = 0
            CanTpTxNSduRef = PT_TesterPhysicalResPSCM_FD1_PP_TesterPhysicalResPSCM_FD1_Tx_3290b631_3cf8f7d5
            CanTpRxFcNPdu_a3000bfc (CanTpRxFcNPdu): CanTpRxFcNPduId=1, CanTpRxFcNPduRef=PT_TesterPhysicalReqPSCM_FD1_Tp_PP_TesterPhysicalReqPSCM_FD1_Tp_Rx_3290b631_3cf8f7d5
            CanTpTxNPdu_a3000bfc (CanTpTxNPdu): CanTpTxNPduConfirmationPduId=1, CanTpTxNPduRef=PT_TesterPhysicalResPSCM_FD1_Tp_PP_TesterPhysicalResPSCM_FD1_Tp_Tx_3290b631_3cf8f7d5
          RxNSdu_4962324c (CanTpRxNSdu):
            CanTpRxAddressingFormat = CANTP_STANDARD
            CanTpRxDl = 8
            CanTpRxTaType = CANTP_CANFD_PHYSICAL
            CanTpRxPaddingActivation = CANTP_ON
            CanTpNar = 1.4
            CanTpNcr = 1.4
            CanTpNbr = 0.9
            CanTpRxNSduId = 2
            CanTpBs = 0
            CanTpRxWftMax = 0
            CanTpSTmin = 0.02
            CanTpRxNSduRef = PT_TesterPhysicalReqPSCM_FD1_PP_TesterPhysicalReqPSCM_FD1_Rx_3290b631_3cf8f7d5
            CanTpRxNPdu_35bd2844 (CanTpRxNPdu): CanTpRxNPduId=1, CanTpRxNPduRef=PT_TesterPhysicalReqPSCM_FD1_Tp_PP_TesterPhysicalReqPSCM_FD1_Tp_Rx_3290b631_3cf8f7d5
            CanTpTxFcNPdu_35bd2844 (CanTpTxFcNPdu): CanTpTxFcNPduConfirmationPduId=1, CanTpTxFcNPduRef=PT_TesterPhysicalResPSCM_FD1_Tp_PP_TesterPhysicalResPSCM_FD1_Tp_Tx_3290b631_3cf8f7d5
