AUTOSAR XML (schema 4-2-1)
package /ActiveEcuC
  module config CanIf: implementation-config-variant=VARIANT-POST-BUILD-SELECTABLE, module-description=CanIf_Impl
    CanIfDispatchCfg:
      CanIfDispatchUserCtrlBusOffName = CanSM_ControllerBusOff
      CanIfDispatchUserCtrlBusOffUL = CAN_SM
      CanIfDispatchUserCtrlModeIndicationName = CanSM_ControllerModeIndication
      CanIfDispatchUserCtrlModeIndicationUL = CAN_SM
    CanIfInitCfg
      CanIfInitHohCfg: CanIfInitRefCfgSet=CanConfigSet
        CN_FD1_CAN_b4e1ca3b_Tx_Std (CanIfHthCfg): CanIfHthCanCtrlIdRef=CT_FD1_CAN_b4e1ca3b, CanIfHthIdSymRef=CN_FD1_CAN_b4e1ca3b_Tx_Std
        42 x CanIfHrhCfg, all with CanIfHrhCanCtrlIdRef=CT_FD1_CAN_b4e1ca3b:
          CN_FD1_CAN_b4e1ca3b_Rx_Std: CanIfHrhSoftwareFilter=true, CanIfHrhIdSymRef=CN_FD1_CAN_b4e1ca3b_Rx_Std
          CanIfHrhCfg_ABS_BrkBst_Data_FD1_oFD1_CAN_Rx_3abd61be: CanIfHrhSoftwareFilter=false, CanIfHrhIdSymRef=CanHardwareObject_ABS_BrkBst_Data_FD1_oFD1_CAN_Rx_3abd61be
          CanIfHrhCfg_Yaw_Data_FD1_oFD1_CAN_Rx_3abd61be: CanIfHrhSoftwareFilter=false, CanIfHrhIdSymRef=CanHardwareObject_Yaw_Data_FD1_oFD1_CAN_Rx_3abd61be
          CanIfHrhCfg_ActiveFrontStrg_Stat2_FD1_oFD1_CAN_Rx_3abd61be: CanIfHrhSoftwareFilter=false, CanIfHrhIdSymRef=CanHardwareObject_ActiveFrontStrg_Stat2_FD1_oFD1_CAN_Rx_3abd61be
          CanIfHrhCfg_APIM_Send_Signals1_FD1_oFD1_CAN_Rx_3abd61be: CanIfHrhSoftwareFilter=false, CanIfHrhIdSymRef=CanHardwareObject_APIM_Send_Signals1_FD1_oFD1_CAN_Rx_3abd61be
          CanIfHrhCfg_APIM_Send_Signals_2_FD1_oFD1_CAN_Rx_3abd61be: CanIfHrhSoftwareFilter=false, CanIfHrhIdSymRef=CanHardwareObject_APIM_Send_Signals_2_FD1_oFD1_CAN_Rx_3abd61be
          CanIfHrhCfg_Body_Info_4_FD1_oFD1_CAN_Rx_3abd61be: CanIfHrhSoftwareFilter=false, CanIfHrhIdSymRef=CanHardwareObject_Body_Info_4_FD1_oFD1_CAN_Rx_3abd61be
          CanIfHrhCfg_BodyInfo_3_FD1_oFD1_CAN_Rx_3abd61be: CanIfHrhSoftwareFilter=false, CanIfHrhIdSymRef=CanHardwareObject_BodyInfo_3_FD1_oFD1_CAN_Rx_3abd61be
          CanIfHrhCfg_BrakeSnData_{3..6}_FD1_oFD1_CAN_Rx_3abd61be: CanIfHrhSoftwareFilter=false, CanIfHrhIdSymRef=CanHardwareObject_BrakeSnData_{3..6}_FD1_oFD1_CAN_Rx_3abd61be
          CanIfHrhCfg_BrakeSysFeatures_3_oFD1_CAN_Rx_3abd61be: CanIfHrhSoftwareFilter=false, CanIfHrhIdSymRef=CanHardwareObject_BrakeSysFeatures_3_oFD1_CAN_Rx_3abd61be
          CanIfHrhCfg_WheelSpeed_FD1_oFD1_CAN_Rx_3abd61be: CanIfHrhSoftwareFilter=false, CanIfHrhIdSymRef=CanHardwareObject_WheelSpeed_FD1_oFD1_CAN_Rx_3abd61be
          CanIfHrhCfg_TrailerInfo_FD1_oFD1_CAN_Rx_3abd61be: CanIfHrhSoftwareFilter=false, CanIfHrhIdSymRef=CanHardwareObject_TrailerInfo_FD1_oFD1_CAN_Rx_3abd61be
          CanIfHrhCfg_TrailerBrakeInfo_FD1_oFD1_CAN_Rx_3abd61be: CanIfHrhSoftwareFilter=false, CanIfHrhIdSymRef=CanHardwareObject_TrailerBrakeInfo_FD1_oFD1_CAN_Rx_3abd61be
          CanIfHrhCfg_BrakeSysFeatures_FD1_oFD1_CAN_Rx_3abd61be: CanIfHrhSoftwareFilter=false, CanIfHrhIdSymRef=CanHardwareObject_BrakeSysFeatures_FD1_oFD1_CAN_Rx_3abd61be
          CanIfHrhCfg_VehicleOperatingModes_FD1_oFD1_CAN_Rx_3abd61be: CanIfHrhSoftwareFilter=false, CanIfHrhIdSymRef=CanHardwareObject_VehicleOperatingModes_FD1_oFD1_CAN_Rx_3abd61be
          CanIfHrhCfg_TrailerAid_Stat2_FD1_oFD1_CAN_Rx_3abd61be: CanIfHrhSoftwareFilter=false, CanIfHrhIdSymRef=CanHardwareObject_TrailerAid_Stat2_FD1_oFD1_CAN_Rx_3abd61be
          CanIfHrhCfg_TrailerAid_Data_FD1_oFD1_CAN_Rx_3abd61be: CanIfHrhSoftwareFilter=false, CanIfHrhIdSymRef=CanHardwareObject_TrailerAid_Data_FD1_oFD1_CAN_Rx_3abd61be
          CanIfHrhCfg_Mc_Send_Signals_2_FD1_oFD1_CAN_Rx_3abd61be: CanIfHrhSoftwareFilter=false, CanIfHrhIdSymRef=CanHardwareObject_Mc_Send_Signals_2_FD1_oFD1_CAN_Rx_3abd61be
          CanIfHrhCfg_Lane_Assist_Data1_FD1_oFD1_CAN_Rx_3abd61be: CanIfHrhSoftwareFilter=false, CanIfHrhIdSymRef=CanHardwareObject_Lane_Assist_Data1_FD1_oFD1_CAN_Rx_3abd61be
          CanIfHrhCfg_Steering_Data_FD1_oFD1_CAN_Rx_3abd61be: CanIfHrhSoftwareFilter=false, CanIfHrhIdSymRef=CanHardwareObject_Steering_Data_FD1_oFD1_CAN_Rx_3abd61be
          CanIfHrhCfg_PowertrainData_10_FD1_oFD1_CAN_Rx_3abd61be: CanIfHrhSoftwareFilter=false, CanIfHrhIdSymRef=CanHardwareObject_PowertrainData_10_FD1_oFD1_CAN_Rx_3abd61be
          CanIfHrhCfg_DesiredTorqBrk_FD1_oFD1_CAN_Rx_3abd61be: CanIfHrhSoftwareFilter=false, CanIfHrhIdSymRef=CanHardwareObject_DesiredTorqBrk_FD1_oFD1_CAN_Rx_3abd61be
          CanIfHrhCfg_Climate_Control_Data_FD1_oFD1_CAN_Rx_3abd61be: CanIfHrhSoftwareFilter=false, CanIfHrhIdSymRef=CanHardwareObject_Climate_Control_Data_FD1_oFD1_CAN_Rx_3abd61be
          CanIfHrhCfg_GGCC_Config_Mgmt_ID_1_FD1_oFD1_CAN_Rx_3abd61be: CanIfHrhSoftwareFilter=false, CanIfHrhIdSymRef=CanHardwareObject_GGCC_Config_Mgmt_ID_1_FD1_oFD1_CAN_Rx_3abd61be
          CanIfHrhCfg_EngVehicleSpThrottle2_FD1_oFD1_CAN_Rx_3abd61be: CanIfHrhSoftwareFilter=false, CanIfHrhIdSymRef=CanHardwareObject_EngVehicleSpThrottle2_FD1_oFD1_CAN_Rx_3abd61be
          CanIfHrhCfg_TrailerInfo_2_FD1_oFD1_CAN_Rx_3abd61be: CanIfHrhSoftwareFilter=false, CanIfHrhIdSymRef=CanHardwareObject_TrailerInfo_2_FD1_oFD1_CAN_Rx_3abd61be
          CanIfHrhCfg_TrailerAid_Stat3_FD1_oFD1_CAN_Rx_3abd61be: CanIfHrhSoftwareFilter=false, CanIfHrhIdSymRef=CanHardwareObject_TrailerAid_Stat3_FD1_oFD1_CAN_Rx_3abd61be
          CanIfHrhCfg_WheelData_FD1_oFD1_CAN_Rx_3abd61be: CanIfHrhSoftwareFilter=false, CanIfHrhIdSymRef=CanHardwareObject_WheelData_FD1_oFD1_CAN_Rx_3abd61be
          CanIfHrhCfg_TransGearData_FD1_oFD1_CAN_Rx_3abd61be: CanIfHrhSoftwareFilter=false, CanIfHrhIdSymRef=CanHardwareObject_TransGearData_FD1_oFD1_CAN_Rx_3abd61be
          CanIfHrhCfg_TrailerAid_Stat1_FD1_oFD1_CAN_Rx_3abd61be: CanIfHrhSoftwareFilter=false, CanIfHrhIdSymRef=CanHardwareObject_TrailerAid_Stat1_FD1_oFD1_CAN_Rx_3abd61be
          CanIfHrhCfg_TrailerAid_Data3_FD1_oFD1_CAN_Rx_3abd61be: CanIfHrhSoftwareFilter=false, CanIfHrhIdSymRef=CanHardwareObject_TrailerAid_Data3_FD1_oFD1_CAN_Rx_3abd61be
          CanIfHrhCfg_LateralMotionControl_FD1_oFD1_CAN_Rx_3abd61be: CanIfHrhSoftwareFilter=false, CanIfHrhIdSymRef=CanHardwareObject_LateralMotionControl_FD1_oFD1_CAN_Rx_3abd61be
          CanIfHrhCfg_Image_Processing_Data_FD1_oFD1_CAN_Rx_3abd61be: CanIfHrhSoftwareFilter=false, CanIfHrhIdSymRef=CanHardwareObject_Image_Processing_Data_FD1_oFD1_CAN_Rx_3abd61be
          CanIfHrhCfg_Steer_Assist_Data_FD1_oFD1_CAN_Rx_3abd61be: CanIfHrhSoftwareFilter=false, CanIfHrhIdSymRef=CanHardwareObject_Steer_Assist_Data_FD1_oFD1_CAN_Rx_3abd61be
          CanIfHrhCfg_ParkAid_Data_FD1_oFD1_CAN_Rx_3abd61be: CanIfHrhSoftwareFilter=false, CanIfHrhIdSymRef=CanHardwareObject_ParkAid_Data_FD1_oFD1_CAN_Rx_3abd61be
          CanIfHrhCfg_Cluster_Info1_FD1_oFD1_CAN_Rx_3abd61be: CanIfHrhSoftwareFilter=false, CanIfHrhIdSymRef=CanHardwareObject_Cluster_Info1_FD1_oFD1_CAN_Rx_3abd61be
          CanIfHrhCfg_CanIfRxPduCfg_Nm_Dummy: CanIfHrhSoftwareFilter=false, CanIfHrhIdSymRef=CanHardwareObject_CanIfRxPduCfg_Nm_Dummy
          CanIfHrhCfg_EngVehicleSpThrottle_FD1_oFD1_CAN_Rx_3abd61be: CanIfHrhSoftwareFilter=false, CanIfHrhIdSymRef=CanHardwareObject_EngVehicleSpThrottle_FD1_oFD1_CAN_Rx_3abd61be
          CanIfHrhCfg_EngBrakeData_FD1_oFD1_CAN_Rx_3abd61be: CanIfHrhSoftwareFilter=false, CanIfHrhIdSymRef=CanHardwareObject_EngBrakeData_FD1_oFD1_CAN_Rx_3abd61be
      TesterPhysicalReqPSCM_FD1_Tp_oFD1_CAN_20_Rx_3abd61be (CanIfRxPduCfg):
        CanIfRxPduCanId = 1840 if post-build-variant-condition{matching-criterion=Communication, value=0}
        CanIfRxPduCanIdType = STANDARD_NO_FD_CAN
        CanIfRxPduDlc = 8
        CanIfRxPduUserRxIndicationName = CanTp_RxIndication
        CanIfRxPduUserRxIndicationType = PDUID_PDUINFOPTR
        CanIfRxPduUserRxIndicationUL = CAN_TP
        CanIfRxPduId = 30
        CanIfRxPduReadData = false
        CanIfRxPduReadNotifyStatus = false
        CanIfRxPduDlcCheck = true
        CanIfRxPduCanId = 1630 if post-build-variant-condition{matching-criterion=Communication, value=1}
        CanIfRxPduHrhIdRef = CN_FD1_CAN_b4e1ca3b_Rx_Std
        CanIfRxPduRef = PT_TesterPhysicalReqPSCM_FD1_Tp_20_PP_TesterPhysicalReqPSCM_FD1_Tp_Rx_20_3290b631_3cf8f7d5
      TesterPhysicalResPSCM_FD1_Tp_oFD1_CAN_Tx_3abd61be (CanIfTxPduCfg):
        CanIfTxPduCanId = 1848 if post-build-variant-condition{matching-criterion=Communication, value=0}
        CanIfTxPduCanIdType = STANDARD_FD_CAN
        CanIfTxPduDlc = 64
        CanIfTxPduUserTxConfirmationName = CanTp_TxConfirmation
        CanIfTxPduUserTxConfirmationUL = CAN_TP
        CanIfTxPduId = 5
        CanIfTxPduReadNotifyStatus = false
        CanIfTxPduType = STATIC
        CanIfTxPduCanId = 1631 if post-build-variant-condition{matching-criterion=Communication, value=1}
        CanIfTxPduBufferRef = CanIfBufferCfg_Tx_Std_3290b631
        CanIfTxPduRef = PT_TesterPhysicalResPSCM_FD1_Tp_PP_TesterPhysicalResPSCM_FD1_Tp_Tx_3290b631_3cf8f7d5
      5 x CanIfRxPduCfg, all with CanIfRxPduCanIdType=STANDARD_CAN, CanIfRxPduDlc=8, CanIfRxPduUserRxIndicationName=PduR_CanIfRxIndication, CanIfRxPduUserRxIndicationUL=PDUR, CanIfRxPduReadData=false, CanIfRxPduReadNotifyStatus=false, CanIfRxPduDlcCheck=true:
        DesiredTorqBrk_FD1_oFD1_CAN_Rx_3abd61be: CanIfRxPduCanId=531, CanIfRxPduId=15, CanIfRxPduHrhIdRef=CanIfHrhCfg_DesiredTorqBrk_FD1_oFD1_CAN_Rx_3abd61be, CanIfRxPduRef=PT_DesiredTorqBrk_FD1_PP_DesiredTorqBrk_FD1_Rx_3290b631_3cf8f7d5
        TrailerInfo_2_FD1_oFD1_CAN_Rx_3abd61be: CanIfRxPduCanId=1146, CanIfRxPduId=38, CanIfRxPduHrhIdRef=CanIfHrhCfg_TrailerInfo_2_FD1_oFD1_CAN_Rx_3abd61be, CanIfRxPduRef=PT_TrailerInfo_2_FD1_PP_TrailerInfo_2_FD1_Rx_3290b631_3cf8f7d5
        WheelData_FD1_oFD1_CAN_Rx_3abd61be: CanIfRxPduCanId=534, CanIfRxPduId=42, CanIfRxPduHrhIdRef=CanIfHrhCfg_WheelData_FD1_oFD1_CAN_Rx_3abd61be, CanIfRxPduRef=PT_WheelData_FD1_PP_WheelData_FD1_Rx_3290b631_3cf8f7d5
        Steering_Data_FD1_oFD1_CAN_Rx_3abd61be: CanIfRxPduCanId=131, CanIfRxPduId=27, CanIfRxPduHrhIdRef=CanIfHrhCfg_Steering_Data_FD1_oFD1_CAN_Rx_3abd61be, CanIfRxPduRef=PT_Steering_Data_FD1_PP_Steering_Data_FD1_Rx_3290b631_3cf8f7d5
        APIM_Send_Signals1_FD1_oFD1_CAN_Rx_3abd61be: CanIfRxPduCanId=1009, CanIfRxPduId=1, CanIfRxPduHrhIdRef=CanIfHrhCfg_APIM_Send_Signals1_FD1_oFD1_CAN_Rx_3abd61be, CanIfRxPduRef=PT_APIM_Send_Signals1_FD1_PP_APIM_Send_Signals1_FD1_Rx_3290b631_3cf8f7d5
      SteeringPinion_Data_FD1_oFD1_CAN_Tx_3abd61be (CanIfTxPduCfg):
        CanIfTxPduCanId = 126 if post-build-variant-condition{matching-criterion=Communication, value=0}
        CanIfTxPduCanIdType = STANDARD_FD_CAN
        CanIfTxPduDlc = 8
        CanIfTxPduUserTxConfirmationName = NULL_PTR
        CanIfTxPduUserTxConfirmationUL = NONE
        CanIfTxPduId = 3
        CanIfTxPduReadNotifyStatus = false
        CanIfTxPduType = STATIC
        CanIfTxPduCanId = 382 if post-build-variant-condition{matching-criterion=Communication, value=1}
        CanIfTxPduBufferRef = CanIfBufferCfg_Tx_Std_3290b631
        CanIfTxPduRef = PT_SteeringPinion_Data_FD1_PP_SteeringPinion_Data_FD1_Tx_3290b631_3cf8f7d5
      5 x CanIfRxPduCfg, all with CanIfRxPduCanIdType=STANDARD_CAN, CanIfRxPduDlc=8, CanIfRxPduUserRxIndicationName=PduR_CanIfRxIndication, CanIfRxPduUserRxIndicationUL=PDUR, CanIfRxPduReadData=false, CanIfRxPduReadNotifyStatus=false, CanIfRxPduDlcCheck=true:
        EngVehicleSpThrottle_FD1_oFD1_CAN_Rx_3abd61be: CanIfRxPduCanId=516, CanIfRxPduId=18, CanIfRxPduHrhIdRef=CanIfHrhCfg_EngVehicleSpThrottle_FD1_oFD1_CAN_Rx_3abd61be, CanIfRxPduRef=PT_EngVehicleSpThrottle_FD1_PP_EngVehicleSpThrottle_FD1_Rx_3290b631_3cf8f7d5
        ParkAid_Data_FD1_oFD1_CAN_Rx_3abd61be: CanIfRxPduCanId=936, CanIfRxPduId=24, CanIfRxPduHrhIdRef=CanIfHrhCfg_ParkAid_Data_FD1_oFD1_CAN_Rx_3abd61be, CanIfRxPduRef=PT_ParkAid_Data_FD1_PP_ParkAid_Data_FD1_Rx_3290b631_3cf8f7d5
        TransGearData_FD1_oFD1_CAN_Rx_3abd61be: CanIfRxPduCanId=560, CanIfRxPduId=40, CanIfRxPduHrhIdRef=CanIfHrhCfg_TransGearData_FD1_oFD1_CAN_Rx_3abd61be, CanIfRxPduRef=PT_TransGearData_FD1_PP_TransGearData_FD1_Rx_3290b631_3cf8f7d5
        LateralMotionControl_FD1_oFD1_CAN_Rx_3abd61be: CanIfRxPduCanId=979, CanIfRxPduId=22, CanIfRxPduHrhIdRef=CanIfHrhCfg_LateralMotionControl_FD1_oFD1_CAN_Rx_3abd61be, CanIfRxPduRef=PT_LateralMotionControl_FD1_PP_LateralMotionControl_FD1_Rx_3290b631_3cf8f7d5
        BrakeSysFeatures_FD1_oFD1_CAN_Rx_3abd61be: CanIfRxPduCanId=1045, CanIfRxPduId=11, CanIfRxPduHrhIdRef=CanIfHrhCfg_BrakeSysFeatures_FD1_oFD1_CAN_Rx_3abd61be, CanIfRxPduRef=PT_BrakeSysFeatures_FD1_PP_BrakeSysFeatures_FD1_Rx_3290b631_3cf8f7d5
      TrailerAid_Data2_FD1_oFD1_CAN_Tx_3abd61be (CanIfTxPduCfg):
        CanIfTxPduCanId = 1047 if post-build-variant-condition{matching-criterion=Communication, value=0}
        CanIfTxPduCanIdType = STANDARD_FD_CAN
        CanIfTxPduDlc = 8
        CanIfTxPduUserTxConfirmationName = PduR_CanIfTxConfirmation
        CanIfTxPduUserTxConfirmationUL = PDUR
        CanIfTxPduId = 6
        CanIfTxPduReadNotifyStatus = false
        CanIfTxPduType = STATIC
        CanIfTxPduCanId = 1303 if post-build-variant-condition{matching-criterion=Communication, value=1}
        CanIfTxPduBufferRef = CanIfBufferCfg_Tx_Std_3290b631
        CanIfTxPduRef = PT_TrailerAid_Data2_FD1_PP_TrailerAid_Data2_FD1_Tx_3290b631_3cf8f7d5
      14 x CanIfRxPduCfg, all with CanIfRxPduReadData=false, CanIfRxPduReadNotifyStatus=false:
        Body_Info_4_FD1_oFD1_CAN_Rx_3abd61be: CanIfRxPduCanId=578, CanIfRxPduCanIdType=STANDARD_CAN, CanIfRxPduDlc=8, CanIfRxPduUserRxIndicationName=PduR_CanIfRxIndication, CanIfRxPduUserRxIndicationUL=PDUR, CanIfRxPduId=5, CanIfRxPduDlcCheck=true, CanIfRxPduHrhIdRef=CanIfHrhCfg_Body_Info_4_FD1_oFD1_CAN_Rx_3abd61be, CanIfRxPduRef=PT_Body_Info_4_FD1_PP_Body_Info_4_FD1_Rx_3290b631_3cf8f7d5
        TrailerAid_Data_FD1_oFD1_CAN_Rx_3abd61be: CanIfRxPduCanId=1114, CanIfRxPduCanIdType=STANDARD_CAN, CanIfRxPduDlc=8, CanIfRxPduUserRxIndicationName=PduR_CanIfRxIndication, CanIfRxPduUserRxIndicationUL=PDUR, CanIfRxPduId=33, CanIfRxPduDlcCheck=true, CanIfRxPduHrhIdRef=CanIfHrhCfg_TrailerAid_Data_FD1_oFD1_CAN_Rx_3abd61be, CanIfRxPduRef=PT_TrailerAid_Data_FD1_PP_TrailerAid_Data_FD1_Rx_3290b631_3cf8f7d5
        EngBrakeData_FD1_oFD1_CAN_Rx_3abd61be: CanIfRxPduCanId=357, CanIfRxPduCanIdType=STANDARD_CAN, CanIfRxPduDlc=8, CanIfRxPduUserRxIndicationName=PduR_CanIfRxIndication, CanIfRxPduUserRxIndicationUL=PDUR, CanIfRxPduId=16, CanIfRxPduDlcCheck=true, CanIfRxPduHrhIdRef=CanIfHrhCfg_EngBrakeData_FD1_oFD1_CAN_Rx_3abd61be, CanIfRxPduRef=PT_EngBrakeData_FD1_PP_EngBrakeData_FD1_Rx_3290b631_3cf8f7d5
        TesterPhysicalReqPSCM_FD1_Tp_oFD1_CAN_Rx_3abd61be: CanIfRxPduCanId=1840 if post-build-variant-condition{matching-criterion=Communication, value=0}, CanIfRxPduCanIdType=STANDARD_FD_CAN, CanIfRxPduDlc=64, CanIfRxPduUserRxIndicationName=CanTp_RxIndication, CanIfRxPduUserRxIndicationType=PDUID_PDUINFOPTR, CanIfRxPduUserRxIndicationUL=CAN_TP, CanIfRxPduId=31, CanIfRxPduDlcCheck=false, CanIfRxPduCanId=1630 if post-build-variant-condition{matching-criterion=Communication, value=1}, CanIfRxPduHrhIdRef=CN_FD1_CAN_b4e1ca3b_Rx_Std, CanIfRxPduRef=PT_TesterPhysicalReqPSCM_FD1_Tp_PP_TesterPhysicalReqPSCM_FD1_Tp_Rx_3290b631_3cf8f7d5
        EngVehicleSpThrottle2_FD1_oFD1_CAN_Rx_3abd61be: CanIfRxPduCanId=514, CanIfRxPduCanIdType=STANDARD_CAN, CanIfRxPduDlc=8, CanIfRxPduUserRxIndicationName=PduR_CanIfRxIndication, CanIfRxPduUserRxIndicationUL=PDUR, CanIfRxPduId=17, CanIfRxPduDlcCheck=true, CanIfRxPduHrhIdRef=CanIfHrhCfg_EngVehicleSpThrottle2_FD1_oFD1_CAN_Rx_3abd61be, CanIfRxPduRef=PT_EngVehicleSpThrottle2_FD1_PP_EngVehicleSpThrottle2_FD1_Rx_3290b631_3cf8f7d5
        GGCC_Config_Mgmt_ID_1_FD1_oFD1_CAN_Rx_3abd61be: CanIfRxPduCanId=1034, CanIfRxPduCanIdType=STANDARD_CAN, CanIfRxPduDlc=8, CanIfRxPduUserRxIndicationName=PduR_CanIfRxIndication, CanIfRxPduUserRxIndicationUL=PDUR, CanIfRxPduId=19, CanIfRxPduDlcCheck=true, CanIfRxPduHrhIdRef=CanIfHrhCfg_GGCC_Config_Mgmt_ID_1_FD1_oFD1_CAN_Rx_3abd61be, CanIfRxPduRef=PT_GGCC_Config_Mgmt_ID_1_FD1_PP_GGCC_Config_Mgmt_ID_1_FD1_Rx_3290b631_3cf8f7d5
        Steer_Assist_Data_FD1_oFD1_CAN_Rx_3abd61be: CanIfRxPduCanId=983, CanIfRxPduCanIdType=STANDARD_CAN, CanIfRxPduDlc=8, CanIfRxPduUserRxIndicationName=PduR_CanIfRxIndication, CanIfRxPduUserRxIndicationUL=PDUR, CanIfRxPduId=26, CanIfRxPduDlcCheck=true, CanIfRxPduHrhIdRef=CanIfHrhCfg_Steer_Assist_Data_FD1_oFD1_CAN_Rx_3abd61be, CanIfRxPduRef=PT_Steer_Assist_Data_FD1_PP_Steer_Assist_Data_FD1_Rx_3290b631_3cf8f7d5
        Cluster_Info1_FD1_oFD1_CAN_Rx_3abd61be: CanIfRxPduCanId=1072, CanIfRxPduCanIdType=STANDARD_CAN, CanIfRxPduDlc=8, CanIfRxPduUserRxIndicationName=PduR_CanIfRxIndication, CanIfRxPduUserRxIndicationUL=PDUR, CanIfRxPduId=14, CanIfRxPduDlcCheck=true, CanIfRxPduHrhIdRef=CanIfHrhCfg_Cluster_Info1_FD1_oFD1_CAN_Rx_3abd61be, CanIfRxPduRef=PT_Cluster_Info1_FD1_PP_Cluster_Info1_FD1_Rx_3290b631_3cf8f7d5
        WheelSpeed_FD1_oFD1_CAN_Rx_3abd61be: CanIfRxPduCanId=535, CanIfRxPduCanIdType=STANDARD_CAN, CanIfRxPduDlc=8, CanIfRxPduUserRxIndicationName=PduR_CanIfRxIndication, CanIfRxPduUserRxIndicationUL=PDUR, CanIfRxPduId=43, CanIfRxPduDlcCheck=true, CanIfRxPduHrhIdRef=CanIfHrhCfg_WheelSpeed_FD1_oFD1_CAN_Rx_3abd61be, CanIfRxPduRef=PT_WheelSpeed_FD1_PP_WheelSpeed_FD1_Rx_3290b631_3cf8f7d5
        ActiveFrontStrg_Stat2_FD1_oFD1_CAN_Rx_3abd61be: CanIfRxPduCanId=138, CanIfRxPduCanIdType=STANDARD_CAN, CanIfRxPduDlc=8, CanIfRxPduUserRxIndicationName=PduR_CanIfRxIndication, CanIfRxPduUserRxIndicationUL=PDUR, CanIfRxPduId=3, CanIfRxPduDlcCheck=true, CanIfRxPduHrhIdRef=CanIfHrhCfg_ActiveFrontStrg_Stat2_FD1_oFD1_CAN_Rx_3abd61be, CanIfRxPduRef=PT_ActiveFrontStrg_Stat2_FD1_PP_ActiveFrontStrg_Stat2_FD1_Rx_3290b631_3cf8f7d5
        PowertrainData_10_FD1_oFD1_CAN_Rx_3abd61be: CanIfRxPduCanId=374, CanIfRxPduCanIdType=STANDARD_CAN, CanIfRxPduDlc=8, CanIfRxPduUserRxIndicationName=PduR_CanIfRxIndication, CanIfRxPduUserRxIndicationUL=PDUR, CanIfRxPduId=25, CanIfRxPduDlcCheck=true, CanIfRxPduHrhIdRef=CanIfHrhCfg_PowertrainData_10_FD1_oFD1_CAN_Rx_3abd61be, CanIfRxPduRef=PT_PowertrainData_10_FD1_PP_PowertrainData_10_FD1_Rx_3290b631_3cf8f7d5
        TesterFunctionalReq_FD1_Tp_oFD1_CAN_20_Rx_3abd61be: CanIfRxPduCanId=2015 if post-build-variant-condition{matching-criterion=Communication, value=0}, CanIfRxPduCanIdType=STANDARD_NO_FD_CAN, CanIfRxPduDlc=8, CanIfRxPduUserRxIndicationName=CanTp_RxIndication, CanIfRxPduUserRxIndicationType=PDUID_PDUINFOPTR, CanIfRxPduUserRxIndicationUL=CAN_TP, CanIfRxPduId=28, CanIfRxPduDlcCheck=true, CanIfRxPduCanId=1759 if post-build-variant-condition{matching-criterion=Communication, value=1}, CanIfRxPduHrhIdRef=CN_FD1_CAN_b4e1ca3b_Rx_Std, CanIfRxPduRef=PT_TesterFunctionalReq_FD1_Tp_20_PP_TesterFunctionalReq_FD1_Tp_Rx_20_3290b631_3cf8f7d5
        TrailerAid_Data3_FD1_oFD1_CAN_Rx_3abd61be: CanIfRxPduCanId=1116, CanIfRxPduCanIdType=STANDARD_CAN, CanIfRxPduDlc=8, CanIfRxPduUserRxIndicationName=PduR_CanIfRxIndication, CanIfRxPduUserRxIndicationUL=PDUR, CanIfRxPduId=32, CanIfRxPduDlcCheck=true, CanIfRxPduHrhIdRef=CanIfHrhCfg_TrailerAid_Data3_FD1_oFD1_CAN_Rx_3abd61be, CanIfRxPduRef=PT_TrailerAid_Data3_FD1_PP_TrailerAid_Data3_FD1_Rx_3290b631_3cf8f7d5
        VehicleOperatingModes_FD1_oFD1_CAN_Rx_3abd61be: CanIfRxPduCanId=359, CanIfRxPduCanIdType=STANDARD_CAN, CanIfRxPduDlc=8, CanIfRxPduUserRxIndicationName=PduR_CanIfRxIndication, CanIfRxPduUserRxIndicationUL=PDUR, CanIfRxPduId=41, CanIfRxPduDlcCheck=true, CanIfRxPduHrhIdRef=CanIfHrhCfg_VehicleOperatingModes_FD1_oFD1_CAN_Rx_3abd61be, CanIfRxPduRef=PT_VehicleOperatingModes_FD1_PP_VehicleOperatingModes_FD1_Rx_3290b631_3cf8f7d5
      EPAS_INFO_FD1_oFD1_CAN_Tx_3abd61be (CanIfTxPduCfg):
        CanIfTxPduCanId = 130 if post-build-variant-condition{matching-criterion=Communication, value=0}
        CanIfTxPduCanIdType = STANDARD_FD_CAN
        CanIfTxPduDlc = 8
        CanIfTxPduUserTxConfirmationName = PduR_CanIfTxConfirmation
        CanIfTxPduUserTxConfirmationUL = PDUR
        CanIfTxPduId = 0
        CanIfTxPduReadNotifyStatus = false
        CanIfTxPduType = STATIC
        CanIfTxPduCanId = 386 if post-build-variant-condition{matching-criterion=Communication, value=1}
        CanIfTxPduBufferRef = CanIfBufferCfg_Tx_Std_3290b631
        CanIfTxPduRef = PT_EPAS_INFO_FD1_PP_EPAS_INFO_FD1_Tx_3290b631_3cf8f7d5
      3 x CanIfRxPduCfg, all with CanIfRxPduCanIdType=STANDARD_CAN, CanIfRxPduDlc=8, CanIfRxPduUserRxIndicationName=PduR_CanIfRxIndication, CanIfRxPduUserRxIndicationUL=PDUR, CanIfRxPduReadData=false, CanIfRxPduReadNotifyStatus=false, CanIfRxPduDlcCheck=true:
        BodyInfo_3_FD1_oFD1_CAN_Rx_3abd61be: CanIfRxPduCanId=947, CanIfRxPduId=4, CanIfRxPduHrhIdRef=CanIfHrhCfg_BodyInfo_3_FD1_oFD1_CAN_Rx_3abd61be, CanIfRxPduRef=PT_BodyInfo_3_FD1_PP_BodyInfo_3_FD1_Rx_3290b631_3cf8f7d5
        BrakeSysFeatures_3_oFD1_CAN_Rx_3abd61be: CanIfRxPduCanId=1054, CanIfRxPduId=10, CanIfRxPduHrhIdRef=CanIfHrhCfg_BrakeSysFeatures_3_oFD1_CAN_Rx_3abd61be, CanIfRxPduRef=PT_BrakeSysFeatures_3_PP_BrakeSysFeatures_3_Rx_3290b631_3cf8f7d5
        TrailerAid_Stat1_FD1_oFD1_CAN_Rx_3abd61be: CanIfRxPduCanId=1106, CanIfRxPduId=34, CanIfRxPduHrhIdRef=CanIfHrhCfg_TrailerAid_Stat1_FD1_oFD1_CAN_Rx_3abd61be, CanIfRxPduRef=PT_TrailerAid_Stat1_FD1_PP_TrailerAid_Stat1_FD1_Rx_3290b631_3cf8f7d5
      Lane_Assist_Data3_FD1_oFD1_CAN_Tx_3abd61be (CanIfTxPduCfg):
        CanIfTxPduCanId = 972 if post-build-variant-condition{matching-criterion=Communication, value=0}
        CanIfTxPduCanIdType = STANDARD_FD_CAN
        CanIfTxPduDlc = 8
        CanIfTxPduUserTxConfirmationName = PduR_CanIfTxConfirmation
        CanIfTxPduUserTxConfirmationUL = PDUR
        CanIfTxPduId = 1
        CanIfTxPduReadNotifyStatus = false
        CanIfTxPduType = STATIC
        CanIfTxPduCanId = 1228 if post-build-variant-condition{matching-criterion=Communication, value=1}
        CanIfTxPduBufferRef = CanIfBufferCfg_Tx_Std_3290b631
        CanIfTxPduRef = PT_Lane_Assist_Data3_FD1_PP_Lane_Assist_Data3_FD1_Tx_3290b631_3cf8f7d5
      7 x CanIfRxPduCfg, all with CanIfRxPduReadData=false, CanIfRxPduReadNotifyStatus=false:
        TesterFunctionalReq_FD1_Tp_oFD1_CAN_Rx_3abd61be: CanIfRxPduCanId=2015 if post-build-variant-condition{matching-criterion=Communication, value=0}, CanIfRxPduCanIdType=STANDARD_FD_CAN, CanIfRxPduDlc=64, CanIfRxPduUserRxIndicationName=CanTp_RxIndication, CanIfRxPduUserRxIndicationType=PDUID_PDUINFOPTR, CanIfRxPduUserRxIndicationUL=CAN_TP, CanIfRxPduId=29, CanIfRxPduDlcCheck=false, CanIfRxPduCanId=1759 if post-build-variant-condition{matching-criterion=Communication, value=1}, CanIfRxPduHrhIdRef=CN_FD1_CAN_b4e1ca3b_Rx_Std, CanIfRxPduRef=PT_TesterFunctionalReq_FD1_Tp_PP_TesterFunctionalReq_FD1_Tp_Rx_3290b631_3cf8f7d5
        TrailerInfo_FD1_oFD1_CAN_Rx_3abd61be: CanIfRxPduCanId=1091, CanIfRxPduCanIdType=STANDARD_CAN, CanIfRxPduDlc=8, CanIfRxPduUserRxIndicationName=PduR_CanIfRxIndication, CanIfRxPduUserRxIndicationUL=PDUR, CanIfRxPduId=39, CanIfRxPduDlcCheck=true, CanIfRxPduHrhIdRef=CanIfHrhCfg_TrailerInfo_FD1_oFD1_CAN_Rx_3abd61be, CanIfRxPduRef=PT_TrailerInfo_FD1_PP_TrailerInfo_FD1_Rx_3290b631_3cf8f7d5
        TrailerBrakeInfo_FD1_oFD1_CAN_Rx_3abd61be: CanIfRxPduCanId=1093, CanIfRxPduCanIdType=STANDARD_CAN, CanIfRxPduDlc=8, CanIfRxPduUserRxIndicationName=PduR_CanIfRxIndication, CanIfRxPduUserRxIndicationUL=PDUR, CanIfRxPduId=37, CanIfRxPduDlcCheck=true, CanIfRxPduHrhIdRef=CanIfHrhCfg_TrailerBrakeInfo_FD1_oFD1_CAN_Rx_3abd61be, CanIfRxPduRef=PT_TrailerBrakeInfo_FD1_PP_TrailerBrakeInfo_FD1_Rx_3290b631_3cf8f7d5
        TrailerAid_Stat3_FD1_oFD1_CAN_Rx_3abd61be: CanIfRxPduCanId=1113, CanIfRxPduCanIdType=STANDARD_CAN, CanIfRxPduDlc=8, CanIfRxPduUserRxIndicationName=PduR_CanIfRxIndication, CanIfRxPduUserRxIndicationUL=PDUR, CanIfRxPduId=36, CanIfRxPduDlcCheck=true, CanIfRxPduHrhIdRef=CanIfHrhCfg_TrailerAid_Stat3_FD1_oFD1_CAN_Rx_3abd61be, CanIfRxPduRef=PT_TrailerAid_Stat3_FD1_PP_TrailerAid_Stat3_FD1_Rx_3290b631_3cf8f7d5
        BrakeSnData_6_FD1_oFD1_CAN_Rx_3abd61be: CanIfRxPduCanId=1044, CanIfRxPduCanIdType=STANDARD_CAN, CanIfRxPduDlc=8, CanIfRxPduUserRxIndicationName=PduR_CanIfRxIndication, CanIfRxPduUserRxIndicationUL=PDUR, CanIfRxPduId=9, CanIfRxPduDlcCheck=true, CanIfRxPduHrhIdRef=CanIfHrhCfg_BrakeSnData_6_FD1_oFD1_CAN_Rx_3abd61be, CanIfRxPduRef=PT_BrakeSnData_6_FD1_PP_BrakeSnData_6_FD1_Rx_3290b631_3cf8f7d5
        Mc_Send_Signals_2_FD1_oFD1_CAN_Rx_3abd61be: CanIfRxPduCanId=765, CanIfRxPduCanIdType=STANDARD_CAN, CanIfRxPduDlc=8, CanIfRxPduUserRxIndicationName=PduR_CanIfRxIndication, CanIfRxPduUserRxIndicationUL=PDUR, CanIfRxPduId=23, CanIfRxPduDlcCheck=true, CanIfRxPduHrhIdRef=CanIfHrhCfg_Mc_Send_Signals_2_FD1_oFD1_CAN_Rx_3abd61be, CanIfRxPduRef=PT_Mc_Send_Signals_2_FD1_PP_Mc_Send_Signals_2_FD1_Rx_3290b631_3cf8f7d5
        APIM_Send_Signals_2_FD1_oFD1_CAN_Rx_3abd61be: CanIfRxPduCanId=533, CanIfRxPduCanIdType=STANDARD_CAN, CanIfRxPduDlc=8, CanIfRxPduUserRxIndicationName=PduR_CanIfRxIndication, CanIfRxPduUserRxIndicationUL=PDUR, CanIfRxPduId=2, CanIfRxPduDlcCheck=true, CanIfRxPduHrhIdRef=CanIfHrhCfg_APIM_Send_Signals_2_FD1_oFD1_CAN_Rx_3abd61be, CanIfRxPduRef=PT_APIM_Send_Signals_2_FD1_PP_APIM_Send_Signals_2_FD1_Rx_3290b631_3cf8f7d5
      PSCM_AutoSar_NetwrkMgt_FD1_oFD1_CAN_Tx_3abd61be (CanIfTxPduCfg):
        CanIfTxPduCanId = 1461 if post-build-variant-condition{matching-criterion=Communication, value=0}
        CanIfTxPduCanIdType = STANDARD_FD_CAN
        CanIfTxPduDlc = 8
        CanIfTxPduUserTxConfirmationName = CanNm_TxConfirmation
        CanIfTxPduUserTxConfirmationUL = CAN_NM
        CanIfTxPduId = 2
        CanIfTxPduReadNotifyStatus = false
        CanIfTxPduType = STATIC
        CanIfTxPduCanId = 1717 if post-build-variant-condition{matching-criterion=Communication, value=1}
        CanIfTxPduBufferRef = CanIfBufferCfg_Tx_Std_3290b631
        CanIfTxPduRef = PSCM_AutoSar_NetwrkMgt_FD1_9b1e365c
      Climate_Control_Data_FD1_oFD1_CAN_Rx_3abd61be (CanIfRxPduCfg):
        CanIfRxPduCanId = 1050
        CanIfRxPduCanIdType = STANDARD_CAN
        CanIfRxPduDlc = 8
        CanIfRxPduUserRxIndicationName = PduR_CanIfRxIndication
        CanIfRxPduUserRxIndicationUL = PDUR
        CanIfRxPduId = 13
        CanIfRxPduReadData = false
        CanIfRxPduReadNotifyStatus = false
        CanIfRxPduDlcCheck = true
        CanIfRxPduHrhIdRef = CanIfHrhCfg_Climate_Control_Data_FD1_oFD1_CAN_Rx_3abd61be
        CanIfRxPduRef = PT_Climate_Control_Data_FD1_PP_Climate_Control_Data_FD1_Rx_3290b631_3cf8f7d5
      CanIfBufferCfg_Tx_Std_3290b631 (CanIfBufferCfg):
        CanIfBufferSize = 8
        CanIfTxBufferHandlingType = PRIO_BY_CANID
        CanIfTxBufferMappedTxPdus = 8
        CanIfTxBufferMaxPduLength = 64
        CanIfBufferHthRef = CN_FD1_CAN_b4e1ca3b_Tx_Std
      5 x CanIfRxPduCfg, all with CanIfRxPduCanIdType=STANDARD_CAN, CanIfRxPduDlc=8, CanIfRxPduUserRxIndicationName=PduR_CanIfRxIndication, CanIfRxPduUserRxIndicationUL=PDUR, CanIfRxPduReadData=false, CanIfRxPduReadNotifyStatus=false, CanIfRxPduDlcCheck=true:
        TrailerAid_Stat2_FD1_oFD1_CAN_Rx_3abd61be: CanIfRxPduCanId=1111, CanIfRxPduId=35, CanIfRxPduHrhIdRef=CanIfHrhCfg_TrailerAid_Stat2_FD1_oFD1_CAN_Rx_3abd61be, CanIfRxPduRef=PT_TrailerAid_Stat2_FD1_PP_TrailerAid_Stat2_FD1_Rx_3290b631_3cf8f7d5
        Image_Processing_Data_FD1_oFD1_CAN_Rx_3abd61be: CanIfRxPduCanId=1105, CanIfRxPduId=20, CanIfRxPduHrhIdRef=CanIfHrhCfg_Image_Processing_Data_FD1_oFD1_CAN_Rx_3abd61be, CanIfRxPduRef=PT_Image_Processing_Data_FD1_PP_Image_Processing_Data_FD1_Rx_3290b631_3cf8f7d5
        BrakeSnData_3_FD1_oFD1_CAN_Rx_3abd61be: CanIfRxPduCanId=119, CanIfRxPduId=6, CanIfRxPduHrhIdRef=CanIfHrhCfg_BrakeSnData_3_FD1_oFD1_CAN_Rx_3abd61be, CanIfRxPduRef=PT_BrakeSnData_3_FD1_PP_BrakeSnData_3_FD1_Rx_3290b631_3cf8f7d5
        Yaw_Data_FD1_oFD1_CAN_Rx_3abd61be: CanIfRxPduCanId=145, CanIfRxPduId=45, CanIfRxPduHrhIdRef=CanIfHrhCfg_Yaw_Data_FD1_oFD1_CAN_Rx_3abd61be, CanIfRxPduRef=PT_Yaw_Data_FD1_PP_Yaw_Data_FD1_Rx_3290b631_3cf8f7d5
        ABS_BrkBst_Data_FD1_oFD1_CAN_Rx_3abd61be: CanIfRxPduCanId=1200, CanIfRxPduId=0, CanIfRxPduHrhIdRef=CanIfHrhCfg_ABS_BrkBst_Data_FD1_oFD1_CAN_Rx_3abd61be, CanIfRxPduRef=PT_ABS_BrkBst_Data_FD1_PP_ABS_BrkBst_Data_FD1_Rx_3290b631_3cf8f7d5
      TesterPhysicalResPSCM_FD1_Tp_oFD1_CAN_20_Tx_3abd61be (CanIfTxPduCfg):
        CanIfTxPduCanId = 1848 if post-build-variant-condition{matching-criterion=Communication, value=0}
        CanIfTxPduCanIdType = STANDARD_CAN
        CanIfTxPduDlc = 8
        CanIfTxPduUserTxConfirmationName = CanTp_TxConfirmation
        CanIfTxPduUserTxConfirmationUL = CAN_TP
        CanIfTxPduId = 4
        CanIfTxPduReadNotifyStatus = false
        CanIfTxPduType = STATIC
        CanIfTxPduCanId = 1631 if post-build-variant-condition{matching-criterion=Communication, value=1}
        CanIfTxPduBufferRef = CanIfBufferCfg_Tx_Std_3290b631
        CanIfTxPduRef = PT_TesterPhysicalResPSCM_FD1_Tp_20_PP_TesterPhysicalResPSCM_FD1_Tp_Tx_20_3290b631_3cf8f7d5
      4 x CanIfRxPduCfg, all with CanIfRxPduCanIdType=STANDARD_CAN, CanIfRxPduDlc=8, CanIfRxPduReadData=false, CanIfRxPduReadNotifyStatus=false, CanIfRxPduDlcCheck=true:
        BrakeSnData_4_FD1_oFD1_CAN_Rx_3abd61be: CanIfRxPduCanId=125, CanIfRxPduUserRxIndicationName=PduR_CanIfRxIndication, CanIfRxPduUserRxIndicationUL=PDUR, CanIfRxPduId=7, CanIfRxPduHrhIdRef=CanIfHrhCfg_BrakeSnData_4_FD1_oFD1_CAN_Rx_3abd61be, CanIfRxPduRef=PT_BrakeSnData_4_FD1_PP_BrakeSnData_4_FD1_Rx_3290b631_3cf8f7d5
        Lane_Assist_Data1_FD1_oFD1_CAN_Rx_3abd61be: CanIfRxPduCanId=970, CanIfRxPduUserRxIndicationName=PduR_CanIfRxIndication, CanIfRxPduUserRxIndicationUL=PDUR, CanIfRxPduId=21, CanIfRxPduHrhIdRef=CanIfHrhCfg_Lane_Assist_Data1_FD1_oFD1_CAN_Rx_3abd61be, CanIfRxPduRef=PT_Lane_Assist_Data1_FD1_PP_Lane_Assist_Data1_FD1_Rx_3290b631_3cf8f7d5
        BrakeSnData_5_FD1_oFD1_CAN_Rx_3abd61be: CanIfRxPduCanId=118, CanIfRxPduUserRxIndicationName=PduR_CanIfRxIndication, CanIfRxPduUserRxIndicationUL=PDUR, CanIfRxPduId=8, CanIfRxPduHrhIdRef=CanIfHrhCfg_BrakeSnData_5_FD1_oFD1_CAN_Rx_3abd61be, CanIfRxPduRef=PT_BrakeSnData_5_FD1_PP_BrakeSnData_5_FD1_Rx_3290b631_3cf8f7d5
        CanIfRxPduCfg_Nm_Dummy: CanIfRxPduId=12, CanIfRxPduUserRxIndicationName=CanNm_RxIndication, CanIfRxPduUserRxIndicationUL=CAN_NM, CanIfRxPduCanId=4660, CanIfRxPduHrhIdRef=CanIfHrhCfg_CanIfRxPduCfg_Nm_Dummy, CanIfRxPduRef=Pdu_NmRx_Dummy
      Xcp_DTO_Msg_oFD1_CAN_Tx_3abd61be (CanIfTxPduCfg):
        CanIfTxPduCanId = 1547 if post-build-variant-condition{matching-criterion=Communication, value=0}
        CanIfTxPduCanIdType = STANDARD_CAN
        CanIfTxPduDlc = 8
        CanIfTxPduUserTxConfirmationName = Xcp_CanIfTxConfirmation
        CanIfTxPduUserTxConfirmationUL = XCP
        CanIfTxPduId = 7
        CanIfTxPduReadNotifyStatus = false
        CanIfTxPduType = STATIC
        CanIfTxPduCanId = 1633 if post-build-variant-condition{matching-criterion=Communication, value=1}
        CanIfTxPduBufferRef = CanIfBufferCfg_Tx_Std_3290b631
        CanIfTxPduRef = PT_Xcp_DTO_Msg_PP_Xcp_DTO_Msg_Tx_3290b631_3cf8f7d5
      Xcp_CRO_Msg_oFD1_CAN_Rx_3abd61be (CanIfRxPduCfg):
        CanIfRxPduCanId = 1546 if post-build-variant-condition{matching-criterion=Communication, value=0}
        CanIfRxPduCanIdType = STANDARD_CAN
        CanIfRxPduDlc = 8
        CanIfRxPduUserRxIndicationName = Xcp_CanIfRxIndication
        CanIfRxPduUserRxIndicationUL = XCP
        CanIfRxPduId = 44
        CanIfRxPduReadData = false
        CanIfRxPduReadNotifyStatus = false
        CanIfRxPduDlcCheck = true
        CanIfRxPduCanId = 1632 if post-build-variant-condition{matching-criterion=Communication, value=1}
        CanIfRxPduHrhIdRef = CN_FD1_CAN_b4e1ca3b_Rx_Std
        CanIfRxPduRef = PT_Xcp_CRO_Msg_PP_Xcp_CRO_Msg_Rx_3290b631_3cf8f7d5
    CanIfPrivateCfg:
      CanIfPrivateSoftwareFilterType = LINEAR
      CanIfPrivateDlcCheck = true
      CanIfSupportTTCAN = false
      CanIfTransceiverMapping = false
      CanIfTransceiverHandling = false
      CanIfSupportExtendedIds = false
      CanIfSupportNmOsek = false
      CanIfTxBufferType = BYTE_QUEUE
      CanIfOptimizeOneController = false
      CanIfWakeupSupport = false
      CanIfStaticFdTxBufferSupport = true
      CanIfRxSearchConsiderMsgType = true
      CanIfMultipleBasicCANTxObjects = false
      CanIfTxBufferFifoSupport = false
      CanIfSetPduReceptionModeSupport = false
      CanIfDataChecksumRxSupport = false
      CanIfDataChecksumTxSupport = false
    CanIfPublicCfg:
      CanIfPublicPnSupport = false
      CanIfPublicCancelTransmitSupport = false
      CanIfPublicDevErrorDetect = true
      CanIfPublicHandleTypeEnum = UINT8
      CanIfPublicMultipleDrvSupport = false
      CanIfPublicNumberOfCanHwUnits = 1
      CanIfPublicReadRxPduDataApi = false
      CanIfPublicReadRxPduNotifyStatusApi = false
      CanIfPublicReadTxPduNotifyStatusApi = false
      CanIfPublicSetDynamicTxIdApi = false
      CanIfPublicTxBuffering = true
      CanIfPublicTxConfirmPollingSupport = false
      CanIfPublicVersionInfoApi = false
      CanIfPublicWakeupCheckValidSupport = false
      CanIfPnWakeupTxPduFilterSupport = false
      CanIfPnTrcvHandlingSupport = false
      CanIfJ1939DynAddrSupport = DISABLED
      CanIfSetBaudrateApi = false
      CanIfExtendedRamCheckSupport = false
    Can (CanIfCtrlDrvCfg): CanIfCtrlDrvTxCancellation=false, CanIfCtrlDrvInitHohConfigRef=CanIfInitHohCfg, CanIfCtrlDrvNameRef=CanGeneral
      CT_FD1_CAN_b4e1ca3b (CanIfCtrlCfg): CanIfCtrlId=0, CanIfCtrlWakeupSupport=false, CanIfCtrlJ1939DynAddrSupport=DISABLED, CanIfCtrlCanCtrlRef=CT_FD1_CAN_b4e1ca3b
    CanIfTrcvDrvCfg
      CanIfTrcvCfg: CanIfTrcvId=0, CanIfTrcvWakeupSupport=false, CanIfTrcvCanTrcvRef=CanTrcvChannel
