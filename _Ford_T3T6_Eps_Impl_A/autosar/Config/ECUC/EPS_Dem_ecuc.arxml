AUTOSAR XML (schema 4-2-1)
package /ActiveEcuC
  module config Dem: implementation-config-variant=VARIANT-PRE-COMPILE, module-description=Dem_Impl
    DemGeneral:
      DemAgingCycleCounterProcessing = DEM_PROCESS_AGINGCTR_INTERN
      DemDebounceCounterBasedSupport = true
      DemDtcStatusAvailabilityMask = 255
      DemMaxNumberEventEntryMirror = 0
      DemPTOSupport = false
      DemTypeOfFreezeFrameRecordNumeration = DEM_FF_RECNUM_CONFIGURED
      DemGeneralInterfaceSupport = false
      DemClearDTCLimitation = DEM_ALL_SUPPORTED_DTCS
      DemDataElementDefaultEndianness = LITTLE_ENDIAN
      DemAgingRequieresTestedCycle = false
      DemTriggerMonitorInitBeforeClearOk = true
      DemExtendedDataCapture = DEM_TRIGGER_EVENT_MEMORY_STORAGE
      DemFreezeFrameCapture = DEM_TRIGGER_EVENT_MEMORY_STORAGE
      DemOperationCycleProcessing = DEM_PROCESS_OPCYC_STATE
      DemMaxNumberTimeSeriesSnapshots = 0
      DemEventDisplacementStrategy = DEM_DISPLACEMENT_PRIO_OCC
      DemAgingBehavior = DEM_AGING_TYPE_6
      DemAgingCounterReporting = DEM_AGING_ZERO_AS_ONE_REPORTING
      DemEventDisplacementFallbackStrategy = DEM_FALLBACK_DISPLACE_OLDEST_EVENT
      DemAgingRetainEnvironmentalData = false
      DemResetConfirmedBitOnOverflow = false
      DemTypeOfDTCSupported = DEM_DTC_TRANSLATION_ISO15031_6
      DemAvailabilitySupport = DEM_EVENT_AVAILABILITY
      DemAvailabilityStorage = false
      DemBswErrorBufferSize = 0
      DemClearDTCBehavior = DEM_CLRRESP_VOLATILE
      DemDebounceTimeBasedSupport = false
      DemDevErrorDetect = true
      DemEnableConditionSupport = false
      DemEventCombinationSupport = DEM_EVCOMB_DISABLED
      DemEventMemoryEntryStorageTrigger = DEM_STORAGE_ON_TEST_FAILED
      DemMaxNumberEventEntryOBDFreezeFrame = 0
      DemMaxNumberEventEntryPermanent = 0
      DemMaxNumberEventEntryPrimary = 8
      DemMaxNumberEventEntrySecondary = 40
      DemMaxNumberPrestoredFF = 0
      DemOBDSupport = DEM_OBD_NO_OBD_SUPPORT
      DemOccurrenceCounterProcessing = DEM_PROCESS_OCCCTR_TF
      DemOperationCycleStatusStorage = false
      DemStatusBitHandlingTestFailedSinceLastClear = DEM_STATUS_BIT_NORMAL
      DemStatusBitStorageTestFailed = true
      DemStorageConditionSupport = false
      DemSuppressionSupport = DEM_NO_SUPPRESSION
      DemTaskTime = 0.01
      DemTriggerDcmReports = false
      DemTriggerDltReports = false
      DemTriggerFiMReports = false
      DemTriggerMonitorInitForEnableConditions = false
      DemVersionInfoApi = false
      DemBswApiVersion = DEM_BSW_API_3_XX_XX
      DemBswApiVersionNvM = DEM_BSW_API_4_XX_XX
      DemBswApiVersionFiM = DEM_BSW_API_4_XX_XX
      DemAgingAfterHealing = DEM_AGING_WHILE_HEALING
      DemAgingCounterBehavior = DEM_AGING_COUNT_ALWAYS
      DemCompiledPostbuildCrc = 2966265134
      DemCompiledPostbuildCrcMode = DEM_POSTBUILD_CRC_AUTOMATIC
      DemGeneralDiagnosticInfoSupport = true
      DemJ1939Support = false
      DemNvSynchronizeSupport = false
      DemPendingDtcProcessing = DEM_PROCESS_PDTC_ALL_DTC
      DemResetDebounceBehavior = DEM_RESET_DEBOUNCE_ON_ENABLE_ENABLE_CONDITIONS
      DemResetTestFailedOnOperationCycleStart = false
      DemRetryStorageSupport = false
      DemUseMemcopyMacros = false
      DemUseRte = true
      DemUserControlledWirBehavior = DEM_DISABLED_DURING_CONTROLDTCSETTING
      DemWarningIndicatorRequestedProcessing = DEM_PROCESS_WIR_STOREDONLY
      DemUseNvm = false
      DemRestartCycleOnInitRef = PowerCycle
      DemOperationCycle: DemOperationCycleAutomaticEnd=false, DemOperationCycleAutostart=false, DemOperationCycleType=DEM_OPCYC_OTHER
      DemPostbuild: DemEventAvailableDefaultSupport=true, DemMaxSizeFreezeFrame=0
      50 x DemNvRamBlockId:
        Dem_AdminData: DemNvRamBlockIdType=DEM_NVBLOCK_ADMIN, DemNvRamBlockIdRef=DemAdminDataBlock
        Dem_StatusData: DemNvRamBlockIdType=DEM_NVBLOCK_STATUS, DemNvRamBlockIdRef=DemStatusDataBlock
        Dem_PrimaryEntry{0..7}: DemNvRamBlockIdType=DEM_NVBLOCK_PRIMARY, DemNvRamBlockIdIndex={0..7}, DemNvRamBlockIdRef=DemPrimaryDataBlock{0..7}
        Dem_SecondaryEntry{0..39}: DemNvRamBlockIdType=DEM_NVBLOCK_SECONDARY, DemNvRamBlockIdIndex={0..39}, DemNvRamBlockIdRef=DemSecondaryDataBlock{0..39}
      IgnitionCycle (DemOperationCycle): DemOperationCycleType=DEM_OPCYC_IGNITION, DemOperationCycleAutomaticEnd=false, DemOperationCycleAutostart=false
      PowerCycle (DemOperationCycle): DemOperationCycleAutomaticEnd=false, DemOperationCycleAutostart=false, DemOperationCycleType=DEM_OPCYC_POWER
      DTCdetectioncounter (DemExtendedDataRecordClass): DemExtendedDataRecordNumber=16, DemDataElementClassRef=DTCDetectionCounter
      ExtendedDataClass_d1497ac7 (DemExtendedDataClass): DemExtendedDataRecordClassRef=Monitoringcyclecounter2, DemExtendedDataRecordClassRef=DTCdetectioncounter
      Monitoringcyclecounter2 (DemExtendedDataRecordClass): DemExtendedDataRecordNumber=2, DemDataElementClassRef=MonitoringCycleCounter2
      DemDataElementClass_DTCDetectionCounter (DemDataElementClass)
        DTCDetectionCounter (DemExternalCSDataElementClass): DemDataElementDataSize=1, DemDataElementUsePort=true, DemUseEventIdArgumentForCallback=false, DemDataElementStoreNonVolatile=true
      DemDataElementClass_MonitoringCycleCounter2 (DemDataElementClass)
        MonitoringCycleCounter2 (DemExternalCSDataElementClass): DemDataElementDataSize=2, DemDataElementUsePort=true, DemUseEventIdArgumentForCallback=false, DemDataElementStoreNonVolatile=true
    DemConfigSet
      23 x DemEventParameter, all with DemEventTimeSeries=DEM_TIMESERIES_SNAPSHOT_NONE, DemEventAvailable=true, DemEventAvailableInVariant=true, DemEventLatchTestFailed=false:
        MCU_E_CLOCK_FAILURE: DemEventId=68, DemEventKind=DEM_EVENT_KIND_BSW
          DemEventClass:
            DemAgingAllowed = false
            DemConsiderPtoStatus = false
            DemEventDestination = DEM_DTC_ORIGIN_SECONDARY_MEMORY
            DemEventPriority = 2
            DemFFPrestorageSupported = false
            DemOperationCycleRef = DemOperationCycle
            DemDebounceAlgorithmClass
              DemDebounceCounterBased:
                DemDebounceBehavior = DEM_DEBOUNCE_FREEZE
                DemDebounceCounterDecrementStepSize = 1
                DemDebounceCounterFailedThreshold = 127
                DemDebounceCounterIncrementStepSize = 1
                DemDebounceCounterJumpDown = true
                DemDebounceCounterJumpDownValue = 0
                DemDebounceCounterJumpUp = true
                DemDebounceCounterJumpUpValue = 0
                DemDebounceCounterPassedThreshold = -128
                DemDebounceCounterStorage = false
                DemDebounceContinuous = false
        MCU_E_POWERDOWN_MODE_FAILURE: DemEventId=67, DemEventKind=DEM_EVENT_KIND_BSW
          DemEventClass:
            DemAgingAllowed = false
            DemConsiderPtoStatus = false
            DemEventDestination = DEM_DTC_ORIGIN_SECONDARY_MEMORY
            DemEventPriority = 2
            DemFFPrestorageSupported = false
            DemOperationCycleRef = DemOperationCycle
            DemDebounceAlgorithmClass
              DemDebounceCounterBased:
                DemDebounceBehavior = DEM_DEBOUNCE_FREEZE
                DemDebounceCounterDecrementStepSize = 1
                DemDebounceCounterFailedThreshold = 127
                DemDebounceCounterIncrementStepSize = 1
                DemDebounceCounterJumpDown = true
                DemDebounceCounterJumpDownValue = 0
                DemDebounceCounterJumpUp = true
                DemDebounceCounterJumpUpValue = 0
                DemDebounceCounterPassedThreshold = -128
                DemDebounceCounterStorage = false
                DemDebounceContinuous = false
        MCU_E_WRITE_TIMEOUT_FAILURE: DemEventId=66, DemEventKind=DEM_EVENT_KIND_BSW
          DemEventClass:
            DemAgingAllowed = false
            DemConsiderPtoStatus = false
            DemEventDestination = DEM_DTC_ORIGIN_SECONDARY_MEMORY
            DemEventPriority = 2
            DemFFPrestorageSupported = false
            DemOperationCycleRef = DemOperationCycle
            DemDebounceAlgorithmClass
              DemDebounceCounterBased:
                DemDebounceBehavior = DEM_DEBOUNCE_FREEZE
                DemDebounceCounterDecrementStepSize = 1
                DemDebounceCounterFailedThreshold = 127
                DemDebounceCounterIncrementStepSize = 1
                DemDebounceCounterJumpDown = true
                DemDebounceCounterJumpDownValue = 0
                DemDebounceCounterJumpUp = true
                DemDebounceCounterJumpUpValue = 0
                DemDebounceCounterPassedThreshold = -128
                DemDebounceCounterStorage = false
                DemDebounceContinuous = false
        FLS_E_COMPARE_FAILED: DemEventId=74, DemEventKind=DEM_EVENT_KIND_BSW
          DemEventClass:
            DemAgingAllowed = false
            DemConsiderPtoStatus = false
            DemEventDestination = DEM_DTC_ORIGIN_SECONDARY_MEMORY
            DemEventPriority = 2
            DemFFPrestorageSupported = false
            DemOperationCycleRef = DemOperationCycle
            DemDebounceAlgorithmClass
              DemDebounceCounterBased:
                DemDebounceBehavior = DEM_DEBOUNCE_FREEZE
                DemDebounceCounterDecrementStepSize = 1
                DemDebounceCounterFailedThreshold = 127
                DemDebounceCounterIncrementStepSize = 1
                DemDebounceCounterJumpDown = true
                DemDebounceCounterJumpDownValue = 0
                DemDebounceCounterJumpUp = true
                DemDebounceCounterJumpUpValue = 0
                DemDebounceCounterPassedThreshold = -128
                DemDebounceCounterStorage = false
                DemDebounceContinuous = false
        FLS_E_ERASE_FAILED: DemEventId=73, DemEventKind=DEM_EVENT_KIND_BSW
          DemEventClass:
            DemAgingAllowed = false
            DemConsiderPtoStatus = false
            DemEventDestination = DEM_DTC_ORIGIN_SECONDARY_MEMORY
            DemEventPriority = 2
            DemFFPrestorageSupported = false
            DemOperationCycleRef = DemOperationCycle
            DemDebounceAlgorithmClass
              DemDebounceCounterBased:
                DemDebounceBehavior = DEM_DEBOUNCE_FREEZE
                DemDebounceCounterDecrementStepSize = 1
                DemDebounceCounterFailedThreshold = 127
                DemDebounceCounterIncrementStepSize = 1
                DemDebounceCounterJumpDown = true
                DemDebounceCounterJumpDownValue = 0
                DemDebounceCounterJumpUp = true
                DemDebounceCounterJumpUpValue = 0
                DemDebounceCounterPassedThreshold = -128
                DemDebounceCounterStorage = false
                DemDebounceContinuous = false
        FLS_E_HW_FAILURE: DemEventId=72, DemEventKind=DEM_EVENT_KIND_BSW
          DemEventClass:
            DemAgingAllowed = false
            DemConsiderPtoStatus = false
            DemEventDestination = DEM_DTC_ORIGIN_SECONDARY_MEMORY
            DemEventPriority = 2
            DemFFPrestorageSupported = false
            DemOperationCycleRef = DemOperationCycle
            DemDebounceAlgorithmClass
              DemDebounceCounterBased:
                DemDebounceBehavior = DEM_DEBOUNCE_FREEZE
                DemDebounceCounterDecrementStepSize = 1
                DemDebounceCounterFailedThreshold = 127
                DemDebounceCounterIncrementStepSize = 1
                DemDebounceCounterJumpDown = true
                DemDebounceCounterJumpDownValue = 0
                DemDebounceCounterJumpUp = true
                DemDebounceCounterJumpUpValue = 0
                DemDebounceCounterPassedThreshold = -128
                DemDebounceCounterStorage = false
                DemDebounceContinuous = false
        FLS_E_READ_FAILED: DemEventId=71, DemEventKind=DEM_EVENT_KIND_BSW
          DemEventClass:
            DemAgingAllowed = false
            DemConsiderPtoStatus = false
            DemEventDestination = DEM_DTC_ORIGIN_SECONDARY_MEMORY
            DemEventPriority = 2
            DemFFPrestorageSupported = false
            DemOperationCycleRef = DemOperationCycle
            DemDebounceAlgorithmClass
              DemDebounceCounterBased:
                DemDebounceBehavior = DEM_DEBOUNCE_FREEZE
                DemDebounceCounterDecrementStepSize = 1
                DemDebounceCounterFailedThreshold = 127
                DemDebounceCounterIncrementStepSize = 1
                DemDebounceCounterJumpDown = true
                DemDebounceCounterJumpDownValue = 0
                DemDebounceCounterJumpUp = true
                DemDebounceCounterJumpUpValue = 0
                DemDebounceCounterPassedThreshold = -128
                DemDebounceCounterStorage = false
                DemDebounceContinuous = false
        FLS_E_READ_FAILED_DED: DemEventId=70, DemEventKind=DEM_EVENT_KIND_BSW
          DemEventClass:
            DemAgingAllowed = false
            DemConsiderPtoStatus = false
            DemEventDestination = DEM_DTC_ORIGIN_SECONDARY_MEMORY
            DemEventPriority = 2
            DemFFPrestorageSupported = false
            DemOperationCycleRef = DemOperationCycle
            DemDebounceAlgorithmClass
              DemDebounceCounterBased:
                DemDebounceBehavior = DEM_DEBOUNCE_FREEZE
                DemDebounceCounterDecrementStepSize = 1
                DemDebounceCounterFailedThreshold = 127
                DemDebounceCounterIncrementStepSize = 1
                DemDebounceCounterJumpDown = true
                DemDebounceCounterJumpDownValue = 0
                DemDebounceCounterJumpUp = true
                DemDebounceCounterJumpUpValue = 0
                DemDebounceCounterPassedThreshold = -128
                DemDebounceCounterStorage = false
                DemDebounceContinuous = false
        FLS_E_WRITE_FAILED: DemEventId=69, DemEventKind=DEM_EVENT_KIND_BSW
          DemEventClass:
            DemAgingAllowed = false
            DemConsiderPtoStatus = false
            DemEventDestination = DEM_DTC_ORIGIN_SECONDARY_MEMORY
            DemEventPriority = 2
            DemFFPrestorageSupported = false
            DemOperationCycleRef = DemOperationCycle
            DemDebounceAlgorithmClass
              DemDebounceCounterBased:
                DemDebounceBehavior = DEM_DEBOUNCE_FREEZE
                DemDebounceCounterDecrementStepSize = 1
                DemDebounceCounterFailedThreshold = 127
                DemDebounceCounterIncrementStepSize = 1
                DemDebounceCounterJumpDown = true
                DemDebounceCounterJumpDownValue = 0
                DemDebounceCounterJumpUp = true
                DemDebounceCounterJumpUpValue = 0
                DemDebounceCounterPassedThreshold = -128
                DemDebounceCounterStorage = false
                DemDebounceContinuous = false
        NVM_E_INTEGRITY_FAILED: DemEventId=65, DemEventKind=DEM_EVENT_KIND_BSW
          DemEventClass:
            DemAgingAllowed = false
            DemConsiderPtoStatus = false
            DemEventDestination = DEM_DTC_ORIGIN_SECONDARY_MEMORY
            DemEventPriority = 2
            DemFFPrestorageSupported = false
            DemOperationCycleRef = DemOperationCycle
            DemDebounceAlgorithmClass
              DemDebounceCounterBased:
                DemDebounceBehavior = DEM_DEBOUNCE_FREEZE
                DemDebounceCounterDecrementStepSize = 1
                DemDebounceCounterFailedThreshold = 127
                DemDebounceCounterIncrementStepSize = 1
                DemDebounceCounterJumpDown = true
                DemDebounceCounterJumpDownValue = 0
                DemDebounceCounterJumpUp = true
                DemDebounceCounterJumpUpValue = 0
                DemDebounceCounterPassedThreshold = -128
                DemDebounceCounterStorage = false
                DemDebounceContinuous = false
        NVM_E_LOSS_OF_REDUNDANCY: DemEventId=64, DemEventKind=DEM_EVENT_KIND_BSW
          DemEventClass:
            DemAgingAllowed = false
            DemConsiderPtoStatus = false
            DemEventDestination = DEM_DTC_ORIGIN_SECONDARY_MEMORY
            DemEventPriority = 2
            DemFFPrestorageSupported = false
            DemOperationCycleRef = DemOperationCycle
            DemDebounceAlgorithmClass
              DemDebounceCounterBased:
                DemDebounceBehavior = DEM_DEBOUNCE_FREEZE
                DemDebounceCounterDecrementStepSize = 1
                DemDebounceCounterFailedThreshold = 127
                DemDebounceCounterIncrementStepSize = 1
                DemDebounceCounterJumpDown = true
                DemDebounceCounterJumpDownValue = 0
                DemDebounceCounterJumpUp = true
                DemDebounceCounterJumpUpValue = 0
                DemDebounceCounterPassedThreshold = -128
                DemDebounceCounterStorage = false
                DemDebounceContinuous = false
        NVM_E_QUEUE_OVERFLOW: DemEventId=63, DemEventKind=DEM_EVENT_KIND_BSW
          DemEventClass:
            DemAgingAllowed = false
            DemConsiderPtoStatus = false
            DemEventDestination = DEM_DTC_ORIGIN_SECONDARY_MEMORY
            DemEventPriority = 2
            DemFFPrestorageSupported = false
            DemOperationCycleRef = DemOperationCycle
            DemDebounceAlgorithmClass
              DemDebounceCounterBased:
                DemDebounceBehavior = DEM_DEBOUNCE_FREEZE
                DemDebounceCounterDecrementStepSize = 1
                DemDebounceCounterFailedThreshold = 127
                DemDebounceCounterIncrementStepSize = 1
                DemDebounceCounterJumpDown = true
                DemDebounceCounterJumpDownValue = 0
                DemDebounceCounterJumpUp = true
                DemDebounceCounterJumpUpValue = 0
                DemDebounceCounterPassedThreshold = -128
                DemDebounceCounterStorage = false
                DemDebounceContinuous = false
        NVM_E_REQ_FAILED: DemEventId=62, DemEventKind=DEM_EVENT_KIND_BSW
          DemEventClass:
            DemAgingAllowed = false
            DemConsiderPtoStatus = false
            DemEventDestination = DEM_DTC_ORIGIN_SECONDARY_MEMORY
            DemEventPriority = 2
            DemFFPrestorageSupported = false
            DemOperationCycleRef = DemOperationCycle
            DemDebounceAlgorithmClass
              DemDebounceCounterBased:
                DemDebounceBehavior = DEM_DEBOUNCE_FREEZE
                DemDebounceCounterDecrementStepSize = 1
                DemDebounceCounterFailedThreshold = 127
                DemDebounceCounterIncrementStepSize = 1
                DemDebounceCounterJumpDown = true
                DemDebounceCounterJumpDownValue = 0
                DemDebounceCounterJumpUp = true
                DemDebounceCounterJumpUpValue = 0
                DemDebounceCounterPassedThreshold = -128
                DemDebounceCounterStorage = false
                DemDebounceContinuous = false
        NVM_E_WRITE_PROTECTED: DemEventId=59, DemEventKind=DEM_EVENT_KIND_BSW
          DemEventClass:
            DemAgingAllowed = false
            DemConsiderPtoStatus = false
            DemEventDestination = DEM_DTC_ORIGIN_SECONDARY_MEMORY
            DemEventPriority = 2
            DemFFPrestorageSupported = false
            DemOperationCycleRef = DemOperationCycle
            DemDebounceAlgorithmClass
              DemDebounceCounterBased:
                DemDebounceBehavior = DEM_DEBOUNCE_FREEZE
                DemDebounceCounterDecrementStepSize = 1
                DemDebounceCounterFailedThreshold = 127
                DemDebounceCounterIncrementStepSize = 1
                DemDebounceCounterJumpDown = true
                DemDebounceCounterJumpDownValue = 0
                DemDebounceCounterJumpUp = true
                DemDebounceCounterJumpUpValue = 0
                DemDebounceCounterPassedThreshold = -128
                DemDebounceCounterStorage = false
                DemDebounceContinuous = false
        SPI_E_DATA_TX_TIMEOUT_FAILURE: DemEventId=60, DemEventKind=DEM_EVENT_KIND_BSW
          DemEventClass:
            DemAgingAllowed = false
            DemConsiderPtoStatus = false
            DemEventDestination = DEM_DTC_ORIGIN_SECONDARY_MEMORY
            DemEventPriority = 2
            DemFFPrestorageSupported = false
            DemOperationCycleRef = DemOperationCycle
            DemDebounceAlgorithmClass
              DemDebounceCounterBased:
                DemDebounceBehavior = DEM_DEBOUNCE_FREEZE
                DemDebounceCounterDecrementStepSize = 1
                DemDebounceCounterFailedThreshold = 127
                DemDebounceCounterIncrementStepSize = 1
                DemDebounceCounterJumpDown = true
                DemDebounceCounterJumpDownValue = 0
                DemDebounceCounterJumpUp = true
                DemDebounceCounterJumpUpValue = 0
                DemDebounceCounterPassedThreshold = -128
                DemDebounceCounterStorage = false
                DemDebounceContinuous = false
        SPI_E_HARDWARE_ERROR: DemEventId=61, DemEventKind=DEM_EVENT_KIND_BSW
          DemEventClass:
            DemAgingAllowed = false
            DemConsiderPtoStatus = false
            DemEventDestination = DEM_DTC_ORIGIN_SECONDARY_MEMORY
            DemEventPriority = 2
            DemFFPrestorageSupported = false
            DemOperationCycleRef = DemOperationCycle
            DemDebounceAlgorithmClass
              DemDebounceCounterBased:
                DemDebounceBehavior = DEM_DEBOUNCE_FREEZE
                DemDebounceCounterDecrementStepSize = 1
                DemDebounceCounterFailedThreshold = 127
                DemDebounceCounterIncrementStepSize = 1
                DemDebounceCounterJumpDown = true
                DemDebounceCounterJumpDownValue = 0
                DemDebounceCounterJumpUp = true
                DemDebounceCounterJumpUpValue = 0
                DemDebounceCounterPassedThreshold = -128
                DemDebounceCounterStorage = false
                DemDebounceContinuous = false
        WDG_E_DISABLE_REJECTED: DemEventId=56, DemEventKind=DEM_EVENT_KIND_BSW
          DemEventClass:
            DemAgingAllowed = false
            DemConsiderPtoStatus = false
            DemEventDestination = DEM_DTC_ORIGIN_SECONDARY_MEMORY
            DemEventPriority = 2
            DemFFPrestorageSupported = false
            DemOperationCycleRef = DemOperationCycle
            DemDebounceAlgorithmClass
              DemDebounceCounterBased:
                DemDebounceBehavior = DEM_DEBOUNCE_FREEZE
                DemDebounceCounterDecrementStepSize = 1
                DemDebounceCounterFailedThreshold = 127
                DemDebounceCounterIncrementStepSize = 1
                DemDebounceCounterJumpDown = true
                DemDebounceCounterJumpDownValue = 0
                DemDebounceCounterJumpUp = true
                DemDebounceCounterJumpUpValue = 0
                DemDebounceCounterPassedThreshold = -128
                DemDebounceCounterStorage = false
                DemDebounceContinuous = false
        WDG_E_MODE_FAILED: DemEventId=57, DemEventKind=DEM_EVENT_KIND_BSW
          DemEventClass:
            DemAgingAllowed = false
            DemConsiderPtoStatus = false
            DemEventDestination = DEM_DTC_ORIGIN_SECONDARY_MEMORY
            DemEventPriority = 2
            DemFFPrestorageSupported = false
            DemOperationCycleRef = DemOperationCycle
            DemDebounceAlgorithmClass
              DemDebounceCounterBased:
                DemDebounceBehavior = DEM_DEBOUNCE_FREEZE
                DemDebounceCounterDecrementStepSize = 1
                DemDebounceCounterFailedThreshold = 127
                DemDebounceCounterIncrementStepSize = 1
                DemDebounceCounterJumpDown = true
                DemDebounceCounterJumpDownValue = 0
                DemDebounceCounterJumpUp = true
                DemDebounceCounterJumpUpValue = 0
                DemDebounceCounterPassedThreshold = -128
                DemDebounceCounterStorage = false
                DemDebounceContinuous = false
        WDG_E_READBACK_FAILURE: DemEventId=58, DemEventKind=DEM_EVENT_KIND_BSW
          DemEventClass:
            DemAgingAllowed = false
            DemConsiderPtoStatus = false
            DemEventDestination = DEM_DTC_ORIGIN_SECONDARY_MEMORY
            DemEventPriority = 2
            DemFFPrestorageSupported = false
            DemOperationCycleRef = DemOperationCycle
            DemDebounceAlgorithmClass
              DemDebounceCounterBased:
                DemDebounceBehavior = DEM_DEBOUNCE_FREEZE
                DemDebounceCounterDecrementStepSize = 1
                DemDebounceCounterFailedThreshold = 127
                DemDebounceCounterIncrementStepSize = 1
                DemDebounceCounterJumpDown = true
                DemDebounceCounterJumpDownValue = 0
                DemDebounceCounterJumpUp = true
                DemDebounceCounterJumpUpValue = 0
                DemDebounceCounterPassedThreshold = -128
                DemDebounceCounterStorage = false
                DemDebounceContinuous = false
        DIO_E_REG_WRITE_VERIFY: DemEventId=1, DemEventKind=DEM_EVENT_KIND_BSW
          DemEventClass:
            DemAgingAllowed = false
            DemConsiderPtoStatus = false
            DemEventDestination = DEM_DTC_ORIGIN_PRIMARY_MEMORY
            DemEventPriority = 2
            DemFFPrestorageSupported = false
            DemOperationCycleRef = DemOperationCycle
            DemDebounceAlgorithmClass
              DemDebounceCounterBased:
                DemDebounceBehavior = DEM_DEBOUNCE_FREEZE
                DemDebounceCounterDecrementStepSize = 1
                DemDebounceCounterFailedThreshold = 127
                DemDebounceCounterIncrementStepSize = 1
                DemDebounceCounterJumpDown = true
                DemDebounceCounterJumpDownValue = 0
                DemDebounceCounterJumpUp = true
                DemDebounceCounterJumpUpValue = 0
                DemDebounceCounterPassedThreshold = -128
                DemDebounceCounterStorage = false
                DemDebounceContinuous = false
        PORT_E_REG_WRITE_VERIFY: DemEventId=2, DemEventKind=DEM_EVENT_KIND_BSW
          DemEventClass:
            DemAgingAllowed = false
            DemConsiderPtoStatus = false
            DemEventDestination = DEM_DTC_ORIGIN_PRIMARY_MEMORY
            DemEventPriority = 2
            DemFFPrestorageSupported = false
            DemOperationCycleRef = DemOperationCycle
            DemDebounceAlgorithmClass
              DemDebounceCounterBased:
                DemDebounceBehavior = DEM_DEBOUNCE_FREEZE
                DemDebounceCounterDecrementStepSize = 1
                DemDebounceCounterFailedThreshold = 127
                DemDebounceCounterIncrementStepSize = 1
                DemDebounceCounterJumpDown = true
                DemDebounceCounterJumpDownValue = 0
                DemDebounceCounterJumpUp = true
                DemDebounceCounterJumpUpValue = 0
                DemDebounceCounterPassedThreshold = -128
                DemDebounceCounterStorage = false
                DemDebounceContinuous = false
        DTC_0x600b62: DemEventKind=DEM_EVENT_KIND_SWC, DemEventId=8, DemDTCClassRef=DTCClass_DTC_0x600b62, DemExtendedDataClassRef=ExtendedDataClass_d1497ac7
          DemEventClass:
            DemAgingCycleCounterThreshold = 0
            DemEventDestination = DEM_DTC_ORIGIN_PRIMARY_MEMORY
            DemAgingAllowed = false
            DemConsiderPtoStatus = false
            DemEventPriority = 2
            DemFFPrestorageSupported = false
            DemAgingCycleRef = IgnitionCycle
            DemOperationCycleRef = IgnitionCycle
            DemDebounceAlgorithmClass
              DemDebounceCounterBased:
                DemDebounceCounterDecrementStepSize = 1
                DemDebounceCounterIncrementStepSize = 1
                DemDebounceCounterJumpUp = true
                DemDebounceCounterFailedThreshold = 128
                DemDebounceCounterPassedThreshold = -128
                DemDebounceBehavior = DEM_DEBOUNCE_FREEZE
                DemDebounceCounterJumpDown = true
                DemDebounceCounterJumpDownValue = 0
                DemDebounceCounterJumpUpValue = 0
                DemDebounceCounterStorage = false
                DemDebounceContinuous = false
        DTC_0xc25600: DemEventKind=DEM_EVENT_KIND_SWC, DemEventId=30, DemDTCClassRef=DTCClass_DTC_0xc25600, DemExtendedDataClassRef=ExtendedDataClass_d1497ac7
          DemEventClass:
            DemAgingCycleCounterThreshold = 0
            DemEventDestination = DEM_DTC_ORIGIN_PRIMARY_MEMORY
            DemAgingAllowed = false
            DemConsiderPtoStatus = false
            DemEventPriority = 2
            DemFFPrestorageSupported = false
            DemAgingCycleRef = IgnitionCycle
            DemOperationCycleRef = IgnitionCycle
            DemDebounceAlgorithmClass
              DemDebounceCounterBased:
                DemDebounceCounterDecrementStepSize = 1
                DemDebounceCounterIncrementStepSize = 1
                DemDebounceCounterJumpUp = true
                DemDebounceCounterFailedThreshold = 128
                DemDebounceCounterPassedThreshold = -128
                DemDebounceBehavior = DEM_DEBOUNCE_FREEZE
                DemDebounceCounterJumpDown = true
                DemDebounceCounterJumpDownValue = 0
                DemDebounceCounterJumpUpValue = 0
                DemDebounceCounterStorage = false
                DemDebounceContinuous = false
      DTCClass_DTC_0xc55700 (DemDTCClass): DemUdsDTC=12932864, DemImmediateNvStorage=false
      5 x DemEventParameter, all with DemEventKind=DEM_EVENT_KIND_SWC, DemEventTimeSeries=DEM_TIMESERIES_SNAPSHOT_NONE, DemEventAvailable=true, DemEventAvailableInVariant=true, DemEventLatchTestFailed=false, DemExtendedDataClassRef=ExtendedDataClass_d1497ac7:
        DTC_0xf00049: DemEventId=50, DemDTCClassRef=DTCClass_DTC_0xf00049
          DemEventClass:
            DemAgingCycleCounterThreshold = 0
            DemEventDestination = DEM_DTC_ORIGIN_PRIMARY_MEMORY
            DemAgingAllowed = false
            DemConsiderPtoStatus = false
            DemEventPriority = 2
            DemFFPrestorageSupported = false
            DemAgingCycleRef = IgnitionCycle
            DemOperationCycleRef = IgnitionCycle
            DemDebounceAlgorithmClass
              DemDebounceCounterBased:
                DemDebounceCounterDecrementStepSize = 1
                DemDebounceCounterIncrementStepSize = 1
                DemDebounceCounterJumpUp = true
                DemDebounceCounterFailedThreshold = 128
                DemDebounceCounterPassedThreshold = -128
                DemDebounceBehavior = DEM_DEBOUNCE_FREEZE
                DemDebounceCounterJumpDown = true
                DemDebounceCounterJumpDownValue = 0
                DemDebounceCounterJumpUpValue = 0
                DemDebounceCounterStorage = false
                DemDebounceContinuous = false
        DTC_0xe10000: DemEventId=47, DemDTCClassRef=DTCClass_DTC_0xe10000
          DemEventClass:
            DemAgingCycleCounterThreshold = 0
            DemEventDestination = DEM_DTC_ORIGIN_PRIMARY_MEMORY
            DemAgingAllowed = false
            DemConsiderPtoStatus = false
            DemEventPriority = 2
            DemFFPrestorageSupported = false
            DemAgingCycleRef = IgnitionCycle
            DemOperationCycleRef = IgnitionCycle
            DemDebounceAlgorithmClass
              DemDebounceCounterBased:
                DemDebounceCounterDecrementStepSize = 1
                DemDebounceCounterIncrementStepSize = 1
                DemDebounceCounterJumpUp = true
                DemDebounceCounterFailedThreshold = 128
                DemDebounceCounterPassedThreshold = -128
                DemDebounceBehavior = DEM_DEBOUNCE_FREEZE
                DemDebounceCounterJumpDown = true
                DemDebounceCounterJumpDownValue = 0
                DemDebounceCounterJumpUpValue = 0
                DemDebounceCounterStorage = false
                DemDebounceContinuous = false
        DTC_0xf00168: DemEventId=52, DemDTCClassRef=DTCClass_DTC_0xf00168
          DemEventClass:
            DemAgingCycleCounterThreshold = 0
            DemEventDestination = DEM_DTC_ORIGIN_PRIMARY_MEMORY
            DemAgingAllowed = false
            DemConsiderPtoStatus = false
            DemEventPriority = 2
            DemFFPrestorageSupported = false
            DemAgingCycleRef = IgnitionCycle
            DemOperationCycleRef = IgnitionCycle
            DemDebounceAlgorithmClass
              DemDebounceCounterBased:
                DemDebounceCounterDecrementStepSize = 1
                DemDebounceCounterIncrementStepSize = 1
                DemDebounceCounterJumpUp = true
                DemDebounceCounterFailedThreshold = 128
                DemDebounceCounterPassedThreshold = -128
                DemDebounceBehavior = DEM_DEBOUNCE_FREEZE
                DemDebounceCounterJumpDown = true
                DemDebounceCounterJumpDownValue = 0
                DemDebounceCounterJumpUpValue = 0
                DemDebounceCounterStorage = false
                DemDebounceContinuous = false
        DTC_0xf00042: DemEventId=49, DemDTCClassRef=DTCClass_DTC_0xf00042
          DemEventClass:
            DemAgingCycleCounterThreshold = 0
            DemEventDestination = DEM_DTC_ORIGIN_PRIMARY_MEMORY
            DemAgingAllowed = false
            DemConsiderPtoStatus = false
            DemEventPriority = 2
            DemFFPrestorageSupported = false
            DemAgingCycleRef = IgnitionCycle
            DemOperationCycleRef = IgnitionCycle
            DemDebounceAlgorithmClass
              DemDebounceCounterBased:
                DemDebounceCounterDecrementStepSize = 1
                DemDebounceCounterIncrementStepSize = 1
                DemDebounceCounterJumpUp = true
                DemDebounceCounterFailedThreshold = 128
                DemDebounceCounterPassedThreshold = -128
                DemDebounceBehavior = DEM_DEBOUNCE_FREEZE
                DemDebounceCounterJumpDown = true
                DemDebounceCounterJumpDownValue = 0
                DemDebounceCounterJumpUpValue = 0
                DemDebounceCounterStorage = false
                DemDebounceContinuous = false
        DTC_0xc25200: DemEventId=28, DemDTCClassRef=DTCClass_DTC_0xc25200
          DemEventClass:
            DemAgingCycleCounterThreshold = 0
            DemEventDestination = DEM_DTC_ORIGIN_PRIMARY_MEMORY
            DemAgingAllowed = false
            DemConsiderPtoStatus = false
            DemEventPriority = 2
            DemFFPrestorageSupported = false
            DemAgingCycleRef = IgnitionCycle
            DemOperationCycleRef = IgnitionCycle
            DemDebounceAlgorithmClass
              DemDebounceCounterBased:
                DemDebounceCounterDecrementStepSize = 1
                DemDebounceCounterIncrementStepSize = 1
                DemDebounceCounterJumpUp = true
                DemDebounceCounterFailedThreshold = 128
                DemDebounceCounterPassedThreshold = -128
                DemDebounceBehavior = DEM_DEBOUNCE_FREEZE
                DemDebounceCounterJumpDown = true
                DemDebounceCounterJumpDownValue = 0
                DemDebounceCounterJumpUpValue = 0
                DemDebounceCounterStorage = false
                DemDebounceContinuous = false
      DTCClass_DTC_0x511056 (DemDTCClass): DemUdsDTC=5312598, DemImmediateNvStorage=false
      DTC_0xe01492 (DemEventParameter):
        DemEventKind = DEM_EVENT_KIND_SWC
        DemEventTimeSeries = DEM_TIMESERIES_SNAPSHOT_NONE
        DemEventAvailable = true
        DemEventId = 44
        DemEventAvailableInVariant = true
        DemEventLatchTestFailed = false
        DemDTCClassRef = DTCClass_DTC_0xe01492
        DemExtendedDataClassRef = ExtendedDataClass_d1497ac7
        DemEventClass:
          DemAgingCycleCounterThreshold = 0
          DemEventDestination = DEM_DTC_ORIGIN_PRIMARY_MEMORY
          DemAgingAllowed = false
          DemConsiderPtoStatus = false
          DemEventPriority = 2
          DemFFPrestorageSupported = false
          DemAgingCycleRef = IgnitionCycle
          DemOperationCycleRef = IgnitionCycle
          DemDebounceAlgorithmClass
            DemDebounceCounterBased:
              DemDebounceCounterDecrementStepSize = 1
              DemDebounceCounterIncrementStepSize = 1
              DemDebounceCounterJumpUp = true
              DemDebounceCounterFailedThreshold = 128
              DemDebounceCounterPassedThreshold = -128
              DemDebounceBehavior = DEM_DEBOUNCE_FREEZE
              DemDebounceCounterJumpDown = true
              DemDebounceCounterJumpDownValue = 0
              DemDebounceCounterJumpUpValue = 0
              DemDebounceCounterStorage = false
              DemDebounceContinuous = false
      DTC_0xc41522 (DemEventParameter):
        DemEventKind = DEM_EVENT_KIND_SWC
        DemEventTimeSeries = DEM_TIMESERIES_SNAPSHOT_NONE
        DemEventAvailable = true
        DemEventId = 34
        DemEventAvailableInVariant = true
        DemEventLatchTestFailed = false
        DemDTCClassRef = DTCClass_DTC_0xc41522
        DemExtendedDataClassRef = ExtendedDataClass_d1497ac7
        DemEventClass:
          DemAgingCycleCounterThreshold = 0
          DemEventDestination = DEM_DTC_ORIGIN_PRIMARY_MEMORY
          DemAgingAllowed = false
          DemConsiderPtoStatus = false
          DemEventPriority = 2
          DemFFPrestorageSupported = false
          DemAgingCycleRef = IgnitionCycle
          DemOperationCycleRef = IgnitionCycle
          DemDebounceAlgorithmClass
            DemDebounceCounterBased:
              DemDebounceCounterDecrementStepSize = 1
              DemDebounceCounterIncrementStepSize = 1
              DemDebounceCounterJumpUp = true
              DemDebounceCounterFailedThreshold = 128
              DemDebounceCounterPassedThreshold = -128
              DemDebounceBehavior = DEM_DEBOUNCE_FREEZE
              DemDebounceCounterJumpDown = true
              DemDebounceCounterJumpDownValue = 0
              DemDebounceCounterJumpUpValue = 0
              DemDebounceCounterStorage = false
              DemDebounceContinuous = false
      DTCClass_DTC_0xc14600 (DemDTCClass): DemUdsDTC=12666368, DemImmediateNvStorage=false
      DTC_0xc55700 (DemEventParameter):
        DemEventKind = DEM_EVENT_KIND_SWC
        DemEventTimeSeries = DEM_TIMESERIES_SNAPSHOT_NONE
        DemEventAvailable = true
        DemEventId = 41
        DemEventAvailableInVariant = true
        DemEventLatchTestFailed = false
        DemDTCClassRef = DTCClass_DTC_0xc55700
        DemExtendedDataClassRef = ExtendedDataClass_d1497ac7
        DemEventClass:
          DemAgingCycleCounterThreshold = 0
          DemEventDestination = DEM_DTC_ORIGIN_PRIMARY_MEMORY
          DemAgingAllowed = false
          DemConsiderPtoStatus = false
          DemEventPriority = 2
          DemFFPrestorageSupported = false
          DemAgingCycleRef = IgnitionCycle
          DemOperationCycleRef = IgnitionCycle
          DemDebounceAlgorithmClass
            DemDebounceCounterBased:
              DemDebounceCounterDecrementStepSize = 1
              DemDebounceCounterIncrementStepSize = 1
              DemDebounceCounterJumpUp = true
              DemDebounceCounterFailedThreshold = 128
              DemDebounceCounterPassedThreshold = -128
              DemDebounceBehavior = DEM_DEBOUNCE_FREEZE
              DemDebounceCounterJumpDown = true
              DemDebounceCounterJumpDownValue = 0
              DemDebounceCounterJumpUpValue = 0
              DemDebounceCounterStorage = false
              DemDebounceContinuous = false
      DTCClass_DTC_0xc10000 (DemDTCClass): DemUdsDTC=12648448, DemImmediateNvStorage=false
      DTC_0xc55300 (DemEventParameter):
        DemEventKind = DEM_EVENT_KIND_SWC
        DemEventTimeSeries = DEM_TIMESERIES_SNAPSHOT_NONE
        DemEventAvailable = true
        DemEventId = 39
        DemEventAvailableInVariant = true
        DemEventLatchTestFailed = false
        DemDTCClassRef = DTCClass_DTC_0xc55300
        DemExtendedDataClassRef = ExtendedDataClass_d1497ac7
        DemEventClass:
          DemAgingCycleCounterThreshold = 0
          DemEventDestination = DEM_DTC_ORIGIN_PRIMARY_MEMORY
          DemAgingAllowed = false
          DemConsiderPtoStatus = false
          DemEventPriority = 2
          DemFFPrestorageSupported = false
          DemAgingCycleRef = IgnitionCycle
          DemOperationCycleRef = IgnitionCycle
          DemDebounceAlgorithmClass
            DemDebounceCounterBased:
              DemDebounceCounterDecrementStepSize = 1
              DemDebounceCounterIncrementStepSize = 1
              DemDebounceCounterJumpUp = true
              DemDebounceCounterFailedThreshold = 128
              DemDebounceCounterPassedThreshold = -128
              DemDebounceBehavior = DEM_DEBOUNCE_FREEZE
              DemDebounceCounterJumpDown = true
              DemDebounceCounterJumpDownValue = 0
              DemDebounceCounterJumpUpValue = 0
              DemDebounceCounterStorage = false
              DemDebounceContinuous = false
      3 x DemDTCClass, all with DemImmediateNvStorage=false:
        DTCClass_DTC_0xe01648: DemUdsDTC=14685768
        DTCClass_DTC_0xe01647: DemUdsDTC=14685767
        DTCClass_DTC_0xf00061: DemUdsDTC=15728737
      DTC_0x5b0062 (DemEventParameter):
        DemEventKind = DEM_EVENT_KIND_SWC
        DemEventTimeSeries = DEM_TIMESERIES_SNAPSHOT_NONE
        DemEventAvailable = true
        DemEventId = 4
        DemEventAvailableInVariant = true
        DemEventLatchTestFailed = false
        DemDTCClassRef = DTCClass_DTC_0x5b0062
        DemExtendedDataClassRef = ExtendedDataClass_d1497ac7
        DemEventClass:
          DemAgingCycleCounterThreshold = 0
          DemEventDestination = DEM_DTC_ORIGIN_PRIMARY_MEMORY
          DemAgingAllowed = false
          DemConsiderPtoStatus = false
          DemEventPriority = 2
          DemFFPrestorageSupported = false
          DemAgingCycleRef = IgnitionCycle
          DemOperationCycleRef = IgnitionCycle
          DemDebounceAlgorithmClass
            DemDebounceCounterBased:
              DemDebounceCounterDecrementStepSize = 1
              DemDebounceCounterIncrementStepSize = 1
              DemDebounceCounterJumpUp = true
              DemDebounceCounterFailedThreshold = 128
              DemDebounceCounterPassedThreshold = -128
              DemDebounceBehavior = DEM_DEBOUNCE_FREEZE
              DemDebounceCounterJumpDown = true
              DemDebounceCounterJumpDownValue = 0
              DemDebounceCounterJumpUpValue = 0
              DemDebounceCounterStorage = false
              DemDebounceContinuous = false
      DTC_0x511056 (DemEventParameter):
        DemEventKind = DEM_EVENT_KIND_SWC
        DemEventTimeSeries = DEM_TIMESERIES_SNAPSHOT_NONE
        DemEventAvailable = true
        DemEventId = 13
        DemEventAvailableInVariant = true
        DemEventLatchTestFailed = false
        DemDTCClassRef = DTCClass_DTC_0x511056
        DemExtendedDataClassRef = ExtendedDataClass_d1497ac7
        DemEventClass:
          DemAgingCycleCounterThreshold = 0
          DemEventDestination = DEM_DTC_ORIGIN_PRIMARY_MEMORY
          DemAgingAllowed = false
          DemConsiderPtoStatus = false
          DemEventPriority = 2
          DemFFPrestorageSupported = false
          DemAgingCycleRef = IgnitionCycle
          DemOperationCycleRef = IgnitionCycle
          DemDebounceAlgorithmClass
            DemDebounceCounterBased:
              DemDebounceCounterDecrementStepSize = 1
              DemDebounceCounterIncrementStepSize = 1
              DemDebounceCounterJumpUp = true
              DemDebounceCounterFailedThreshold = 128
              DemDebounceCounterPassedThreshold = -128
              DemDebounceBehavior = DEM_DEBOUNCE_FREEZE
              DemDebounceCounterJumpDown = true
              DemDebounceCounterJumpDownValue = 0
              DemDebounceCounterJumpUpValue = 0
              DemDebounceCounterStorage = false
              DemDebounceContinuous = false
      DTCClass_DTC_0xc41522 (DemDTCClass): DemUdsDTC=12850466, DemImmediateNvStorage=false
      DTC_0xc10000 (DemEventParameter):
        DemEventKind = DEM_EVENT_KIND_SWC
        DemEventTimeSeries = DEM_TIMESERIES_SNAPSHOT_NONE
        DemEventAvailable = true
        DemEventId = 19
        DemEventAvailableInVariant = true
        DemEventLatchTestFailed = false
        DemDTCClassRef = DTCClass_DTC_0xc10000
        DemExtendedDataClassRef = ExtendedDataClass_d1497ac7
        DemEventClass:
          DemAgingCycleCounterThreshold = 0
          DemEventDestination = DEM_DTC_ORIGIN_PRIMARY_MEMORY
          DemAgingAllowed = false
          DemConsiderPtoStatus = false
          DemEventPriority = 2
          DemFFPrestorageSupported = false
          DemAgingCycleRef = IgnitionCycle
          DemOperationCycleRef = IgnitionCycle
          DemDebounceAlgorithmClass
            DemDebounceCounterBased:
              DemDebounceCounterDecrementStepSize = 1
              DemDebounceCounterIncrementStepSize = 1
              DemDebounceCounterJumpUp = true
              DemDebounceCounterFailedThreshold = 128
              DemDebounceCounterPassedThreshold = -128
              DemDebounceBehavior = DEM_DEBOUNCE_FREEZE
              DemDebounceCounterJumpDown = true
              DemDebounceCounterJumpDownValue = 0
              DemDebounceCounterJumpUpValue = 0
              DemDebounceCounterStorage = false
              DemDebounceContinuous = false
      DTC_0xe01481 (DemEventParameter):
        DemEventKind = DEM_EVENT_KIND_SWC
        DemEventTimeSeries = DEM_TIMESERIES_SNAPSHOT_NONE
        DemEventAvailable = true
        DemEventId = 43
        DemEventAvailableInVariant = true
        DemEventLatchTestFailed = false
        DemDTCClassRef = DTCClass_DTC_0xe01481
        DemExtendedDataClassRef = ExtendedDataClass_d1497ac7
        DemEventClass:
          DemAgingCycleCounterThreshold = 0
          DemEventDestination = DEM_DTC_ORIGIN_PRIMARY_MEMORY
          DemAgingAllowed = false
          DemConsiderPtoStatus = false
          DemEventPriority = 2
          DemFFPrestorageSupported = false
          DemAgingCycleRef = IgnitionCycle
          DemOperationCycleRef = IgnitionCycle
          DemDebounceAlgorithmClass
            DemDebounceCounterBased:
              DemDebounceCounterDecrementStepSize = 1
              DemDebounceCounterIncrementStepSize = 1
              DemDebounceCounterJumpUp = true
              DemDebounceCounterFailedThreshold = 128
              DemDebounceCounterPassedThreshold = -128
              DemDebounceBehavior = DEM_DEBOUNCE_FREEZE
              DemDebounceCounterJumpDown = true
              DemDebounceCounterJumpDownValue = 0
              DemDebounceCounterJumpUpValue = 0
              DemDebounceCounterStorage = false
              DemDebounceContinuous = false
      DTCClass_DTC_0xe01492 (DemDTCClass): DemUdsDTC=14685330, DemImmediateNvStorage=false
      DTCClass_DTC_0xe10000 (DemDTCClass): DemUdsDTC=14745600, DemImmediateNvStorage=false
      DTC_0xc14600 (DemEventParameter):
        DemEventKind = DEM_EVENT_KIND_SWC
        DemEventTimeSeries = DEM_TIMESERIES_SNAPSHOT_NONE
        DemEventAvailable = true
        DemEventId = 25
        DemEventAvailableInVariant = true
        DemEventLatchTestFailed = false
        DemDTCClassRef = DTCClass_DTC_0xc14600
        DemExtendedDataClassRef = ExtendedDataClass_d1497ac7
        DemEventClass:
          DemAgingCycleCounterThreshold = 0
          DemEventDestination = DEM_DTC_ORIGIN_PRIMARY_MEMORY
          DemAgingAllowed = false
          DemConsiderPtoStatus = false
          DemEventPriority = 2
          DemFFPrestorageSupported = false
          DemAgingCycleRef = IgnitionCycle
          DemOperationCycleRef = IgnitionCycle
          DemDebounceAlgorithmClass
            DemDebounceCounterBased:
              DemDebounceCounterDecrementStepSize = 1
              DemDebounceCounterIncrementStepSize = 1
              DemDebounceCounterJumpUp = true
              DemDebounceCounterFailedThreshold = 128
              DemDebounceCounterPassedThreshold = -128
              DemDebounceBehavior = DEM_DEBOUNCE_FREEZE
              DemDebounceCounterJumpDown = true
              DemDebounceCounterJumpDownValue = 0
              DemDebounceCounterJumpUpValue = 0
              DemDebounceCounterStorage = false
              DemDebounceContinuous = false
      DTCClass_DTC_0x600b62 (DemDTCClass): DemUdsDTC=6294370, DemImmediateNvStorage=false
      4 x DemEventParameter, all with DemEventKind=DEM_EVENT_KIND_SWC, DemEventTimeSeries=DEM_TIMESERIES_SNAPSHOT_NONE, DemEventAvailable=true, DemEventAvailableInVariant=true, DemEventLatchTestFailed=false, DemExtendedDataClassRef=ExtendedDataClass_d1497ac7:
        DTC_0xe01647: DemEventId=45, DemDTCClassRef=DTCClass_DTC_0xe01647
          DemEventClass:
            DemAgingCycleCounterThreshold = 0
            DemEventDestination = DEM_DTC_ORIGIN_PRIMARY_MEMORY
            DemAgingAllowed = false
            DemConsiderPtoStatus = false
            DemEventPriority = 2
            DemFFPrestorageSupported = false
            DemAgingCycleRef = IgnitionCycle
            DemOperationCycleRef = IgnitionCycle
            DemDebounceAlgorithmClass
              DemDebounceCounterBased:
                DemDebounceCounterDecrementStepSize = 1
                DemDebounceCounterIncrementStepSize = 1
                DemDebounceCounterJumpUp = true
                DemDebounceCounterFailedThreshold = 128
                DemDebounceCounterPassedThreshold = -128
                DemDebounceBehavior = DEM_DEBOUNCE_FREEZE
                DemDebounceCounterJumpDown = true
                DemDebounceCounterJumpDownValue = 0
                DemDebounceCounterJumpUpValue = 0
                DemDebounceCounterStorage = false
                DemDebounceContinuous = false
        DTC_0xe01648: DemEventId=46, DemDTCClassRef=DTCClass_DTC_0xe01648
          DemEventClass:
            DemAgingCycleCounterThreshold = 0
            DemEventDestination = DEM_DTC_ORIGIN_PRIMARY_MEMORY
            DemAgingAllowed = false
            DemConsiderPtoStatus = false
            DemEventPriority = 2
            DemFFPrestorageSupported = false
            DemAgingCycleRef = IgnitionCycle
            DemOperationCycleRef = IgnitionCycle
            DemDebounceAlgorithmClass
              DemDebounceCounterBased:
                DemDebounceCounterDecrementStepSize = 1
                DemDebounceCounterIncrementStepSize = 1
                DemDebounceCounterJumpUp = true
                DemDebounceCounterFailedThreshold = 128
                DemDebounceCounterPassedThreshold = -128
                DemDebounceBehavior = DEM_DEBOUNCE_FREEZE
                DemDebounceCounterJumpDown = true
                DemDebounceCounterJumpDownValue = 0
                DemDebounceCounterJumpUpValue = 0
                DemDebounceCounterStorage = false
                DemDebounceContinuous = false
        DTC_0xc40100: DemEventId=31, DemDTCClassRef=DTCClass_DTC_0xc40100
          DemEventClass:
            DemAgingCycleCounterThreshold = 0
            DemEventDestination = DEM_DTC_ORIGIN_PRIMARY_MEMORY
            DemAgingAllowed = false
            DemConsiderPtoStatus = false
            DemEventPriority = 2
            DemFFPrestorageSupported = false
            DemAgingCycleRef = IgnitionCycle
            DemOperationCycleRef = IgnitionCycle
            DemDebounceAlgorithmClass
              DemDebounceCounterBased:
                DemDebounceCounterDecrementStepSize = 1
                DemDebounceCounterIncrementStepSize = 1
                DemDebounceCounterJumpUp = true
                DemDebounceCounterFailedThreshold = 128
                DemDebounceCounterPassedThreshold = -128
                DemDebounceBehavior = DEM_DEBOUNCE_FREEZE
                DemDebounceCounterJumpDown = true
                DemDebounceCounterJumpDownValue = 0
                DemDebounceCounterJumpUpValue = 0
                DemDebounceCounterStorage = false
                DemDebounceContinuous = false
        DTC_0xc53b00: DemEventId=17, DemDTCClassRef=DTCClass_DTC_0xc53b00
          DemEventClass:
            DemAgingCycleCounterThreshold = 0
            DemEventDestination = DEM_DTC_ORIGIN_PRIMARY_MEMORY
            DemAgingAllowed = false
            DemConsiderPtoStatus = false
            DemEventPriority = 2
            DemFFPrestorageSupported = false
            DemAgingCycleRef = IgnitionCycle
            DemOperationCycleRef = IgnitionCycle
            DemDebounceAlgorithmClass
              DemDebounceCounterBased:
                DemDebounceCounterDecrementStepSize = 1
                DemDebounceCounterIncrementStepSize = 1
                DemDebounceCounterJumpUp = true
                DemDebounceCounterFailedThreshold = 128
                DemDebounceCounterPassedThreshold = -128
                DemDebounceBehavior = DEM_DEBOUNCE_FREEZE
                DemDebounceCounterJumpDown = true
                DemDebounceCounterJumpDownValue = 0
                DemDebounceCounterJumpUpValue = 0
                DemDebounceCounterStorage = false
                DemDebounceContinuous = false
      DTCClass_DTC_0xf00316 (DemDTCClass): DemUdsDTC=15729430, DemImmediateNvStorage=false
      DTC_0xf00061 (DemEventParameter):
        DemEventKind = DEM_EVENT_KIND_SWC
        DemEventTimeSeries = DEM_TIMESERIES_SNAPSHOT_NONE
        DemEventAvailable = true
        DemEventId = 51
        DemEventAvailableInVariant = true
        DemEventLatchTestFailed = false
        DemDTCClassRef = DTCClass_DTC_0xf00061
        DemExtendedDataClassRef = ExtendedDataClass_d1497ac7
        DemEventClass:
          DemAgingCycleCounterThreshold = 0
          DemEventDestination = DEM_DTC_ORIGIN_PRIMARY_MEMORY
          DemAgingAllowed = false
          DemConsiderPtoStatus = false
          DemEventPriority = 2
          DemFFPrestorageSupported = false
          DemAgingCycleRef = IgnitionCycle
          DemOperationCycleRef = IgnitionCycle
          DemDebounceAlgorithmClass
            DemDebounceCounterBased:
              DemDebounceCounterDecrementStepSize = 1
              DemDebounceCounterIncrementStepSize = 1
              DemDebounceCounterJumpUp = true
              DemDebounceCounterFailedThreshold = 128
              DemDebounceCounterPassedThreshold = -128
              DemDebounceBehavior = DEM_DEBOUNCE_FREEZE
              DemDebounceCounterJumpDown = true
              DemDebounceCounterJumpDownValue = 0
              DemDebounceCounterJumpUpValue = 0
              DemDebounceCounterStorage = false
              DemDebounceContinuous = false
      DTC_0x600d49 (DemEventParameter):
        DemEventKind = DEM_EVENT_KIND_SWC
        DemEventTimeSeries = DEM_TIMESERIES_SNAPSHOT_NONE
        DemEventAvailable = true
        DemEventId = 11
        DemEventAvailableInVariant = true
        DemEventLatchTestFailed = false
        DemDTCClassRef = DTCClass_DTC_0x600d49
        DemExtendedDataClassRef = ExtendedDataClass_d1497ac7
        DemEventClass:
          DemAgingCycleCounterThreshold = 0
          DemEventDestination = DEM_DTC_ORIGIN_PRIMARY_MEMORY
          DemAgingAllowed = false
          DemConsiderPtoStatus = false
          DemEventPriority = 2
          DemFFPrestorageSupported = false
          DemAgingCycleRef = IgnitionCycle
          DemOperationCycleRef = IgnitionCycle
          DemDebounceAlgorithmClass
            DemDebounceCounterBased:
              DemDebounceCounterDecrementStepSize = 1
              DemDebounceCounterIncrementStepSize = 1
              DemDebounceCounterJumpUp = true
              DemDebounceCounterFailedThreshold = 128
              DemDebounceCounterPassedThreshold = -128
              DemDebounceBehavior = DEM_DEBOUNCE_FREEZE
              DemDebounceCounterJumpDown = true
              DemDebounceCounterJumpDownValue = 0
              DemDebounceCounterJumpUpValue = 0
              DemDebounceCounterStorage = false
              DemDebounceContinuous = false
      3 x DemDTCClass, all with DemImmediateNvStorage=false:
        DTCClass_DTC_0x5b0062: DemUdsDTC=5963874
        DTCClass_DTC_0xc40300: DemUdsDTC=12845824
        DTCClass_DTC_0xc53b00: DemUdsDTC=12925696
      DTC_0xc55400 (DemEventParameter):
        DemEventKind = DEM_EVENT_KIND_SWC
        DemEventTimeSeries = DEM_TIMESERIES_SNAPSHOT_NONE
        DemEventAvailable = true
        DemEventId = 40
        DemEventAvailableInVariant = true
        DemEventLatchTestFailed = false
        DemDTCClassRef = DTCClass_DTC_0xc55400
        DemExtendedDataClassRef = ExtendedDataClass_d1497ac7
        DemEventClass:
          DemAgingCycleCounterThreshold = 0
          DemEventDestination = DEM_DTC_ORIGIN_PRIMARY_MEMORY
          DemAgingAllowed = false
          DemConsiderPtoStatus = false
          DemEventPriority = 2
          DemFFPrestorageSupported = false
          DemAgingCycleRef = IgnitionCycle
          DemOperationCycleRef = IgnitionCycle
          DemDebounceAlgorithmClass
            DemDebounceCounterBased:
              DemDebounceCounterDecrementStepSize = 1
              DemDebounceCounterIncrementStepSize = 1
              DemDebounceCounterJumpUp = true
              DemDebounceCounterFailedThreshold = 128
              DemDebounceCounterPassedThreshold = -128
              DemDebounceBehavior = DEM_DEBOUNCE_FREEZE
              DemDebounceCounterJumpDown = true
              DemDebounceCounterJumpDownValue = 0
              DemDebounceCounterJumpUpValue = 0
              DemDebounceCounterStorage = false
              DemDebounceContinuous = false
      DTC_0xe01478 (DemEventParameter):
        DemEventKind = DEM_EVENT_KIND_SWC
        DemEventTimeSeries = DEM_TIMESERIES_SNAPSHOT_NONE
        DemEventAvailable = true
        DemEventId = 42
        DemEventAvailableInVariant = true
        DemEventLatchTestFailed = false
        DemDTCClassRef = DTCClass_DTC_0xe01478
        DemExtendedDataClassRef = ExtendedDataClass_d1497ac7
        DemEventClass:
          DemAgingCycleCounterThreshold = 0
          DemEventDestination = DEM_DTC_ORIGIN_PRIMARY_MEMORY
          DemAgingAllowed = false
          DemConsiderPtoStatus = false
          DemEventPriority = 2
          DemFFPrestorageSupported = false
          DemAgingCycleRef = IgnitionCycle
          DemOperationCycleRef = IgnitionCycle
          DemDebounceAlgorithmClass
            DemDebounceCounterBased:
              DemDebounceCounterDecrementStepSize = 1
              DemDebounceCounterIncrementStepSize = 1
              DemDebounceCounterJumpUp = true
              DemDebounceCounterFailedThreshold = 128
              DemDebounceCounterPassedThreshold = -128
              DemDebounceBehavior = DEM_DEBOUNCE_FREEZE
              DemDebounceCounterJumpDown = true
              DemDebounceCounterJumpDownValue = 0
              DemDebounceCounterJumpUpValue = 0
              DemDebounceCounterStorage = false
              DemDebounceContinuous = false
      DTCClass_DTC_0xf00042 (DemDTCClass): DemUdsDTC=15728706, DemImmediateNvStorage=false
      DTC_0x502d00 (DemEventParameter):
        DemEventKind = DEM_EVENT_KIND_SWC
        DemEventTimeSeries = DEM_TIMESERIES_SNAPSHOT_NONE
        DemEventAvailable = true
        DemEventId = 6
        DemEventAvailableInVariant = true
        DemEventLatchTestFailed = false
        DemDTCClassRef = DTCClass_DTC_0x502d00
        DemExtendedDataClassRef = ExtendedDataClass_d1497ac7
        DemEventClass:
          DemAgingCycleCounterThreshold = 0
          DemEventDestination = DEM_DTC_ORIGIN_PRIMARY_MEMORY
          DemAgingAllowed = false
          DemConsiderPtoStatus = false
          DemEventPriority = 2
          DemFFPrestorageSupported = false
          DemAgingCycleRef = IgnitionCycle
          DemOperationCycleRef = IgnitionCycle
          DemDebounceAlgorithmClass
            DemDebounceCounterBased:
              DemDebounceCounterDecrementStepSize = 1
              DemDebounceCounterIncrementStepSize = 1
              DemDebounceCounterJumpUp = true
              DemDebounceCounterFailedThreshold = 128
              DemDebounceCounterPassedThreshold = -128
              DemDebounceBehavior = DEM_DEBOUNCE_FREEZE
              DemDebounceCounterJumpDown = true
              DemDebounceCounterJumpDownValue = 0
              DemDebounceCounterJumpUpValue = 0
              DemDebounceCounterStorage = false
              DemDebounceContinuous = false
      5 x DemDTCClass, all with DemImmediateNvStorage=false:
        DTCClass_DTC_0xc25600: DemUdsDTC=12736000
        DTCClass_DTC_0xf00049: DemUdsDTC=15728713
        DTCClass_DTC_0xc25200: DemUdsDTC=12734976
        DTCClass_DTC_0xc42200: DemUdsDTC=12853760
        DTCClass_DTC_0xf00168: DemUdsDTC=15729000
      DTC_0xc12200 (DemEventParameter):
        DemEventKind = DEM_EVENT_KIND_SWC
        DemEventTimeSeries = DEM_TIMESERIES_SNAPSHOT_NONE
        DemEventAvailable = true
        DemEventId = 22
        DemEventAvailableInVariant = true
        DemEventLatchTestFailed = false
        DemDTCClassRef = DTCClass_DTC_0xc12200
        DemExtendedDataClassRef = ExtendedDataClass_d1497ac7
        DemEventClass:
          DemAgingCycleCounterThreshold = 0
          DemEventDestination = DEM_DTC_ORIGIN_PRIMARY_MEMORY
          DemAgingAllowed = false
          DemConsiderPtoStatus = false
          DemEventPriority = 2
          DemFFPrestorageSupported = false
          DemAgingCycleRef = IgnitionCycle
          DemOperationCycleRef = IgnitionCycle
          DemDebounceAlgorithmClass
            DemDebounceCounterBased:
              DemDebounceCounterDecrementStepSize = 1
              DemDebounceCounterIncrementStepSize = 1
              DemDebounceCounterJumpUp = true
              DemDebounceCounterFailedThreshold = 128
              DemDebounceCounterPassedThreshold = -128
              DemDebounceBehavior = DEM_DEBOUNCE_FREEZE
              DemDebounceCounterJumpDown = true
              DemDebounceCounterJumpDownValue = 0
              DemDebounceCounterJumpUpValue = 0
              DemDebounceCounterStorage = false
              DemDebounceContinuous = false
      3 x DemDTCClass, all with DemImmediateNvStorage=false:
        DTCClass_DTC_0xc41500: DemUdsDTC=12850432
        DTCClass_DTC_0x600b49: DemUdsDTC=6294345
        DTCClass_DTC_0xf00317: DemUdsDTC=15729431
      DTC_0xc12600 (DemEventParameter):
        DemEventKind = DEM_EVENT_KIND_SWC
        DemEventTimeSeries = DEM_TIMESERIES_SNAPSHOT_NONE
        DemEventAvailable = true
        DemEventId = 23
        DemEventAvailableInVariant = true
        DemEventLatchTestFailed = false
        DemDTCClassRef = DTCClass_DTC_0xc12600
        DemExtendedDataClassRef = ExtendedDataClass_d1497ac7
        DemEventClass:
          DemAgingCycleCounterThreshold = 0
          DemEventDestination = DEM_DTC_ORIGIN_PRIMARY_MEMORY
          DemAgingAllowed = false
          DemConsiderPtoStatus = false
          DemEventPriority = 2
          DemFFPrestorageSupported = false
          DemAgingCycleRef = IgnitionCycle
          DemOperationCycleRef = IgnitionCycle
          DemDebounceAlgorithmClass
            DemDebounceCounterBased:
              DemDebounceCounterDecrementStepSize = 1
              DemDebounceCounterIncrementStepSize = 1
              DemDebounceCounterJumpUp = true
              DemDebounceCounterFailedThreshold = 128
              DemDebounceCounterPassedThreshold = -128
              DemDebounceBehavior = DEM_DEBOUNCE_FREEZE
              DemDebounceCounterJumpDown = true
              DemDebounceCounterJumpDownValue = 0
              DemDebounceCounterJumpUpValue = 0
              DemDebounceCounterStorage = false
              DemDebounceContinuous = false
      DTCClass_DTC_0x600c62 (DemDTCClass): DemUdsDTC=6294626, DemImmediateNvStorage=false
      DTCClass_DTC_0x502d00 (DemDTCClass): DemUdsDTC=5254400, DemImmediateNvStorage=false
      DTC_0xf00368 (DemEventParameter):
        DemEventKind = DEM_EVENT_KIND_SWC
        DemEventTimeSeries = DEM_TIMESERIES_SNAPSHOT_NONE
        DemEventAvailable = true
        DemEventId = 55
        DemEventAvailableInVariant = true
        DemEventLatchTestFailed = false
        DemDTCClassRef = DTCClass_DTC_0xf00368
        DemExtendedDataClassRef = ExtendedDataClass_d1497ac7
        DemEventClass:
          DemAgingCycleCounterThreshold = 0
          DemEventDestination = DEM_DTC_ORIGIN_PRIMARY_MEMORY
          DemAgingAllowed = false
          DemConsiderPtoStatus = false
          DemEventPriority = 2
          DemFFPrestorageSupported = false
          DemAgingCycleRef = IgnitionCycle
          DemOperationCycleRef = IgnitionCycle
          DemDebounceAlgorithmClass
            DemDebounceCounterBased:
              DemDebounceCounterDecrementStepSize = 1
              DemDebounceCounterIncrementStepSize = 1
              DemDebounceCounterJumpUp = true
              DemDebounceCounterFailedThreshold = 128
              DemDebounceCounterPassedThreshold = -128
              DemDebounceBehavior = DEM_DEBOUNCE_FREEZE
              DemDebounceCounterJumpDown = true
              DemDebounceCounterJumpDownValue = 0
              DemDebounceCounterJumpUpValue = 0
              DemDebounceCounterStorage = false
              DemDebounceContinuous = false
      DTC_0x600d62 (DemEventParameter):
        DemEventKind = DEM_EVENT_KIND_SWC
        DemEventTimeSeries = DEM_TIMESERIES_SNAPSHOT_NONE
        DemEventAvailable = true
        DemEventId = 12
        DemEventAvailableInVariant = true
        DemEventLatchTestFailed = false
        DemDTCClassRef = DTCClass_DTC_0x600d62
        DemExtendedDataClassRef = ExtendedDataClass_d1497ac7
        DemEventClass:
          DemAgingCycleCounterThreshold = 0
          DemEventDestination = DEM_DTC_ORIGIN_PRIMARY_MEMORY
          DemAgingAllowed = false
          DemConsiderPtoStatus = false
          DemEventPriority = 2
          DemFFPrestorageSupported = false
          DemAgingCycleRef = IgnitionCycle
          DemOperationCycleRef = IgnitionCycle
          DemDebounceAlgorithmClass
            DemDebounceCounterBased:
              DemDebounceCounterDecrementStepSize = 1
              DemDebounceCounterIncrementStepSize = 1
              DemDebounceCounterJumpUp = true
              DemDebounceCounterFailedThreshold = 128
              DemDebounceCounterPassedThreshold = -128
              DemDebounceBehavior = DEM_DEBOUNCE_FREEZE
              DemDebounceCounterJumpDown = true
              DemDebounceCounterJumpDownValue = 0
              DemDebounceCounterJumpUpValue = 0
              DemDebounceCounterStorage = false
              DemDebounceContinuous = false
      DTCClass_DTC_0x5b0049 (DemDTCClass): DemUdsDTC=5963849, DemImmediateNvStorage=false
      4 x DemEventParameter, all with DemEventKind=DEM_EVENT_KIND_SWC, DemEventTimeSeries=DEM_TIMESERIES_SNAPSHOT_NONE, DemEventAvailable=true, DemEventAvailableInVariant=true, DemEventLatchTestFailed=false, DemExtendedDataClassRef=ExtendedDataClass_d1497ac7:
        DTC_0xc42300: DemEventId=37, DemDTCClassRef=DTCClass_DTC_0xc42300
          DemEventClass:
            DemAgingCycleCounterThreshold = 0
            DemEventDestination = DEM_DTC_ORIGIN_PRIMARY_MEMORY
            DemAgingAllowed = false
            DemConsiderPtoStatus = false
            DemEventPriority = 2
            DemFFPrestorageSupported = false
            DemAgingCycleRef = IgnitionCycle
            DemOperationCycleRef = IgnitionCycle
            DemDebounceAlgorithmClass
              DemDebounceCounterBased:
                DemDebounceCounterDecrementStepSize = 1
                DemDebounceCounterIncrementStepSize = 1
                DemDebounceCounterJumpUp = true
                DemDebounceCounterFailedThreshold = 128
                DemDebounceCounterPassedThreshold = -128
                DemDebounceBehavior = DEM_DEBOUNCE_FREEZE
                DemDebounceCounterJumpDown = true
                DemDebounceCounterJumpDownValue = 0
                DemDebounceCounterJumpUpValue = 0
                DemDebounceCounterStorage = false
                DemDebounceContinuous = false
        DTC_0xc53c00: DemEventId=18, DemDTCClassRef=DTCClass_DTC_0xc53c00
          DemEventClass:
            DemAgingCycleCounterThreshold = 0
            DemEventDestination = DEM_DTC_ORIGIN_PRIMARY_MEMORY
            DemAgingAllowed = false
            DemConsiderPtoStatus = false
            DemEventPriority = 2
            DemFFPrestorageSupported = false
            DemAgingCycleRef = IgnitionCycle
            DemOperationCycleRef = IgnitionCycle
            DemDebounceAlgorithmClass
              DemDebounceCounterBased:
                DemDebounceCounterDecrementStepSize = 1
                DemDebounceCounterIncrementStepSize = 1
                DemDebounceCounterJumpUp = true
                DemDebounceCounterFailedThreshold = 128
                DemDebounceCounterPassedThreshold = -128
                DemDebounceBehavior = DEM_DEBOUNCE_FREEZE
                DemDebounceCounterJumpDown = true
                DemDebounceCounterJumpDownValue = 0
                DemDebounceCounterJumpUpValue = 0
                DemDebounceCounterStorage = false
                DemDebounceContinuous = false
        DTC_0xe30055: DemEventId=48, DemDTCClassRef=DTCClass_DTC_0xe30055
          DemEventClass:
            DemAgingCycleCounterThreshold = 0
            DemEventDestination = DEM_DTC_ORIGIN_PRIMARY_MEMORY
            DemAgingAllowed = false
            DemConsiderPtoStatus = false
            DemEventPriority = 2
            DemFFPrestorageSupported = false
            DemAgingCycleRef = IgnitionCycle
            DemOperationCycleRef = IgnitionCycle
            DemDebounceAlgorithmClass
              DemDebounceCounterBased:
                DemDebounceCounterDecrementStepSize = 1
                DemDebounceCounterIncrementStepSize = 1
                DemDebounceCounterJumpUp = true
                DemDebounceCounterFailedThreshold = 128
                DemDebounceCounterPassedThreshold = -128
                DemDebounceBehavior = DEM_DEBOUNCE_FREEZE
                DemDebounceCounterJumpDown = true
                DemDebounceCounterJumpDownValue = 0
                DemDebounceCounterJumpUpValue = 0
                DemDebounceCounterStorage = false
                DemDebounceContinuous = false
        DTC_0x600c49: DemEventId=9, DemDTCClassRef=DTCClass_DTC_0x600c49
          DemEventClass:
            DemAgingCycleCounterThreshold = 0
            DemEventDestination = DEM_DTC_ORIGIN_PRIMARY_MEMORY
            DemAgingAllowed = false
            DemConsiderPtoStatus = false
            DemEventPriority = 2
            DemFFPrestorageSupported = false
            DemAgingCycleRef = IgnitionCycle
            DemOperationCycleRef = IgnitionCycle
            DemDebounceAlgorithmClass
              DemDebounceCounterBased:
                DemDebounceCounterDecrementStepSize = 1
                DemDebounceCounterIncrementStepSize = 1
                DemDebounceCounterJumpUp = true
                DemDebounceCounterFailedThreshold = 128
                DemDebounceCounterPassedThreshold = -128
                DemDebounceBehavior = DEM_DEBOUNCE_FREEZE
                DemDebounceCounterJumpDown = true
                DemDebounceCounterJumpDownValue = 0
                DemDebounceCounterJumpUpValue = 0
                DemDebounceCounterStorage = false
                DemDebounceContinuous = false
      DTCClass_DTC_0xc14000 (DemDTCClass): DemUdsDTC=12664832, DemImmediateNvStorage=false
      DTCClass_DTC_0xc53c00 (DemDTCClass): DemUdsDTC=12925952, DemImmediateNvStorage=false
      DTC_0xc23b00 (DemEventParameter):
        DemEventKind = DEM_EVENT_KIND_SWC
        DemEventTimeSeries = DEM_TIMESERIES_SNAPSHOT_NONE
        DemEventAvailable = true
        DemEventId = 15
        DemEventAvailableInVariant = true
        DemEventLatchTestFailed = false
        DemDTCClassRef = DTCClass_DTC_0xc23b00
        DemExtendedDataClassRef = ExtendedDataClass_d1497ac7
        DemEventClass:
          DemAgingCycleCounterThreshold = 0
          DemEventDestination = DEM_DTC_ORIGIN_PRIMARY_MEMORY
          DemAgingAllowed = false
          DemConsiderPtoStatus = false
          DemEventPriority = 2
          DemFFPrestorageSupported = false
          DemAgingCycleRef = IgnitionCycle
          DemOperationCycleRef = IgnitionCycle
          DemDebounceAlgorithmClass
            DemDebounceCounterBased:
              DemDebounceCounterDecrementStepSize = 1
              DemDebounceCounterIncrementStepSize = 1
              DemDebounceCounterJumpUp = true
              DemDebounceCounterFailedThreshold = 128
              DemDebounceCounterPassedThreshold = -128
              DemDebounceBehavior = DEM_DEBOUNCE_FREEZE
              DemDebounceCounterJumpDown = true
              DemDebounceCounterJumpDownValue = 0
              DemDebounceCounterJumpUpValue = 0
              DemDebounceCounterStorage = false
              DemDebounceContinuous = false
      DTC_0xc41600 (DemEventParameter):
        DemEventKind = DEM_EVENT_KIND_SWC
        DemEventTimeSeries = DEM_TIMESERIES_SNAPSHOT_NONE
        DemEventAvailable = true
        DemEventId = 35
        DemEventAvailableInVariant = true
        DemEventLatchTestFailed = false
        DemDTCClassRef = DTCClass_DTC_0xc41600
        DemExtendedDataClassRef = ExtendedDataClass_d1497ac7
        DemEventClass:
          DemAgingCycleCounterThreshold = 0
          DemEventDestination = DEM_DTC_ORIGIN_PRIMARY_MEMORY
          DemAgingAllowed = false
          DemConsiderPtoStatus = false
          DemEventPriority = 2
          DemFFPrestorageSupported = false
          DemAgingCycleRef = IgnitionCycle
          DemOperationCycleRef = IgnitionCycle
          DemDebounceAlgorithmClass
            DemDebounceCounterBased:
              DemDebounceCounterDecrementStepSize = 1
              DemDebounceCounterIncrementStepSize = 1
              DemDebounceCounterJumpUp = true
              DemDebounceCounterFailedThreshold = 128
              DemDebounceCounterPassedThreshold = -128
              DemDebounceBehavior = DEM_DEBOUNCE_FREEZE
              DemDebounceCounterJumpDown = true
              DemDebounceCounterJumpDownValue = 0
              DemDebounceCounterJumpUpValue = 0
              DemDebounceCounterStorage = false
              DemDebounceContinuous = false
      DTCClass_DTC_0xc10200 (DemDTCClass): DemUdsDTC=12648960, DemImmediateNvStorage=false
      DTCClass_DTC_0xc12100 (DemDTCClass): DemUdsDTC=12656896, DemImmediateNvStorage=false
      DTC_0x9d234b (DemEventParameter):
        DemEventKind = DEM_EVENT_KIND_SWC
        DemEventTimeSeries = DEM_TIMESERIES_SNAPSHOT_NONE
        DemEventAvailable = true
        DemEventId = 5
        DemEventAvailableInVariant = true
        DemEventLatchTestFailed = false
        DemDTCClassRef = DTCClass_DTC_0x9d234b
        DemExtendedDataClassRef = ExtendedDataClass_d1497ac7
        DemEventClass:
          DemAgingCycleCounterThreshold = 0
          DemEventDestination = DEM_DTC_ORIGIN_PRIMARY_MEMORY
          DemAgingAllowed = false
          DemConsiderPtoStatus = false
          DemEventPriority = 2
          DemFFPrestorageSupported = false
          DemAgingCycleRef = IgnitionCycle
          DemOperationCycleRef = IgnitionCycle
          DemDebounceAlgorithmClass
            DemDebounceCounterBased:
              DemDebounceCounterDecrementStepSize = 1
              DemDebounceCounterIncrementStepSize = 1
              DemDebounceCounterJumpUp = true
              DemDebounceCounterFailedThreshold = 128
              DemDebounceCounterPassedThreshold = -128
              DemDebounceBehavior = DEM_DEBOUNCE_FREEZE
              DemDebounceCounterJumpDown = true
              DemDebounceCounterJumpDownValue = 0
              DemDebounceCounterJumpUpValue = 0
              DemDebounceCounterStorage = false
              DemDebounceContinuous = false
      DTCClass_DTC_0xc25300 (DemDTCClass): DemUdsDTC=12735232, DemImmediateNvStorage=false
      DTCClass_DTC_0xc42300 (DemDTCClass): DemUdsDTC=12854016, DemImmediateNvStorage=false
      DTC_0xc10200 (DemEventParameter):
        DemEventKind = DEM_EVENT_KIND_SWC
        DemEventTimeSeries = DEM_TIMESERIES_SNAPSHOT_NONE
        DemEventAvailable = true
        DemEventId = 20
        DemEventAvailableInVariant = true
        DemEventLatchTestFailed = false
        DemDTCClassRef = DTCClass_DTC_0xc10200
        DemExtendedDataClassRef = ExtendedDataClass_d1497ac7
        DemEventClass:
          DemAgingCycleCounterThreshold = 0
          DemEventDestination = DEM_DTC_ORIGIN_PRIMARY_MEMORY
          DemAgingAllowed = false
          DemConsiderPtoStatus = false
          DemEventPriority = 2
          DemFFPrestorageSupported = false
          DemAgingCycleRef = IgnitionCycle
          DemOperationCycleRef = IgnitionCycle
          DemDebounceAlgorithmClass
            DemDebounceCounterBased:
              DemDebounceCounterDecrementStepSize = 1
              DemDebounceCounterIncrementStepSize = 1
              DemDebounceCounterJumpUp = true
              DemDebounceCounterFailedThreshold = 128
              DemDebounceCounterPassedThreshold = -128
              DemDebounceBehavior = DEM_DEBOUNCE_FREEZE
              DemDebounceCounterJumpDown = true
              DemDebounceCounterJumpDownValue = 0
              DemDebounceCounterJumpUpValue = 0
              DemDebounceCounterStorage = false
              DemDebounceContinuous = false
      DTCClass_DTC_0x600c49 (DemDTCClass): DemUdsDTC=6294601, DemImmediateNvStorage=false
      DTC_0xc12100 (DemEventParameter):
        DemEventKind = DEM_EVENT_KIND_SWC
        DemEventTimeSeries = DEM_TIMESERIES_SNAPSHOT_NONE
        DemEventAvailable = true
        DemEventId = 21
        DemEventAvailableInVariant = true
        DemEventLatchTestFailed = false
        DemDTCClassRef = DTCClass_DTC_0xc12100
        DemExtendedDataClassRef = ExtendedDataClass_d1497ac7
        DemEventClass:
          DemAgingCycleCounterThreshold = 0
          DemEventDestination = DEM_DTC_ORIGIN_PRIMARY_MEMORY
          DemAgingAllowed = false
          DemConsiderPtoStatus = false
          DemEventPriority = 2
          DemFFPrestorageSupported = false
          DemAgingCycleRef = IgnitionCycle
          DemOperationCycleRef = IgnitionCycle
          DemDebounceAlgorithmClass
            DemDebounceCounterBased:
              DemDebounceCounterDecrementStepSize = 1
              DemDebounceCounterIncrementStepSize = 1
              DemDebounceCounterJumpUp = true
              DemDebounceCounterFailedThreshold = 128
              DemDebounceCounterPassedThreshold = -128
              DemDebounceBehavior = DEM_DEBOUNCE_FREEZE
              DemDebounceCounterJumpDown = true
              DemDebounceCounterJumpDownValue = 0
              DemDebounceCounterJumpUpValue = 0
              DemDebounceCounterStorage = false
              DemDebounceContinuous = false
      DTCClass_DTC_0xc41600 (DemDTCClass): DemUdsDTC=12850688, DemImmediateNvStorage=false
      DTC_0xc42800 (DemEventParameter):
        DemEventKind = DEM_EVENT_KIND_SWC
        DemEventTimeSeries = DEM_TIMESERIES_SNAPSHOT_NONE
        DemEventAvailable = true
        DemEventId = 38
        DemEventAvailableInVariant = true
        DemEventLatchTestFailed = false
        DemDTCClassRef = DTCClass_DTC_0xc42800
        DemExtendedDataClassRef = ExtendedDataClass_d1497ac7
        DemEventClass:
          DemAgingCycleCounterThreshold = 0
          DemEventDestination = DEM_DTC_ORIGIN_PRIMARY_MEMORY
          DemAgingAllowed = false
          DemConsiderPtoStatus = false
          DemEventPriority = 2
          DemFFPrestorageSupported = false
          DemAgingCycleRef = IgnitionCycle
          DemOperationCycleRef = IgnitionCycle
          DemDebounceAlgorithmClass
            DemDebounceCounterBased:
              DemDebounceCounterDecrementStepSize = 1
              DemDebounceCounterIncrementStepSize = 1
              DemDebounceCounterJumpUp = true
              DemDebounceCounterFailedThreshold = 128
              DemDebounceCounterPassedThreshold = -128
              DemDebounceBehavior = DEM_DEBOUNCE_FREEZE
              DemDebounceCounterJumpDown = true
              DemDebounceCounterJumpDownValue = 0
              DemDebounceCounterJumpUpValue = 0
              DemDebounceCounterStorage = false
              DemDebounceContinuous = false
      DTCClass_DTC_0xc15900 (DemDTCClass): DemUdsDTC=12671232, DemImmediateNvStorage=false
      DTC_0xc14000 (DemEventParameter):
        DemEventKind = DEM_EVENT_KIND_SWC
        DemEventTimeSeries = DEM_TIMESERIES_SNAPSHOT_NONE
        DemEventAvailable = true
        DemEventId = 24
        DemEventAvailableInVariant = true
        DemEventLatchTestFailed = false
        DemDTCClassRef = DTCClass_DTC_0xc14000
        DemExtendedDataClassRef = ExtendedDataClass_d1497ac7
        DemEventClass:
          DemAgingCycleCounterThreshold = 0
          DemEventDestination = DEM_DTC_ORIGIN_PRIMARY_MEMORY
          DemAgingAllowed = false
          DemConsiderPtoStatus = false
          DemEventPriority = 2
          DemFFPrestorageSupported = false
          DemAgingCycleRef = IgnitionCycle
          DemOperationCycleRef = IgnitionCycle
          DemDebounceAlgorithmClass
            DemDebounceCounterBased:
              DemDebounceCounterDecrementStepSize = 1
              DemDebounceCounterIncrementStepSize = 1
              DemDebounceCounterJumpUp = true
              DemDebounceCounterFailedThreshold = 128
              DemDebounceCounterPassedThreshold = -128
              DemDebounceBehavior = DEM_DEBOUNCE_FREEZE
              DemDebounceCounterJumpDown = true
              DemDebounceCounterJumpDownValue = 0
              DemDebounceCounterJumpUpValue = 0
              DemDebounceCounterStorage = false
              DemDebounceContinuous = false
      4 x DemDTCClass, all with DemImmediateNvStorage=false:
        DTCClass_DTC_0x600d62: DemUdsDTC=6294882
        DTCClass_DTC_0xc15500: DemUdsDTC=12670208
        DTCClass_DTC_0xc55400: DemUdsDTC=12932096
        DTCClass_DTC_0xc23a00: DemUdsDTC=12728832
      5 x DemEventParameter, all with DemEventKind=DEM_EVENT_KIND_SWC, DemEventTimeSeries=DEM_TIMESERIES_SNAPSHOT_NONE, DemEventAvailable=true, DemEventAvailableInVariant=true, DemEventLatchTestFailed=false, DemExtendedDataClassRef=ExtendedDataClass_d1497ac7:
        DTC_0xc45a00: DemEventId=16, DemDTCClassRef=DTCClass_DTC_0xc45a00
          DemEventClass:
            DemAgingCycleCounterThreshold = 0
            DemEventDestination = DEM_DTC_ORIGIN_PRIMARY_MEMORY
            DemAgingAllowed = false
            DemConsiderPtoStatus = false
            DemEventPriority = 2
            DemFFPrestorageSupported = false
            DemAgingCycleRef = IgnitionCycle
            DemOperationCycleRef = IgnitionCycle
            DemDebounceAlgorithmClass
              DemDebounceCounterBased:
                DemDebounceCounterDecrementStepSize = 1
                DemDebounceCounterIncrementStepSize = 1
                DemDebounceCounterJumpUp = true
                DemDebounceCounterFailedThreshold = 128
                DemDebounceCounterPassedThreshold = -128
                DemDebounceBehavior = DEM_DEBOUNCE_FREEZE
                DemDebounceCounterJumpDown = true
                DemDebounceCounterJumpDownValue = 0
                DemDebounceCounterJumpUpValue = 0
                DemDebounceCounterStorage = false
                DemDebounceContinuous = false
        DTC_0xc25300: DemEventId=29, DemDTCClassRef=DTCClass_DTC_0xc25300
          DemEventClass:
            DemAgingCycleCounterThreshold = 0
            DemEventDestination = DEM_DTC_ORIGIN_PRIMARY_MEMORY
            DemAgingAllowed = false
            DemConsiderPtoStatus = false
            DemEventPriority = 2
            DemFFPrestorageSupported = false
            DemAgingCycleRef = IgnitionCycle
            DemOperationCycleRef = IgnitionCycle
            DemDebounceAlgorithmClass
              DemDebounceCounterBased:
                DemDebounceCounterDecrementStepSize = 1
                DemDebounceCounterIncrementStepSize = 1
                DemDebounceCounterJumpUp = true
                DemDebounceCounterFailedThreshold = 128
                DemDebounceCounterPassedThreshold = -128
                DemDebounceBehavior = DEM_DEBOUNCE_FREEZE
                DemDebounceCounterJumpDown = true
                DemDebounceCounterJumpDownValue = 0
                DemDebounceCounterJumpUpValue = 0
                DemDebounceCounterStorage = false
                DemDebounceContinuous = false
        DTC_0x600c62: DemEventId=10, DemDTCClassRef=DTCClass_DTC_0x600c62
          DemEventClass:
            DemAgingCycleCounterThreshold = 0
            DemEventDestination = DEM_DTC_ORIGIN_PRIMARY_MEMORY
            DemAgingAllowed = false
            DemConsiderPtoStatus = false
            DemEventPriority = 2
            DemFFPrestorageSupported = false
            DemAgingCycleRef = IgnitionCycle
            DemOperationCycleRef = IgnitionCycle
            DemDebounceAlgorithmClass
              DemDebounceCounterBased:
                DemDebounceCounterDecrementStepSize = 1
                DemDebounceCounterIncrementStepSize = 1
                DemDebounceCounterJumpUp = true
                DemDebounceCounterFailedThreshold = 128
                DemDebounceCounterPassedThreshold = -128
                DemDebounceBehavior = DEM_DEBOUNCE_FREEZE
                DemDebounceCounterJumpDown = true
                DemDebounceCounterJumpDownValue = 0
                DemDebounceCounterJumpUpValue = 0
                DemDebounceCounterStorage = false
                DemDebounceContinuous = false
        DTC_0xc42200: DemEventId=36, DemDTCClassRef=DTCClass_DTC_0xc42200
          DemEventClass:
            DemAgingCycleCounterThreshold = 0
            DemEventDestination = DEM_DTC_ORIGIN_PRIMARY_MEMORY
            DemAgingAllowed = false
            DemConsiderPtoStatus = false
            DemEventPriority = 2
            DemFFPrestorageSupported = false
            DemAgingCycleRef = IgnitionCycle
            DemOperationCycleRef = IgnitionCycle
            DemDebounceAlgorithmClass
              DemDebounceCounterBased:
                DemDebounceCounterDecrementStepSize = 1
                DemDebounceCounterIncrementStepSize = 1
                DemDebounceCounterJumpUp = true
                DemDebounceCounterFailedThreshold = 128
                DemDebounceCounterPassedThreshold = -128
                DemDebounceBehavior = DEM_DEBOUNCE_FREEZE
                DemDebounceCounterJumpDown = true
                DemDebounceCounterJumpDownValue = 0
                DemDebounceCounterJumpUpValue = 0
                DemDebounceCounterStorage = false
                DemDebounceContinuous = false
        DTC_0xc40300: DemEventId=32, DemDTCClassRef=DTCClass_DTC_0xc40300
          DemEventClass:
            DemAgingCycleCounterThreshold = 0
            DemEventDestination = DEM_DTC_ORIGIN_PRIMARY_MEMORY
            DemAgingAllowed = false
            DemConsiderPtoStatus = false
            DemEventPriority = 2
            DemFFPrestorageSupported = false
            DemAgingCycleRef = IgnitionCycle
            DemOperationCycleRef = IgnitionCycle
            DemDebounceAlgorithmClass
              DemDebounceCounterBased:
                DemDebounceCounterDecrementStepSize = 1
                DemDebounceCounterIncrementStepSize = 1
                DemDebounceCounterJumpUp = true
                DemDebounceCounterFailedThreshold = 128
                DemDebounceCounterPassedThreshold = -128
                DemDebounceBehavior = DEM_DEBOUNCE_FREEZE
                DemDebounceCounterJumpDown = true
                DemDebounceCounterJumpDownValue = 0
                DemDebounceCounterJumpUpValue = 0
                DemDebounceCounterStorage = false
                DemDebounceContinuous = false
      DTCClass_DTC_0x600d49 (DemDTCClass): DemUdsDTC=6294857, DemImmediateNvStorage=false
      DTCClass_DTC_0x9d234b (DemDTCClass): DemUdsDTC=10298187, DemImmediateNvStorage=false
      3 x DemEventParameter, all with DemEventKind=DEM_EVENT_KIND_SWC, DemEventTimeSeries=DEM_TIMESERIES_SNAPSHOT_NONE, DemEventAvailable=true, DemEventAvailableInVariant=true, DemEventLatchTestFailed=false, DemExtendedDataClassRef=ExtendedDataClass_d1497ac7:
        DTC_0x600b49: DemEventId=7, DemDTCClassRef=DTCClass_DTC_0x600b49
          DemEventClass:
            DemAgingCycleCounterThreshold = 0
            DemEventDestination = DEM_DTC_ORIGIN_PRIMARY_MEMORY
            DemAgingAllowed = false
            DemConsiderPtoStatus = false
            DemEventPriority = 2
            DemFFPrestorageSupported = false
            DemAgingCycleRef = IgnitionCycle
            DemOperationCycleRef = IgnitionCycle
            DemDebounceAlgorithmClass
              DemDebounceCounterBased:
                DemDebounceCounterDecrementStepSize = 1
                DemDebounceCounterIncrementStepSize = 1
                DemDebounceCounterJumpUp = true
                DemDebounceCounterFailedThreshold = 128
                DemDebounceCounterPassedThreshold = -128
                DemDebounceBehavior = DEM_DEBOUNCE_FREEZE
                DemDebounceCounterJumpDown = true
                DemDebounceCounterJumpDownValue = 0
                DemDebounceCounterJumpUpValue = 0
                DemDebounceCounterStorage = false
                DemDebounceContinuous = false
        DTC_0xc15900: DemEventId=27, DemDTCClassRef=DTCClass_DTC_0xc15900
          DemEventClass:
            DemAgingCycleCounterThreshold = 0
            DemEventDestination = DEM_DTC_ORIGIN_PRIMARY_MEMORY
            DemAgingAllowed = false
            DemConsiderPtoStatus = false
            DemEventPriority = 2
            DemFFPrestorageSupported = false
            DemAgingCycleRef = IgnitionCycle
            DemOperationCycleRef = IgnitionCycle
            DemDebounceAlgorithmClass
              DemDebounceCounterBased:
                DemDebounceCounterDecrementStepSize = 1
                DemDebounceCounterIncrementStepSize = 1
                DemDebounceCounterJumpUp = true
                DemDebounceCounterFailedThreshold = 128
                DemDebounceCounterPassedThreshold = -128
                DemDebounceBehavior = DEM_DEBOUNCE_FREEZE
                DemDebounceCounterJumpDown = true
                DemDebounceCounterJumpDownValue = 0
                DemDebounceCounterJumpUpValue = 0
                DemDebounceCounterStorage = false
                DemDebounceContinuous = false
        DTC_0xc23a00: DemEventId=14, DemDTCClassRef=DTCClass_DTC_0xc23a00
          DemEventClass:
            DemAgingCycleCounterThreshold = 0
            DemEventDestination = DEM_DTC_ORIGIN_PRIMARY_MEMORY
            DemAgingAllowed = false
            DemConsiderPtoStatus = false
            DemEventPriority = 2
            DemFFPrestorageSupported = false
            DemAgingCycleRef = IgnitionCycle
            DemOperationCycleRef = IgnitionCycle
            DemDebounceAlgorithmClass
              DemDebounceCounterBased:
                DemDebounceCounterDecrementStepSize = 1
                DemDebounceCounterIncrementStepSize = 1
                DemDebounceCounterJumpUp = true
                DemDebounceCounterFailedThreshold = 128
                DemDebounceCounterPassedThreshold = -128
                DemDebounceBehavior = DEM_DEBOUNCE_FREEZE
                DemDebounceCounterJumpDown = true
                DemDebounceCounterJumpDownValue = 0
                DemDebounceCounterJumpUpValue = 0
                DemDebounceCounterStorage = false
                DemDebounceContinuous = false
      DTCClass_DTC_0xc42800 (DemDTCClass): DemUdsDTC=12855296, DemImmediateNvStorage=false
      DTC_0xc15500 (DemEventParameter):
        DemEventKind = DEM_EVENT_KIND_SWC
        DemEventTimeSeries = DEM_TIMESERIES_SNAPSHOT_NONE
        DemEventAvailable = true
        DemEventId = 26
        DemEventAvailableInVariant = true
        DemEventLatchTestFailed = false
        DemDTCClassRef = DTCClass_DTC_0xc15500
        DemExtendedDataClassRef = ExtendedDataClass_d1497ac7
        DemEventClass:
          DemAgingCycleCounterThreshold = 0
          DemEventDestination = DEM_DTC_ORIGIN_PRIMARY_MEMORY
          DemAgingAllowed = false
          DemConsiderPtoStatus = false
          DemEventPriority = 2
          DemFFPrestorageSupported = false
          DemAgingCycleRef = IgnitionCycle
          DemOperationCycleRef = IgnitionCycle
          DemDebounceAlgorithmClass
            DemDebounceCounterBased:
              DemDebounceCounterDecrementStepSize = 1
              DemDebounceCounterIncrementStepSize = 1
              DemDebounceCounterJumpUp = true
              DemDebounceCounterFailedThreshold = 128
              DemDebounceCounterPassedThreshold = -128
              DemDebounceBehavior = DEM_DEBOUNCE_FREEZE
              DemDebounceCounterJumpDown = true
              DemDebounceCounterJumpDownValue = 0
              DemDebounceCounterJumpUpValue = 0
              DemDebounceCounterStorage = false
              DemDebounceContinuous = false
      DTC_0xc41500 (DemEventParameter):
        DemEventKind = DEM_EVENT_KIND_SWC
        DemEventTimeSeries = DEM_TIMESERIES_SNAPSHOT_NONE
        DemEventAvailable = true
        DemEventId = 33
        DemEventAvailableInVariant = true
        DemEventLatchTestFailed = false
        DemDTCClassRef = DTCClass_DTC_0xc41500
        DemExtendedDataClassRef = ExtendedDataClass_d1497ac7
        DemEventClass:
          DemAgingCycleCounterThreshold = 0
          DemEventDestination = DEM_DTC_ORIGIN_PRIMARY_MEMORY
          DemAgingAllowed = false
          DemConsiderPtoStatus = false
          DemEventPriority = 2
          DemFFPrestorageSupported = false
          DemAgingCycleRef = IgnitionCycle
          DemOperationCycleRef = IgnitionCycle
          DemDebounceAlgorithmClass
            DemDebounceCounterBased:
              DemDebounceCounterDecrementStepSize = 1
              DemDebounceCounterIncrementStepSize = 1
              DemDebounceCounterJumpUp = true
              DemDebounceCounterFailedThreshold = 128
              DemDebounceCounterPassedThreshold = -128
              DemDebounceBehavior = DEM_DEBOUNCE_FREEZE
              DemDebounceCounterJumpDown = true
              DemDebounceCounterJumpDownValue = 0
              DemDebounceCounterJumpUpValue = 0
              DemDebounceCounterStorage = false
              DemDebounceContinuous = false
      4 x DemDTCClass, all with DemImmediateNvStorage=false:
        DTCClass_DTC_0xe01481: DemUdsDTC=14685313
        DTCClass_DTC_0xc45a00: DemUdsDTC=12868096
        DTCClass_DTC_0xc12600: DemUdsDTC=12658176
        DTCClass_DTC_0xc12200: DemUdsDTC=12657152
      3 x DemEventParameter, all with DemEventKind=DEM_EVENT_KIND_SWC, DemEventTimeSeries=DEM_TIMESERIES_SNAPSHOT_NONE, DemEventAvailable=true, DemEventAvailableInVariant=true, DemEventLatchTestFailed=false, DemExtendedDataClassRef=ExtendedDataClass_d1497ac7:
        DTC_0x5b0049: DemEventId=3, DemDTCClassRef=DTCClass_DTC_0x5b0049
          DemEventClass:
            DemAgingCycleCounterThreshold = 0
            DemEventDestination = DEM_DTC_ORIGIN_PRIMARY_MEMORY
            DemAgingAllowed = false
            DemConsiderPtoStatus = false
            DemEventPriority = 2
            DemFFPrestorageSupported = false
            DemAgingCycleRef = IgnitionCycle
            DemOperationCycleRef = IgnitionCycle
            DemDebounceAlgorithmClass
              DemDebounceCounterBased:
                DemDebounceCounterDecrementStepSize = 1
                DemDebounceCounterIncrementStepSize = 1
                DemDebounceCounterJumpUp = true
                DemDebounceCounterFailedThreshold = 128
                DemDebounceCounterPassedThreshold = -128
                DemDebounceBehavior = DEM_DEBOUNCE_FREEZE
                DemDebounceCounterJumpDown = true
                DemDebounceCounterJumpDownValue = 0
                DemDebounceCounterJumpUpValue = 0
                DemDebounceCounterStorage = false
                DemDebounceContinuous = false
        DTC_0xf00317: DemEventId=54, DemDTCClassRef=DTCClass_DTC_0xf00317
          DemEventClass:
            DemAgingCycleCounterThreshold = 0
            DemEventDestination = DEM_DTC_ORIGIN_PRIMARY_MEMORY
            DemAgingAllowed = false
            DemConsiderPtoStatus = false
            DemEventPriority = 2
            DemFFPrestorageSupported = false
            DemAgingCycleRef = IgnitionCycle
            DemOperationCycleRef = IgnitionCycle
            DemDebounceAlgorithmClass
              DemDebounceCounterBased:
                DemDebounceCounterDecrementStepSize = 1
                DemDebounceCounterIncrementStepSize = 1
                DemDebounceCounterJumpUp = true
                DemDebounceCounterFailedThreshold = 128
                DemDebounceCounterPassedThreshold = -128
                DemDebounceBehavior = DEM_DEBOUNCE_FREEZE
                DemDebounceCounterJumpDown = true
                DemDebounceCounterJumpDownValue = 0
                DemDebounceCounterJumpUpValue = 0
                DemDebounceCounterStorage = false
                DemDebounceContinuous = false
        DTC_0xf00316: DemEventId=53, DemDTCClassRef=DTCClass_DTC_0xf00316
          DemEventClass:
            DemAgingCycleCounterThreshold = 0
            DemEventDestination = DEM_DTC_ORIGIN_PRIMARY_MEMORY
            DemAgingAllowed = false
            DemConsiderPtoStatus = false
            DemEventPriority = 2
            DemFFPrestorageSupported = false
            DemAgingCycleRef = IgnitionCycle
            DemOperationCycleRef = IgnitionCycle
            DemDebounceAlgorithmClass
              DemDebounceCounterBased:
                DemDebounceCounterDecrementStepSize = 1
                DemDebounceCounterIncrementStepSize = 1
                DemDebounceCounterJumpUp = true
                DemDebounceCounterFailedThreshold = 128
                DemDebounceCounterPassedThreshold = -128
                DemDebounceBehavior = DEM_DEBOUNCE_FREEZE
                DemDebounceCounterJumpDown = true
                DemDebounceCounterJumpDownValue = 0
                DemDebounceCounterJumpUpValue = 0
                DemDebounceCounterStorage = false
                DemDebounceContinuous = false
      6 x DemDTCClass, all with DemImmediateNvStorage=false:
        DTCClass_DTC_0xf00368: DemUdsDTC=15729512
        DTCClass_DTC_0xc40100: DemUdsDTC=12845312
        DTCClass_DTC_0xe30055: DemUdsDTC=14876757
        DTCClass_DTC_0xc55300: DemUdsDTC=12931840
        DTCClass_DTC_0xe01478: DemUdsDTC=14685304
        DTCClass_DTC_0xc23b00: DemUdsDTC=12729088
