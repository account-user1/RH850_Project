AUTOSAR XML (schema 4-2-1)
package /ActiveEcuC
  module config TunSelnMngt: implementation-config-variant=VARIANT-PRE-COMPILE
    TunSelnMngtCommon: OnlineCalibrationRamSize=7000
    XcpWriteAccess: EnableDevelopmentMode=STD_OFF
      Ram (XcpWriteAccessRegions): StartingAddress=4273864704, EndingAddress=4273995775, UseSymbolName=false, ProductionModeOnly=false, StartingAddressSymbol=, EndingAddressSymbol=
    CalRegn01 (CalRegions)
      CalRegn01CmnGroupA (CommonComponent): ComponentPartOfIntegration=true
      CalRegn01Inin00GroupA (InitializationComponent): ComponentPartOfIntegration=true
      CalRegn01Cmn (CommonComponent): ComponentPartOfIntegration=true
      3 x InitializationComponent, all with ComponentPartOfIntegration=true:
        CalRegn01Inin00
        CalRegn01Inin00GroupB
        CalRegn01Inin00GroupD
      6 x RuntimeComponent:
        CalRegn01Rt00: ComponentPartOfIntegration=true
        CalRegn01Rt{01..05}: ComponentPartOfIntegration=false, RuntimeComponentReference=CalRegn01Rt00
    CalibrationConfiguration
      IninIdx00 (InitializationCalibrationConfiguration):
        InitializationIndex = 0
        InitializationComponentReference = CalRegn01Inin00
        InitializationComponentReference = CalRegn01Inin00GroupA
        InitializationComponentReference = CalRegn01Inin00GroupB
        InitializationComponentReference = CalRegn01Inin00GroupD
        InitializationComponentReference = CalRegn02Inin00
        InitializationComponentReference = CalRegn02Inin00GroupA
        InitializationComponentReference = CalRegn02Inin00GroupB
      6 x RuntimeSelectableCalibrationConfiguration:
        RtIdx00: RuntimeIndex=0, RuntimeComponentReference=CalRegn01Rt00, RuntimeComponentReference=CalRegn02Rt00GroupA, RuntimeComponentReference=CalRegn02Rt00GroupB
        RtIdx01: RuntimeIndex=1, RuntimeComponentReference=CalRegn01Rt01, RuntimeComponentReference=CalRegn02Rt01GroupA, RuntimeComponentReference=CalRegn02Rt01GroupB
        RtIdx02: RuntimeIndex=2, RuntimeComponentReference=CalRegn01Rt02, RuntimeComponentReference=CalRegn02Rt02GroupA, RuntimeComponentReference=CalRegn02Rt02GroupB
        RtIdx03: RuntimeIndex=3, RuntimeComponentReference=CalRegn01Rt03, RuntimeComponentReference=CalRegn02Rt03GroupA, RuntimeComponentReference=CalRegn02Rt03GroupB
        RtIdx04: RuntimeIndex=4, RuntimeComponentReference=CalRegn01Rt04, RuntimeComponentReference=CalRegn02Rt04GroupA, RuntimeComponentReference=CalRegn02Rt04GroupB
        RtIdx05: RuntimeIndex=5, RuntimeComponentReference=CalRegn01Rt05, RuntimeComponentReference=CalRegn02Rt05GroupA, RuntimeComponentReference=CalRegn02Rt05GroupB
    GroupA (OnlineCalibrationGroup):
      GroupIndex = 0
      CommonComponentReference = CalRegn01CmnGroupA
      InitializationComponentReference = CalRegn01Inin00GroupA
      RuntimeComponentReference = CalRegn02Rt00GroupA
      CommonComponentReference = CalRegn02CmnGroupA
      RuntimeComponentReference = CalRegn02Rt{01..05}GroupA
      InitializationComponentReference = CalRegn02Inin00GroupA
    CalRegn02 (CalRegions)
      6 x RuntimeComponent:
        CalRegn02Rt00GroupA: ComponentPartOfIntegration=true
        CalRegn02Rt{01..05}GroupA: ComponentPartOfIntegration=false, RuntimeComponentReference=CalRegn02Rt00GroupA
      CalRegn02Inin00GroupA (InitializationComponent): ComponentPartOfIntegration=true
      3 x CommonComponent, all with ComponentPartOfIntegration=true:
        CalRegn02CmnGroupA
        CalRegn02Cmn
        CalRegn02CmnGroupB
      CalRegn02Inin00 (InitializationComponent): ComponentPartOfIntegration=true
      CalRegn02Inin00GroupB (InitializationComponent): ComponentPartOfIntegration=true
      6 x RuntimeComponent:
        CalRegn02Rt00GroupB: ComponentPartOfIntegration=true
        CalRegn02Rt{01..05}GroupB: ComponentPartOfIntegration=false, RuntimeComponentReference=CalRegn02Rt00GroupB
    GroupB (OnlineCalibrationGroup):
      GroupIndex = 1
      InitializationComponentReference = CalRegn01Inin00GroupB
      RuntimeComponentReference = CalRegn02Rt{00..05}GroupB
      InitializationComponentReference = CalRegn02Inin00GroupB
      CommonComponentReference = CalRegn02CmnGroupB
    GroupD (OnlineCalibrationGroup): GroupIndex=2, InitializationComponentReference=CalRegn01Inin00GroupD
