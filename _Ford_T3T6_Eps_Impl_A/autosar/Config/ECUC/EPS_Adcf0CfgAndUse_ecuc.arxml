AUTOSAR XML (schema 4-2-1)
package /ActiveEcuC
  module config Adcf0CfgAndUse: implementation-config-variant=VARIANT-PRE-COMPILE
    Adcf0CfgAndUseGeneral:
      ADCF0VCR00 = 24580
      ADCF0VCR01 = 0
      ADCF0VCR02 = 1
      ADCF0VCR03 = 2
      ADCF0VCR04 = 24588
      ADCF0VCR05 = 24580
      ADCF0VCR06 = 0
      ADCF0VCR07 = 1
      ADCF0VCR08 = 2
      ADCF0VCR09 = 10
      ADCF0VCR10 = 4
      ADCF0VCR11 = 6
      ADCF0VCR12 = 5
      ADCF0VCR13 = 8
      ADCF0VCR14 = 24588
      ADCF0VCR{15..20} = 24584
      ADCF0SGVCSP2 = 5
      ADCF0SGVCSP3 = 0
      ADCF0SGVCEP2 = 14
      ADCF0SGVCEP3 = 4
