AUTOSAR XML (schema 4-2-1)
package /ActiveEcuC
  module config Xcp: implementation-config-variant=VARIANT-POST-BUILD-SELECTABLE, module-description=Xcp_Impl
    XcpConfig
      XCPEVECH2MILLISEC (XcpEventChannel):
        XcpEventChannelNumber = 0
        XcpEventChannelTimeCycle = 2
        XcpEventChannelTimeUnit = TIMESTAMP_UNIT_1MS
        XcpEventChannelType = DAQ
        XcpEventChannelMaxDaqList = 1
      Xcp_DTO_Msg_oFD1_CAN_3abd61be (XcpPdu)
        Xcp_DTO_Msg_oFD1_CAN_3abd61be (XcpTxPdu): XcpTxPduId=0, XcpTxPduRef=PT_Xcp_DTO_Msg_PP_Xcp_DTO_Msg_Tx_3290b631_3cf8f7d5
      Xcp_CRO_Msg_oFD1_CAN_3abd61be (XcpPdu)
        Xcp_CRO_Msg_oFD1_CAN_3abd61be (XcpRxPdu):
          XcpRxPduId = 0
          XcpRxPduRef = PT_Xcp_CRO_Msg_PP_Xcp_CRO_Msg_Rx_3290b631_3cf8f7d5
          XcpTxPduContRef = Xcp_DTO_Msg_oFD1_CAN_3abd61be/Xcp_DTO_Msg_oFD1_CAN_3abd61be
    XcpGeneral:
      XcpOnCanEnabled = true
      XcpDevErrorDetect = true
      XcpMainFunctionPeriod = 0.01
      XcpMaxEventChannel = 255
      XcpPrescalerSupported = true
      XcpVersionInfoApi = false
      XcpCommandParameterCheck = true
      XcpEventCodes = false
      XcpBootloaderDownload = false
      XcpMemoryWriteProtection = false
      XcpMemoryReadProtection = false
      XcpControl = true
      XcpGetDataPointer = true
      XcpOpenCommandInterface = true
      XcpEEPROMReadAccess = false
      XcpEEPROMWriteAccess = false
      XcpSynchronousDataAquisition = true
      XcpSendQueue = true
      XcpMemorySize = 256
      XcpOverrunIndication = true
      XcpWriteDAQMultiple = false
      XcpDAQODTMessageHeader = false
      XcpResumeMode = false
      XcpGeneralInfo = true
      XcpResolutionInfo = true
      XcpSynchronousDataStimulation = false
      XcpNumberofODTsforSTIM = 1
      XcpDAQTimestamp = true
      XcpFixedTimestamp = false
      XcpCommunicationModeInfo = true
      XcpSeedKey = false
      XcpModifyBits = false
      XcpShortDownload = false
      XcpUserDefinedCommand = false
      XcpBlockUpload = false
      XcpBlockDownload = false
      XcpMIN_STForBlockDownload = 0
      XcpChecksum = false
      XcpAUTOSARCRCModuleSupport = false
      XcpCRCCalculationMethod = ADD_12
      XcpCRCBlockSize = 256
      XcpPageSwitching = true
      XcpGeneralPagingInfo = true
      XcpCopyPage = true
      XcpFreezeMode = false
      XcpProgramming = false
      XcpMinStPgm = 0
      XcpProcessorAndSectorInfo = false
      XcpServiceRequestMessage = false
      XcpPrintf = false
      XcpEnableCalibration = true
      XcpProgrammingWriteProtection = false
      XcpReadCCConfig = false
      XcpExtAddrReadCCConfig = 253
      XcpGenericMeasurement = false
      XcpRuntimeMeasurementSupport = false
      XcpGetDAQEventInfo = true
      XcpSendQueueOverflowFirst = false
      XcpVxSupport = false
      XcpGetIdGeneric = false
      XcpCustomCRC = false
      XcpTimeoutT1 = 2000
      XcpTimeoutT2 = 10000
      XcpTimeoutT{3..6} = 2000
      XcpTimeoutT7 = 0
      XcpTypeSafeCopy = false
      XcpMultiClientSupport = false
      CanXcpConfirmationTimeout = 10
      CanXcpMaxCto = 8
      CanXcpMaxDto = 8
      CanXcpVariableDlc = false
      CanXcpMultiConnectionProtection = false
      CanXcpSetPduModeSupport = false
      XcpOnCddEnabled = false
      XcpOnEthernetEnabled = false
      XcpOnFlexRayEnabled = false
      XcpUserConfigFile = ./Config/Xcp/NxtrXcp.cfg
      XcpTimestampTicks = 1
      XcpTimestampType = TWO_BYTE
      XcpTimestampUnit = TIMESTAMP_UNIT_1US
