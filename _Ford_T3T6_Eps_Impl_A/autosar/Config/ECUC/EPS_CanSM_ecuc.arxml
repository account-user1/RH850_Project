AUTOSAR XML (schema 4-2-1)
package /ActiveEcuC
  module config CanSM: implementation-config-variant=VARIANT-PRE-COMPILE, module-description=CanSM_Impl
    CanSMConfiguration: CanSMModeRequestRepetitionMax=10, CanSMModeRequestRepetitionTime=0.1
      CHNL_cd1e16dc (CanSMManagerNetwork):
        CanSMBorCounterL1ToL2 = 10
        CanSMBorTimeL1 = 0.04
        CanSMBorTimeL2 = 1
        CanSMBorTimeTxEnsured = 1
        CanSMBorTxConfirmationPolling = false
        CanSMComMNetworkHandleRef = FD1_CAN_f26020e5
        CT_FD1_CAN_b4e1ca3b (CanSMController): CanSMControllerId=CT_FD1_CAN_b4e1ca3b
    CanSMGeneral:
      CanSMDevErrorDetect = true
      CanSMMainFunctionTimePeriod = 0.01
      CanSMVersionInfoApi = false
      CanSMBorCheckLevel = false
      CanSMSetBaudrateApi = false
      CanSMExtendedRamCheck = false
      CanSmChangeBaudrateApi = false
      CanSMGeneration: CanSMOutOfBoundsWriteSanitizer=false, CanSMOutOfBoundsReadSanitizer=false
