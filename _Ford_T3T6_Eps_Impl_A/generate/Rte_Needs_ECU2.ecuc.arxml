AUTOSAR XML (schema 4-0-3)
package /DaVinci_Project
  module config Com
    ComConfig
      121 x ComSignal:
        AbsActv_B_Actl_eaa4779a: ComSignalType=BOOLEAN
        BrkTot_Tq_Actl_22c61bd2: ComSignalType=UINT16
        CmbbBrkDis_B_Actl_eaa4779a: ComSignalType=BOOLEAN
        CmbbDeny_B_ActlBrk_eaa4779a: ComSignalType=BOOLEAN
        CmbbObjClass_D_Stat_dafea5bb: ComSignalType=UINT8
        CmbbObjColl_T_Actl_dafea5bb: ComSignalType=UINT8
        CmbbObjConfdnc_D_Stat_dafea5bb: ComSignalType=UINT8
        CmbbObjDistLat_L_Actl_dafea5bb: ComSignalType=UINT16
        CmbbObjDistLong_L_Actl_dafea5bb: ComSignalType=UINT16
        CmbbObjRelLat_V_Actl_dafea5bb: ComSignalType=UINT16
        CmbbObjRelLong_V_Actl_dafea5bb: ComSignalType=UINT16
        DrvSteActv_B_Stat_635efcb3: ComSignalType=BOOLEAN
        DrvSte_Tq_Actl_635efcb3: ComSignalType=UINT8
        EPAS_Failure_635efcb3: ComSignalType=UINT8
        ElPw_D_StatStrtStop_e6deed9e: ComSignalType=UINT8
        ElPw_D_Stat_e6deed9e: ComSignalType=UINT8
        EsaEnbl_D2_Rq_dafea5bb: ComSignalType=UINT8
        EsaOn_B_Rq_bffaafb8: ComSignalType=BOOLEAN
        EsaOn_B_Stat_51142c79: ComSignalType=BOOLEAN
        GearLvrPos_D_Actl_8c4ca771: ComSignalType=UINT8
        GearRvrse_D_Actl_2508f61f: ComSignalType=UINT8
        HandsOffCnfm_B_Rq_5abef978: ComSignalType=BOOLEAN
        HitchToVehAxle_L_Calc_0bf22cce: ComSignalType=UINT8
        Ignition_Status_3c341b34: ComSignalType=UINT8
        LaActAvail_D_Actl_3724073d: ComSignalType=UINT8
        LaActDeny_B_Actl_3724073d: ComSignalType=BOOLEAN
        LaCurvature_No_Calc_d64ac390: ComSignalType=UINT16
        LaHandsOff_B_Actl_3724073d: ComSignalType=BOOLEAN
        LaRampType_B_Req_d64ac390: ComSignalType=BOOLEAN
        LaRefAng_No_Req_d64ac390: ComSignalType=UINT16
        LatCtlCurv_NoRate_Actl_5abef978: ComSignalType=UINT16
        LatCtlCurv_No_Actl_5abef978: ComSignalType=UINT16
        LatCtlLim_D_Stat_51142c79: ComSignalType=UINT8
        LatCtlPathOffst_L_Actl_5abef978: ComSignalType=UINT16
        LatCtlPath_An_Actl_5abef978: ComSignalType=UINT16
        LatCtlPrecision_D_Rq_5abef978: ComSignalType=UINT8
        LatCtlRampType_D_Rq_5abef978: ComSignalType=UINT8
        LatCtlRng_L_Max_5abef978: ComSignalType=UINT8
        LatCtlSte_D_Stat_51142c79: ComSignalType=UINT8
        LatCtl_D_Rq_5abef978: ComSignalType=UINT8
        LdwActvIntns_D_Req_d64ac390: ComSignalType=UINT8
        LdwActvStats_D_Req_d64ac390: ComSignalType=UINT8
        LifeCycMde_D_Actl_3c341b34: ComSignalType=UINT8
        LkaActvStats_D2_Req_d64ac390: ComSignalType=UINT8
        LsmcBrkDecelEnbl_D_Rq_3724073d: ComSignalType=UINT8
        LsmcBrkDecel_D_Stat_9f750b9f: ComSignalType=UINT8
        LsmcBrk_Tq_Rq_3724073d: ComSignalType=UINT16
        OdometerMasterValue_09a60c78: ComSignalType=UINT32
        Outside_Air_Temp_Stat_f1463698: ComSignalType=UINT8
        PrplWhlTot2_Tq_Actl_e6deed9e: ComSignalType=UINT16
        PwPckTq_D_Stat_e6deed9e: ComSignalType=UINT8
        SAPPAngleControlStat1_635efcb3: ComSignalType=UINT8
        SAPPAngleControlStat{2..6}_635efcb3: ComSignalType=BOOLEAN
        SelDrvMdeChassis2_D_Rq_e000acae: ComSignalType=UINT8
        SelDrvMdeSte_D_Stat_51142c79: ComSignalType=UINT8
        StabCtlBrkActv_B_Actl_eaa4779a: ComSignalType=BOOLEAN
        SteMdule_D_Stat_635efcb3: ComSignalType=UINT8
        SteMdule_I_Est_635efcb3: ComSignalType=UINT16
        SteMdule_U_Meas_635efcb3: ComSignalType=UINT8
        StePinAn_No_Cnt_837112cd: ComSignalType=UINT8
        StePinAn_No_Cs_837112cd: ComSignalType=UINT8
        StePinCompAnEst_D_Qf_837112cd: ComSignalType=UINT8
        StePinComp_An_Est_837112cd: ComSignalType=UINT16
        StePinOffst_An_Est_c3a8df7f: ComSignalType=UINT16
        StePinOffst_D_Stat_c3a8df7f: ComSignalType=UINT8
        StePinOffst_No_Cnt_c3a8df7f: ComSignalType=UINT8
        StePinOffst_No_Cs_c3a8df7f: ComSignalType=UINT8
        StePinRelInit_An_Sns_837112cd: ComSignalType=UINT16
        StePw_B_Rq_837112cd: ComSignalType=BOOLEAN
        SteeringColumnTorque_635efcb3: ComSignalType=UINT8
        TjaHandsOnCnfdnc_B_Est_3724073d: ComSignalType=BOOLEAN
        TrlrAidCtl_U_RqDrv_372f28fe: ComSignalType=UINT16
        TrlrAidEnbl_D2_Stat_51142c79: ComSignalType=UINT8
        TrlrAidMde_D_Rq_a35cbfab: ComSignalType=UINT8
        TrlrAidMsgTxt_D2_Rq_51142c79: ComSignalType=UINT8
        TrlrAidSwtch_D_RqDrv_372f28fe: ComSignalType=UINT8
        TrlrAidTrgtId_No_Actl_0bf22cce: ComSignalType=UINT8
        TrlrAid_An3_Actl_0bf22cce: ComSignalType=UINT16
        TrlrAid_AnRate2_Actl_0bf22cce: ComSignalType=UINT16
        TrlrAid_D2_Stat_0bf22cce: ComSignalType=UINT8
        TrlrAn_An_TrgtCalc_3724073d: ComSignalType=UINT8
        TrlrHitchLamp_D_Rqst_635efcb3: ComSignalType=BOOLEAN
        TrlrLampCnnct_B_Actl_6acffff2: ComSignalType=BOOLEAN
        TrlrRvrse_D_Stat_0bf22cce: ComSignalType=UINT8
        TrlrTrgtAcquire_D_Stat_0bf22cce: ComSignalType=UINT8
        TurnLghtSwtch_D_Stat_7262fead: ComSignalType=UINT8
        VehLatComp_A_Actl_470bb112: ComSignalType=UINT16
        VehLongComp_A_Actl_470bb112: ComSignalType=UINT16
        VehOverGnd_V_Est_470bb112: ComSignalType=UINT16
        VehVActlBrk_D_Qf_9f750b9f: ComSignalType=UINT8
        VehVActlBrk_No_Cnt_9f750b9f: ComSignalType=UINT8
        VehVActlBrk_No_Cs_9f750b9f: ComSignalType=UINT8
        VehVActlEng_D_Qf_2508f61f: ComSignalType=UINT8
        VehVActlEng_No_Cnt_2508f61f: ComSignalType=UINT8
        VehVActlEng_No_Cs_2508f61f: ComSignalType=UINT8
        VehVTrlrAid_B_Avail_2508f61f: ComSignalType=BOOLEAN
        VehVTrlrAid_B_Rq_635efcb3: ComSignalType=BOOLEAN
        VehVertComp_A_Actl_22c61bd2: ComSignalType=UINT16
        VehYawComp_W_Actl_470bb112: ComSignalType=UINT16
        VehYaw_W_Actl_f318059c: ComSignalType=UINT16
        Veh_V_ActlBrk_9f750b9f: ComSignalType=UINT16
        Veh_V_ActlEng_2508f61f: ComSignalType=UINT16
        Veh_V_RqMxTrlrAid_635efcb3: ComSignalType=UINT8
        VehicleGGCCData_575096ac: ComSignalType=UINT8_N
        WhlDirFl_D_Actl_91fa0768: ComSignalType=UINT8
        WhlDirFr_D_Actl_91fa0768: ComSignalType=UINT8
        WhlDirRl_D_Actl_91fa0768: ComSignalType=UINT8
        WhlDirRr_D_Actl_91fa0768: ComSignalType=UINT8
        WhlFl_W_Meas_5a620481: ComSignalType=UINT16
        WhlFr_W_Meas_5a620481: ComSignalType=UINT16
        WhlRl_W_Meas_5a620481: ComSignalType=UINT16
        WhlRotatFl_No_Cnt_91fa0768: ComSignalType=UINT8
        WhlRotatFr_No_Cnt_91fa0768: ComSignalType=UINT8
        WhlRotatRl_No_Cnt_91fa0768: ComSignalType=UINT8
        WhlRotatRr_No_Cnt_91fa0768: ComSignalType=UINT8
        WhlRr_W_Meas_5a620481: ComSignalType=UINT16
        YawStabilityIndex_706a037f: ComSignalType=UINT16
  ecuc value collection DaVinci_Project: ecuc-values=Com
