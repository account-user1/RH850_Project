/**********************************************************************************************************************
* COPYRIGHT
* \verbatim
* This software is copyright protected and proprietary to Vector Informatik GmbH.
* Vector Informatik GmbH grants to you only those rights as set out in the license conditions.
* All other rights remain with Vector Informatik GmbH.
* \endverbatim
* LICENSE
* Module: Xcp
* Program: MSR_Ford_SLP1 (MSR_Ford_SLP1)
* Customer: Nexteer Automotive Corporation
* Expiry Date: Not restricted
* Ordered Derivat.: R7F701373EABG
* License Scope : The usage is restricted to CBD1601056_D00
* FILE DESCRIPTION
* File: CanXcp_CT_FD1_CAN_b4e1ca3b_1546.a2l
* Generation Time: 2018-04-03 15:49:12
* Project: EPS - Version 1.0
* Delivery: CBD1601056_D00
* Tool Version: DaVinci Configurator (beta) 5.14.21 SP3
*********************************************************************************************************************/
/**********************************************************************************************************************
! BETA VERSION !
! These programs are fully operative programs. With regard to the fact that the programs are a beta-version only, !
! Vector Informatik's liability shall be expressly excluded in cases of ordinary negligence, to the extent !
! admissible by law or statute. !
**********************************************************************************************************************/
/begin XCP_ON_CAN 0x0102 /* XCP on CAN version */ CAN_ID_MASTER 1546 /* CMD/STIM */ CAN_ID_SLAVE 1547 /* RES/ERR/EV/SERV/DAQ */ BAUDRATE 500000 /* BAUDRATE */ SAMPLE_POINT 80 /* SAMPLE_POINT */ SAMPLE_RATE SINGLE /* SAMPLE_RATE */ BTL_CYCLES 15 /* BTL_CYCLES */ SJW 3 /* length synchr. segment */ MAX_DLC_REQUIRED /* master to slave frames always to have DLC = MAX_DLC = 8 */
 /begin CAN_FD MAX_DLC 8 /* DLC of CAN frame */ CAN_FD_DATA_TRANSFER_BAUDRATE 2000000 /* Baudrate [Hz] * //CanControllerFdBaudRate
SAMPLE_POINT 50 /* Sample Point Receiver */ BTL_CYCLES 4 /* BTL_CYCLES */ SJW 1 /* length synchr. segment */ MAX_DLC_REQUIRED /* Master to Slave Max DLC */ SECONDARY_SAMPLE_POINT 0 /* Sender Sample Point */ TRANSCEIVER_DELAY_COMPENSATION ON /end CAN_FD
 /begin PROTOCOL_LAYER 0x0101 2000 10000 2000 2000 2000 2000 0 8 /* kXcpMaxCto */ 8 /* kXcpMaxDto */ BYTE_ORDER_MSB_LAST /* Byte Order */ ADDRESS_GRANULARITY_BYTE OPTIONAL_CMD GET_COMM_MODE_INFO OPTIONAL_CMD SET_MTA OPTIONAL_CMD UPLOAD OPTIONAL_CMD SHORT_UPLOAD OPTIONAL_CMD DOWNLOAD OPTIONAL_CMD DOWNLOAD_MAX OPTIONAL_CMD SET_CAL_PAGE OPTIONAL_CMD GET_CAL_PAGE OPTIONAL_CMD GET_PAG_PROCESSOR_INFO OPTIONAL_CMD GET_PAGE_INFO OPTIONAL_CMD COPY_CAL_PAGE OPTIONAL_CMD SET_DAQ_PTR OPTIONAL_CMD WRITE_DAQ OPTIONAL_CMD SET_DAQ_LIST_MODE OPTIONAL_CMD GET_DAQ_LIST_MODE OPTIONAL_CMD START_STOP_DAQ_LIST OPTIONAL_CMD START_STOP_SYNCH OPTIONAL_CMD GET_DAQ_CLOCK OPTIONAL_CMD GET_DAQ_PROCESSOR_INFO OPTIONAL_CMD GET_DAQ_RESOLUTION_INFO OPTIONAL_CMD GET_DAQ_EVENT_INFO OPTIONAL_CMD FREE_DAQ OPTIONAL_CMD ALLOC_DAQ OPTIONAL_CMD ALLOC_ODT OPTIONAL_CMD ALLOC_ODT_ENTRY /end PROTOCOL_LAYER
/end XCP_ON_CAN
