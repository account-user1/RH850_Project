/***********************************************************************************************************************
| Description: Project specific master A2L file. The file may need to be adapted in order to match the ECU configuration
| C O P Y R I G H T
| Copyright by Vector Informatik GmbH. All rights reserved.
| This software is copyright protected and proprietary to
| Vector Informatik GmbH. Vector Informatik GmbH grants to you
| only those rights as set out in the license conditions. All
| other rights remain with Vector Informatik GmbH.
| A U T H O R I D E N T I T Y
| Initials Name Company
| Hs Hannes Haas Vector Informatik GmbH
| R E V I S I O N H I S T O R Y
| Date Version Author Description
| 2012-11-23 1.00.00 Hs Creation
|*********************************************************************************************************************/ ASAP2_VERSION 1 60
/begin PROJECT MICROSAR ""
/begin MODULE CPP ""
/begin MOD_COMMON "" /* BYTE_ORDER MSB_FIRST // TODO: Set the Byte Order of the ECU as defined by the ECUC module MSB_FIRST or MSB_LAST */ /* TODO: Please configure the byte alignment used in this project */ /* ALIGNMENT_BYTE 1 */ /* ALIGNMENT_WORD 2 */ /* ALIGNMENT_LONG 4 */ /* ALIGNMENT_INT64 8 */ /* ALIGNMENT_FLOAT32_IEEE 4 */ /* ALIGNMENT_FLOAT64_IEEE 8 */ /end MOD_COMMON
/begin MOD_PAR "" /* TODO: Add or include MEMORY_SEGMENT information here */ /* include "Config\McData\Rte_MemSeg.a2l"       // TODO: Adapt path of A2L file accordingly. Remove if not required. */ /end MOD_PAR
/begin IF_DATA XCP
 /include "Config\McData\XCP.a2l"
 /begin DAQ /* TODO: Add or include further a2l file splitter that provide XCP Events */
  /include "Config\McData\XCP_daq.a2l" /* TODO: Adapt path of A2L file accordingly. Remove if not required. */
  /include "Config\McData\XCP_events.a2l" /* TODO: Adapt path of A2L file accordingly. Remove if not required. */ /* include "Config\McData\Rte_XcpEvents.a2l"   // TODO: Adapt path of A2L file accordingly. Remove if not required. */ /* include "Config\McData\McData_Events.a2l"       // TODO: Adapt path of A2L file accordingly. Remove if not required. */ /end DAQ
 /include "Config\McData\CanXCPAsr.a2l"
 /include "Config\McData\FrXCPAsr.a2l" /end IF_DATA
/* TODO: Add or include further a2l splitter that provide measurement objects */
/* include "Config\McData\Rte.a2l"  // TODO: Adapt path of A2L file accordingly. Remove if not required. */
/* include "Config\McData\McData.a2l"   // TODO: Adapt path of A2L file accordingly. Remove if not required. */
/end MODULE
/end PROJECT
