AUTOSAR XML (schema 4-0-3)
# The material contained in this specification is protected by copyright and
# other types of Intellectual Property Rights. The commercial exploitation of
# the material contained in this specification requires a license to such
# Intellectual Property Rights.
# This specification may be utilized or reproduced without any modification, in
# any form or by any means, for informational purposes only.
# For any other purpose, no part of the specification may be utilized or
# reproduced, in any form or by any means, without permission in writing from
# the publisher.
# licensed under the same rules as applicable to the AUTOSAR Standard.
package /AUTOSAR/EcucDefs
  module definition Xcp [0..1]: variants post-build/pre-compile  # Configuration of the XCP module
    container XcpConfig: multiple-configuration-container=true
      container XcpDaqList [1..*]  # This container contains the configuration of the DAQs.
        integer XcpDaqListNumber: 0..65534, set at pre-compile, symbolic-name-value=true  # Index number of the DAQ list
        enumeration XcpDaqListType: {DAQ, DAQ_STIM, STIM}, set at pre-compile  # This indicates whether this DAQ list represents a DAQ or a STIM.
        integer XcpMaxOdt: 0..252, set at pre-compile  # MAX_ODT indicates the maximum amount of ODTs in this DAQ list | (STATIC configuration)
        integer XcpMaxOdtEntries: 0..255, set at pre-compile  # This parameter indicates the maximum amount of entries in an ODT of this DAQ list (STATIC configuration).
        container XcpDto [0..*]  # This container collects data transfer object specific parameters for the DAQ list.
          integer XcpDtoPid: 0..251, set at pre-compile, symbolic-name-value=true  # Packet identifier (PID) of the DTO that identifies the ODT the content of the DTO.
          choice reference XcpDto2PduMapping: set at pre-compile, destination=[XcpRxPdu, XcpTxPdu]  # This reference specifies the mapping of the DTO to the PDUs from the lower-layer interfaces (CanIf, FrIf, SoAd and Cdd). | A reference to a XcpRxPdu is only feasible if the the DaqListType is DAQ_STIM. A reference to a XcpTxPdu is only feasible if the DaqListType is DAQ.
        container XcpOdt [1..*]  # This container contains ODT-specific parameter for the DAQ list.
          integer XcpOdtEntryMaxSize: 0..254, set at pre-compile  # This parameter indicates the upper limit for the size of the element described by an ODT entry. Depending on the DaqListType this ODT belongs to it describes the limit for a DAQ (MAX_ODT_ENTRY_SIZE_DAQ) or a STIM (MAX_ODT_ENTRY_SIZE_STIM).
          integer XcpOdtNumber: 0..251, set at pre-compile, symbolic-name-value=true  # Index number of this ODT within the DAQ list.
          reference XcpOdt2DtoMapping: set at pre-compile, destination=XcpDto  # This reference maps the ODT to the according DTO in which it will be transmitted.
          container XcpOdtEntry [1..*]  # This container collects all configuration parameters that comprise an ODT entry.
            linker symbol XcpOdtEntryAddress: set at pre-compile  # Memory address that the ODT entry is referencing to.
            integer XcpOdtEntryLength: 0..255, set at pre-compile  # Length of the referenced memory area that is referenced by the ODT entry.
            integer XcpOdtEntryNumber: 0..254, set at pre-compile  # Index number of the ODT entry
      container XcpDemEventParameterRefs [0..1]  # Container for the references to DemEventParameter elements which shall be invoked using the API Dem_ReportErrorStatus API in case the corresponding error occurs. The EventId is taken from the referenced DemEventParameter's DemEventId value. The standardized errors are provided in the container and can be extended by vendor specific error references.
        symbolic name reference XCP_E_INIT_FAILED [0..1]: set at post-build in variant post-build / pre-compile in variant pre-compile, destination=DemEventParameter  # Reference to the DemEventParameter which shall be issued when the error "Initialization of XCP failed" has occured.
      container XcpEventChannel [1..*]  # This container contains the configuration of event channels on the XCP slave.
        enumeration XcpEventChannelConsistency: {DAQ, EVENT, ODT}, set at pre-compile, default-value=ODT  # Type of consistency used by event channel
        integer XcpEventChannelMaxDaqList: 0..255, set at pre-compile  # Maximum amount of DAQ lists that are handled by this event channel.
        integer XcpEventChannelNumber: 0..65534, set at pre-compile, symbolic-name-value=true  # Index number of the event channel.
        integer XcpEventChannelPriority: 0..255, set at pre-compile  # Priority of the event channel
        integer XcpEventChannelTimeCycle: 0..255, set at pre-compile  # The event channel time cycle indicates which sampling period is used to process this event channel. A value of 0 means 'Not cyclic'.
        enumeration XcpEventChannelTimeUnit [0..1]: {TIMESTAMP_UNIT_100MS, TIMESTAMP_UNIT_100NS, TIMESTAMP_UNIT_100PS, TIMESTAMP_UNIT_100US, TIMESTAMP_UNIT_10MS, TIMESTAMP_UNIT_10NS, TIMESTAMP_UNIT_10PS, TIMESTAMP_UNIT_10US, TIMESTAMP_UNIT_1MS, TIMESTAMP_UNIT_1NS, TIMESTAMP_UNIT_1PS, TIMESTAMP_UNIT_1S, TIMESTAMP_UNIT_1US}, set at pre-compile  # This configuration parameter indicates the unit of the event channel time cycle.
        enumeration XcpEventChannelType: {DAQ, DAQ_STIM, STIM}, set at pre-compile, default-value=DAQ  # This configuration parameter indicates what kind of DAQ list can be allocated to this event channel.
        reference XcpEventChannelTriggeredDaqListRef [1..*]: set at pre-compile, destination=XcpDaqList  # References all DAQ lists that are trigged by this event channel.
      choice container XcpPdu [1..*]  # Contains PDU information. A PDU may be either a transmission PDU or a reception PDU.
        container XcpRxPdu [0..1]  # This container specifies received PDUs.
          integer XcpRxPduId: 0..65535, set at pre-compile, symbolic-name-value=true  # ID of the PDU that will be received via a Xcp_<module>RxIndication.
          reference XcpRxPduRef: set at post-build in variant post-build / pre-compile in variant pre-compile, destination=Pdu
        container XcpTxPdu [0..1]  # This container specifies transmission PDUs.
          integer XcpTxPduId: 0..65535, set at pre-compile, symbolic-name-value=true  # The PDU identifier, which has to be used by the lower layer BSW module for TxConfirmations or TriggerTransmits.
          reference XcpTxPduRef: set at post-build in variant post-build / pre-compile in variant pre-compile, destination=Pdu  # Reference to the external PDU definition.
    container XcpGeneral  # This container contains the general configuration parameters of the XCP.
      enumeration XcpDaqConfigType: {DAQ_DYNAMIC, DAQ_STATIC}, set at pre-compile  # Sets the DAQ_CONFIG_TYPE bit within the DAQ_PROPERTIES parameter to "static" or to "dynamic". If DAQ_STATIC is selected, the DAQ_CONFIG_TYPE bit is set to "0". If DAQ_DYNAMIC is selected, the DAQ_CONFIG_TYPE bit is set to "1".
      integer XcpDaqCount: 0..65535, set at pre-compile  # Indicates the number of DAQ lists for dynamic configuration.
      boolean XcpDevErrorDetect: set at pre-compile  # Switches the Development Error Detection and Notification on or off. | TRUE: Development Error Detection and Notificiation on FALSE: Development Error Detection and Notification off
      enumeration XcpIdentificationFieldType: {ABSOLUTE, RELATIVE_BYTE, RELATIVE_WORD, RELATIVE_WORD_ALIGNED}, set at pre-compile  # Type of Identification Field the slave will use when transferring DAQ Packets to the master. The master has to use the same Type of Identification Field when transferring STIM Packets to the slave.
      float XcpMainFunctionPeriod: 0..Inf, set at pre-compile  # The XCP does not require this information but the BSW scheduler, which invokes the main function, needs it in order to plan its tasks.
      integer XcpMaxCto: 8..255, set at pre-compile  # MAX_CTO shows the maximum length of a CTO packet in bytes.
      integer XcpMaxDto: 8..65535, set at pre-compile  # MAX_DTO shows the maximum length of a DTO packet in bytes.
      integer XcpMaxEventChannel: 0..65535, set at pre-compile
      integer XcpMinDaq: 0..255, set at pre-compile  # Indicates the number of predefined, read only DAQ lists on the XCP slave.
      integer XcpOdtCount: 0..252, set at pre-compile  # This parameter indicates the amount of ODTs of a DAQ list using dynamic DAQ list configuration.
      integer XcpOdtEntriesCount: 0..255, set at pre-compile  # Indicates the amount of entries into an ODT using dynamic DAQ list configuration.
      integer XcpOdtEntrySizeDaq: 0..255, set at pre-compile  # Indicates the size of an element described by an ODT entry to the DaqListType for a DAQ.
      integer XcpOdtEntrySizeStim: 0..255, set at pre-compile  # Indicates the size of an element described by an ODT entry to the DaqListType for a stim.
      boolean XcpOnCanEnabled: set at pre-compile  # Enabling of XCPonCAN functionality
      boolean XcpOnCddEnabled: set at pre-compile  # Enabling of XCPonCdd functionality
      boolean XcpOnEthernetEnabled: set at pre-compile  # Enabling of XCPonEthernet functionality
      boolean XcpOnFlexRayEnabled: set at pre-compile  # Enabling of XCPonFlexRay functionality
      boolean XcpPrescalerSupported: set at pre-compile  # This parameter enables and disables the support for Prescaler support. True is Enabled, False is disabled
      boolean XcpSuppressTxSupport: set at pre-compile  # Switches the support of suppressing transmission of PDUs per communication channel on or off. | TRUE: Suppressing of TxPDUs supported FALSE: Suppressing of TxPDUs not supported
      integer XcpTimestampTicks: 0..65535, set at pre-compile  # This parameter defines the timestamp that will increment based TIMESTAMP_TICKS per unit and wrap around if an overflow occurs.
      enumeration XcpTimestampType: {FOUR_BYTE, NO_TIME_STAMP, ONE_BYTE, TWO_BYTE}, set at pre-compile  # This parameter indicates the number of bytes used for the timestamp field. In case No_TIME_STAMP is selected the timestamp field is not available.
      enumeration XcpTimestampUnit: {TIMESTAMP_UNIT_100MS, TIMESTAMP_UNIT_100NS, TIMESTAMP_UNIT_100PS, TIMESTAMP_UNIT_100US, TIMESTAMP_UNIT_10MS, TIMESTAMP_UNIT_10NS, TIMESTAMP_UNIT_10PS, TIMESTAMP_UNIT_10US, TIMESTAMP_UNIT_1MS, TIMESTAMP_UNIT_1NS, TIMESTAMP_UNIT_1PS, TIMESTAMP_UNIT_1S, TIMESTAMP_UNIT_1US}, set at pre-compile  # This parameter indicates the resolution of the data acquisition clock of the slave when transferring data to master.
      boolean XcpVersionInfoApi: set at pre-compile  # Enables/disables the existence of the XCP_GetVersionInfo() API service. | TRUE: XCP_GetVersionInfo() API service exists FALSE: XCP_GetVersionInfo() API service does not exist
      reference XcpCounterRef: set at pre-compile, destination=OsCounter  # This parameter contains a reference to the counter, which is used by XCP.
