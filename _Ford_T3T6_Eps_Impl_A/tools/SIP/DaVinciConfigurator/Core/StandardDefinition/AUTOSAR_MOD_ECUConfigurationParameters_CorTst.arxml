AUTOSAR XML (schema 4-0-3)
# The material contained in this specification is protected by copyright and
# other types of Intellectual Property Rights. The commercial exploitation of
# the material contained in this specification requires a license to such
# Intellectual Property Rights.
# This specification may be utilized or reproduced without any modification, in
# any form or by any means, for informational purposes only.
# For any other purpose, no part of the specification may be utilized or
# reproduced, in any form or by any means, without permission in writing from
# the publisher.
# licensed under the same rules as applicable to the AUTOSAR Standard.
package /AUTOSAR/EcucDefs
  module definition CorTst [0..1]: variants link-time/pre-compile  # Configuration of the CorTst module.
    container CorTstBackgroundConfigSet [0..*]  # Multiple Configuration Set Container, defines background mode.
      container CorTstSelect  # This container specifies configuration parameters to select individual tests for foreground mode and background mode. The availability is hardware and implementation specific.
        boolean CorTstAddress: set at link in variant link-time / pre-compile in variant pre-compile, default-value=false  # Enable/Disables core address test.
        boolean CorTstAlu: set at link in variant link-time / pre-compile in variant pre-compile, default-value=false  # Enable/Disables core ALU test.
        boolean CorTstCache: set at link in variant link-time / pre-compile in variant pre-compile, default-value=false  # Enable/Disables core cache test.
        boolean CorTstInterrupt: set at link in variant link-time / pre-compile in variant pre-compile, default-value=false  # Enable/Disables core interrupt test
        boolean CorTstMemoryIf: set at link in variant link-time / pre-compile in variant pre-compile, default-value=false  # Enable/Disables core memory interface test
        boolean CorTstMpu: set at link in variant link-time / pre-compile in variant pre-compile, default-value=false  # Enable/Disables core MPU test
        boolean CorTstRegister: set at link in variant link-time / pre-compile in variant pre-compile, default-value=false  # Enable/Disables core register test
    container CorTstConfigApiServices
      boolean CorTstAbortApi: set at pre-compile, default-value=false  # Adds / removes the service CorTst_Abort() from the code.
      boolean CorTstGetCurrentStatus: set at pre-compile, default-value=false  # Adds / removes the service CorTst_GetCurrentStatus() from the code.
      boolean CorTstGetFgndSignature: set at pre-compile, default-value=false  # Adds / removes the service CorTst_GetFgndSignature() from the code.
      boolean CorTstGetSignature: set at pre-compile, default-value=false  # Adds / removes the service CorTst_GetSignature() from the code.
      boolean CorTstGetStateApi: set at pre-compile, default-value=false  # Adds / removes the service CorTst_GetState() from the code.
      boolean CorTstStartApi: set at pre-compile, default-value=false  # Adds / removes the service CorTst_Start() from the code.
      boolean CorTstVersionInfoApi: set at pre-compile, default-value=false  # Adds / removes the service CorTst_GetVersionInfo() from the code.
    container CorTstDemEventParameterRefs [0..1]  # Container for the references to DemEventParameter elements which shall be invoked using the API Dem_ReportErrorStatus in case the corresponding error occurs. The EventId is taken from the referenced DemEventParameter's DemEventId value. The standardized errors are provided in the container and can be extended by vendor specific error references.
      symbolic name reference CORTST_E_CORE_FAILURE [0..1]: set at pre-compile, destination=DemEventParameter  # Reference to the DemEventParameter which shall be issued when the error "CORE failure" has occured.
    container CorTstForegroundConfigSet [1..*]  # Multiple Configuration Set Container , defines foreground mode.
      integer CorTstTestIdFgnd: 0..4294967295, set at pre-compile  # This is the Id of this specific foreground test configuration. The value shall be used in the call to the API CorTst_Start(CorTst_TestIdFgndType TestId).
      container CorTstSelect  # This container specifies configuration parameters to select individual tests for foreground mode and background mode. The availability is hardware and implementation specific.
        boolean CorTstAddress: set at link in variant link-time / pre-compile in variant pre-compile, default-value=false  # Enable/Disables core address test.
        boolean CorTstAlu: set at link in variant link-time / pre-compile in variant pre-compile, default-value=false  # Enable/Disables core ALU test.
        boolean CorTstCache: set at link in variant link-time / pre-compile in variant pre-compile, default-value=false  # Enable/Disables core cache test.
        boolean CorTstInterrupt: set at link in variant link-time / pre-compile in variant pre-compile, default-value=false  # Enable/Disables core interrupt test
        boolean CorTstMemoryIf: set at link in variant link-time / pre-compile in variant pre-compile, default-value=false  # Enable/Disables core memory interface test
        boolean CorTstMpu: set at link in variant link-time / pre-compile in variant pre-compile, default-value=false  # Enable/Disables core MPU test
        boolean CorTstRegister: set at link in variant link-time / pre-compile in variant pre-compile, default-value=false  # Enable/Disables core register test
    container CorTstGeneral
      boolean CorTstDevErrorDetect: set at pre-compile, default-value=false  # Switch for enabling the development error detection.
      integer CorTstFgndTestNumber: 1..4294967295, set at pre-compile  # This parameter holds the number of test configurations available for the foreground tests as defined in this configuration.
      boolean CorTstNotificationSupported: set at pre-compile, default-value=true  # Switch to indicate that the notification is supported.
      integer CorTstTestIntervalIdEndValue [0..1]: 0..4294967295, set at pre-compile  # Defines the end value of the Test Interval Id.
      boolean CorTstTestResultMode: set at pre-compile, default-value=false  # Switch for enabling test result comparison within the Core test driver. In this mode a core test result OK or NOTOK shall not be calculated from the core test driver. Within core test driver no comparison against the reference value is processed.
