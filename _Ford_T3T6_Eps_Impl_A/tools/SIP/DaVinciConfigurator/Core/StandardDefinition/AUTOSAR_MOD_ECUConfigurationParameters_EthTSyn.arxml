AUTOSAR XML (schema 4-0-3)
# The material contained in this specification is protected by copyright and
# other types of Intellectual Property Rights. The commercial exploitation of
# the material contained in this specification requires a license to such
# Intellectual Property Rights.
# This specification may be utilized or reproduced without any modification, in
# any form or by any means, for informational purposes only.
# For any other purpose, no part of the specification may be utilized or
# reproduced, in any form or by any means, without permission in writing from
# the publisher.
# licensed under the same rules as applicable to the AUTOSAR Standard.
package /AUTOSAR/EcucDefs
  module definition EthTSyn [0..1]: category=VENDOR_SPECIFIC_MODULE_DEFINITION, variants pre-compile  # Configuration of the Synchronized Time-base Manager (StbM) module with respect to global time handling on Ethernet.
    container EthTSynGeneral  # This container holds the general parameters of the Ethernet-specific Synchronized Time-base Manager
      boolean EthTSynDevErrorDetect: set at pre-compile, default-value=true  # This parameter switches the Development Error Detection and Notification ON or OFF. true: Development error detection is enabled. false: Development error detection is disabled. Note: In general, the development error detection is recommended during pre-test phase. It is not recommended to enable the development error detection in production code due to increased runtime and ROM needs.
      boolean EthTSynHardwareTimestampSupport: set at pre-compile, default-value=true  # Activate/Deactivate the hardware time stamping functionality of the Ethernet hardware. True: Clock is administrated by EthIf-Lower layer (e.g. Eth). Timestamps are requested from EthIf (e.g. EthIf_GetIngressTimestamp()) False: Clock is administrated by StbM, therefore timestamps are provided by the StbM. | True: Timestamp is retrieved from the Ethernet hardware False: Timestamp is retrieved from the StbM
      float EthTSynMainFunctionPeriod: 0..1.7976931348623157E+308, set at pre-compile, default-value=0.005  # Schedule period of the main function EthTSyn_MainFunction. Unit: [s].
      boolean EthTSynVersionInfo: default-value=false  # Activate/Deactivate the version information API (EthTSyn_GetVersionInfo) to get major, minor and patch version information. True: version information API activated False: version information API deactivated.
      string EthTSynDestPhyAddr: set at pre-compile, origin=Vector Informatik, default-value=01:80:C2:00:00:0E  # Destination Physical Address (MAC-Address) | Destination Physical Hardware Address (MAC-Address) of EthTSyn-gPTP Frames. Input format has to match xx::xx::xx::xx::xx::xx, where x stands for a hex value between 0 and F.
      string EthTSynUserConfigFile [0..1]: set at pre-compile, origin=Vector Informatik  # Reference to an external user configuration file that will be included during generation. The content of the user configuration file will be added at the end of the generated module configuration file and allows altering or extending the generated code. Caution: User configuration files can cause the software module to malfunction and must only be used with great care!
      string EthTSynPublicCddHeaderFile [0..*]: set at pre-compile, origin=Vector Informatik, max-length=32, min-length=1  # Defines header files for call-back functions (e.g. Sync / FollowUp sent) which shall be included in case of CDDs. Range of characters is 1.. 32.
      boolean EthTSynGmCapable: origin=Vector Informatik, default-value=false  # Grand Master Capable | Select whether the EthTSyn can act as Grand Master. In a bridge configuration, the ECU will take over the role of the GM in case a Sync-Timeout is detected on the Slave-Por
      reference EthTSynEthIfFrameType: set at pre-compile, origin=Vector Informatik, destination=EthIfFrameOwnerConfig  # Frame Type | The chosen frame owner determines which frames (in respect to ethertype) are received.
    container EthTSynGlobalTimeDomain [1..*]  # This represents the existence of a global time domain on Ethernet. The EthTSyn module can administrate several global time domains at the same time that in itself form a hierarchy of domains and sub-domains. | If the EthTSyn exists it is assumed that at least one global time domain exists.
      integer EthTSynGlobalTimeDomainId: 0..31, set at pre-compile, symbolic-name-value=true, default-value=0  # The global time domain ID.
      float EthTSynGlobalTimeFollowUpTimeout: 0..1.7976931348623157E+308, set at pre-compile, default-value=0.125  # Specifies the time waited for the reception of a FollowUp message after receiving a Sync message. After the Timeout the Sync message will be discarded. Unit: seconds
      float EthTSynGlobalTimeSyncTimeout [0..1]: 0..255, origin=Vector Informatik, default-value=0.25  # This parameter is only used in a Bridge configuration. It specifies the time, the bridge is waiting for the reception of a new Sync message on its slave port before a Grand Master timeout is assumed and the Bridge begins to generate its own Sync and FollowUp messages.
      boolean EthTSynBridgeKeepSourcePortIdentity [0..1]: origin=Vector Informatik, default-value=false  # This parameter is only used in a bridge configuration. When this parameter is enabled, the source port identity of forwarded Sync/FollowUp messages is not modified.
      symbolic name reference EthTSynSynchronizedTimeBaseRef: set at pre-compile, destination=StbMSynchronizedTimeBase  # Optional reference to the synchronized time-base. The refernece is only used when a TimeSource with STBM_TIMESTAMPING as TimestampMethdo is used.
      reference EthTSynTimeSourceRef: set at pre-compile, origin=Vector Informatik, destination=EthTSynTimeSourceConfig  # Refernece to the Time Source which will be used for the TimeDomain.
      container EthTSynGlobalTimeMaster [0..1]  # Configuration of the global time master. Each global time domain is required to have exactly one global time master. This master may or may not exist on the configured ECU.
        float EthTSynGlobalTimeTxFollowUpOffset: 0..Inf  # This represents configuration of the TX offset for Follow_Up / Pdelay_Resp_Follow_Up messages. Unit: seconds
        float EthTSynGlobalTimeTxPdelayReqPeriod: 0..Inf  # This represents configuration of the TX period for Pdelay_Req messages. Unit: seconds
        float EthTSynGlobalTimeTxPeriod: 0..Inf  # This represents configuration of the TX period. Unit: seconds
        reference EthTSynGlobalTimeEthIfRef: destination=EthIfController  # This represents the reference to the Ethernet interface taken to fetch the global time information.
      container EthTSynGlobalTimeSlave [0..1]  # Configuration of a time slave. Each global time domain is required to have at least one time slave. The configured ECU may or may not represent a time slave.
        float EthTSynGlobalTimeTxFollowUpOffset: 0..Inf  # This represents configuration of the TX offset for Follow_Up / Pdelay_Resp_Follow_Up messages. Unit: seconds
        float EthTSynGlobalTimeTxPdelayReqPeriod: 0..Inf  # This represents configuration of the TX period for Pdelay_Req messages. Unit: seconds
        float EthTSynTimeHardwareCorrectionThreshold [0..1]  # This parameter can be taken to define the maximum deviation between the local time and the time obtained from SYNC message that triggers a correction of the time drift caused by the hardware on the local node.
        reference EthTSynGlobalTimeEthIfRef: destination=EthIfController  # This represents the reference to the Ethernet interface taken to fetch the global time information.
    container EthTSynTimeSourceConfig [1..*]  # Configuration of the Time Sources used by the EthTSyn module
      enumeration EthTSynTimestampMethod: {HW_TIMESTAMPING, STBM_TIMESTAMPING, GPT_TIMESTAMPING, OS_TIMESTAMPING, CALLOUT_TIMESTAMPING}, set at pre-compile, origin=Vector Informatik, default-value=HW_TIMESTAMPING  # Select which timestamping method is used. HW_TIMESTAMPING: - Clock is managed in HW STBM_TIMESTAMPING: - Clock is managed in StbM OS/GPT/CALLOUT_TIMESTAMPING: - Clock is managed in EthTSyn - Local Time is derived from Os/Gpt Counter or from UserCallout
      choice reference EthTSynTimeBaseRef [0..1]: set at pre-compile, origin=Vector Informatik, destination=[OsCounter, GptChannelConfiguration]  # Reference to the Counter/EthIfController used as Time base. This parameter is only used if EthTSynTImestampMethod is set to: GPT_TIMESTAMPING OS_TIMESTAMPING
      container EthTSynTimestampCalloutConfig [0..1]  # Configuration of Timestamp Usercallout.
        function name EthTSynTimestampUserCallout: set at pre-compile, origin=Vector Informatik  # Name of the User-Callout function when Timestamp Method is set to "CALLOUT-TIMESTAMPING". This Function is called when EthTSyn_GetCurrentTimeRaw is invoked. The Callout-function has the following signature: Std_ReturnType TimestampUserCallout(EthTSyn_TimestampTickType *CurrentTickTime) The function shall return "E_OK" when the retrieval of the Time was successful and "E_NOT_OK" otherwise.
        integer EthTSynUserCalloutMaxValue: 1..4294967296, set at pre-compile, origin=Vector Informatik, default-value=1000000000  # Max Tick Value returned by the Usercallout.
        string EthTSynUserIncludeFile: set at pre-compile, origin=Vector Informatik  # This parameter defines a header file name which shall be included by EthTSyn for the Timestamp UserCallout.
        float EthTSynUserCalloutNsPerTick: 1..1000000000, set at pre-compile, origin=Vector Informatik, default-value=1  # Time of one "Tick" (returned by the Usercallout) in Nanoseconds.
