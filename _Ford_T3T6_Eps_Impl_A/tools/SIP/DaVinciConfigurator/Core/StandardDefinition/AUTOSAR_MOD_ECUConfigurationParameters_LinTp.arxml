AUTOSAR XML (schema 4-0-3)
# The material contained in this specification is protected by copyright and
# other types of Intellectual Property Rights. The commercial exploitation of
# the material contained in this specification requires a license to such
# Intellectual Property Rights.
# This specification may be utilized or reproduced without any modification, in
# any form or by any means, for informational purposes only.
# For any other purpose, no part of the specification may be utilized or
# reproduced, in any form or by any means, without permission in writing from
# the publisher.
# licensed under the same rules as applicable to the AUTOSAR Standard.
package /AUTOSAR/EcucDefs
  module definition LinTp [0..1]: variants link-time/post-build/pre-compile  # Singleton descriptor for the LIN Transport Protocol.
    container LinTpGeneral  # Container that holds all LIN transport protocol general parameters.
      boolean LinTpVersionInfoApi: set at pre-compile  # Switches the LinTp_GetVersionInfo function ON or OFF.
    container LinTpGlobalConfig: multiple-configuration-container=true  # This container contains the global configuration parameter of the LinTp. | It is a MultipleConfigurationContainer, i.e. this container and its sub-containers exit once per configuration set.
      integer LinTpMaxNumberOfRespPendingFrames: 0..65535, set at link in variant link-time / post-build in variant post-build / pre-compile in variant pre-compile  # Configures the maximum number of allowed response pending frames.
      integer LinTpNumberOfRxNSdu: 0..65535, set at link in variant link-time / post-build in variant post-build / pre-compile in variant pre-compile  # Number of transport protocol messages that can be received for all channels this node is connected to.
      integer LinTpNumberOfTxNSdu: 0..65535, set at link in variant link-time / post-build in variant post-build / pre-compile in variant pre-compile  # Number of transport protocol messages that can be transmitted for all channels this node is connected to.
      float LinTpP2Max: 0..5, set at link in variant link-time / post-build in variant post-build / pre-compile in variant pre-compile  # P2 Timeout when a response pending frame is expected in seconds.
      float LinTpP2Timing: 0..5, set at link in variant link-time / post-build in variant post-build / pre-compile in variant pre-compile  # Definition of the P2 timeout observation parameter in seconds.
      container LinTpChannelConfig [0..*]  # This container contains the channel specific configuration parameter of LinTp.
        boolean LinTpDropNotRequestedNad: set at link in variant link-time / post-build in variant post-build / pre-compile in variant pre-compile, default-value=false  # Configures if TP Frames of not requested LIN-Slaves are dropped or not. | false: Do drop TP Frames of Not requested LIN-Slaves true: Drop not TP Frames of Not requested LIN-Slaves
        boolean LinTpScheduleChangeDiag: set at link in variant link-time / post-build in variant post-build / pre-compile in variant pre-compile, default-value=false  # Enables or disables the call of BswM_LinTp_RequestMode() to diagnostic request/response schedule. | false: BswM is not called true: BswM is called
      container LinTpRxNSdu [0..*]  # For each received N-SDU on any channel the node is connected to.
        integer LinTpDl: 1..4095, set at link in variant link-time / post-build in variant post-build / pre-compile in variant pre-compile  # Data Length Code of this RxNsdu. In case of variable length message, this value indicates the minimum data length. | Range of minimum length is 1 to 4095. Note that this is not relevant for Tx. The reason for this is to have identical structures for Tx and Rx.
        float LinTpNcr [0..1]: 0..1, set at post-build in variant post-build / pre-compile in variant pre-compile  # Value in seconds of the N_Cr timeout. N_Cr is the time until reception of the next Consecutive Frame N_PDU.
        integer LinTpRxNSduId: 0..65535, set at link in variant link-time / post-build in variant post-build / pre-compile in variant pre-compile, symbolic-name-value=true  # The identifier of the Transport Protocol message. This ID will be the one that is communicated with upper layers.
        integer LinTpRxNSduNad: 0..255, set at link in variant link-time / post-build in variant post-build / pre-compile in variant pre-compile  # A N-SDU transported on LIN is identified using the NAD for the specific slave.
        reference LinTpRxNSduPduRef: set at link in variant link-time / post-build in variant post-build / pre-compile in variant pre-compile, destination=Pdu  # Reference to the global PDU
        symbolic name reference LinTpRxNSduChannelRef: set at link in variant link-time / post-build in variant post-build / pre-compile in variant pre-compile, destination=LinIfChannel  # Index of the channel this N-SDU belongs to.
      container LinTpTxNSdu [0..*]  # For each transmitted N-SDU on any channel the node is connected to.
        float LinTpNas: 0..1, set at post-build in variant post-build / pre-compile in variant pre-compile  # Value in second of the N_As timeout. N_As is the time for transmission of a LIN frame (any N_PDU) on the part of the sender.
        float LinTpNcs [0..1]: 0..Inf, set at post-build in variant post-build / pre-compile in variant pre-compile  # Value in seconds of the performance requirement of N_Cs. N_Cs is the time which elapses between the transmit request of a CF N-PDU until the transmit request of the next CF N-PDU.
        integer LinTpTxNSduId: 0..65535, set at link in variant link-time / post-build in variant post-build / pre-compile in variant pre-compile, symbolic-name-value=true  # The identifier of the Transport Protocol message. This ID will be the one that is communicated with upper layers.
        integer LinTpTxNSduNad: 0..255, set at link in variant link-time / post-build in variant post-build / pre-compile in variant pre-compile  # A N-SDU transported on LIN is identified using the NAD for the specific slave.
        reference LinTpTxNSduPduRef: set at link in variant link-time / post-build in variant post-build / pre-compile in variant pre-compile, destination=Pdu  # Reference to the global PDU
        symbolic name reference LinTpTxNSduChannelRef: set at link in variant link-time / post-build in variant post-build / pre-compile in variant pre-compile, destination=LinIfChannel  # Index of the channel this N-SDU belongs to.
