AUTOSAR XML (schema 4-0-3)
# The material contained in this specification is protected by copyright and
# other types of Intellectual Property Rights. The commercial exploitation of
# the material contained in this specification requires a license to such
# Intellectual Property Rights.
# This specification may be utilized or reproduced without any modification, in
# any form or by any means, for informational purposes only.
# For any other purpose, no part of the specification may be utilized or
# reproduced, in any form or by any means, without permission in writing from
# the publisher.
# licensed under the same rules as applicable to the AUTOSAR Standard.
package /AUTOSAR/EcucDefs
  module definition FiM [0..1]: variants post-build/pre-compile  # Configuration of the FiM (Function Inhibition Manager) module.
    container FiMConfigSet: multiple-configuration-container=true  # This container contains the configuration parameters and sub containers of the FiM module supporting multiple configuration sets. | This container is a MultipleConfigurationContainer, i.e. this container and its sub-containers exist once per configuration set.
      container FiMEventSummary [0..*]  # The summarized EventId definition record consists of a summarized event ID and a specific EventId. | This record means that a particular FID that has to be disabled in case of summarized event (defined above) is to be disabled in any of the specific events. A possible solution could be assigning events as summarized events along with a list of specific events. During the configuration process the summarized event substitutes the referenced single events. However, it is not outlined how this requirement is solved - whether by configuration process or by implementation within the FiM. The FiM configuration tool could also build up a suitable data structure for summarized events and deal with it in the FiM implementation.
        symbolic name reference FiMInputSumEventRef [1..*]: set at post-build in variant post-build / pre-compile in variant pre-compile, destination=DemEventParameter
        symbolic name reference FiMOutputSumEventRef: set at post-build in variant post-build / pre-compile in variant pre-compile, destination=FiMSummaryEventId
      container FiMFID [0..*]  # This container includes symbolic names of all FIDs.
        integer FiMFunctionId: 0..65535, set at pre-compile, symbolic-name-value=true  # The configuration parameter is used as an ID which represents a functionality. FiMFunctionId is the unique identifier assigned during FIM configuration. | Implementation Type: FiM_FunctionIdType.
      container FiMInhibitionConfiguration [0..*]  # This container includes all configuration parameters concerning the relationship between event and FID.
        enumeration FiMInhInhibitionMask: {FIM_LAST_FAILED, FIM_NOT_TESTED, FIM_TESTED, FIM_TESTED_AND_FAILED}, set at post-build in variant post-build / pre-compile in variant pre-compile  # The configuration parameter is used to specify the inhibition mask for an event - FID relation.
        reference FiMInhFunctionIdRef: set at post-build in variant post-build / pre-compile in variant pre-compile, destination=FiMFID
        container FiMInhEventId  # The configuration parameter is used for an existing DEM event and summarized events as well.
          choice container FiMInhRefChoice
            container FiMInhChoiceDemRef [0..1]
              symbolic name reference FiMInhEventRef: destination=DemEventParameter
            container FiMInhChoiceSumRef [0..1]
              symbolic name reference FiMInhSumRef [1..*]: destination=FiMSummaryEventId
      container FiMSummaryEventId [0..*]  # This container defines the name of a summarized event.
        integer FiMEventSumId: 0..65535, set at post-build in variant post-build / pre-compile in variant pre-compile, symbolic-name-value=true  # The summarized EventId definition record defines the existence of a summarized event with a specific name. This summarized event can be referenced in the EventSummary (as FimSummaryEventId) and Inhibition configuration (as FimInhEventId).
    container FiMGeneral
      boolean FiMDataFixed: set at pre-compile  # Enable or disable calibration of inhibit relations The scope of the parameter is to meet the requirement (FIM008) to have the option to calibrate inhibit data on the one hand side and also to provide the option to protect inhibit data for consistency reasons.
      boolean FiMDevErrorDetect: set at pre-compile  # This configuration parameter is used to switch on or to switch off the detection of development errors during development.
      boolean FiMEventUpdateTriggeredByDem: set at pre-compile  # This configuration parameter specifies the way FIM obtains status of EventIds. | TRUE: the DEM informs FIM about changes of event status, FALSE: the FIM polls event status from the DEM module either cyclically or on demand.
      integer FiMMaxEventFidLinks: 1..65535, set at pre-compile  # This configuration parameter specifies the total maximum number of links between EventIds and FIDs.
      integer FiMMaxEventsPerFid: 1..65535, set at pre-compile  # This configuration parameter specifies the maximum number of EventIds that can be linked to a single FID.
      integer FiMMaxFidsPerEvent: 1..65535, set at pre-compile  # This configuration parameter specifies the maximum number of FIDs that can be linked to a single event.
      integer FiMMaxSummaryEvents: 0..65535, set at pre-compile  # This configuration parameter specifies the maximum number of summarized events that can be configured.
      integer FiMMaxSummaryLinks: 0..65535, set at pre-compile  # This configuration parameter specifies the total maximum number of links between EventIds and summarized events.
      integer FiMMaxTotalLinks: 1..65535, set at pre-compile  # This configuration parameter specifies the total maximum number of links between EventIds and FIDs plus the number of links between EventIds and summarized events.
      float FiMTaskTime: 0..0.1, set at pre-compile, origin=AUTOSAR_ECUC V1.0.0  # Allow to configure the time for the periodic cyclic task. Please note: This configuration value shall be equal to the value in the Basic Software Scheduler configuration of the RTE module. | The AUTOSAR configuration standard is to use SI units, so this parameter is defined as float value in seconds. DEM configuration tools must convert this float value to the appropriate value format for the use in the software implementation of DEM. min: A negative value is not allowed. max: FID must be set after a maximal time of 100ms after DEM status is set. upperMultiplicity: Exactly one TaskTime must be specified per configuration. lowerMultiplicity: Exactly one TaskTime must be specified per configuration.
      boolean FiMVersionInfoApi: set at pre-compile  # This configuration parameter is used to switch on or to switch off the API to get the version information.
