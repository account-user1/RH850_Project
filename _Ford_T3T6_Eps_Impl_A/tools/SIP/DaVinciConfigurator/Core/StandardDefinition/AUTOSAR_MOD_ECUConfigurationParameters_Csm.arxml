AUTOSAR XML (schema 4-0-3)
# The material contained in this specification is protected by copyright and
# other types of Intellectual Property Rights. The commercial exploitation of
# the material contained in this specification requires a license to such
# Intellectual Property Rights.
# This specification may be utilized or reproduced without any modification, in
# any form or by any means, for informational purposes only.
# For any other purpose, no part of the specification may be utilized or
# reproduced, in any form or by any means, without permission in writing from
# the publisher.
# licensed under the same rules as applicable to the AUTOSAR Standard.
package /AUTOSAR/EcucDefs
  module definition Csm [0..1]: category=VENDOR_SPECIFIC_MODULE_DEFINITION, variants pre-compile  # Configuration of the Csm (CryptoServiceManager) module.
    container CsmKeys [0..1]  # Container for CSM keys
      container CsmKey [0..*]  # Container for configuration of a CSM key. The container name serves as a symbolic name for the identifier of a key configuration.
        integer CsmKeyId: 0..4294967295, set at pre-compile, symbolic-name-value=true, default-value=0  # Identifier of the CsmKey
        symbolic name reference CsmKeyRef: set at pre-compile, destination=CryIfKey
    container CsmPrimitives
      container CsmMacGenerate [0..1]  # Container for MacGenerate Configurations
        container CsmMacGenerateConfig [1..*]  # Container for configuration of a CSM mac generation interface. The container name serves as a symbolic name for the identifier of a MAC generation interface.
          integer CsmMacGenerateAlgorithmKeyLength: set at pre-compile  # Size of the MAC key in bytes
          enumeration CsmMacGenerateAlgorithmMode: {CRYPTO_ALGOMODE_HMAC, CRYPTO_ALGOMODE_CMAC, CRYPTO_ALGOMODE_GMAC, CRYPTO_ALGOMODE_SIPHASH_2_4, CRYPTO_ALGOMODE_SIPHASH_4_8, CRYPTO_ALGOMODE_CUSTOM}, set at pre-compile  # Determines the algorithm mode used for the crypto service
          enumeration CsmMacGenerateProcessing: {CSM_ASYNCHRONOUS, CSM_SYNCHRONOUS}, set at pre-compile  # Determines how the interface shall be used for that primitive
          integer CsmMacGenerateLength: set at pre-compile
          string CsmMacGenerateAlgorithmFamilyCustom [0..1]: set at pre-compile
          string CsmMacGenerateAlgorithmModeCustom [0..1]: set at pre-compile
          enumeration CsmMacGenerateAlgorithmSecondaryFamily: {CRYPTO_ALGOFAM_NOT_SET, CRYPTO_ALGOFAM_CUSTOM}, set at pre-compile  # Determines the secondary algorithm family used for the crypto service e.g. The hash algorithm for RSA Signatures
          string CsmMacGenerateAlgorithmSecondaryFamilyCustom [0..1]: set at pre-compile
          enumeration CsmMacGenerateAlgorithmFamily: {CRYPTO_ALGOFAM_NOT_SET, CRYPTO_ALGOFAM_SHA1, CRYPTO_ALGOFAM_SHA2_224, CRYPTO_ALGOFAM_SHA2_256, CRYPTO_ALGOFAM_SHA2_384, CRYPTO_ALGOFAM_SHA2_512, CRYPTO_ALGOFAM_SHA2_512_224, CRYPTO_ALGOFAM_SHA2_512_256, CRYPTO_ALGOFAM_SHA3_224, CRYPTO_ALGOFAM_SHA3_256, CRYPTO_ALGOFAM_SHA3_384, CRYPTO_ALGOFAM_SHA3_512, CRYPTO_ALGOFAM_SHAKE128, CRYPTO_ALGOFAM_SHAKE265, CRYPTO_ALGOFAM_RIPEMD160, CRYPTO_ALGOFAM_BLAKE_1_256, CRYPTO_ALGOFAM_BLAKE_1_512, CRYPTO_ALGOFAM_BLAKE_2S_256, CRYPTO_ALGOFAM_BLAKE_2S_512, CRYPTO_ALGOFAM_AES, CRYPTO_ALGOFAM_SIPHASH, CRYPTO_ALGOFAM_CUSTOM}, set at pre-compile  # Determines the algorithm family used for the crypto service
      container CsmMacVerify [0..1]  # Container for MacVerify Configurations
        container CsmMacVerifyConfig [1..*]  # Container for configuration of a CSM MAC verification interface. The container name serves as a symbolic name for the identifier of a MAC generation interface.
          integer CsmMacVerifyAlgorithmKeyLength: set at pre-compile  # Size of the MAC key in bytes
          enumeration CsmMacVerifyAlgorithmMode: {CRYPTO_ALGOMODE_HMAC, CRYPTO_ALGOMODE_CMAC, CRYPTO_ALGOMODE_GMAC, CRYPTO_ALGOMODE_SIPHASH_2_4, CRYPTO_ALGOMODE_SIPHASH_4_8, CRYPTO_ALGOMODE_CUSTOM}, set at pre-compile  # Determines the algorithm mode used for the crypto service
          enumeration CsmMacVerifyProcessing: {CSM_ASYNCHRONOUS, CSM_SYNCHRONOUS}, set at pre-compile  # Determines how the interface shall be used for that primitive
          integer CsmMacVerifyLength: set at pre-compile  # Size of the input MAC length in bits
          string CsmMacVerifyAlgorithmFamilyCustom [0..1]: set at pre-compile
          string CsmMacVerifyAlgorithmModeCustom [0..1]: set at pre-compile
          string CsmMacVerifyAlgorithmSecondaryFamilyCustom [0..1]: set at pre-compile
          enumeration CsmMacVerifyAlgorithmSecondaryFamily: {CRYPTO_ALGOFAM_NOT_SET, CRYPTO_ALGOFAM_CUSTOM}, set at pre-compile  # Determines the secondary algorithm family used for the crypto service e.g. The hash algorithm for RSA Signatures
          enumeration CsmMacVerifyAlgorithmFamily: {CRYPTO_ALGOFAM_NOT_SET, CRYPTO_ALGOFAM_SHA1, CRYPTO_ALGOFAM_SHA2_224, CRYPTO_ALGOFAM_SHA2_256, CRYPTO_ALGOFAM_SHA2_384, CRYPTO_ALGOFAM_SHA2_512, CRYPTO_ALGOFAM_SHA2_512_224, CRYPTO_ALGOFAM_SHA2_512_256, CRYPTO_ALGOFAM_SHA3_224, CRYPTO_ALGOFAM_SHA3_256, CRYPTO_ALGOFAM_SHA3_384, CRYPTO_ALGOFAM_SHA3_512, CRYPTO_ALGOFAM_SHAKE128, CRYPTO_ALGOFAM_SHAKE265, CRYPTO_ALGOFAM_RIPEMD160, CRYPTO_ALGOFAM_BLAKE_1_256, CRYPTO_ALGOFAM_BLAKE_1_512, CRYPTO_ALGOFAM_BLAKE_2S_256, CRYPTO_ALGOFAM_BLAKE_2S_512, CRYPTO_ALGOFAM_AES, CRYPTO_ALGOFAM_SIPHASH, CRYPTO_ALGOFAM_CUSTOM}, set at pre-compile  # Determines the algorithm family used for the crypto service
      container CsmSignatureGenerate [0..1]
        container CsmSignatureGenerateConfig [1..*]
          enumeration CsmSignatureGenerateAlgorithmFamily: {CRYPTO_ALGOFAM_RSA, CRYPTO_ALGOFAM_ED25519, CRYPTO_ALGOFAM_BRAINPOOL, CRYPTO_ALGOFAM_ECCNIST, CRYPTO_ALGOFAM_CUSTOM}, set at pre-compile  # Determines the algorithm family used for the crypto service
          enumeration CsmSignatureGenerateAlgorithmMode: {CRYPTO_ALGOMODE_NOT_SET, CRYPTO_ALGOMODE_RSASSA_PSS, CRYPTO_ALGOMODE_RSASSA_PKCS1_v1_5, CRYPTO_ALGOMODE_CUSTOM}, set at pre-compile  # Determines the algorithm mode used for the crypto service
          enumeration CsmSignatureGenerateProcessing: {CSM_ASYNCHRONOUS, CSM_SYNCHRONOUS}, set at pre-compile  # Determines how the interface shall be used for that primitive
          integer CsmSignatureGenerateAlgorithmKeyLength: set at pre-compile
          integer CsmSignatureGenerateLength: set at pre-compile
          string CsmSignatureGenerateAlgorithmFamilyCustom [0..1]: set at pre-compile
          string CsmSignatureGenerateAlgorithmModeCustom [0..1]: set at pre-compile
          string CsmSignatureGenerateAlgorithmSecondaryFamilyCustom [0..1]: set at pre-compile
          enumeration CsmSignatureGenerateAlgorithmSecondaryFamily: {CRYPTO_ALGOFAM_NOT_SET, CRYPTO_ALGOFAM_SHA1, CRYPTO_ALGOFAM_SHA2_224, CRYPTO_ALGOFAM_SHA2_256, CRYPTO_ALGOFAM_SHA2_384, CRYPTO_ALGOFAM_SHA2_512, CRYPTO_ALGOFAM_SHA2_512_224, CRYPTO_ALGOFAM_SHA2_512_256, CRYPTO_ALGOFAM_SHA3_224, CRYPTO_ALGOFAM_SHA3_256, CRYPTO_ALGOFAM_SHA3_384, CRYPTO_ALGOFAM_SHA3_512, CRYPTO_ALGOFAM_SHAKE128, CRYPTO_ALGOFAM_SHAKE265, CRYPTO_ALGOFAM_RIPEMD160, CRYPTO_ALGOFAM_BLAKE_1_256, CRYPTO_ALGOFAM_BLAKE_1_512, CRYPTO_ALGOFAM_BLAKE_2S_256, CRYPTO_ALGOFAM_BLAKE_2S_512, CRYPTO_ALGOFAM_CUSTOM}, set at pre-compile  # Determines the algorithm family used for the crypto service
      container CsmSignatureVerify [0..1]
        container CsmSignatureVerifyConfig [1..*]
          enumeration CsmSignatureVerifyAlgorithmFamily: {CRYPTO_ALGOFAM_RSA, CRYPTO_ALGOFAM_ED25519, CRYPTO_ALGOFAM_BRAINPOOL, CRYPTO_ALGOFAM_ECCNIST, CRYPTO_ALGOFAM_CUSTOM}, set at pre-compile  # Determines the algorithm family used for the crypto service
          enumeration CsmSignatureVerifyAlgorithmMode: {CRYPTO_ALGOMODE_NOT_SET, CRYPTO_ALGOMODE_RSASSA_PSS, CRYPTO_ALGOMODE_RSASSA_PKCS1_v1_5, CRYPTO_ALGOMODE_CUSTOM}, set at pre-compile  # Determines the algorithm mode used for the crypto service
          enumeration CsmSignatureVerifyProcessing: {CSM_ASYNCHRONOUS, CSM_SYNCHRONOUS}, set at pre-compile  # Determines how the interface shall be used for that primitive
          integer CsmSignatureVerifyAlgorithmKeyLength: set at pre-compile
          integer CsmSignatureVerifyLength: set at pre-compile
          string CsmSignatureVerifyAlgorithmFamilyCustom [0..1]: set at pre-compile
          string CsmSignatureVerifyAlgorithmModeCustom [0..1]: set at pre-compile
          string CsmSignatureVerifyAlgorithmSecondaryFamilyCustom [0..1]: set at pre-compile
          enumeration CsmSignatureVerifyAlgorithmSecondaryFamily: {CRYPTO_ALGOFAM_NOT_SET, CRYPTO_ALGOFAM_SHA1, CRYPTO_ALGOFAM_SHA2_224, CRYPTO_ALGOFAM_SHA2_256, CRYPTO_ALGOFAM_SHA2_384, CRYPTO_ALGOFAM_SHA2_512, CRYPTO_ALGOFAM_SHA2_512_224, CRYPTO_ALGOFAM_SHA2_512_256, CRYPTO_ALGOFAM_SHA3_224, CRYPTO_ALGOFAM_SHA3_256, CRYPTO_ALGOFAM_SHA3_384, CRYPTO_ALGOFAM_SHA3_512, CRYPTO_ALGOFAM_SHAKE128, CRYPTO_ALGOFAM_SHAKE265, CRYPTO_ALGOFAM_RIPEMD160, CRYPTO_ALGOFAM_BLAKE_1_256, CRYPTO_ALGOFAM_BLAKE_1_512, CRYPTO_ALGOFAM_BLAKE_2S_256, CRYPTO_ALGOFAM_BLAKE_2S_512, CRYPTO_ALGOFAM_CUSTOM}, set at pre-compile  # Determines the algorithm family used for the crypto service
      container CsmEncrypt [0..1]
        container CsmEncryptConfig [1..*]
          enumeration CsmEncryptAlgorithmMode: {CRYPTO_ALGOMODE_NOT_SET, CRYPTO_ALGOMODE_ECB, CRYPTO_ALGOMODE_CBC, CRYPTO_ALGOMODE_CFB, CRYPTO_ALGOMODE_OFB, CRYPTO_ALGOMODE_CTR, CRYPTO_ALGOMODE_XTS, CRYPTO_ALGOMODE_RSAES_OAEP, CRYPTO_ALGOMODE_RSAES_PKCS1_v1_5, CRYPTO_ALGOMODE_8ROUNDS, CRYPTO_ALGOMODE_12ROUNDS, CRYPTO_ALGOMODE_20ROUNDS, CRYPTO_ALGOMODE_CUSTOM}, set at pre-compile  # Determines the algorithm mode used for the crypto service
          enumeration CsmEncryptProcessing: {CSM_ASYNCHRONOUS, CSM_SYNCHRONOUS}, set at pre-compile  # Determines how the interface shall be used for that primitive
          integer CsmEncryptAlgorithmKeyLength: set at pre-compile
          integer CsmEncryptLength: set at pre-compile
          string CsmEncryptAlgorithmFamilyCustom [0..1]: set at pre-compile
          string CsmEncryptAlgorithmModeCustom [0..1]: set at pre-compile
          string CsmEncryptAlgorithmSecondaryFamilyCustom [0..1]: set at pre-compile
          enumeration CsmEncryptAlgorithmSecondaryFamily: {CRYPTO_ALGOFAM_NOT_SET, CRYPTO_ALGOFAM_CUSTOM}, set at pre-compile  # Determines the algorithm family used for the crypto service
          enumeration CsmEncryptAlgorithmFamily: {CRYPTO_ALGOFAM_3DES, CRYPTO_ALGOFAM_AES, CRYPTO_ALGOFAM_CHACHA, CRYPTO_ALGOFAM_RSA, CRYPTO_ALGOFAM_ECIES, CRYPTO_ALGOFAM_CUSTOM}, set at pre-compile  # Determines the algorithm family used for the crypto service
      container CsmDecrypt [0..1]  # Container for Encrypt Configurations
        container CsmDecryptConfig [1..*]  # Container for configuration of a encrypt interface. The container name serves as a symbolic name for the identifier of a encrypt interface.
          enumeration CsmDecryptAlgorithmFamily: {CRYPTO_ALGOFAM_3DES, CRYPTO_ALGOFAM_AES, CRYPTO_ALGOFAM_CHACHA, CRYPTO_ALGOFAM_RSA, CRYPTO_ALGOFAM_ECIES, CRYPTO_ALGOFAM_CUSTOM}, set at pre-compile  # Determines the algorithm family used for the crypto service
          integer CsmDecryptAlgorithmKeyLength: set at pre-compile  # Size of the MAC key in bytes
          enumeration CsmDecryptAlgorithmMode: {CRYPTO_ALGOMODE_ECB, CRYPTO_ALGOMODE_CBC, CRYPTO_ALGOMODE_CFB, CRYPTO_ALGOMODE_OFB, CRYPTO_ALGOMODE_CTR, CRYPTO_ALGOMODE_XTS, CRYPTO_ALGOMODE_RSAES_OAEP, CRYPTO_ALGOMODE_RSAES_PKCS1_v1_5, CRYPTO_ALGOMODE_8ROUNDS, CRYPTO_ALGOMODE_12ROUNDS, CRYPTO_ALGOMODE_20ROUNDS, CRYPTO_ALGOMODE_CUSTOM}, set at pre-compile  # Determines the algorithm mode used for the crypto service
          enumeration CsmDecryptProcessing: {CSM_ASYNCHRONOUS, CSM_SYNCHRONOUS}, set at pre-compile  # Determines how the interface shall be used for that primitive
          integer CsmDecryptLength: set at pre-compile  # Size of the inputDecrypt length in bits
          string CsmDecryptAlgorithmFamilyCustom [0..1]: set at pre-compile
          string CsmDecryptAlgorithmModeCustom [0..1]: set at pre-compile
          enumeration CsmDecryptAlgorithmSecondaryFamily: {CRYPTO_ALGOFAM_NOT_SET, CRYPTO_ALGOFAM_CUSTOM}, set at pre-compile  # Determines the algorithm family used for the crypto service
          string CsmDecryptAlgorithmSecondaryFamilyCustom [0..1]: set at pre-compile
      container CsmHash [0..1]
        container CsmHashConfig [1..*]  # Container for CSM queues
          integer CsmHashAlgorithmKeyLength: set at pre-compile
          enumeration CsmHashAlgorithmMode: {CRYPTO_ALGOMODE_NOT_SET, CRYPTO_ALGOMODE_CUSTOM}, set at pre-compile  # Determines the algorithm mode used for the crypto service
          enumeration CsmHashProcessing: {CSM_ASYNCHRONOUS, CSM_SYNCHRONOUS}, set at pre-compile  # Determines how the interface shall be used for that primitive
          integer CsmHashLength: set at pre-compile
          string CsmHashAlgorithmFamilyCustom [0..1]: set at pre-compile
          string CsmHashAlgorithmModeCustom [0..1]: set at pre-compile
          enumeration CsmHashAlgorithmSecondaryFamily: {CRYPTO_ALGOFAM_NOT_SET, CRYPTO_ALGOFAM_CUSTOM}, set at pre-compile, default-value=CRYPTO_ALGOFAM_NOT_SET  # Determines the algorithm family used for the crypto service
          string CsmHashAlgorithmSecondaryFamilyCustom [0..1]: set at pre-compile
          enumeration CsmHashAlgorithmFamily: {CRYPTO_ALGOFAM_NOT_SET, CRYPTO_ALGOFAM_SHA1, CRYPTO_ALGOFAM_SHA2_224, CRYPTO_ALGOFAM_SHA2_256, CRYPTO_ALGOFAM_SHA2_384, CRYPTO_ALGOFAM_SHA2_512, CRYPTO_ALGOFAM_SHA2_512_224, CRYPTO_ALGOFAM_SHA2_512_256, CRYPTO_ALGOFAM_SHA3_224, CRYPTO_ALGOFAM_SHA3_256, CRYPTO_ALGOFAM_SHA3_384, CRYPTO_ALGOFAM_SHA3_512, CRYPTO_ALGOFAM_SHAKE128, CRYPTO_ALGOFAM_SHAKE265, CRYPTO_ALGOFAM_RIPEMD160, CRYPTO_ALGOFAM_BLAKE_1_256, CRYPTO_ALGOFAM_BLAKE_1_512, CRYPTO_ALGOFAM_BLAKE_2S_256, CRYPTO_ALGOFAM_BLAKE_2S_512, CRYPTO_ALGOFAM_CUSTOM}, set at pre-compile  # Determines the algorithm family used for the crypto service
      container CsmRandom [0..1]
        container CsmRandomConfig [1..*]  # Container for CSM queues
          enumeration CsmRandomAlgorithmFamily: {CRYPTO_ALGOFAM_3DES, CRYPTO_ALGOFAM_AES, CRYPTO_ALGOFAM_CHACHA, CRYPTO_ALGOFAM_RNG, CRYPTO_ALGOFAM_CUSTOM}, set at pre-compile  # Determines the algorithm family used for the crypto service
          integer CsmRandomAlgorithmKeyLength: set at pre-compile
          enumeration CsmRandomAlgorithmMode: {CRYPTO_ALGOMODE_NOT_SET, CRYPTO_ALGOMODE_CTRDRBG, CRYPTO_ALGOMODE_CUSTOM}, set at pre-compile  # Determines the algorithm mode used for the crypto service
          enumeration CsmRandomProcessing: {CSM_ASYNCHRONOUS, CSM_SYNCHRONOUS}, set at pre-compile  # Determines how the interface shall be used for that primitive
          integer CsmRandomLength: set at pre-compile
          string CsmRandomAlgorithmFamilyCustom [0..1]: set at pre-compile
          string CsmRandomAlgorithmModeCustom [0..1]: set at pre-compile
          enumeration CsmRandomAlgorithmSecondaryFamily: {CRYPTO_ALGOFAM_NOT_SET, CRYPTO_ALGOFAM_CUSTOM}, set at pre-compile  # Determines the algorithm family used for the crypto service
          string CsmRandomAlgorithmSecondaryFamilyCustom [0..1]: set at pre-compile
      container CsmDummy [0..1]
        container CsmDummyConfig [1..*]  # Container for CSM queues
          integer CsmDummyAlgorithmKeyLength: set at pre-compile
          enumeration CsmDummyAlgorithmMode: {CRYPTO_ALGOMODE_NOT_SET, CRYPTO_ALGOMODE_ECB, CRYPTO_ALGOMODE_CBC, CRYPTO_ALGOMODE_CFB, CRYPTO_ALGOMODE_OFB, CRYPTO_ALGOMODE_CTR, CRYPTO_ALGOMODE_GCM, CRYPTO_ALGOMODE_XTS, CRYPTO_ALGOMODE_RSAES_OAEP, CRYPTO_ALGOMODE_RSAES_PKCS1_v1_5, CRYPTO_ALGOMODE_RSASSA_PSS, CRYPTO_ALGOMODE_RSASSA_PKCS1_v1_5, CRYPTO_ALGOMODE_8ROUNDS, CRYPTO_ALGOMODE_12ROUNDS, CRYPTO_ALGOMODE_20ROUNDS, CRYPTO_ALGOMODE_HMAC, CRYPTO_ALGOMODE_CMAC, CRYPTO_ALGOMODE_GMAC, CRYPTO_ALGOMODE_CTRDRBG, CRYPTO_ALGOMODE_SIPHASH_2_4, CRYPTO_ALGOMODE_SIPHASH_4_8, CRYPTO_ALGOMODE_CUSTOM}, set at pre-compile  # Determines the algorithm mode used for the crypto service
          enumeration CsmDummyProcessing: {CSM_ASYNCHRONOUS, CSM_SYNCHRONOUS}, set at pre-compile  # Determines how the interface shall be used for that primitive
          integer CsmDummyLength: set at pre-compile
          string CsmDummyAlgorithmFamilyCustom [0..1]: set at pre-compile
          string CsmDummyAlgorithmModeCustom [0..1]: set at pre-compile
          enumeration CsmDummyAlgorithmSecondaryFamily: {CRYPTO_ALGOFAM_NOT_SET, CRYPTO_ALGOFAM_CUSTOM}, set at pre-compile  # Determines the algorithm family used for the crypto service
          string CsmDummyAlgorithmSecondaryFamilyCustom [0..1]: set at pre-compile
          enumeration CsmDummyAlgorithmFamily: {CRYPTO_ALGOFAM_NOT_SET, CRYPTO_ALGOFAM_SHA1, CRYPTO_ALGOFAM_SHA2_224, CRYPTO_ALGOFAM_SHA2_256, CRYPTO_ALGOFAM_SHA2_384, CRYPTO_ALGOFAM_SHA2_512, CRYPTO_ALGOFAM_SHA2_512_224, CRYPTO_ALGOFAM_SHA2_512_256, CRYPTO_ALGOFAM_SHA3_224, CRYPTO_ALGOFAM_SHA3_256, CRYPTO_ALGOFAM_SHA3_384, CRYPTO_ALGOFAM_SHA3_512, CRYPTO_ALGOFAM_SHAKE128, CRYPTO_ALGOFAM_SHAKE265, CRYPTO_ALGOFAM_RIPEMD160, CRYPTO_ALGOFAM_BLAKE_1_256, CRYPTO_ALGOFAM_BLAKE_1_512, CRYPTO_ALGOFAM_BLAKE_2S_256, CRYPTO_ALGOFAM_BLAKE_2S_512, CRYPTO_ALGOFAM_3DES, CRYPTO_ALGOFAM_AES, CRYPTO_ALGOFAM_CHACHA, CRYPTO_ALGOFAM_RSA, CRYPTO_ALGOFAM_ED25519, CRYPTO_ALGOFAM_BRAINPOOL, CRYPTO_ALGOFAM_ECCNIST, CRYPTO_ALGOFAM_SECURECOUNTER, CRYPTO_ALGOFAM_RNG, CRYPTO_ALGOFAM_SIPHASH, CRYPTO_ALGOFAM_ECIES, CRYPTO_ALGOFAM_CUSTOM}, set at pre-compile  # Determines the algorithm family used for the crypto service
      container CsmAEADDecrypt [0..1]
        container CsmAEADDecryptConfig [1..*]
          enumeration CsmAEADDecryptAlgorithmFamily: {CRYPTO_ALGOFAM_3DES, CRYPTO_ALGOFAM_AES, CRYPTO_ALGOFAM_CUSTOM}, set at pre-compile  # Determines the algorithm family used for the crypto service
          enumeration CsmAEADDecryptAlgorithmMode: {CRYPTO_ALGOMODE_NOT_SET, CRYPTO_ALGOMODE_GCM, CRYPTO_ALGOMODE_CUSTOM}, set at pre-compile  # Determines the algorithm mode used for the crypto service
          enumeration CsmAEADDecryptProcessing: {CSM_ASYNCHRONOUS, CSM_SYNCHRONOUS}, set at pre-compile  # Determines how the interface shall be used for that primitive
          integer CsmAEADDecryptAlgorithmKeyLength: set at pre-compile
          integer CsmAEADDecryptLength: set at pre-compile
          string CsmAEADDecryptAlgorithmFamilyCustom [0..1]: set at pre-compile
          string CsmAEADDecryptAlgorithmModeCustom [0..1]: set at pre-compile
          string CsmAEADDecryptAlgorithmSecondaryFamilyCustom [0..1]: set at pre-compile
          enumeration CsmAEADDecryptAlgorithmSecondaryFamily: {CRYPTO_ALGOFAM_NOT_SET, CRYPTO_ALGOFAM_CUSTOM}, set at pre-compile  # Determines the secondary algorithm family used for the crypto service e.g. The hash algorithm for RSA Signatures
      container CsmAEADEncrypt [0..1]
        container CsmAEADEncryptConfig [1..*]
          enumeration CsmAEADEncryptAlgorithmFamily: {CRYPTO_ALGOFAM_3DES, CRYPTO_ALGOFAM_AES, CRYPTO_ALGOFAM_CUSTOM}, set at pre-compile  # Determines the algorithm family used for the crypto service
          enumeration CsmAEADEncryptAlgorithmMode: {CRYPTO_ALGOMODE_NOT_SET, CRYPTO_ALGOMODE_GCM, CRYPTO_ALGOMODE_CUSTOM}, set at pre-compile  # Determines the algorithm mode used for the crypto service
          enumeration CsmAEADEncryptProcessing: {CSM_ASYNCHRONOUS, CSM_SYNCHRONOUS}, set at pre-compile  # Determines how the interface shall be used for that primitive
          integer CsmAEADEncryptAlgorithmKeyLength: set at pre-compile
          integer CsmAEADEncryptLength: set at pre-compile
          string CsmAEADEncryptAlgorithmFamilyCustom [0..1]: set at pre-compile
          string CsmAEADEncryptAlgorithmModeCustom [0..1]: set at pre-compile
          string CsmAEADEncryptAlgorithmSecondaryFamilyCustom [0..1]: set at pre-compile
          enumeration CsmAEADEncryptAlgorithmSecondaryFamily: {CRYPTO_ALGOFAM_NOT_SET, CRYPTO_ALGOFAM_CUSTOM}, set at pre-compile  # Determines the secondary algorithm family used for the crypto service e.g. The hash algorithm for RSA Signatures
    container CsmQueues
      container CsmQueue [0..*]  # Container for configuration of a CSM queue. The container name serves as a symbolic name for the identifier of a queue configuration.
        integer CsmQueueSize: set at pre-compile
        symbolic name reference CsmChannelRef: set at pre-compile, destination=CryIfChannel  # Refers to a pointer in the CRYIF
    container CsmCallbacks  # Container for callback function configurations
      container CsmCallback [0..*]  # Container for configuration of a callback function
        function name CsmCallbackFunc: set at pre-compile  # Callback function to be called if an asynchronous operation has finished
        integer CsmCallbackId: 0..4294967295, set at pre-compile, symbolic-name-value=true, default-value=0  # Identifier of the callback function.
    container CsmJobs
      container CsmJob [0..*]
        integer CsmJobPriority: set at pre-compile  # Priority of the user
        integer CsmJobId: 0..4294967295, set at pre-compile, symbolic-name-value=true, default-value=0  # Identifier of the CSM user
        boolean CsmJobUsePort: set at pre-compile, default-value=true  # Does the user need RTE interfaces?
        boolean CsmJobPrimitveCallbackUpdateNotification [0..1]: set at pre-compile  # This parameter indicates, whether the callback function shall be called, if the UPDATE operation has finished.
        boolean CsmJobUseOldPort: set at pre-compile, default-value=true  # Does the user need RTE interfaces?
        choice reference CsmJobPrimitiveRef: set at pre-compile, destination=[CsmHash/CsmHashConfig, CsmMacGenerate/CsmMacGenerateConfig, CsmMacVerify/CsmMacVerifyConfig, CsmSignatureGenerate/CsmSignatureGenerateConfig, CsmSignatureVerify/CsmSignatureVerifyConfig, CsmAEADEncryptConfig, CsmAEADDecryptConfig, CsmEncryptConfig, CsmDecryptConfig, CsmDummyConfig, CsmRandomConfig]  # This parameter refers to the used CsmPrimitive
        reference CsmJobPrimitiveCallbackRef [0..1]: set at pre-compile, destination=CsmCallback  # This parameter refers to the used CsmCallback
        reference CsmJobQueueRef: set at pre-compile, destination=CsmQueue
        reference CsmJobKeyRef: set at pre-compile, destination=CsmKey
    container CsmAsymDecrypt [0..1]  # Container for incorporation of AsymDecrypt primitives.
      integer CsmAsymDecryptMaxKeySize: 1..4294967295, set at pre-compile  # The maximum, in bytes, of all key lengths used in all CRY primitives which implement an asymmetrical decryption.
      container CsmAsymDecryptConfig [0..32]  # Container for configuration of service AsymDecrypt. The container name serves as a symbolic name for the identifier of a service configuration.
        string CsmAsymDecryptInitConfiguration: set at pre-compile  # Name of a C symbol which contains the configuration of the underlying cryptographic primitive.
        string CsmAsymDecryptPrimitiveName: set at pre-compile  # Name of the cryptographic primitive to use.
        function name CsmCallbackAsymDecrypt: set at pre-compile  # Callback function to be called if service has finished.
    container CsmAsymEncrypt [0..1]  # Container for incorporation of AsymEncrypt primitives.
      integer CsmAsymEncryptMaxKeySize: 1..4294967295, set at pre-compile  # The maximum, in bytes, of all key lengths used in all CRY primitives which implement an asymmetrical encryption.
      container CsmAsymEncryptConfig [0..32]  # Container for configuration of service AsymEncrypt. The container name serves as a symbolic name for the identifier of a service configuration.
        string CsmAsymEncryptInitConfiguration: set at pre-compile  # Name of a C symbol which contains the configuration of the underlying cryptographic primitive.
        string CsmAsymEncryptPrimitiveName: set at pre-compile  # Name of the cryptographic primitive to use.
        function name CsmCallbackAsymEncrypt: set at pre-compile  # Callback function to be called if service has finished.
    container CsmAsymPrivateKeyExtract [0..1]  # Container for incorporation of AsymPrivateKeyExtract primitives.
      integer CsmAsymPrivateKeyExtractMaxKeySize: 1..4294967295, set at pre-compile  # The maximum, in bytes, of all key lengths used in all CRY primitives which implement an asymmetrical private key extraction.
      container CsmAsymPrivateKeyExtractConfig [0..32]  # Container for configuration of service AsymPrivateKeyExtract. | The container name serves as a symbolic name for the identifier of a service configuration.
        string CsmAsymPrivateKeyExtractInitConfiguration: set at pre-compile  # Name of a C symbol which contains the configuration of the underlying cryptographic primitive.
        string CsmAsymPrivateKeyExtractPrimitiveName: set at pre-compile  # Name of the cryptographic primitive to use.
        function name CsmCallbackAsymPrivateKeyExtract: set at pre-compile  # Callback function to be called if service has finished.
    container CsmAsymPrivateKeyWrapAsym [0..1]  # Container for incorporation of AsymPrivateKeyWrapSym primitives.
      integer CsmAsymPrivateKeyWrapAsymMaxPrivKeySize: 1..4294967295, set at pre-compile  # The maximum length, in bytes, of all private key types used in all CRY primitives which implement an asymmetrical private key wrapping.
      integer CsmAsymPrivateKeyWrapAsymMaxPubKeySize: 1..4294967295, set at pre-compile  # The maximum length, in bytes, of all public key types used in all CRY primitives which implement an asymmetrical private key wrapping.
      container CsmAsymPrivateKeyWrapAsymConfig [0..32]  # Container for configuration of service SymKeyWrapAsym. The container name serves as a symbolic name for the identifier of a service configuration.
        string CsmAsymPrivateKeyWrapAsymInitConfiguration: set at pre-compile  # Name of a C symbol which contains the configuration of the underlying cryptographic primitive.
        string CsmAsymPrivateKeyWrapAsymPrimitiveName: set at pre-compile  # Name of the cryptographic primitive to use.
        function name CsmCallbackAsymPrivateKeyWrapAsym: set at pre-compile  # Callback function to be called if service has finished.
    container CsmAsymPrivateKeyWrapSym [0..1]  # Container for incorporation of AsymPrivateKeyWrapSym primitives.
      integer CsmAsymPrivateKeyWrapSymMaxPrivKeySize: 1..4294967295, set at pre-compile  # The maximum length, in bytes, of all private information types used in all CRY primitives which implement an asymetric private key wrapping.
      integer CsmAsymPrivateKeyWrapSymMaxSymKeySize: 1..4294967295, set at pre-compile  # The maximum, in bytes, of all key lengths used in all CRY primitives which implement an asymetrical private key wrapping.
      container CsmAsymPrivateKeyWrapSymConfig [0..32]  # Container for configuration of service AsymPrivateKeyWrapSym. The container name serves as a symbolic name for the identifier of a service configuration.
        string CsmAsymPrivateKeyWrapSymInitConfiguration: set at pre-compile  # Name of a C symbol which contains the configuration of the underlying cryptographic primitive.
        string CsmAsymPrivateKeyWrapSymPrimitiveName: set at pre-compile  # Name of the cryptographic primitive to use.
        function name CsmCallbackAsymPrivateKeyWrapSym: set at pre-compile  # Callback function to be called if service has finished.
    container CsmAsymPublicKeyExtract [0..1]  # Container for incorporation of AsymPublicKeyExtract primitives.
      integer CsmAsymPublicKeyExtractMaxKeySize: 1..4294967295, set at pre-compile  # The maximum, in bytes, of all key lengths used in all CRY primitives which implement an asymmetrical public key extraction.
      container CsmAsymPublicKeyExtractConfig [0..32]  # Container for configuration of service AsymPublicKeyExtract. | The container name serves as a symbolic name for the identifier of a service configuration.
        string CsmAsymPublicKeyExtractInitConfiguration: set at pre-compile  # Name of a C symbol which contains the configuration of the underlying cryptographic primitive.
        string CsmAsymPublicKeyExtractPrimitiveName: set at pre-compile  # Name of the cryptographic primitive to use.
        function name CsmCallbackAsymPublicKeyExtract: set at pre-compile  # Callback function to be called if service has finished.
    container CsmChecksum [0..1]  # Container for incorporation of Checksum primitives.
      container CsmChecksumConfig [0..32]  # Container for configuration of service Checksum. The container name serves as a symbolic name for the identifier of a service configuration.
        function name CsmCallbackChecksum: set at pre-compile  # Callback function to be called if service has finished.
        string CsmChecksumInitConfiguration: set at pre-compile  # Name of a C symbol which contains the configuration of the underlying cryptographic primitive.
        string CsmChecksumPrimitiveName: set at pre-compile  # Name of the cryptographic primitive to use.
    container CsmDemEventParameterRefs [0..1]  # Container for the references to DemEventParameter elements which shall be invoked using the API Dem_ReportErrorStatus API in case the corresponding error occurs. The EventId is taken from the referenced DemEventParameter's DemEventId value. The standardized errors are provided in the container and can be extended by vendor specific error references.
      symbolic name reference CSM_E_INIT_FAILED [0..1]: set at pre-compile, destination=DemEventParameter  # Reference to the DemEventParameter which shall be issued when the error "Initialization of CSM module failed" has occured.
    container CsmGeneral  # Container for common configuration options.
      boolean CsmDevErrorDetect: set at pre-compile  # Pre-processor switch to enable and disable development error detection. | True: Development error detection enabled. False: Development error detection disabled
      string CsmMaxAlignScalarType: set at pre-compile  # The scalar type which has the maximum alignment restrictions on the given platform. | This type can be e.g. uint8, uint16 or uint32.
      integer CsmMaximumBlockingTime: 1..4294967295, set at pre-compile  # If interruption is turned on with the configuration option CsmUseInterruption, this option configures the maximum time in microseconds the main function shall be allowed to run before it must interrupt itself. The lowest allowed value for the option is implementation dependent.
      boolean CsmUseInterruption: set at pre-compile  # Pre-processor switch to enable and disable interruption of job processing. | True: Interruption of job processing enabled False: Interruption of job processing disabled
      boolean CsmUseSyncJobProcessing: set at pre-compile  # Pre-processor switch to enable and disable synchronous job processing. | True: synchronous job processing enabled False: synchronous job processing disabled
      boolean CsmVersionInfoApi: set at pre-compile  # Pre-processor switch to enable and disable availability of the API Csm_GetVersionInfo(). True: API Csm_GetVersionInfo() is available. False: API Csm_GetVersionInfo() is not available.
      string CsmCustomIncludeFiles [0..*]: set at pre-compile
    container CsmHash [0..1]  # Container for incorporation of Hash primitives.
      container CsmHashConfig [0..32]  # Configurations for the Hash service. The container name serves as a symbolic name for the identifier of a service configuration.
        function name CsmCallbackHash: set at pre-compile  # Callback function to be called if service has finished.
        string CsmHashInitConfiguration: set at pre-compile  # Name of a C symbol which contains the configuration of the underlying cryptographic primitive.
        string CsmHashPrimitiveName: set at pre-compile  # Name of the cryptographic primitive to use.
    container CsmKeyDerive [0..1]  # Container for incorporation of KeyDerive primitives.
      integer CsmKeyDeriveMaxKeySize: 1..4294967295, set at pre-compile  # The maximum, in bytes, of all key lengths used in all CRY primitives which implement a key derivation.
      container CsmKeyDeriveConfig [0..32]  # Container for configuration of service KeyDerive. The container name serves as a symbolic name for the identifier of a service configuration.
        function name CsmCallbackKeyDerive: set at pre-compile  # Callback function to be called if service has finished.
        string CsmKeyDeriveInitConfiguration: set at pre-compile  # Name of a C symbol which contains the configuration of the underlying cryptographic primitive.
        string CsmKeyDerivePrimitiveName: set at pre-compile  # Name of the cryptographic primitive to use.
    container CsmKeyDeriveSymKey [0..1]  # Container for incorporation of CsmKeyDeriveSymKey primitives.
      integer CsmKeyDeriveSymKeyMaxSymKeySize: 1..4294967295, set at pre-compile  # The maximum, in bytes, of all key lengths used in all CRY primitives which implement a key derivation.
      container CsmKeyDeriveSymKeyConfig [0..32]  # Container for configuration of service CsmKeyDeriveSymKey. The container name serves as a symbolic name for the identifier of a service configuration.
        function name CsmCallbackKeyDeriveSymKey: set at pre-compile  # Callback function to be called if service has finished.
        string CsmKeyDeriveSymKeyInitConfiguration: set at pre-compile  # Name of a C symbol which contains the configuration of the underlying cryptographic primitive.
        string CsmKeyDeriveSymKeyPrimitiveName: set at pre-compile  # Name of the cryptographic primitive to use.
    container CsmKeyExchangeCalcPubVal [0..1]  # Container for incorporation of KeyExchangeCalcPubVal primitives.
      integer CsmKeyExchangeCalcPubValMaxBaseTypeSize: 1..4294967295, set at pre-compile  # The maximum length, in bytes, of all base types used in all CRY primitives which implement a public value calculation.
      integer CsmKeyExchangeCalcPubValMaxPrivateTypeSize: 1..4294967295, set at pre-compile  # The maximum length, in bytes, of all private information types used in all CRY primitives which implement a public value calculation.
      container CsmKeyExchangeCalcPubValConfig [0..32]  # Container for configuration of service KeyExchangeCalcPubVal. The container name serves as a symbolic name for the identifier of a service configuration.
        function name CsmCallbackKeyExchangeCalcPubVal: set at pre-compile  # Callback function to be called if service has finished.
        string CsmKeyExchangeCalcPubValInitConfiguration: set at pre-compile  # Name of a C symbol which contains the configuration of the underlying cryptographic primitive.
        string CsmKeyExchangeCalcPubValPrimitiveName: set at pre-compile  # Name of the cryptographic primitive to use.
    container CsmKeyExchangeCalcSecret [0..1]  # Container for incorporation of KeyExchangeCalcSecret primitives.
      integer CsmKeyExchangeCalcSecretMaxBaseTypeSize: 1..4294967295, set at pre-compile  # The maximum length, in bytes, of all base types used in all CRY primitives which implement a shared secret calculation.
      integer CsmKeyExchangeCalcSecretMaxPrivateTypeSize: 1..4294967295, set at pre-compile  # The maximum length, in bytes, of all private information types used in all CRY primitives which implement a shared secret calculation.
      container CsmKeyExchangeCalcSecretConfig [0..32]  # Container for configuration of service KeyExchangeCalcSecret. The container name serves as a symbolic name for the identifier of a service configuration.
        function name CsmCallbackKeyExchangeCalcSecret: set at pre-compile  # Callback function to be called if service has finished.
        string CsmKeyExchangeCalcSecretInitConfiguration: set at pre-compile  # Name of a C symbol which contains the configuration of the underlying cryptographic primitive.
        string CsmKeyExchangeCalcSecretPrimitiveName: set at pre-compile  # Name of the cryptographic primitive to use.
    container CsmKeyExchangeCalcSymKey [0..1]  # Container for incorporation of KeyExchangeCalcSymKey primitives.
      integer CsmKeyExchangeCalcSymKeyMaxBaseTypeSize: 1..4294967295, set at pre-compile  # The maximum length, in bytes, of all base types used in all CRY primitives which implement a symmetrical key calculation.
      integer CsmKeyExchangeCalcSymKeyMaxPrivateTypeSize: 1..4294967295, set at pre-compile  # The maximum length, in bytes, of all private information types used in all CRY primitives which implement a symmetrical key calculation.
      integer CsmKeyExchangeCalcSymKeyMaxSymKeySize: 1..4294967295, set at pre-compile  # The maximum, in bytes, of all key lengths used in all CRY primitives which implement a symmetrical key calculation.
      container CsmKeyExchangeCalcSymKeyConfig [0..32]  # Container for configuration of service KeyExchangeCalcSymKey. The container name serves as a symbolic name for the identifier of a service configuration.
        function name CsmCallbackKeyExchangeCalcSymKey: set at pre-compile  # Callback function to be called if service has finished.
        string CsmKeyExchangeCalcSymKeyInitConfiguration: set at pre-compile  # Name of a C symbol which contains the configuration of the underlying cryptographic primitive.
        string CsmKeyExchangeCalcSymKeyPrimitiveName: set at pre-compile  # Name of the cryptographic primitive to use.
    container CsmMacGenerate [0..1]  # Container for incorporation of MacGenerate primitives.
      integer CsmMacGenerateMaxKeySize: 1..4294967295, set at pre-compile  # The maximum, in bytes, of all key lengths used in all CRY primitives which implement a MAC generation.
      container CsmMacGenerateConfig [0..32]  # Configurations for the MacGenerate service. The container name serves as a symbolic name for the identifier of a service configuration.
        function name CsmCallbackMacGenerate: set at pre-compile  # Callback function to be called if service has finished.
        string CsmMacGenerateInitConfiguration: set at pre-compile  # Name of a C symbol which contains the configuration of the underlying cryptographic primitive.
        string CsmMacGeneratePrimitiveName: set at pre-compile  # Name of the cryptographic primitive to use.
    container CsmMacVerify [0..1]  # Container for incorporation of MacVerify primitives.
      integer CsmMacVerifyMaxKeySize: 1..4294967295, set at pre-compile  # The maximum, in bytes, of all key lengths used in all CRY primitives which implement a MAC verification.
      container CsmMacVerifyConfig [0..32]  # Container for configuration of service MacVerify. The container name serves as a symbolic name for the identifier of a service configuration.
        function name CsmCallbackMacVerify: set at pre-compile  # Callback function to be called if service has finished.
        string CsmMacVerifyInitConfiguration: set at pre-compile  # Name of a C symbol which contains the configuration of the underlying cryptographic primitive.
        string CsmMacVerifyPrimitiveName: set at pre-compile  # Name of the cryptographic primitive to use.
    container CsmRandomGenerate [0..1]  # Container for incorporation of RandomGenerate primitives.
      container CsmRandomGenerateConfig [0..32]  # Container for configuration of service RandomGenerate. The container name serves as a symbolic name for the identifier of a service configuration.
        function name CsmCallbackRandomGenerate: set at pre-compile  # Callback function to be called if service has finished.
        string CsmRandomGenerateInitConfiguration: set at pre-compile  # Name of a C symbol which contains the configuration of the underlying cryptographic primitive.
        string CsmRandomGeneratePrimitiveName: set at pre-compile  # Name of the cryptographic primitive to use.
    container CsmRandomSeed [0..1]  # Container for incorporation of RandomSeed primitives.
      container CsmRandomSeedConfig [0..32]  # Container for configuration of service RandomSeed. The container name serves as a symbolic name for the identifier of a service configuration.
        function name CsmCallbackRandomSeed: set at pre-compile  # Callback function to be called if service has finished.
        string CsmRandomSeedInitConfiguration: set at pre-compile  # Name of a C symbol which contains the configuration of the underlying cryptographic primitive.
        string CsmRandomSeedPrimitiveName: set at pre-compile  # Name of the cryptographic primitive to use.
    container CsmSignatureGenerate [0..1]  # Container for incorporation of SignatureGenerate primitives
      integer CsmSignatureGenerateMaxKeySize: 1..4294967295, set at pre-compile  # The maximum, in bytes, of all key lengths used in all CRY primitives which implement a signature generation.
      container CsmSignatureGenerateConfig [0..32]  # Container for configuration of service SignatureGenerate. The container name serves as a symbolic name for the identifier of a service configuration.
        function name CsmCallbackSignatureGenerate: set at pre-compile  # Callback function to be called if service has finished.
        string CsmSignatureGenerateInitConfiguration: set at pre-compile  # Name of a C symbol which contains the configuration of the underlying cryptographic primitive.
        string CsmSignatureGeneratePrimitiveName: set at pre-compile  # Name of the cryptographic primitive to use.
    container CsmSignatureVerify [0..1]  # Container for incorporation of SignatureVerify primitives.
      integer CsmSignatureVerifyMaxKeySize: 1..4294967295, set at pre-compile  # The maximum, in bytes, of all key lengths used in all CRY primitives which implement a signature verification.
      container CsmSignatureVerifyConfig [0..32]  # Container for configuration of service SignatureVerify. The container name serves as a symbolic name for the identifier of a service configuration.
        function name CsmCallbackSignatureVerify: set at pre-compile  # Callback function to be called if service has finished.
        string CsmSignatureVerifyInitConfiguration: set at pre-compile  # Name of a C symbol which contains the configuration of the underlying cryptographic primitive.
        string CsmSignatureVerifyPrimitiveName: set at pre-compile  # Name of the cryptographic primitive to use.
    container CsmSymBlockDecrypt [0..1]  # Container for incorporation of SymBlockDecrypt primitives.
      integer CsmSymBlockDecryptMaxKeySize: 1..4294967295, set at pre-compile  # The maximum, in bytes, of all key lengths used in all CRY primitives which implement a symmetrical block decryption.
      container CsmSymBlockDecryptConfig [0..32]  # Container for configuration of service SymBlockDecrypt. The container name serves as a symbolic name for the identifier of a service configuration.
        function name CsmCallbackSymBlockDecrypt: set at pre-compile  # Callback function to be called if service has finished.
        string CsmSymBlockDecryptInitConfiguration: set at pre-compile  # Name of a C symbol which contains the configuration of the underlying cryptographic primitive.
        string CsmSymBlockDecryptPrimitiveName: set at pre-compile  # Name of the cryptographic primitive to use.
    container CsmSymBlockEncrypt [0..1]  # Container for incorporation of SymBlockEncrypt primitives.
      integer CsmSymBlockEncryptMaxKeySize: 1..4294967295, set at pre-compile  # The maximum, in bytes, of all key lengths used in all CRY primitives which implement a symmetrical block encryption.
      container CsmSymBlockEncryptConfig [0..32]  # Container for configuration of service SymBlockEncrypt. The container name serves as a symbolic name for the identifier of a service configuration.
        function name CsmCallbackSymBlockEncrypt: set at pre-compile  # Callback function to be called if service has finished.
        string CsmSymBlockEncryptInitConfiguration: set at pre-compile  # Name of a C symbol which contains the configuration of the underlying cryptographic primitive.
        string CsmSymBlockEncryptPrimitiveName: set at pre-compile  # Name of the cryptographic primitive to use.
    container CsmSymDecrypt [0..1]  # Container for incorporation of SymDecrypt primitives
      integer CsmSymDecryptMaxKeySize: 1..4294967295, set at pre-compile  # The maximum, in bytes, of all key lengths used in all CRY primitives which implement a symmetrical decryption.
      container CsmSymDecryptConfig [0..32]  # Container for configuration of service SymDecrypt. | The container name serves as a symbolic name for the identifier of a service configuration.
        function name CsmCallbackSymDecrypt: set at pre-compile  # Callback function to be called if service has finished.
        string CsmSymDecryptInitConfiguration: set at pre-compile  # Name of a C symbol which contains the configuration of the underlying cryptographic primitive.
        string CsmSymDecryptPrimitiveName: set at pre-compile  # Name of the cryptographic primitive to use.
    container CsmSymEncrypt [0..1]  # Container for incorporation of SymEncrypt primitives.
      integer CsmSymEncryptMaxKeySize: 1..4294967295, set at pre-compile  # The maximum, in bytes, of all key lengths used in all CRY primitives which implement a symmetrical encryption.
      container CsmSymEncryptConfig [0..32]  # Container for configuration of service SymEncrypt. The container name serves as a symbolic name for the identifier of a service configuration.
        function name CsmCallbackSymEncrypt: set at pre-compile  # Callback function to be called if service has finished.
        string CsmSymBlockEncryptInitConfiguration: set at pre-compile  # Name of a C symbol which contains the configuration of the underlying cryptographic primitive.
        string CsmSymEncryptPrimitiveName: set at pre-compile  # Name of the cryptographic primitive to use.
    container CsmSymKeyExtract [0..1]  # Container for incorporation of SymKeyExtract primitives.
      integer CsmSymKeyExtractMaxKeySize: 1..4294967295, set at pre-compile  # The maximum, in bytes, of all key lengths used in all CRY primitives which implement a symmetrical key extraction.
      container CsmSymKeyExtractConfig [0..32]  # Container for configuration of service SymKeyExtract. The container name serves as a symbolic name for the identifier of a service configuration.
        function name CsmCallbackSymKeyExtract: set at pre-compile  # Callback function to be called if service has finished.
        string CsmSymKeyExtractInitConfiguration: set at pre-compile  # Name of a C symbol which contains the configuration of the underlying cryptographic primitive.
        string CsmSymKeyExtractPrimitiveName: set at pre-compile  # Name of the cryptographic primitive to use.
    container CsmSymKeyWrapAsym [0..1]  # Container for incorporation of SymKeyWrapSym primitives.
      integer CsmSymKeyWrapAsymMaxPubKeySize: 1..4294967295, set at pre-compile  # The maximum length, in bytes, of all public key types used in all CRY primitives which implement an asymmetrical key wrapping.
      integer CsmSymKeyWrapAsymMaxSymKeySize: 1..4294967295, set at pre-compile  # The maximum, in bytes, of all key lengths used in all CRY primitives which implement an asymmetrical key wrapping.
      container CsmSymKeyWrapAsymConfig [0..32]  # Container for configuration of service SymKeyWrapAsym. The container name serves as a symbolic name for the identifier of a service configuration.
        function name CsmCallbackSymKeyWrapAsym: set at pre-compile  # Callback function to be called if service has finished.
        string CsmSymKeyWrapAsymInitConfiguration: set at pre-compile  # Name of a C symbol which contains the configuration of the underlying cryptographic primitive.
        string CsmSymKeyWrapAsymPrimitiveName: set at pre-compile  # Name of the cryptographic primitive to use.
    container CsmSymKeyWrapSym [0..1]  # Container for incorporation of SymKeyWrapSym primitives.
      integer CsmSymKeyWrapSymMaxSymKeySize: 1..4294967295, set at pre-compile  # The maximum, in bytes, of all key lengths used in all CRY primitives which implement an symmetrical key wrapping.
      container CsmSymKeyWrapSymConfig [0..32]  # Container for configuration of service SymKeyWrapSym. The container name serves as a symbolic name for the identifier of a service configuration.
        function name CsmCallbackSymKeyWrapSym: set at pre-compile  # Callback function to be called if service has finished.
        string CsmSymKeyWrapSymInitConfiguration: set at pre-compile  # Name of a C symbol which contains the configuration of the underlying cryptographic primitive.
        string CsmSymKeyWrapSymPrimitiveName: set at pre-compile  # Name of the cryptographic primitive to use.
