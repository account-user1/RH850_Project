AUTOSAR XML (schema 4-0-3)
package /MICROSAR
  module config CanTp_Pre: definition=CanTp
    CanTpGeneral:
      CanTpSupportStandardAddressing = 1
      CanTpUseOnlyFirstFc = 1
      CanTpSupportExtendedAddressing = 0
      CanTpSupportMixed11Addressing = 0
      CanTpHavePaddingByte = 1
      CanTpPaddingByte = 0
      CanTpPaddingActive = 1
  module config CanTp_Rec: definition=CanTp, implementation-config-variant=VARIANT-PRE-COMPILE
    CanTpGeneral: CanTpEnableTransmitQueue=0, CanTpOnlyNotifyInformedAppl=1
    CanTpConfig
      CanTpChannel
  module config CanTp_Pre_Class1: definition=CanTp
    CanTpConfig
      CanTpChannel
        CanTpRxNSdu: CanTpRxPaddingActivation=CANTP_ON, CanTpRxAddressingFormat=CANTP_STANDARD, CanTpRxDl=8, CanTpNar=1.4, CanTpNcr=1.4, CanTpNbr=0.9
  module config CanTp_Pre_Class2: definition=CanTp
    CanTpConfig
      CanTpChannel
        CanTpTxNSdu: CanTpTxPaddingActivation=CANTP_ON, CanTpTxAddressingFormat=CANTP_STANDARD, CanTpTxDl=8, CanTpNcs=0.2, CanTpNas=1.4, CanTpNbs=1.4
  module config CanTp_Rec_Class1: definition=CanTp
    CanTpConfig
      CanTpChannel
        CanTpRxNSdu: CanTpNar=0.1, CanTpNcr=0.18, CanTpRxWftMax=0, CanTpBs=0
