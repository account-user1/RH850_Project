AUTOSAR XML (schema 4-0-3)
package /MICROSAR
  bsw implementation WdgIf_Impl: programming-language=C, sw-version=5.1.1, used-code-generator=DaVinci Configurator, vendor-id=30, ar-release-version=4.00.01, preconfigured-configuration=WdgIf_Pre, recommended-configuration=WdgIf_Rec, vendor-specific-module-def=WdgIf
  module definition WdgIf [0..1]: category=VENDOR_SPECIFIC_MODULE_DEFINITION, refined-module-def=WdgIf, variants pre-compile  # Configuration of the WdgIf (Watchdog Interface) module.
    container WdgIfDevice [1..*]  # It contains the information for the selection of a particular Watchdog device in case multiple Watchdog drivers are connected.
      integer WdgIfDeviceIndex: 0..255, set at pre-compile, symbolic-name-value=true, default-value=255  # Represents the watchdog Device ID so that it can be referenced by the watchdog manager.
      choice reference WdgIfDriverRef: set at pre-compile, destination=[WdgGeneral, WdgIfStateCombinerMaster, WdgIfStateCombinerSlave]  # Reference to the watchdog driver of this watchdog device or to a master or slave State Combiner instance.
    container WdgIfGeneral  # This container collects all generic watchdog interface parameters.
      boolean WdgIfDevErrorDetect: set at pre-compile, default-value=true  # Pre-processor switch for enabling the development error reporting. true: Development error reporting enabled false: Development error reporting disabled
      boolean WdgIfVersionInfoApi: set at pre-compile, default-value=false  # Pre-processor switch to enable / disable the service returning the version information. true: Version information service enabled false: Version information service disabled
      boolean WdgIfUseAutosarDrvApi: set at pre-compile, origin=Vector Informatik, default-value=true  # Pre-processor switch for enabling the usage of a fully AUTOSAR compliant driver API functions. true: AUTOSAR compliant driver API functions are utilized. Note: the parameter Window Start (WdgMTriggerWindowStart) of the WdgM configuration is then ignored. false: Enhanced driver API functions are utilized.
      boolean WdgIfUseStateCombiner: set at pre-compile, origin=Vector Informatik, default-value=false  # Pre-processor switch for enabling the usage of the State Combiner feature, which is part of the WdgIf. If enabled, it allows WdgM instances running on different processor cores to share and trigger one watchdog device. true: WdgIf State Combiner is enabled and must be configured. false: WdgIf State Combiner is disabled.
      choice reference WdgIfInternalTickCounterRef [0..0]: set at pre-compile, origin=Vector Informatik, destination=Wdg  # If this parameter references a driver which implements an internal tick counter then the API WdgIf_InternalTickCounter() is compiled and can be used by the Safe Watchdog Manager. Otherwise the API is not compiled. Note: If a driver is selected then it must support internal tick counter and its parameter WdgInternalTickCounter must be set to true.
    container WdgIfStateCombiner [0..1]  # This container describes the optinal feature of the Safe Watchdog Interface - the State Combiner.
      container WdgIfStateCombinerGeneral  # All general parameters of the StateCombiner are collected here.
        boolean WdgIfStateCombinerUseOsSpinlock: set at pre-compile, origin=Vector Informatik, default-value=true  # This preprocessor switch enables/disables the usage of OS spinlock mechanism. Note: If no OS spinlock is used a user-defined spinlock must be implemented - the file Appl_Spinlock.h will be inlcuded (instead of Os.h).
        boolean WdgIfStateCombinerUseManualMode: set at pre-compile, origin=Vector Informatik, default-value=false  # If set to "true" the user can manually specify - the interval of expected number of slave triggers (minimum and maximum) for each slave and - the reference cycle to check each slave.
        integer WdgIfStateCombinerSpinlockID [0..1]: 0..4294967295, set at pre-compile, origin=Vector Informatik  # ID of the spinlock used by the StateCombiner for inter-core synchronization.
        integer WdgIfStateCombinerStartUpSyncCycles: 0..65535, set at pre-compile, origin=Vector Informatik  # Number of master cycles during start-up in which the master does not check the slave triggering. Used to synchronize master and slave during start-up.
      container WdgIfStateCombinerMaster  # Parameters for the State Combiner master device.
        choice reference WdgIfGlobalMemoryAppTaskRef [0..1]: set at pre-compile, origin=Vector Informatik, destination=OsApplication  # Reference to an OS Application. In case of OS SC3 the global variables of this State Combiner master device module should be placed in the same memory segment as the application that the overlying Watchdog Manager module is part of.
        reference WdgIfStateCombinerMasterWdgRef: set at pre-compile, origin=Vector Informatik, destination=WdgGeneral  # Reference to the watchdog driver serviced by the StateCombiner master.
      container WdgIfStateCombinerSlave [1..3]: multiple-configuration-container=true  # Parameters for the State Combiner slave.
        integer WdgIfStateCombinerReferenceCycle: 0..65535, set at pre-compile, origin=Vector Informatik, symbolic-name-value=true, default-value=0  # This parameter specifies the reference cycle of the master for this slave. Note: the value can only be used if WdgIfStateCombinerUseManualMode is set to true.
        integer WdgIfStateCombinerSlaveIncrementsMin: 0..65535, set at pre-compile, origin=Vector Informatik, symbolic-name-value=true, default-value=0  # This parameter specifies the minimum allowed number of increments (triggers) for slave instance in one master check period. Note: the value will only be used if WdgIfStateCombinerUseManualMode is set to true. Note: in synchronous mode WdgIfStateCombinerSlaveIncrementsMin is equal to WdgIfStateCombinerSlaveIncrementsMax.
        integer WdgIfStateCombinerSlaveIncrementsMax: 0..65535, set at pre-compile, origin=Vector Informatik, symbolic-name-value=true, default-value=0  # This parameter specifies the maximum allowed number of increments (triggers) for slave instance in one master check period. Note: the value will only be used if WdgIfStateCombinerUseManualMode is set to true. Note: in synchronous mode WdgIfStateCombinerSlaveIncrementsMax is equal to WdgIfStateCombinerSlaveIncrementsMin.
        choice reference WdgIfGlobalMemoryAppTaskRef [0..1]: set at pre-compile, origin=Vector Informatik, destination=OsApplication  # Parameter not used. Reference to an OS Application. In case of OS SC3 the global variables of this State Combiner slave device should be placed in the same memory segment as the application that the overlying Watchdog Manager module is part of.
  module config WdgIf_Pre: definition=WdgIf, implementation-config-variant=VARIANT-PRE-COMPILE
    WdgIfGeneral: WdgIfUseAutosarDrvApi=1
  module config WdgIf_Rec: definition=WdgIf
