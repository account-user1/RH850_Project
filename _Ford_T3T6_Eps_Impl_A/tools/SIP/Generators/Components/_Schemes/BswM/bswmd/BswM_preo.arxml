AUTOSAR XML (schema 4-0-3)
package /MICROSAR
  module config BswM_Pre: definition=BswM
  module config BswM_Rec: definition=BswM, implementation-config-variant=VARIANT-PRE-COMPILE
    BswMGeneral: BswMMainFunctionPeriod=0.01, BswMVersionInfoApi=0, BswMDevErrorDetect=1
