AUTOSAR XML (schema 4-0-3)
package /Renesas/EcucDefs_Port
  module config Port_Rec: definition=Port, implementation-config-variant=VARIANT-POST-BUILD
    PortGeneral: PortVersionCheckExternalModules=0
  bsw implementation Port_Impl: programming-language=C, used-code-generator=EXTERNAL, behavior=PortBehavior, recommended-configuration=Port_Rec, vendor-specific-module-def=Port
