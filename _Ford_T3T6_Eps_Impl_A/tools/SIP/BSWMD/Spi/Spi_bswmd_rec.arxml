AUTOSAR XML (schema 4-0-3)
package /Renesas/EcucDefs_Spi
  module config Spi_Rec: definition=Spi, implementation-config-variant=VARIANT-POST-BUILD
    SpiGeneral: SpiVersionCheckExternalModules=0
  bsw implementation Spi_Impl: programming-language=C, used-code-generator=EXTERNAL, behavior=SpiBehavior, recommended-configuration=Spi_Rec, vendor-specific-module-def=Spi
