AUTOSAR XML (schema 4-0-3)
package /MICROSAR
  module config CanIf_Pre: definition=CanIf
  module config CanIf_Rec: definition=CanIf, implementation-config-variant=VARIANT-PRE-COMPILE
