AUTOSAR XML (schema 4-0-3)
package /Renesas/EcucDefs_Wdg0
  module config Wdg_Rec: definition=Wdg, implementation-config-variant=VARIANT-POST-BUILD
    WdgGeneral: WdgVersionCheckExternalModules=0
  bsw implementation Wdg_Impl: programming-language=C, used-code-generator=EXTERNAL, vendor-id=59, behavior=Wdg_59_DriverABehavior, recommended-configuration=Wdg_Rec, vendor-api-infix=DriverA, vendor-specific-module-def=Wdg
