AUTOSAR XML (schema 4-0-3)
package /Nexteer
  module definition HwTq9Meas [0..1]: variants pre-compile  # Configuration of the HwTq9Meas.
    container HwTq9MeasGeneral  # This container contains the configuration (parameters) of the HwTq9Meas.
      enumeration NTC_HwTq9MfgFlt: {NTCNR_0X1E0, NTCNR_0X1E1, NTCNR_0X1E2, NTCNR_0X1E3}, set at pre-compile, origin=Nexteer, default-value=NTCNR_0X1E0  # .
      enumeration NTC_HwTq9PrtclFlt: {NTCNR_0X073, NTCNR_0X074, NTCNR_0X075, NTCNR_0X076, NTCNR_0X077, NTCNR_0X078, NTCNR_0X079, NTCNR_0X07A}, set at pre-compile, origin=Nexteer, default-value=NTCNR_0X073  # .
