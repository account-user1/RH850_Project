AUTOSAR XML (schema 4-0-3)
package /Renesas/EcucDefs_Dio
  module config Dio_Rec: definition=Dio, implementation-config-variant=VARIANT-POST-BUILD
    DioGeneral: DioVersionCheckExternalModules=0
  bsw implementation Dio_Impl: programming-language=C, used-code-generator=EXTERNAL, behavior=DioBehavior, recommended-configuration=Dio_Rec, vendor-specific-module-def=Dio
