AUTOSAR XML (schema 4-0-3)
package /Nexteer
  module definition FlsMem [0..1]: variants pre-compile  # Configuration of the Flash CRC Blocks.
    container FlashCRCRegnConfig [0..255]  # This is the container for the Flash Block Configuration
      integer StartingAddress: 0..4294967295, origin=NEXTEER, default-value=0  # Starting Address of the CRC region.
      integer Length: 0..4294967295, origin=NEXTEER, default-value=0  # Length of the CRC region.
      integer PredefinedCrcAddress: 0..4294967295, origin=NEXTEER, default-value=4294967295  # Predefined CRC address.
      boolean UseSymbolName: origin=NEXTEER, default-value=0  # If TRUE, symbol names for start and end address will be used. If FALSE, raw addresses will be used.
      string StartingAddressSymbol: origin=NEXTEER, default-value=NULL_PTR  # Symbol name for the starting address of CRC Region
      string LengthSymbol: origin=NEXTEER, default-value=NULL_PTR  # Symbol name for the length of CRC Region
      string PredefinedCrcAddressSymbol: origin=NEXTEER, default-value=NULL_PTR  # Symbol name for the Predefined CRC address
    container ApplCRCRegnIdx  # This is the container for the Application CRC Region Index Number
      integer ApplCrcRegnNr: 0..255, origin=NEXTEER, default-value=0  # Application CRC Region Index Number.
