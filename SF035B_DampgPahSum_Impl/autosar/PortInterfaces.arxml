AUTOSAR XML (schema 4-0-3)
package /Nexteer/PortInterfaces
  sender receiver interface float32_PortIf1: invalidation-policy{data-element=Val, handle-invalid=DONT-INVALIDATE}
    data Val: sw-calibration-access=READ-ONLY, type=float32
