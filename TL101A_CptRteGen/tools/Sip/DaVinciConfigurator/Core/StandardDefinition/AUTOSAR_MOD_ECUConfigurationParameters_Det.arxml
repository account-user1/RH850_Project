AUTOSAR XML (schema 4-0-3)
# The material contained in this specification is protected by copyright and
# other types of Intellectual Property Rights. The commercial exploitation of
# the material contained in this specification requires a license to such
# Intellectual Property Rights.
# This specification may be utilized or reproduced without any modification, in
# any form or by any means, for informational purposes only.
# For any other purpose, no part of the specification may be utilized or
# reproduced, in any form or by any means, without permission in writing from
# the publisher.
# licensed under the same rules as applicable to the AUTOSAR Standard.
package /AUTOSAR/EcucDefs
  module definition Det [0..1]: variants pre-compile  # Det configuration includes the functions to be called at notification. On one | side the application functions are specified and in general it can be decided whether Dlt shall be called at each call of Det.
    container DetGeneral  # Generic configuration parameters of the Det module.
      boolean DetForwardToDlt [0..1]: set at pre-compile  # Only if the parameter is present and set to true, the Det requires the Dlt interface and forwards it's call to the function Dlt_DetForwardErrorTrace. In this case the optional interface to Dlt_Det is required.
      boolean DetVersionInfoApi: set at pre-compile  # Pre-processor switch to enable / disable the API to read out the modules version information. | true: Version info API enabled. false: Version info API disabled.
    container DetNotification [0..1]  # Configuration of the notification functions.
      function name DetErrorHook [0..*]: set at pre-compile  # Optional list of functions to be called by the Development Error Tracer in context of each call of Det_ReportError. | The type of these functions shall be identical the type of Det_ReportError itself: Std_ReturnType (*f)(uint16, uint8, uint8, uint8).
