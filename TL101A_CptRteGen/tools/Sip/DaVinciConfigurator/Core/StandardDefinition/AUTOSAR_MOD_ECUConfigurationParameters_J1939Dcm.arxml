AUTOSAR XML (schema 4-0-3)
# The material contained in this specification is protected by copyright and
# other types of Intellectual Property Rights. The commercial exploitation of
# the material contained in this specification requires a license to such
# Intellectual Property Rights.
# This specification may be utilized or reproduced without any modification, in
# any form or by any means, for informational purposes only.
# For any other purpose, no part of the specification may be utilized or
# reproduced, in any form or by any means, without permission in writing from
# the publisher.
# licensed under the same rules as applicable to the AUTOSAR Standard.
package /AUTOSAR/EcucDefs
  module definition J1939Dcm [0..1]: variants link-time/post-build/pre-compile  # The SAE J1939 Dcm module
    container J1939DcmConfigSet: multiple-configuration-container=true  # This container contains the configuration parameters and sub containers of the J1939DCM module supporting multiple configuration sets. | This container is a MultipleConfigurationContainer, i.e. this container and its sub-containers exist once per configuration set.
      container J1939DcmChannel [1..*]  # Contains the J1939DcmChannel parameters.
        enumeration J1939DcmBusType: {J1939DCM_ISO9141, J1939DCM_J1587, J1939DCM_J1850, J1939DCM_J1922, J1939DCM_J1939_NETWORK_1, J1939DCM_J1939_NETWORK_2, J1939DCM_J1939_NETWORK_3, J1939DCM_OTHER}, set at pre-compile  # Identifies the communication port
        symbolic name reference J1939DcmComMChannelRef: set at link in variant link-time / post-build in variant post-build / pre-compile in variant pre-compile, destination=ComMChannel  # Reference to the ComMChannel.
      container J1939DcmNode [1..*]  # Contains the parameters for the support of a logical J1939 node (identified by an ECU address).
        reference J1939DcmNodeChannelRef [1..*]: set at link in variant link-time+post-build / pre-compile in variant pre-compile, destination=J1939DcmChannel  # References to all J1939DcmChannels this node has access to.
        symbolic name reference J1939DcmNmNodeRef [1..*]: set at link in variant link-time+post-build / pre-compile in variant pre-compile, destination=J1939NmNode  # Reference to the corresponding J1939Nm node.
        container J1939DcmDiagnosticMessageSupport [1..*]  # Contains parameters to configure the diagnostic message support
          enumeration J1939DcmDmxSupport: {J1939DCM_DM10_SUPPORT, J1939DCM_DM11_SUPPORT, J1939DCM_DM12_SUPPORT, J1939DCM_DM13_SUPPORT, J1939DCM_DM14_SUPPORT, J1939DCM_DM15_SUPPORT, J1939DCM_DM16_SUPPORT, J1939DCM_DM17_SUPPORT, J1939DCM_DM18_SUPPORT, J1939DCM_DM19_SUPPORT, J1939DCM_DM1_SUPPORT, J1939DCM_DM20_SUPPORT, J1939DCM_DM21_SUPPORT, J1939DCM_DM22_SUPPORT, J1939DCM_DM23_SUPPORT, J1939DCM_DM24_SUPPORT, J1939DCM_DM25_SUPPORT, J1939DCM_DM26_SUPPORT, J1939DCM_DM27_SUPPORT, J1939DCM_DM28_SUPPORT, J1939DCM_DM29_SUPPORT, J1939DCM_DM2_SUPPORT, J1939DCM_DM30_SUPPORT, J1939DCM_DM31_SUPPORT, J1939DCM_DM32_SUPPORT, J1939DCM_DM33_SUPPORT, J1939DCM_DM34_SUPPORT, J1939DCM_DM35_SUPPORT, J1939DCM_DM36_SUPPORT, J1939DCM_DM37_SUPPORT, J1939DCM_DM38_SUPPORT, J1939DCM_DM39_SUPPORT, J1939DCM_DM3_SUPPORT, J1939DCM_DM40_SUPPORT, J1939DCM_DM41_SUPPORT, J1939DCM_DM42_SUPPORT, J1939DCM_DM43_SUPPORT, J1939DCM_DM44_SUPPORT, J1939DCM_DM45_SUPPORT, J1939DCM_DM46_SUPPORT, J1939DCM_DM47_SUPPORT, J1939DCM_DM48_SUPPORT, J1939DCM_DM49_SUPPORT, J1939DCM_DM4_SUPPORT, J1939DCM_DM50_SUPPORT, J1939DCM_DM51_SUPPORT, J1939DCM_DM52_SUPPORT, J1939DCM_DM5_SUPPORT, J1939DCM_DM6_SUPPORT, J1939DCM_DM7_SUPPORT, J1939DCM_DM8_SUPPORT, J1939DCM_DM9_SUPPORT}, set at pre-compile  # This parameter is used to identify the actual DMx message.
          container J1939DcmRxPdu [0..1]  # Contains parameters to configure the J1939DcmRxPdu.
            integer J1939DcmRxPduId: 0..65535, set at link in variant link-time+post-build / pre-compile in variant pre-compile, symbolic-name-value=true  # The I-PDU identifier used for communication with PduR.
            reference J1939DcmRxPduRef: set at link in variant link-time / post-build in variant post-build / pre-compile in variant pre-compile, destination=Pdu  # Reference to the global Pdu element in the Ecuc module.
          container J1939DcmTxPdu [0..1]  # Contains parameters to configure the J1939DcmTxPdu.
            integer J1939DcmTxPduId: 0..65535, set at link in variant link-time+post-build / pre-compile in variant pre-compile, symbolic-name-value=true  # The I-PDU identifier used to identify the Tx message.
            reference J1939DcmTxPduRef: set at link in variant link-time / post-build in variant post-build / pre-compile in variant pre-compile, destination=Pdu  # Reference to the global Pdu element in the Ecuc module.
    container J1939DcmGeneral  # Contains the general configuration parameters of the module.
      integer J1939DcmCommonBufferSize: 1..65535, set at pre-compile  # Size of common buffer (in Bytes). The buffer size should be as large as the longest command or response message.
      integer J1939DcmDM1BufferSize [0..1]: 1..65535, set at pre-compile  # Size of DM1 buffer (in Bytes). The buffer size should be as large as the longest DM1 response message.
      boolean J1939DcmDevErrorDetect: set at pre-compile  # Pre-processor switch for enabling development error detection support.
      float J1939DcmMainFunctionPeriod: 0.001..0.255, set at link in variant link-time+post-build / pre-compile in variant pre-compile  # Call cycle in seconds of J1939Dcm_MainFunction.
      integer J1939DcmMaxDTCsPerMainFunction [0..1]: 1..255, set at pre-compile  # Maximum threshold of DTCs filtered in a single MainFunction cycle.
      integer J1939DcmMaxFreezeFramesPerMainFunction [0..1]: 1..255, set at pre-compile  # Maximum threshold of FreezeFrames filtered in a single MainFunction cycle.
      integer J1939DcmMaxRatiosPerMainFunction [0..1]: 1..255, set at pre-compile  # Maximum threshold of Ratios filtered in a single MainFunction cycle.
      boolean J1939DcmVersionInfoApi: set at pre-compile  # Pre-processor switch for enabling version info API support.
