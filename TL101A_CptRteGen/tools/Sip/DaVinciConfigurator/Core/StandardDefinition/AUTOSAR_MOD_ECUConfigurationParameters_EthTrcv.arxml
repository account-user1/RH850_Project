AUTOSAR XML (schema 4-0-3)
# The material contained in this specification is protected by copyright and
# other types of Intellectual Property Rights. The commercial exploitation of
# the material contained in this specification requires a license to such
# Intellectual Property Rights.
# This specification may be utilized or reproduced without any modification, in
# any form or by any means, for informational purposes only.
# For any other purpose, no part of the specification may be utilized or
# reproduced, in any form or by any means, without permission in writing from
# the publisher.
# licensed under the same rules as applicable to the AUTOSAR Standard.
package /AUTOSAR/EcucDefs
  module definition EthTrcv [0..*]: variants link-time/post-build/pre-compile  # Configuration of Ethernet Transceiver Driver module
    container EthTrcvConfigSet: multiple-configuration-container=true  # All underlying parameters may be part of a multiple configuration set.
      container EthTrcvConfig [1..*]  # Configuration of the individual transceiver
        boolean EthTrcvAutoNegotiationEnabled: set at link in variant link-time / post-build in variant post-build / pre-compile in variant pre-compile  # Specifies if Auto-Negotiation is enabled (TRUE) or disabled (FALSE) for determination of the Ethernet transceiver speed.
        integer EthTrcvCtrlIdx: 0..255, set at link in variant link-time / post-build in variant post-build / pre-compile in variant pre-compile  # Specifies the controller used for MII access to the transceiver
        enumeration EthTrcvDuplexMode: {ETHTRCV_DUPLEX_MODE_FULL, ETHTRCV_DUPLEX_MODE_HALF}, set at link in variant link-time / post-build in variant post-build / pre-compile in variant pre-compile  # Specifies the duplex mode of the Ethernet transceiver link if Auto-Negotiation is disabled. This parameter is ignored if Auto-Negotiation is enabled.
        integer EthTrcvIdx: 0..255, set at link in variant link-time / post-build in variant post-build / pre-compile in variant pre-compile, symbolic-name-value=true  # Specifies the instance ID of the configured transceiver.
        integer EthTrcvMiiIdx: 0..255, set at link in variant link-time / post-build in variant post-build / pre-compile in variant pre-compile  # Specifies the transceiver index used for MII access to the transceiver
        enumeration EthTrcvSpeed: {TRCV_SPEED_10, TRCV_SPEED_100, TRCV_SPEED_1000}, set at link in variant link-time / post-build in variant post-build / pre-compile in variant pre-compile  # Specifies the speed of the Ethernet transceiver link in [MBit/s]. If AutoNegotiation is enabled this is the maximum speed advertised for Auto-Negotiation.
        container EthTrcvDemEventParameterRefs [0..1]  # Container for the references to DemEventParameter elements which shall be invoked using the API Dem_ReportErrorStatus API in case the corresponding error occurs. The EventId is taken from the referenced DemEventParameter's DemEventId value. The standardized errors are provided in the container and can be extended by vendor specific error references.
          symbolic name reference ETHTRCV_E_ACCESS [0..1]: set at link in variant link-time / post-build in variant post-build / pre-compile in variant pre-compile, destination=DemEventParameter  # Reference to the DemEventParameter which shall be issued when the error "Transceiver access failed" has occurred.
    container EthTrcvGeneral  # General configuration of Ethernet Transceiver Driver module
      boolean EthTrcvDevErrorDetect: set at pre-compile  # Enables / Disables development error detection
      boolean EthTrcvGetBaudRateApi: set at pre-compile  # Enables / Disables EthTrcv_GetBaudRate API
      boolean EthTrcvGetDuplexModeApi: set at pre-compile  # Enables / Disables EthTrcv_GetDuplexMode API
      boolean EthTrcvGetLinkStateApi: set at pre-compile  # Enables / Disables EthTrcv_GetLinkState API
      boolean EthTrcvGetTransceiverModeApi: set at pre-compile  # Enables / Disables EthTrcv_GetTransceiverMode API
      integer EthTrcvIndex: 0..255, set at pre-compile  # Specifies the InstanceId of this module instance. If only one instance is present it shall have the Id 0.
      integer EthTrcvMaxTrcvsSupported: 0..255, set at pre-compile, default-value=1
      boolean EthTrcvSetTransceiverModeApi: set at pre-compile  # Enables / Disables EthTrcv_SetTransceiverMode API
      boolean EthTrcvStartAutoNegotiationApi: set at pre-compile  # Enables / Disables EthTrcv_StartAutoNegotiation API
      boolean EthTrcvVersionInfoApi: set at pre-compile  # Enables / Disables version info API
      boolean EthTrcvVersionInfoApiMacro: set at pre-compile  # Enables / Disables version info API macro implementation
