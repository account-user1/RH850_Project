AUTOSAR XML (schema 4-0-3)
# COPYRIGHT
# Copyright (c) 2016 by Vector Informatik GmbH. All rights reserved.
# This software is copyright protected and proprietary to Vector Informatik GmbH.
# Vector Informatik GmbH grants to you only those rights as set out in the license conditions.
package /AUTOSAR/EcucDefs
  module definition Cry [0..*]: category=VENDOR_SPECIFIC_MODULE_DEFINITION, variants pre-compile  # Cry for MICROSAR Cry Implementations
    container CryGeneral
      boolean CryUseSyncJobProcessing: set at pre-compile, origin=Vector Informatik, default-value=true  # Pre-processor switch to enable and disable synchronous job processing.
      boolean CryVersionInfoApi: set at pre-compile, origin=Vector Informatik, default-value=false  # Pre-processor switch to enable and disable availability of the API Cry_GetVersionInfo(). True: API Cry_GetVersionInfo() is available. False: API Cry_GetVersionInfo() is not available.
    container CryAesEncrypt128 [0..1]
      container CryAesEncrypt128Config [1..32]
    container CryAesDecrypt128 [0..1]
      container CryAesDecrypt128Config [1..32]
    container CryFips186 [0..1]
      container CryFips186Config [1..32]
    container CryHmacSha1Verify [0..1]
      container CryHmacSha1VerifyConfig [1..32]
    container CryCmacAes128Gen [0..1]
      container CryCmacAes128GenConfig [1..32]
    container CryCmacAes128Ver [0..1]
      container CryCmacAes128VerConfig [1..32]
    container CryRsaDecrypt [0..1]
      container CryRsaDecryptConfig [1..32]
    container CryRsaSha1SigVer [0..1]
      container CryRsaSha1SigVerConfig [1..32]
    container CryKdf2HmacSha1 [0..1]
      container CryKdf2HmacSha1Config [1..32]
    container CryHashSha256 [0..1]
      container CryHashSha256Config [1..32]
    container CryEcdsaSigGen [0..1]
      container CryEcdsaSigGenConfig [1..32]
    container CryHmacSha256Verify [0..1]
      container CryHmacSha256VerifyConfig [1..32]
    container CryHmacSha256Generate [0..1]
      container CryHmacSha256GenerateConfig [1..32]
    container CryEcdsaSigVer [0..1]
      container CryEcdsaSigVerConfig [1..32]
    container CryEcdh [0..1]
      container CryEcdhConfig [1..32]
    container CryKeyExtract [0..1]
      container CryKeyExtractConfig [1..32]
    container CryKeyWrapSym [0..1]
      container CryKeyWrapSymConfig [1..32]
    container CryRng [0..1]
      container CryRngConfig [1..32]
    container CryHashSha512 [0..1]
      container CryHashSha512Config [1..32]
    container CryHashSha1 [0..1]
      container CryHashSha1Config [1..32]
    container CryHashRipemd160 [0..1]
      container CryHashRipemd160Config [1..32]
    container CryEd25519SigGen [0..1]
      container CryEd25519SigGenConfig [1..32]
    container CryEd25519SigVer [0..1]
      container CryEd25519SigVerConfig [1..32]
    container CryDhX25519CalcSecret [0..1]
      container CryDhX25519CalcSecretConfig [1..32]
