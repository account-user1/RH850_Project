AUTOSAR XML (schema 4-0-3)
# The material contained in this specification is protected by copyright and
# other types of Intellectual Property Rights. The commercial exploitation of
# the material contained in this specification requires a license to such
# Intellectual Property Rights.
# This specification may be utilized or reproduced without any modification, in
# any form or by any means, for informational purposes only.
# For any other purpose, no part of the specification may be utilized or
# reproduced, in any form or by any means, without permission in writing from
# the publisher.
# licensed under the same rules as applicable to the AUTOSAR Standard.
package /AUTOSAR/EcucDefs
  module definition MemIf [0..1]: variants pre-compile  # Configuration of the MemIf (Memory Abstraction Interface) module.
    container MemIfGeneral  # Configuration of the memory abstraction interface (Memif) module.
      boolean MemIfDevErrorDetect: set at pre-compile  # Pre-processor switch to enable and disable development error detection. | true: Development error detection enabled. false: Development error detection disabled.
      integer MemIfNumberOfDevices: 1..255, set at pre-compile  # Concrete number of underlying memory abstraction modules. | Calculation Formula: Count number of configured EA and FEE modules.
      boolean MemIfVersionInfoApi: set at pre-compile  # Pre-processor switch to enable / disable the API to read out the modules version information. | true: Version info API enabled. false: Version info API disabled.
