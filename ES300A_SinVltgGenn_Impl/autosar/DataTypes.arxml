AUTOSAR XML (schema 4-0-3)
standard types defined: boolean, float32, sint8, uint16, uint8, boolean_CompuMethod, boolean_DataConstr, float32_DataConstr, sint8_DataConstr, uint16_DataConstr, uint8_DataConstr, float64_DataConstr, sint16_DataConstr, sint32_DataConstr, uint32_DataConstr, float64, sint16, sint32, uint32
package /Nexteer/DataTypes
  4 x impl type, all with category=TYPE_REFERENCE, type-emitter=RTE:
    IvtrFetFltPha1: compu {0=IVTRFETFLTPHA_NOPHASNGFETFLT, 1=IVTRFETFLTPHA_PHAASNGFETFLT, 2=3 (IVTRFETFLTPHA_PHABSNGFETFLT), 4=2 (IVTRFETFLTPHA_PHACSNGFETFLT)}, implementation-data-type=ImplementationDataTypes/uint8
    IvtrFetFltTyp1: compu {0=IVTRFETFLTTYP_NOFETFLT, 1=IVTRFETFLTTYP_LOWRFETFLT, 2=IVTRFETFLTTYP_UPPRFETFLT, 4=3 (IVTRFETFLTTYP_MPLFETFLT)}, implementation-data-type=ImplementationDataTypes/uint8
    MfgEnaSt1: compu {0=MFGENAST_PRDNMOD, 1=MFGENAST_MFGMOD, 2=MFGENAST_TESTMOD}, implementation-data-type=ImplementationDataTypes/uint8
    u0p16: implementation-data-type=ImplementationDataTypes/uint16
