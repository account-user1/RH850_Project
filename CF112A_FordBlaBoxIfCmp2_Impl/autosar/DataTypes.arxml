AUTOSAR XML (schema 4-0-3)
standard types defined: boolean, dtRef_const_VOID, dtRef_VOID, float32, float64, sint16, sint16_least, sint32, sint32_least, sint64, sint8, sint8_least, uint16, uint16_least, uint32, uint32_least, uint64, uint8, uint8_least, boolean_CompuMethod, boolean_DataConstr, float32_DataConstr, float64_DataConstr, sint16_DataConstr, sint16_least_DataConstr, sint32_DataConstr, sint32_least_DataConstr, sint64_DataConstr, sint8_DataConstr, sint8_least_DataConstr, uint16_DataConstr, uint16_least_DataConstr, uint32_DataConstr, uint32_least_DataConstr, uint64_DataConstr, uint8_DataConstr, uint8_least_DataConstr
package /DataType/Unit
  unit U_SED: display-name=SED, factor-si-to-unit=1, offset-si-to-unit=0
package /Ford/DataTypes
  impl type Ford_EsaOn_B_Stat: category=VALUE, base-type=DataType/boolean, sw-calibration-access=READ-ONLY, compu {phys=raw for raw 0..1, 0=Cx0_Off, 1=Cx1_On; unit SED}
package /Nexteer/DataTypes
  impl type FordArbnCmd1: compu {0=Cx0_PASSIVE, 3=Cx3_ACTIVE, 5=Cx5_LOCKED, 99=Cx99_DONT_CARE}, implementation-data-type=uint8, type-emitter=RTE
  impl type FordFeatSt1: compu {0=Cx0_PASSIVE, 1=Cx1_ACTIVATION_REQUEST, 2=Cx2_RAMP_IN_REQUEST, 3=Cx3_ACTIVE, 4=Cx4_RAMP_OUT_REQUEST, 5=Cx5_LOCKED}, implementation-data-type=uint8, type-emitter=RTE
