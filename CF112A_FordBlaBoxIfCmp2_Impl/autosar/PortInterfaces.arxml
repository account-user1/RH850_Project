AUTOSAR XML (schema 4-0-3)
package /Ford/PortInterfaces
  sender receiver interface Ford_EsaOn_B_Stat: invalidation-policy{data-element=Ford_EsaOn_B_Stat/Val, handle-invalid=DONT-INVALIDATE}
    data Val: sw-calibration-access=READ-ONLY, type=Ford_EsaOn_B_Stat
package /Nexteer/PortInterfaces
  6 x sender receiver interface:
    float32_PortIf1: invalidation-policy{data-element=float32_PortIf1/Val, handle-invalid=DONT-INVALIDATE}
      data Val: sw-calibration-access=READ-ONLY, type=float32
    FordArbnCmd1_PortIf1: invalidation-policy{data-element=FordArbnCmd1_PortIf1/Val, handle-invalid=DONT-INVALIDATE}
      data Val: type=FordArbnCmd1
    FordFeatSt1_PortIf1: invalidation-policy{data-element=FordFeatSt1_PortIf1/Val, handle-invalid=DONT-INVALIDATE}
      data Val: type=FordFeatSt1
    uint16_PortIf1: invalidation-policy{data-element=uint16_PortIf1/Val, handle-invalid=DONT-INVALIDATE}
      data Val: sw-calibration-access=READ-ONLY, type=uint16
    uint32_PortIf1: invalidation-policy{data-element=uint32_PortIf1/Val, handle-invalid=DONT-INVALIDATE}
      data Val: sw-calibration-access=READ-ONLY, type=uint32
    uint8_PortIf1: invalidation-policy{data-element=uint8_PortIf1/Val, handle-invalid=DONT-INVALIDATE}
      data Val: sw-calibration-access=READ-ONLY, type=uint8
