AUTOSAR XML (schema 4-0-3)
package /ComponentTypes
  complex device driver sw component type CDD_McuCoreCfgAndDiagc  # MicroController Core Configuration And Diagnostics This function describes some of the basic MCU diagnostics of the RH850/P1MC microcontroller Field BIST (built-in self-test)
    behavior CDD_McuCoreCfgAndDiagc_InternalBehavior
      ar-typed-per-instance-memorys:
        data dMcuCoreCfgAndDiagcBistRunCmpl: sw-calibration-access=READ-ONLY, type=boolean  # MCU Core Configuration And Diagnostic BIST Run Complete
      timing event CDD_McuCoreCfgAndDiagc_InitEvent: start-on-event=McuCoreCfgAndDiagcInit2, period=0
      runnable McuCoreCfgAndDiagcInit2
  swc implementation CDD_McuCoreCfgAndDiagc_Implementation: behavior=CDD_McuCoreCfgAndDiagc_InternalBehavior
    code-descriptors:
      code Default: artifact-descriptors=autosar-engineering-object={short-label=Default, category=SWSRC}
