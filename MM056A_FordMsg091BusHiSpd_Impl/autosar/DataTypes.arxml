AUTOSAR XML (schema 4-0-3)
standard types defined: boolean, float32, uint16, uint32, uint8, boolean_CompuMethod, boolean_DataConstr, float32_DataConstr, uint16_DataConstr, uint32_DataConstr, uint8_DataConstr
package /DataType/Unit
  28 x unit, all with factor-si-to-unit=1, offset-si-to-unit=0:
    U_1Ym: display-name=1/m
    U_1Ymeter: display-name=1/meter
    U_Amps: display-name=Amps
    U_deg: display-name=deg
    U_degrees: display-name=degrees
    U_Degrees: display-name=Degrees
    U_Degrees_C: display-name=Degrees C
    U_degreesYsecond: display-name=degrees/second
    U_degYs: display-name=deg/s
    U_km: display-name=km
    U_kmYh: display-name=km/h
    U_kph: display-name=kph
    U_meter: display-name=meter
    U_metersYsec: display-name=meters/sec
    U_mrad: display-name=mrad
    U_mYsX2: display-name=m/s^2
    U_Nm: display-name=Nm
    U_p: display-name=%
    U_radians: display-name=radians
    U_radiansYsecond: display-name=radians/second
    U_radYs: display-name=rad/s
    U_rpm: display-name=rpm
    U_second: display-name=second
    U_SED: display-name=SED
    U_volt: display-name=volt
    U_Volts: display-name=Volts
    unitless: display-name=unitless
    Unitless: display-name=Unitless
package /Ford/DataTypes
  impl type Ford_VehYaw_W_Actl: category=VALUE, base-type=DataType/uint16, sw-calibration-access=READ-ONLY, compu {65534=CxFFFE_NoDataExists, 65535=CxFFFF_Faulty, phys=raw*0.0002-6.5 for raw 0..65535; unit rad/s} "Source signal range: [0,65533]"
package /Nexteer/DataTypes
  impl type NtcNr1: compu {1..511=NTCNR_0X001..NTCNR_0X1FF}, implementation-data-type=uint16, type-emitter=RTE
  impl type NtcSts1: compu {0=NTCSTS_PASSD, 1=NTCSTS_FAILD, 2=NTCSTS_PREPASSD, 3=NTCSTS_PREFAILD}, implementation-data-type=uint8, type-emitter=RTE
