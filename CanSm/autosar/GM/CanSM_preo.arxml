AUTOSAR XML (schema 4-0-3)
# COPYRIGHT
# Copyright (c) 2016 by Vector Informatik GmbH. All rights reserved.
# This software is copyright protected and proprietary to Vector Informatik GmbH.
# Vector Informatik GmbH grants to you only those rights as set out in the license conditions.
package /MICROSAR  # CanSM Preconfiguration
  module config CanSM_Pre: definition=CanSM
  module config CanSM_Rec: definition=CanSM, implementation-config-variant=VARIANT-PRE-COMPILE
