AUTOSAR XML (schema 4-0-3)
package /MICROSAR
  module config CanSM_Pre: definition=CanSM
    CanSMConfiguration
  module config CanSM_Pre_Class1: definition=CanSM
    CanSMConfiguration
      CanSMManagerNetwork: CanSMBorCounterL1ToL2=10, CanSMBorTimeL1=0.04, CanSMBorTimeL2=1, CanSMBorTimeTxEnsured=1, CanSMBorTxConfirmationPolling=0
  module config CanSM_Rec: definition=CanSM, implementation-config-variant=VARIANT-PRE-COMPILE
