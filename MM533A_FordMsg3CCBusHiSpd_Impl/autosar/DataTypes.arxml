AUTOSAR XML (schema 4-0-3)
standard types defined: float32, uint8, float32_DataConstr, uint8_DataConstr, boolean, uint16
package /DataType/Unit
  unit U_degrees: display-name=degrees, factor-si-to-unit=1, offset-si-to-unit=0
  unit U_Nm: display-name=Nm, factor-si-to-unit=1, offset-si-to-unit=0
  unit U_SED: display-name=SED, factor-si-to-unit=1, offset-si-to-unit=0
package /Ford/DataTypes
  7 x impl type, all with category=VALUE, sw-calibration-access=READ-ONLY:
    Ford_LaActAvail_D_Actl: base-type=DataType/uint8, compu {phys=raw for raw 0..3, 0=Cx0_LCA_LKA_LDW_Suppress, 1=Cx1_LCA_LKA_Suppress_LDW_Avail, 2=Cx2_LCA_LKA_Avail_LDW_Suppress, 3=Cx3_LKA_LCA_LDW_Avail; unit SED}, range raw 0..3
    Ford_LaActDeny_B_Actl: base-type=boolean, compu {phys=raw for raw 0..1, 0=Cx0_LA_Not_Denied, 1=Cx1_LA_Denied; unit SED}
    Ford_LaHandsOff_B_Actl: base-type=boolean, compu {phys=raw for raw 0..1, 0=Cx0_Hands_On, 1=Cx1_Hands_Off; unit SED}
    Ford_LsmcBrk_Tq_Rq: base-type=uint16, compu {phys=raw*4 for raw 0..8191; unit Nm}, range raw 0..8191
    Ford_LsmcBrkDecelEnbl_D_Rq: base-type=DataType/uint8, compu {phys=raw for raw 0..3, 0=Cx0_Off, 1=Cx1_On, 2=Cx2_NotUsed1, 3=Cx3_NotUsed2; unit SED}, range raw 0..3
    Ford_TjaHandsOnCnfdnc_B_Est: base-type=boolean, compu {phys=raw for raw 0..1, 0=Cx0_Low_Confidence, 1=Cx1_High_Confidence; unit SED}
    Ford_TrlrAn_An_TrgtCalc: base-type=DataType/uint8, compu {phys=raw-128 for raw 0..255; unit degrees}
