AUTOSAR XML (schema 4-0-3)
# COPYRIGHT
# Copyright (c) 2016 by Vector Informatik GmbH. All rights reserved.
# This software is copyright protected and proprietary to Vector Informatik GmbH.
# Vector Informatik GmbH grants to you only those rights as set out in the license conditions.
package /MICROSAR  # CanIf Preconfiguration
  module config CanIf_Pre: definition=CanIf
  module config CanIf_Rec: definition=CanIf, implementation-config-variant=VARIANT-PRE-COMPILE
    CanIfPublicCfg: CanIfPublicDevErrorDetect=0, CanIfPublicTxBuffering=1, CanIfPublicVersionInfoApi=1
