AUTOSAR XML (schema 4-0-3)
package /Nexteer/PortInterfaces
  7 x client server interface:
    Adc1CfgAndUseAdc1EnaCnvn_PortIf1
      operation Oper
    DmaEna2MilliSecToMotCtrlTrf_PortIf1
      operation Oper
    DmaWaitForMotCtrlTo2MilliSecTrf_PortIf1
      operation Oper: possible-error=E_NOT_OK
      error E_NOT_OK: error-code=1
    GetRefTmr1MicroSec32bit_PortIf1
      operation Oper
        arg RefTmr_Arg: type=uint32, direction=OUT, server-argument-impl-policy=USE-ARGUMENT-TYPE
    GetTiSpan1MicroSec32bit_PortIf1
      operation Oper
        arg RefTmr_Arg: type=uint32, direction=IN, server-argument-impl-policy=USE-ARGUMENT-TYPE
        arg TiSpan_Arg: type=uint32, direction=OUT, server-argument-impl-policy=USE-ARGUMENT-TYPE
    ReadErrInjReg_PortIf1
      operation Oper
        arg ErrId_Arg: type=uint32, direction=OUT, server-argument-impl-policy=USE-ARGUMENT-TYPE
    StrtErrInjCntr_PortIf1
      operation Oper
