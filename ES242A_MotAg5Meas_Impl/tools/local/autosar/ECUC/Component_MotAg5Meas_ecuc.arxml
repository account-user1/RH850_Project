AUTOSAR XML (schema 4-0-3)
package /ActiveEcuC
  module config MotAg5Meas: implementation-config-variant=VARIANT-PRE-COMPILE
    MotAg5MeasGeneral: MotAg5PrtclFlt=NTCNR_0X083
