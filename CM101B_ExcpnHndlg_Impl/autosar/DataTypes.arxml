AUTOSAR XML (schema 4-0-3)
standard types defined: boolean, uint16, uint32, uint8, boolean_CompuMethod, boolean_DataConstr, uint16_DataConstr, uint32_DataConstr, uint8_DataConstr
package /Nexteer/DataTypes
  impl type Ary1D_u32_4: category=ARRAY, sw-calibration-access=READ-ONLY, type-emitter=RTE
    element Element: array-size=4, array-size-semantics=FIXED-SIZE, implementation-data-type=uint32
  impl type NtcNr1: compu {1..511=NTCNR_0X001..NTCNR_0X1FF}, implementation-data-type=uint16, type-emitter=RTE
  impl type NtcSts1: compu {0=NTCSTS_PASSD, 1=NTCSTS_FAILD, 2=NTCSTS_PREPASSD, 3=NTCSTS_PREFAILD}, implementation-data-type=uint8, type-emitter=RTE
