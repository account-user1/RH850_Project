AUTOSAR XML (schema 4-0-3)
package /ActiveEcuC
  module config ExcpnHndlg: implementation-config-variant=VARIANT-PRE-COMPILE
    ExcpnHndlgCfg: WdgMCfgStr=WdgMConfig_Mode0
